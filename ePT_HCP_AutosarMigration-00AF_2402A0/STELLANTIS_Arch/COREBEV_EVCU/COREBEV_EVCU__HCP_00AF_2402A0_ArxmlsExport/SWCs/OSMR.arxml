[part 3 of 3: package /STELLANTIS/EPT/ASWCs]
AUTOSAR XML (schema 4-2-2)
package /STELLANTIS/EPT/ASWCs  (continued)
  application sw component type OSMR  (continued)
    behavior IB_OSMR: data-type-mapping=msADTtoIDTMapping, handle-termination-and-restart=NO-SUPPORT, included-data-type-set=data-type=[TeOSMR_e_StateAvailability_SrcID, rt_Array_TeOSMR_e_StateAvailability_SrcID_54]
      4 x timing event, all with period=0.02:
        Event_MedTED{1..4}: start-on-event=OSMR_MedTED{1..4}
      init event Event_OSMR_ac_Init: start-on-event=OSMR_ac_Init
      init event Event_PwrOn: start-on-event=OSMR_PwrOn
      explicit-inter-runnable-variables:
        36 x data, all with sw-calibration-access=READ-ONLY:
          StgcStAllowed_MA_write_IRV: category=VALUE, type=UInt16, init-value=0
          StgcStAllowed_N_write_IRV: category=VALUE, type=UInt16, init-value=0
          NiMin_write_IRV: category=VALUE, type=Float, init-value=0
          StrategicSteadyTransState_write_IRV: category=VALUE, type=TeOSMR_e_SteadyTransState, init-value=CeOSMR_e_TransSt_Drive
          Actual_Gear_write_IRV: category=VALUE, type=TeTRNR_e_TCMGearStat, init-value=CeTRNR_e_Neutral
          Target_Gear_write_IRV: category=VALUE, type=TeTRNR_e_TCMGearStat, init-value=CeTRNR_e_Neutral
          HRSR_State_write_IRV: category=VALUE, type=TeOSMR_e_HRSR_State, init-value=CeOSMR_e_N_State
          EnblGrSlctn_write_IRV: category=VALUE, type=Boolean, init-value=0
          NiMinLimit_xNiCold_write_IRV: category=VALUE, type=Float, init-value=0
          LwrdCreepEna_write_IRV: category=VALUE, type=Boolean, init-value=0
          TransOutSpd_write_IRV: category=VALUE, type=Float, init-value=0
          NTurb_FromNo_write_IRV: category=ARRAY, type=rt_Array_Float_9, init-value=9 x 0
          NTurb_from_NoExtrap_write_IRV: category=ARRAY, type=rt_Array_Float_9, init-value=9 x 0
          BrkReqTorq_Unconstrained_write_IRV: category=VALUE, type=Float, init-value=0
          MaxGrArb_write_IRV: category=VALUE, type=SInt16, init-value=0
          TransOutSpdRaw_write_IRV: category=VALUE, type=Float, init-value=0
          No_Dot_write_IRV: category=VALUE, type=Float, init-value=0
          IsLockedSt_write_IRV: category=VALUE, type=Boolean, init-value=0
          StgcRngStsAllwd_write_IRV: category=ARRAY, type=rt_Array_UInt16_6, init-value=6 x 0
          BrkReqTorq_write_IRV: category=VALUE, type=Float, init-value=0
          StgcInGSIMode_write_IRV: category=VALUE, type=Boolean, init-value=0
          FixGearRngStsAllwd_write_IRV: category=ARRAY, type=rt_Array_UInt16_6, init-value=6 x 0
          Target_Gear_GSI_write_IRV: category=VALUE, type=SInt16, init-value=0
          MaxGrOffset_Actv_write_IRV: category=VALUE, type=Boolean, init-value=0
          FunctionEnableRegister_NonDynSeq_write_IRV: category=VALUE, type=UInt16, init-value=0
          SelectionAllwd_write_IRV: category=VALUE, type=UInt8, init-value=0
          HardConfigConstraints_Allowed_write_IRV: category=ARRAY, type=rt_Array_UInt16_6, init-value=6 x 0
          HardConfigConstraints_FixedGear_Allowed_write_IRV: category=ARRAY, type=rt_Array_UInt16_6, init-value=6 x 0
          Sequence_write_IRV: category=VALUE, type=UInt16, init-value=0
          Na_Axis_Cpblty_out_write_IRV: category=ARRAY, type=rt_Array_Float_16, init-value=16 x 0
          OutTorqReqAccelArb_IRV_IRV: category=VALUE, type=Float, init-value=0
          OutTorqReqAccelRaw_IRV_IRV: category=VALUE, type=Float, init-value=0
          HV_AccPwr_IRV_IRV: category=VALUE, type=Float, init-value=0
          OutTrqReqNetArb_IRV_IRV: category=VALUE, type=Float, init-value=0
          VeOSMR_b_1DOptEnbl_IRV: category=VALUE, type=Boolean, init-value=0
          ToMax_LinConstrn_IRV: category=VALUE, type=Float, init-value=0
      6 x runnable:
        OSMR_ac_Init
          data-send-points:
            63 x access:
              OUT_VaOSMR_i_IndexAllowed_MA_Value: accessed-variable=VaOSMR_i_IndexAllowed_MA.Value
              OUT_VaOSMR_i_IndexAllowed_MB_Value: accessed-variable=VaOSMR_i_IndexAllowed_MB.Value
              OUT_VaOSMR_i_IndexAllowed_N_Value: accessed-variable=VaOSMR_i_IndexAllowed_N.Value
              OUT_VaOSMR_i_IndexAllowed_EVM_Value: accessed-variable=VaOSMR_i_IndexAllowed_EVM.Value
              OUT_VaOSMR_i_IndexAllowed_EVN_Value: accessed-variable=VaOSMR_i_IndexAllowed_EVN.Value
              OUT_VaOSMR_i_IndexAllowed_Gr_Value: accessed-variable=VaOSMR_i_IndexAllowed_Gr.Value
              OUT_VaOSMR_n_InputSpdMinMA_Value: accessed-variable=VaOSMR_n_InputSpdMinMA.Value
              OUT_VaOSMR_n_InputSpdMaxMA_Value: accessed-variable=VaOSMR_n_InputSpdMaxMA.Value
              OUT_VaOSMR_n_InputSpdMinMB_Value: accessed-variable=VaOSMR_n_InputSpdMinMB.Value
              OUT_VaOSMR_n_InputSpdMaxMB_Value: accessed-variable=VaOSMR_n_InputSpdMaxMB.Value
              OUT_VaOSMR_n_InputSpdMinN_Value: accessed-variable=VaOSMR_n_InputSpdMinN.Value
              OUT_VaOSMR_n_InputSpdMaxN_Value: accessed-variable=VaOSMR_n_InputSpdMaxN.Value
              OUT_VaOSMR_n_NC1Min_N_Value: accessed-variable=VaOSMR_n_NC1Min_N.Value
              OUT_VaOSMR_n_NC1Max_N_Value: accessed-variable=VaOSMR_n_NC1Max_N.Value
              OUT_VaOSMR_n_NC1Min_EVN_Value: accessed-variable=VaOSMR_n_NC1Min_EVN.Value
              OUT_VaOSMR_n_NC1Max_EVN_Value: accessed-variable=VaOSMR_n_NC1Max_EVN.Value
              OUT_VaOSMR_n_NC2Max_EVN_Value: accessed-variable=VaOSMR_n_NC2Max_EVN.Value
              OUT_VaOSMR_n_NC2Min_EVN_Value: accessed-variable=VaOSMR_n_NC2Min_EVN.Value
              OUT_VaOSMR_n_NC2Max_N_Value: accessed-variable=VaOSMR_n_NC2Max_N.Value
              OUT_VaOSMR_n_NC2Min_N_Value: accessed-variable=VaOSMR_n_NC2Min_N.Value
              OUT_VeOSMR_e_ActualGear_Value: accessed-variable=VeOSMR_e_ActualGear.Value
              OUT_VeOSMR_e_TargetGear_Value: accessed-variable=VeOSMR_e_TargetGear.Value
              OUT_VaOSMR_n_NTurb_FromNo_Value: accessed-variable=VaOSMR_n_NTurb_FromNo.Value
              OUT_VaOSMR_n_NtiMax_MA_Value: accessed-variable=VaOSMR_n_NtiMax_MA.Value
              OUT_VaOSMR_n_NtiMin_MA_Value: accessed-variable=VaOSMR_n_NtiMin_MA.Value
              OUT_VaOSMR_n_NtiMax_MB_Value: accessed-variable=VaOSMR_n_NtiMax_MB.Value
              OUT_VaOSMR_n_NtiMin_MB_Value: accessed-variable=VaOSMR_n_NtiMin_MB.Value
              OUT_VaOSMR_n_NtiMax_N_Value: accessed-variable=VaOSMR_n_NtiMax_N.Value
              OUT_VaOSMR_n_NtiMin_N_Value: accessed-variable=VaOSMR_n_NtiMin_N.Value
              OUT_VaOSMR_n_NtiMax_Gr_Value: accessed-variable=VaOSMR_n_NtiMax_Gr.Value
              OUT_VaOSMR_n_NtiMin_Gr_Value: accessed-variable=VaOSMR_n_NtiMin_Gr.Value
              OUT_VaOSMR_n_NtiMax_EVM_Value: accessed-variable=VaOSMR_n_NtiMax_EVM.Value
              OUT_VaOSMR_n_NtiMin_EVM_Value: accessed-variable=VaOSMR_n_NtiMin_EVM.Value
              OUT_VaOSMR_n_NtiMax_EVN_Value: accessed-variable=VaOSMR_n_NtiMax_EVN.Value
              OUT_VaOSMR_n_NtiMin_EVN_Value: accessed-variable=VaOSMR_n_NtiMin_EVN.Value
              OUT_VaOSMR_d_FinalAllwdOpt_Value: accessed-variable=VaOSMR_d_FinalAllwdOpt.Value
              OUT_VaOSMR_d_FinalAllwdDsrd_Value: accessed-variable=VaOSMR_d_FinalAllwdDsrd.Value
              OUT_VaOSMR_d_FinalAllwdFxdGr_Value: accessed-variable=VaOSMR_d_FinalAllwdFxdGr.Value
              OUT_VeOSMR_e_TargetGear_GSI_Value: accessed-variable=VeOSMR_e_TargetGear_GSI.Value
              OUT_VeOSMR_e_HRSR_State_Value: accessed-variable=VeOSMR_e_HRSR_State.Value
              OUT_VeOSMR_e_SteadyTransSt_Value: accessed-variable=VeOSMR_e_SteadyTransSt.Value
              OUT_VaOSMR_d_HardAllwdRaw_Value: accessed-variable=VaOSMR_d_HardAllwdRaw.Value
              OUT_VaOSMR_i_IndexAllowed_MBNR_Value: accessed-variable=VaOSMR_i_IndexAllowed_MBNR.Value
              OUT_VaOSMR_n_InputSpdMinMBNR_Value: accessed-variable=VaOSMR_n_InputSpdMinMBNR.Value
              OUT_VaOSMR_n_InputSpdMaxMBNR_Value: accessed-variable=VaOSMR_n_InputSpdMaxMBNR.Value
              OUT_VaOSMR_i_MaxGrPerRngSt_Value: accessed-variable=VaOSMR_i_MaxGrPerRngSt.Value
              OUT_VaOSMR_i_MinGrPerRngSt_Value: accessed-variable=VaOSMR_i_MinGrPerRngSt.Value
              OUT_VaOSMR_P_PShiftMinLim_Value: accessed-variable=VaOSMR_P_PShiftMinLim.Value
              OUT_VaOSMR_P_PShiftMaxLim_Value: accessed-variable=VaOSMR_P_PShiftMaxLim.Value
              OUT_VaOSMR_n_EngCapability_Value: accessed-variable=VaOSMR_n_EngCapability.Value
              OUT_VaOSMR_M_EngCapabilityMinOff_Value: accessed-variable=VaOSMR_M_EngCapabilityMinOff.Value
              OUT_VaOSMR_M_EngCapabilityMaxLmtd_Value: accessed-variable=VaOSMR_M_EngCapabilityMaxLmtd.Value
              OUT_VeOSMR_e_Current_RngSt_Value: accessed-variable=VeOSMR_e_Current_RngSt.Value
              OUT_VeOSMR_e_CurrentGear_Value: accessed-variable=VeOSMR_e_CurrentGear.Value
              OUT_VeOSMR_e_PrevDsrd_RngSt_Value: accessed-variable=VeOSMR_e_PrevDsrd_RngSt.Value
              OUT_VeOSMR_e_DesiredGear_Value: accessed-variable=VeOSMR_e_DesiredGear.Value
              OUT_VaOSMR_M_ToFToRLimOL_Value: accessed-variable=VaOSMR_M_ToFToRLimOL.Value
              OUT_VaOSMR_k_MeshLoss2ndOrderCoeff_Value: accessed-variable=VaOSMR_k_MeshLoss2ndOrderCoeff.Value
              OUT_VaOSMR_k_MeshLoss1stOrderCoeff_Value: accessed-variable=VaOSMR_k_MeshLoss1stOrderCoeff.Value
              OUT_VaOSMR_k_MeshLoss0thOrderCoeff_Value: accessed-variable=VaOSMR_k_MeshLoss0thOrderCoeff.Value
              OUT_VaOSMR_k_MeshLoss2ndOrderCoeffEV_Value: accessed-variable=VaOSMR_k_MeshLoss2ndOrderCoeffEV.Value
              OUT_VaOSMR_k_MeshLoss1stOrderCoeffEV_Value: accessed-variable=VaOSMR_k_MeshLoss1stOrderCoeffEV.Value
              OUT_VaOSMR_k_MeshLoss0thOrderCoeffEV_Value: accessed-variable=VaOSMR_k_MeshLoss0thOrderCoeffEV.Value
        OSMR_PwrOn
          data-send-points:
            193 x access:
              OUT_VeOSMR_d_ManualAllowedN_Value: accessed-variable=VeOSMR_d_ManualAllowedN.Value
              OUT_VeOSMR_Cnt_IdxLength_MA_Value: accessed-variable=VeOSMR_Cnt_IdxLength_MA.Value
              OUT_VeOSMR_Cnt_IdxLength_EVN_Value: accessed-variable=VeOSMR_Cnt_IdxLength_EVN.Value
              OUT_VaOSMR_i_IndexAllowed_Gr_Value: accessed-variable=VaOSMR_i_IndexAllowed_Gr.Value
              OUT_VeOSMR_Cnt_IdxLength_Gr_Value: accessed-variable=VeOSMR_Cnt_IdxLength_Gr.Value
              OUT_VeOSMR_d_ManualAllowedMA_Value: accessed-variable=VeOSMR_d_ManualAllowedMA.Value
              OUT_VeOSMR_d_ManualAllowedMB_Value: accessed-variable=VeOSMR_d_ManualAllowedMB.Value
              OUT_VeOSMR_d_ManualAllowedGr_Value: accessed-variable=VeOSMR_d_ManualAllowedGr.Value
              OUT_VaOSMR_n_InputSpdMinN_Value: accessed-variable=VaOSMR_n_InputSpdMinN.Value
              OUT_VaOSMR_n_InputSpdMaxN_Value: accessed-variable=VaOSMR_n_InputSpdMaxN.Value
              OUT_VaOSMR_n_InputSpdMinMA_Value: accessed-variable=VaOSMR_n_InputSpdMinMA.Value
              OUT_VaOSMR_n_InputSpdMaxMA_Value: accessed-variable=VaOSMR_n_InputSpdMaxMA.Value
              OUT_VaOSMR_i_IndexAllowed_MB_Value: accessed-variable=VaOSMR_i_IndexAllowed_MB.Value
              OUT_VaOSMR_n_InputSpdMinMB_Value: accessed-variable=VaOSMR_n_InputSpdMinMB.Value
              OUT_VaOSMR_n_InputSpdMaxMB_Value: accessed-variable=VaOSMR_n_InputSpdMaxMB.Value
              OUT_VaOSMR_n_NtiMin_MA_Value: accessed-variable=VaOSMR_n_NtiMin_MA.Value
              OUT_VaOSMR_n_NtiMax_MA_Value: accessed-variable=VaOSMR_n_NtiMax_MA.Value
              OUT_VaOSMR_n_NtiMax_MB_Value: accessed-variable=VaOSMR_n_NtiMax_MB.Value
              OUT_VaOSMR_n_NtiMin_MB_Value: accessed-variable=VaOSMR_n_NtiMin_MB.Value
              OUT_VaOSMR_n_NtiMax_N_Value: accessed-variable=VaOSMR_n_NtiMax_N.Value
              OUT_VaOSMR_n_NtiMin_N_Value: accessed-variable=VaOSMR_n_NtiMin_N.Value
              OUT_VaOSMR_n_NtiMax_Gr_Value: accessed-variable=VaOSMR_n_NtiMax_Gr.Value
              OUT_VaOSMR_n_NtiMin_Gr_Value: accessed-variable=VaOSMR_n_NtiMin_Gr.Value
              OUT_VeOSMR_Cnt_IdxLength_MB_Value: accessed-variable=VeOSMR_Cnt_IdxLength_MB.Value
              OUT_VaOSMR_n_NtiMax_EVM_Value: accessed-variable=VaOSMR_n_NtiMax_EVM.Value
              OUT_VaOSMR_n_NtiMin_EVM_Value: accessed-variable=VaOSMR_n_NtiMin_EVM.Value
              OUT_VaOSMR_n_NtiMax_EVN_Value: accessed-variable=VaOSMR_n_NtiMax_EVN.Value
              OUT_VaOSMR_n_NtiMin_EVN_Value: accessed-variable=VaOSMR_n_NtiMin_EVN.Value
              OUT_VeOSMR_n_InputSpdMaxMAAct_Value: accessed-variable=VeOSMR_n_InputSpdMaxMAAct.Value
              OUT_VeOSMR_n_InputSpdMinMAAct_Value: accessed-variable=VeOSMR_n_InputSpdMinMAAct.Value
              OUT_VeOSMR_n_InputSpdMinMATgt_Value: accessed-variable=VeOSMR_n_InputSpdMinMATgt.Value
              OUT_VeOSMR_n_InputSpdMaxMATgt_Value: accessed-variable=VeOSMR_n_InputSpdMaxMATgt.Value
              OUT_VeOSMR_n_InputSpdMinMBAct_Value: accessed-variable=VeOSMR_n_InputSpdMinMBAct.Value
              OUT_VeOSMR_n_InputSpdMaxMBAct_Value: accessed-variable=VeOSMR_n_InputSpdMaxMBAct.Value
              OUT_VaOSMR_i_IndexAllowed_N_Value: accessed-variable=VaOSMR_i_IndexAllowed_N.Value
              OUT_VeOSMR_n_InputSpdMinMBTgt_Value: accessed-variable=VeOSMR_n_InputSpdMinMBTgt.Value
              OUT_VeOSMR_n_InputSpdMaxMBTgt_Value: accessed-variable=VeOSMR_n_InputSpdMaxMBTgt.Value
              OUT_VeOSMR_n_InputSpdMinNAct_Value: accessed-variable=VeOSMR_n_InputSpdMinNAct.Value
              OUT_VeOSMR_n_InputSpdMaxNAct_Value: accessed-variable=VeOSMR_n_InputSpdMaxNAct.Value
              OUT_VeOSMR_n_InputSpdMinNTgt_Value: accessed-variable=VeOSMR_n_InputSpdMinNTgt.Value
              OUT_VeOSMR_n_InputSpdMaxNTgt_Value: accessed-variable=VeOSMR_n_InputSpdMaxNTgt.Value
              OUT_VeOSMR_d_ManualAllowedEVN_Value: accessed-variable=VeOSMR_d_ManualAllowedEVN.Value
              OUT_VeOSMR_d_ManualAllowedEVM_Value: accessed-variable=VeOSMR_d_ManualAllowedEVM.Value
              OUT_VeOSMR_n_InputSpdMinM1_ToilDep_Value: accessed-variable=VeOSMR_n_InputSpdMinM1_ToilDep.Value
              OUT_VeOSMR_n_InputSpdMaxM1_ToilDep_Value: accessed-variable=VeOSMR_n_InputSpdMaxM1_ToilDep.Value
              OUT_VeOSMR_Cnt_IdxLength_N_Value: accessed-variable=VeOSMR_Cnt_IdxLength_N.Value
              OUT_VeOSMR_n_InputSpdMinM2_ToilDep_Value: accessed-variable=VeOSMR_n_InputSpdMinM2_ToilDep.Value
              OUT_VeOSMR_n_InputSpdMaxM2_ToilDep_Value: accessed-variable=VeOSMR_n_InputSpdMaxM2_ToilDep.Value
              OUT_VeOSMR_n_InputSpdMinM1_Value: accessed-variable=VeOSMR_n_InputSpdMinM1.Value
              OUT_VeOSMR_n_InputSpdMaxM1_Value: accessed-variable=VeOSMR_n_InputSpdMaxM1.Value
              OUT_VeOSMR_n_InputSpdMinM2_Value: accessed-variable=VeOSMR_n_InputSpdMinM2.Value
              OUT_VeOSMR_n_InputSpdMaxM2_Value: accessed-variable=VeOSMR_n_InputSpdMaxM2.Value
              OUT_VeOSMR_n_NoMax_M1_WithWideMargin_Value: accessed-variable=VeOSMR_n_NoMax_M1_WithWideMargin.Value
              OUT_VaOSMR_i_IndexAllowed_MBNR_Value: accessed-variable=VaOSMR_i_IndexAllowed_MBNR.Value
              OUT_VeOSMR_Cnt_IdxLength_MBNR_Value: accessed-variable=VeOSMR_Cnt_IdxLength_MBNR.Value
              OUT_VaOSMR_n_InputSpdMinMBNR_Value: accessed-variable=VaOSMR_n_InputSpdMinMBNR.Value
              OUT_VaOSMR_i_IndexAllowed_MA_Value: accessed-variable=VaOSMR_i_IndexAllowed_MA.Value
              OUT_VaOSMR_n_InputSpdMaxMBNR_Value: accessed-variable=VaOSMR_n_InputSpdMaxMBNR.Value
              OUT_VaOSMR_i_MinGrPerRngSt_Value: accessed-variable=VaOSMR_i_MinGrPerRngSt.Value
              OUT_VaOSMR_i_MaxGrPerRngSt_Value: accessed-variable=VaOSMR_i_MaxGrPerRngSt.Value
              OUT_VaOSMR_i_IndexAllowed_EVM_Value: accessed-variable=VaOSMR_i_IndexAllowed_EVM.Value
              OUT_VeOSMR_Cnt_IdxLength_EVM_Value: accessed-variable=VeOSMR_Cnt_IdxLength_EVM.Value
              OUT_VaOSMR_i_IndexAllowed_EVN_Value: accessed-variable=VaOSMR_i_IndexAllowed_EVN.Value
              OUT_VeOSMR_n_TransOutSpd_Value: accessed-variable=VeOSMR_n_TransOutSpd.Value
              OUT_VeOSMR_M_OutTorqReqAccel_Value: accessed-variable=VeOSMR_M_OutTorqReqAccel.Value
              OUT_VeOSMR_M_OutTorqReqBrake_Value: accessed-variable=VeOSMR_M_OutTorqReqBrake.Value
              OUT_VeOSMR_M_InputAccTorq_Value: accessed-variable=VeOSMR_M_InputAccTorq.Value
              OUT_VeOSMR_P_HVBatt_Bus_Min_Value: accessed-variable=VeOSMR_P_HVBatt_Bus_Min.Value
              OUT_VeOSMR_P_HVBatt_Bus_Max_Value: accessed-variable=VeOSMR_P_HVBatt_Bus_Max.Value
              OUT_VeOSMR_M_ZeroPedalOutTrqFiltd_Value: accessed-variable=VeOSMR_M_ZeroPedalOutTrqFiltd.Value
              OUT_VeOSMR_n_TransMinEngSpd_Value: accessed-variable=VeOSMR_n_TransMinEngSpd.Value
              OUT_VeOSMR_P_HV_AccPwr_Value: accessed-variable=VeOSMR_P_HV_AccPwr.Value
              OUT_VeOSMR_n_MtrBSpd_Max_Value: accessed-variable=VeOSMR_n_MtrBSpd_Max.Value
              OUT_VeOSMR_n_MtrBSpd_Min_Value: accessed-variable=VeOSMR_n_MtrBSpd_Min.Value
              OUT_VeOSMR_i_StgcSequencing_Value: accessed-variable=VeOSMR_i_StgcSequencing.Value
              OUT_VaOSMR_n_NC1Min_N_Value: accessed-variable=VaOSMR_n_NC1Min_N.Value
              OUT_VaOSMR_n_NC1Max_N_Value: accessed-variable=VaOSMR_n_NC1Max_N.Value
              OUT_VaOSMR_n_NC1Min_EVN_Value: accessed-variable=VaOSMR_n_NC1Min_EVN.Value
              OUT_VaOSMR_n_NC1Max_EVN_Value: accessed-variable=VaOSMR_n_NC1Max_EVN.Value
              OUT_VaOSMR_n_NC2Max_EVN_Value: accessed-variable=VaOSMR_n_NC2Max_EVN.Value
              OUT_VaOSMR_n_NC2Min_EVN_Value: accessed-variable=VaOSMR_n_NC2Min_EVN.Value
              OUT_VaOSMR_n_NC2Max_N_Value: accessed-variable=VaOSMR_n_NC2Max_N.Value
              OUT_VaOSMR_n_NC2Min_N_Value: accessed-variable=VaOSMR_n_NC2Min_N.Value
              OUT_VeOSMR_e_ActualGear_Value: accessed-variable=VeOSMR_e_ActualGear.Value
              OUT_VeOSMR_e_TargetGear_Value: accessed-variable=VeOSMR_e_TargetGear.Value
              OUT_VaOSMR_n_NTurb_FromNo_Value: accessed-variable=VaOSMR_n_NTurb_FromNo.Value
              OUT_VeOSMR_b_EnblGearSlctn_Value: accessed-variable=VeOSMR_b_EnblGearSlctn.Value
              OUT_VeOSMR_M_OutTorqReqAccel_Raw_Value: accessed-variable=VeOSMR_M_OutTorqReqAccel_Raw.Value
              OUT_VeOSMR_b_StgcInGSIMode_Value: accessed-variable=VeOSMR_b_StgcInGSIMode.Value
              OUT_VeOSMR_d_StgcRngSts_AllowedN_Value: accessed-variable=VeOSMR_d_StgcRngSts_AllowedN.Value
              OUT_VeOSMR_d_StgcRngSts_AllowedMA_Value: accessed-variable=VeOSMR_d_StgcRngSts_AllowedMA.Value
              OUT_VeOSMR_d_StgcRngSts_AllowedMB_Value: accessed-variable=VeOSMR_d_StgcRngSts_AllowedMB.Value
              OUT_VeOSMR_d_StgcRngSts_AllowedGr_Value: accessed-variable=VeOSMR_d_StgcRngSts_AllowedGr.Value
              OUT_VeOSMR_d_StgcRngSts_AllowedEVM_Value: accessed-variable=VeOSMR_d_StgcRngSts_AllowedEVM.Value
              OUT_VeOSMR_d_StgcRngSts_AllowedEVN_Value: accessed-variable=VeOSMR_d_StgcRngSts_AllowedEVN.Value
              OUT_VeOSMR_b_SeriesModeAllowed_Value: accessed-variable=VeOSMR_b_SeriesModeAllowed.Value
              OUT_VaOSMR_d_FinalAllwdOpt_Value: accessed-variable=VaOSMR_d_FinalAllwdOpt.Value
              OUT_VaOSMR_d_FinalAllwdDsrd_Value: accessed-variable=VaOSMR_d_FinalAllwdDsrd.Value
              OUT_VeOSMR_d_FxdGrRngSts_AllowedMA_Value: accessed-variable=VeOSMR_d_FxdGrRngSts_AllowedMA.Value
              OUT_VeOSMR_d_FxdGrRngSts_AllowedMB_Value: accessed-variable=VeOSMR_d_FxdGrRngSts_AllowedMB.Value
              OUT_VeOSMR_d_FxdGrRngSts_AllowedN_Value: accessed-variable=VeOSMR_d_FxdGrRngSts_AllowedN.Value
              OUT_VeOSMR_d_FxdGrRngSts_AllowedGr_Value: accessed-variable=VeOSMR_d_FxdGrRngSts_AllowedGr.Value
              OUT_VeOSMR_d_FxdGrRngSts_AllowedEVM_Value: accessed-variable=VeOSMR_d_FxdGrRngSts_AllowedEVM.Value
              OUT_VeOSMR_d_FxdGrRngSts_AllowedEVN_Value: accessed-variable=VeOSMR_d_FxdGrRngSts_AllowedEVN.Value
              OUT_VaOSMR_d_FinalAllwdFxdGr_Value: accessed-variable=VaOSMR_d_FinalAllwdFxdGr.Value
              OUT_VeOSMR_e_TargetGear_GSI_Value: accessed-variable=VeOSMR_e_TargetGear_GSI.Value
              OUT_VeOSMR_n_TransOutSpdRaw_Value: accessed-variable=VeOSMR_n_TransOutSpdRaw.Value
              OUT_VeOSMR_d_SoftCheckAllwd_MA_Value: accessed-variable=VeOSMR_d_SoftCheckAllwd_MA.Value
              OUT_VeOSMR_d_SoftCheckAllwd_MB_Value: accessed-variable=VeOSMR_d_SoftCheckAllwd_MB.Value
              OUT_VeOSMR_d_SoftCheckAllwd_N_Value: accessed-variable=VeOSMR_d_SoftCheckAllwd_N.Value
              OUT_VeOSMR_d_SoftCheckAllwd_Gr_Value: accessed-variable=VeOSMR_d_SoftCheckAllwd_Gr.Value
              OUT_VeOSMR_d_SoftCheckAllwd_EVM_Value: accessed-variable=VeOSMR_d_SoftCheckAllwd_EVM.Value
              OUT_VeOSMR_d_SoftCheckAllwd_EVN_Value: accessed-variable=VeOSMR_d_SoftCheckAllwd_EVN.Value
              OUT_VeOSMR_b_TempEVDrvMdInhibit_Value: accessed-variable=VeOSMR_b_TempEVDrvMdInhibit.Value
              OUT_VeOSMR_i_Hybrid_ST2Idx_Value: accessed-variable=VeOSMR_i_Hybrid_ST2Idx.Value
              OUT_VeOSMR_b_EngOffAllwdOpt_Value: accessed-variable=VeOSMR_b_EngOffAllwdOpt.Value
              OUT_VeOSMR_e_HRSR_State_Value: accessed-variable=VeOSMR_e_HRSR_State.Value
              OUT_VeOSMR_b_LwrdCreepEna_Value: accessed-variable=VeOSMR_b_LwrdCreepEna.Value
              OUT_VeOSMR_n_LwrdCreepIdleSpd_Value: accessed-variable=VeOSMR_n_LwrdCreepIdleSpd.Value
              OUT_VeOSMR_n_TransMinEngSpd_xNiColdMin_Value: accessed-variable=VeOSMR_n_TransMinEngSpd_xNiColdMin.Value
              OUT_VeOSMR_b_DisableLaunch_Value: accessed-variable=VeOSMR_b_DisableLaunch.Value
              OUT_VeOSMR_b_MaxGearOffsetActv_Value: accessed-variable=VeOSMR_b_MaxGearOffsetActv.Value
              OUT_VeOSMR_M_OutTrqRsrvIdle_Value: accessed-variable=VeOSMR_M_OutTrqRsrvIdle.Value
              OUT_VeOSMR_e_SteadyTransSt_Value: accessed-variable=VeOSMR_e_SteadyTransSt.Value
              OUT_VeOSMR_b_EngRevLim_Actv_Value: accessed-variable=VeOSMR_b_EngRevLim_Actv.Value
              OUT_VeOSMR_b_TCaseN4HiShft_Actv_Value: accessed-variable=VeOSMR_b_TCaseN4HiShft_Actv.Value
              OUT_VeOSMR_b_TcaseShftEffrtRdctn_Actv_Value: accessed-variable=VeOSMR_b_TcaseShftEffrtRdctn_Actv.Value
              OUT_VeOSMR_b_ServEngOffReq_Actv_Value: accessed-variable=VeOSMR_b_ServEngOffReq_Actv.Value
              OUT_VeOSMR_d_FnctnEnblReg_Value: accessed-variable=VeOSMR_d_FnctnEnblReg.Value
              OUT_VeOSMR_M_TgtTrq_Min_Value: accessed-variable=VeOSMR_M_TgtTrq_Min.Value
              OUT_VaOSMR_d_HardAllwdRaw_Value: accessed-variable=VaOSMR_d_HardAllwdRaw.Value
              OUT_VeOSMR_b_NVHLimitation_Enbld_Value: accessed-variable=VeOSMR_b_NVHLimitation_Enbld.Value
              OUT_VeOSMR_n_NiMax_NVH_Value: accessed-variable=VeOSMR_n_NiMax_NVH.Value
              OUT_VeOSMR_b_PnLimitActvFlg_Value: accessed-variable=VeOSMR_b_PnLimitActvFlg.Value
              OUT_VeOSMR_b_WEDclsdAllwdOpt_Value: accessed-variable=VeOSMR_b_WEDclsdAllwdOpt.Value
              OUT_VaOSMR_P_PShiftMinLim_Value: accessed-variable=VaOSMR_P_PShiftMinLim.Value
              OUT_VaOSMR_P_PShiftMaxLim_Value: accessed-variable=VaOSMR_P_PShiftMaxLim.Value
              OUT_VeOSMR_b_1DOptEnbl_Value: accessed-variable=VeOSMR_b_1DOptEnbl.Value
              OUT_VeOSMR_M_OutTrqReqNetArb_Value: accessed-variable=VeOSMR_M_OutTrqReqNetArb.Value
              OUT_VeOSMR_P_PoMaxLinConstrn_Value: accessed-variable=VeOSMR_P_PoMaxLinConstrn.Value
              OUT_VeOSMR_i_DrvPrg_AutoRevMaxType_Value: accessed-variable=VeOSMR_i_DrvPrg_AutoRevMaxType.Value
              OUT_VeOSMR_n_TransOutSpdSqncd_Value: accessed-variable=VeOSMR_n_TransOutSpdSqncd.Value
              OUT_VeOSMR_n_TransOutSpdRawSqncd_Value: accessed-variable=VeOSMR_n_TransOutSpdRawSqncd.Value
              OUT_VeOSMR_M_OutTrqReqNet_Value: accessed-variable=VeOSMR_M_OutTrqReqNet.Value
              OUT_VaOSMR_n_EngCapability_Value: accessed-variable=VaOSMR_n_EngCapability.Value
              OUT_VaOSMR_M_EngCapabilityMinOff_Value: accessed-variable=VaOSMR_M_EngCapabilityMinOff.Value
              OUT_VaOSMR_M_EngCapabilityMaxLmtd_Value: accessed-variable=VaOSMR_M_EngCapabilityMaxLmtd.Value
              OUT_VeOSMR_b_StgcNot_In_Transition_Value: accessed-variable=VeOSMR_b_StgcNot_In_Transition.Value
              OUT_VeOSMR_e_Current_RngSt_Value: accessed-variable=VeOSMR_e_Current_RngSt.Value
              OUT_VeOSMR_e_CurrentGear_Value: accessed-variable=VeOSMR_e_CurrentGear.Value
              OUT_VeOSMR_e_PrevDsrd_RngSt_Value: accessed-variable=VeOSMR_e_PrevDsrd_RngSt.Value
              OUT_VeOSMR_e_DesiredGear_Value: accessed-variable=VeOSMR_e_DesiredGear.Value
              OUT_VeOSMR_M_OutTrqReqArb_MA_Value: accessed-variable=VeOSMR_M_OutTrqReqArb_MA.Value
              OUT_VeOSMR_M_OutTrqReqArb_MB_Value: accessed-variable=VeOSMR_M_OutTrqReqArb_MB.Value
              OUT_VeOSMR_M_OutTrqReqArb_N_Value: accessed-variable=VeOSMR_M_OutTrqReqArb_N.Value
              OUT_VeOSMR_M_ToFront4x4_Max_Value: accessed-variable=VeOSMR_M_ToFront4x4_Max.Value
              OUT_VeOSMR_M_ToFront4x4_Min_Value: accessed-variable=VeOSMR_M_ToFront4x4_Min.Value
              OUT_VeOSMR_M_ToRear4x4_Max_Value: accessed-variable=VeOSMR_M_ToRear4x4_Max.Value
              OUT_VeOSMR_M_ToRear4x4_Min_Value: accessed-variable=VeOSMR_M_ToRear4x4_Min.Value
              OUT_VeOSMR_M_OutTrqReqNetArbSqncd_Value: accessed-variable=VeOSMR_M_OutTrqReqNetArbSqncd.Value
              OUT_VeOSMR_M_OutTrqReqArb_MBNR_Value: accessed-variable=VeOSMR_M_OutTrqReqArb_MBNR.Value
              OUT_VeOSMR_r_CostFactSOCNeg_Stgc_Value: accessed-variable=VeOSMR_r_CostFactSOCNeg_Stgc.Value
              OUT_VeOSMR_r_CostFactSOCPos_Stgc_Value: accessed-variable=VeOSMR_r_CostFactSOCPos_Stgc.Value
              OUT_VeOSMR_P_BattPwrShift_Stgc_Value: accessed-variable=VeOSMR_P_BattPwrShift_Stgc.Value
              OUT_VeOSMR_n_Ni_ColdCtrl_Value: accessed-variable=VeOSMR_n_Ni_ColdCtrl.Value
              OUT_VeOSMR_M_Ti_ColdCtrl_Stgc_Value: accessed-variable=VeOSMR_M_Ti_ColdCtrl_Stgc.Value
              OUT_VeOSMR_r_ColdCtrlCostFact_Stgc_Value: accessed-variable=VeOSMR_r_ColdCtrlCostFact_Stgc.Value
              OUT_VeOSMR_n_NiMinIdlNoFlyZone_Value: accessed-variable=VeOSMR_n_NiMinIdlNoFlyZone.Value
              OUT_VeOSMR_n_NiMaxIdlNoFlyZone_Value: accessed-variable=VeOSMR_n_NiMaxIdlNoFlyZone.Value
              OUT_VeOSMR_P_DrvrPdlCostOffsetNeg_Value: accessed-variable=VeOSMR_P_DrvrPdlCostOffsetNeg.Value
              OUT_VeOSMR_r_DrvrPdlCostGainNeg_Value: accessed-variable=VeOSMR_r_DrvrPdlCostGainNeg.Value
              OUT_VeOSMR_P_DrvrPdlCostOffsetPos_Value: accessed-variable=VeOSMR_P_DrvrPdlCostOffsetPos.Value
              OUT_VeOSMR_r_DrvrPdlCostGainPos_Value: accessed-variable=VeOSMR_r_DrvrPdlCostGainPos.Value
              OUT_VeOSMR_b_StgcRIPEnblOutTorqAccel_Value: accessed-variable=VeOSMR_b_StgcRIPEnblOutTorqAccel.Value
              OUT_VeOSMR_b_StgcRIPEnblOutTorqNet_Value: accessed-variable=VeOSMR_b_StgcRIPEnblOutTorqNet.Value
              OUT_VeOSMR_r_StgcRIPratioOutTorqAccel_Value: accessed-variable=VeOSMR_r_StgcRIPratioOutTorqAccel.Value
              OUT_VeOSMR_r_StgcRIPratioOutTorqNet_Value: accessed-variable=VeOSMR_r_StgcRIPratioOutTorqNet.Value
              OUT_VaOSMR_M_ToFToRLimOL_Value: accessed-variable=VaOSMR_M_ToFToRLimOL.Value
              OUT_VaOSMR_k_MeshLoss2ndOrderCoeff_Value: accessed-variable=VaOSMR_k_MeshLoss2ndOrderCoeff.Value
              OUT_VaOSMR_k_MeshLoss1stOrderCoeff_Value: accessed-variable=VaOSMR_k_MeshLoss1stOrderCoeff.Value
              OUT_VaOSMR_k_MeshLoss0thOrderCoeff_Value: accessed-variable=VaOSMR_k_MeshLoss0thOrderCoeff.Value
              OUT_VaOSMR_k_MeshLoss2ndOrderCoeffEV_Value: accessed-variable=VaOSMR_k_MeshLoss2ndOrderCoeffEV.Value
              OUT_VaOSMR_k_MeshLoss1stOrderCoeffEV_Value: accessed-variable=VaOSMR_k_MeshLoss1stOrderCoeffEV.Value
              OUT_VaOSMR_k_MeshLoss0thOrderCoeffEV_Value: accessed-variable=VaOSMR_k_MeshLoss0thOrderCoeffEV.Value
              OUT_VeOSMR_P_PwrRsrv4EngmtRaw_Value: accessed-variable=VeOSMR_P_PwrRsrv4EngmtRaw.Value
              OUT_VeOSMR_M_BeltCapMaxPrll_Value: accessed-variable=VeOSMR_M_BeltCapMaxPrll.Value
              OUT_VeOSMR_M_BeltCapMinPrll_Value: accessed-variable=VeOSMR_M_BeltCapMinPrll.Value
              OUT_VeOSMR_M_BeltCapMaxSer_Eff_Value: accessed-variable=VeOSMR_M_BeltCapMaxSer_Eff.Value
              OUT_VeOSMR_M_BeltCapMinSer_Eff_Value: accessed-variable=VeOSMR_M_BeltCapMinSer_Eff.Value
              OUT_VeOSMR_r_MachAPwrLossCostFactor_Value: accessed-variable=VeOSMR_r_MachAPwrLossCostFactor.Value
              OUT_VeOSMR_r_MachBPwrLossCostFactor_Value: accessed-variable=VeOSMR_r_MachBPwrLossCostFactor.Value
              OUT_VeOSMR_r_MachCPwrLossCostFactor_Value: accessed-variable=VeOSMR_r_MachCPwrLossCostFactor.Value
              OUT_VeOSMR_r_BattPwrLossCostFactor_Value: accessed-variable=VeOSMR_r_BattPwrLossCostFactor.Value
          written-local-variables:
            36 x access:
              WV_Actual_Gear_write_IRV: accessed-variable=Actual_Gear_write_IRV
              WV_BrkReqTorq_Unconstrained_write_IRV: accessed-variable=BrkReqTorq_Unconstrained_write_IRV
              WV_BrkReqTorq_write_IRV: accessed-variable=BrkReqTorq_write_IRV
              WV_EnblGrSlctn_write_IRV: accessed-variable=EnblGrSlctn_write_IRV
              WV_FixGearRngStsAllwd_write_IRV: accessed-variable=FixGearRngStsAllwd_write_IRV
              WV_FunctionEnableRegister_NonDynSeq_write_IRV: accessed-variable=FunctionEnableRegister_NonDynSeq_write_IRV
              WV_HRSR_State_write_IRV: accessed-variable=HRSR_State_write_IRV
              WV_HardConfigConstraints_Allowed_write_IRV: accessed-variable=HardConfigConstraints_Allowed_write_IRV
              WV_HardConfigConstraints_FixedGear_Allowed_write_IRV: accessed-variable=HardConfigConstraints_FixedGear_Allowed_write_IRV
              WV_IsLockedSt_write_IRV: accessed-variable=IsLockedSt_write_IRV
              WV_LwrdCreepEna_write_IRV: accessed-variable=LwrdCreepEna_write_IRV
              WV_MaxGrArb_write_IRV: accessed-variable=MaxGrArb_write_IRV
              WV_MaxGrOffset_Actv_write_IRV: accessed-variable=MaxGrOffset_Actv_write_IRV
              WV_NTurb_FromNo_write_IRV: accessed-variable=NTurb_FromNo_write_IRV
              WV_NTurb_from_NoExtrap_write_IRV: accessed-variable=NTurb_from_NoExtrap_write_IRV
              WV_Na_Axis_Cpblty_out_write_IRV: accessed-variable=Na_Axis_Cpblty_out_write_IRV
              WV_NiMinLimit_xNiCold_write_IRV: accessed-variable=NiMinLimit_xNiCold_write_IRV
              WV_NiMin_write_IRV: accessed-variable=NiMin_write_IRV
              WV_No_Dot_write_IRV: accessed-variable=No_Dot_write_IRV
              WV_SelectionAllwd_write_IRV: accessed-variable=SelectionAllwd_write_IRV
              WV_Sequence_write_IRV: accessed-variable=Sequence_write_IRV
              WV_StgcInGSIMode_write_IRV: accessed-variable=StgcInGSIMode_write_IRV
              WV_StgcRngStsAllwd_write_IRV: accessed-variable=StgcRngStsAllwd_write_IRV
              WV_StgcStAllowed_MA_write_IRV: accessed-variable=StgcStAllowed_MA_write_IRV
              WV_StgcStAllowed_N_write_IRV: accessed-variable=StgcStAllowed_N_write_IRV
              WV_StrategicSteadyTransState_write_IRV: accessed-variable=StrategicSteadyTransState_write_IRV
              WV_Target_Gear_GSI_write_IRV: accessed-variable=Target_Gear_GSI_write_IRV
              WV_Target_Gear_write_IRV: accessed-variable=Target_Gear_write_IRV
              WV_ToMax_LinConstrn_IRV: accessed-variable=ToMax_LinConstrn_IRV
              WV_TransOutSpdRaw_write_IRV: accessed-variable=TransOutSpdRaw_write_IRV
              WV_TransOutSpd_write_IRV: accessed-variable=TransOutSpd_write_IRV
              WV_OutTorqReqAccelArb_IRV_IRV: accessed-variable=OutTorqReqAccelArb_IRV_IRV
              WV_OutTorqReqAccelRaw_IRV_IRV: accessed-variable=OutTorqReqAccelRaw_IRV_IRV
              WV_OutTrqReqNetArb_IRV_IRV: accessed-variable=OutTrqReqNetArb_IRV_IRV
              WV_HV_AccPwr_IRV_IRV: accessed-variable=HV_AccPwr_IRV_IRV
              WV_VeOSMR_b_1DOptEnbl_IRV: accessed-variable=VeOSMR_b_1DOptEnbl_IRV
        OSMR_MedTED1
          data-receive-point-by-arguments:
            62 x access:
              IN_VaETQR_M_EngCapabilityMax_Value: accessed-variable=VaETQR_M_EngCapabilityMax.Value
              IN_VaETQR_n_EngCapability_Value: accessed-variable=VaETQR_n_EngCapability.Value
              IN_VaMTQR_M_MtrAMinCpblty_LT_Value: accessed-variable=VaMTQR_M_MtrAMinCpblty_LT.Value
              IN_VaMTQR_n_MtrACpbltyspd_Value: accessed-variable=VaMTQR_n_MtrACpbltyspd.Value
              IN_VeABCR_P_HV_AccPwr_Value: accessed-variable=VeABCR_P_HV_AccPwr.Value
              IN_VeADCR_e_WEDCmndArb_Value: accessed-variable=VeADCR_e_WEDCmndArb.Value, variation-point={short-label=vpIN_VeADCR_e_WEDCmndArb_Value, sw-syscond=1}
              IN_VeADCR_i_WEDCmndArbPrioLvl_Value: accessed-variable=VeADCR_i_WEDCmndArbPrioLvl.Value, variation-point={short-label=vpIN_VeADCR_i_WEDCmndArbPrioLvl_Value, sw-syscond=1}
              IN_VeAPSR_Pct_AccelPedalEffPosition_Value: accessed-variable=VeAPSR_Pct_AccelPedalEffPosition.Value
              IN_VeATRR_M_MinPedal_Stgc_Value: accessed-variable=VeATRR_M_MinPedal_Stgc.Value
              IN_VeATRR_M_ToReqPrdctd_Stgc_Value: accessed-variable=VeATRR_M_ToReqPrdctd_Stgc.Value
              IN_VeBPCR_Pct_HV_BatPackSOC_Arb_Value: accessed-variable=VeBPCR_Pct_HV_BatPackSOC_Arb.Value
              IN_VeBPCR_e_HV_BatCntctrStat_Value: accessed-variable=VeBPCR_e_HV_BatCntctrStat.Value
              IN_VeCSVR_l_WhlRadius_Value: accessed-variable=VeCSVR_l_WhlRadius.Value
              IN_VeCSVR_v_VehSpd_Value: accessed-variable=VeCSVR_v_VehSpd.Value
              IN_VeCTCR_b_MinCreep_Enable_Value: accessed-variable=VeCTCR_b_MinCreep_Enable.Value
              IN_VeDMDR_i_DrvMdArbIdx_Value: accessed-variable=VeDMDR_i_DrvMdArbIdx.Value
              IN_VeEBMR_e_eBoostStatus_Value: accessed-variable=VeEBMR_e_eBoostStatus.Value, variation-point={short-label=vpIN_VeEBMR_e_eBoostStatus_Value, sw-syscond=1}
              IN_VeENGR_b_OilDil_EngMinPwrEnbl_Value: accessed-variable=VeENGR_b_OilDil_EngMinPwrEnbl.Value
              IN_VeENGR_b_PnLimitActvFlg_Value: accessed-variable=VeENGR_b_PnLimitActvFlg.Value
              IN_VeEOCR_r_ColdCtrlCostFact_Stgc_Value: accessed-variable=VeEOCR_r_ColdCtrlCostFact_Stgc.Value
              IN_VeESMR_P_BattLTMaxLim_Value: accessed-variable=VeESMR_P_BattLTMaxLim.Value
              IN_VeESMR_P_BattLTMinLim_Value: accessed-variable=VeESMR_P_BattLTMinLim.Value
              IN_VeESMR_P_BoostCnvrtr_LT_ChrgPwrLmt_Value: accessed-variable=VeESMR_P_BoostCnvrtr_LT_ChrgPwrLmt.Value
              IN_VeESMR_P_BoostCnvrtr_LT_DschrgPwrLmt_Value: accessed-variable=VeESMR_P_BoostCnvrtr_LT_DschrgPwrLmt.Value
              IN_VeFWDR_e_Tcase_Stat_Value: accessed-variable=VeFWDR_e_Tcase_Stat.Value
              IN_VeFWDR_r_Axle_Ratio_Value: accessed-variable=VeFWDR_r_Axle_Ratio.Value
              IN_VeFWDR_r_TCaseRatio_Value: accessed-variable=VeFWDR_r_TCaseRatio.Value
              IN_VeHSER_e_HRSR_State_Value: accessed-variable=VeHSER_e_HRSR_State.Value, variation-point={short-label=vpIN_VeHSER_e_HRSR_State_Value, sw-syscond=1}
              IN_VeINVR_e_MtrA_InvrtrSt_Value: accessed-variable=VeINVR_e_MtrA_InvrtrSt.Value
              IN_VeMSPR_n_MtrB_Spd_Value: accessed-variable=VeMSPR_n_MtrB_Spd.Value, variation-point={short-label=vpIN_VeMSPR_n_MtrB_Spd_Value, sw-syscond=1}
              IN_VeOHSR_e_RngDsrd_Value: accessed-variable=VeOHSR_e_RngDsrd.Value
              IN_VeOHSR_e_SGrDsrd_Value: accessed-variable=VeOHSR_e_SGrDsrd.Value
              IN_VeOHSR_e_SGrDsrd_EngOn_Value: accessed-variable=VeOHSR_e_SGrDsrd_EngOn.Value
              IN_VeRGNR_M_DrvIntndTotBrk_Stgc_Value: accessed-variable=VeRGNR_M_DrvIntndTotBrk_Stgc.Value
              IN_VeSRAR_b_Inhibit_Gear{1..4}Cmnd_Value: accessed-variable=VeSRAR_b_Inhibit_Gear{1..4}Cmnd.Value
              IN_VeSRAR_b_Inhibit_Mode1Cmnd_Value: accessed-variable=VeSRAR_b_Inhibit_Mode1Cmnd.Value
              IN_VeSRAR_b_Inhibit_Mode2Cmnd_Value: accessed-variable=VeSRAR_b_Inhibit_Mode2Cmnd.Value
              IN_VeSRAR_b_Inhibit_NeutralCmnd_Value: accessed-variable=VeSRAR_b_Inhibit_NeutralCmnd.Value
              IN_VeSTRR_b_EngOffAllowed_Value: accessed-variable=VeSTRR_b_EngOffAllowed.Value
              IN_VeSTRR_b_EngOnAllowed_Value: accessed-variable=VeSTRR_b_EngOnAllowed.Value
              IN_VeTIMR_e_RaceOptions_Sts_Value: accessed-variable=VeTIMR_e_RaceOptions_Sts.Value
              IN_VeTINR_Cnt_TCM_DriverType_Value: accessed-variable=VeTINR_Cnt_TCM_DriverType.Value
              IN_VeTINR_i_MaxGearAllwd_Value: accessed-variable=VeTINR_i_MaxGearAllwd.Value
              IN_VeTINR_i_MinGearAllwd_Value: accessed-variable=VeTINR_i_MinGearAllwd.Value
              IN_VeTINR_i_TCM_DriveProgram_Value: accessed-variable=VeTINR_i_TCM_DriveProgram.Value
              IN_VeTINR_r_TCM_HillMode_Value: accessed-variable=VeTINR_r_TCM_HillMode.Value
              IN_VeTINR_t_TCM_TimeToSpeedChange_Value: accessed-variable=VeTINR_t_TCM_TimeToSpeedChange.Value
              IN_VeTISR_n_TransMinInputSpd_Value: accessed-variable=VeTISR_n_TransMinInputSpd.Value
              IN_VeTMDR_e_LockLowSt_Value: accessed-variable=VeTMDR_e_LockLowSt.Value
              IN_VeTMDR_i_TrueTrrnMd_Value: accessed-variable=VeTMDR_i_TrueTrrnMd.Value
              IN_VeTRGR_b_ManualMode_Value: accessed-variable=VeTRGR_b_ManualMode.Value
              IN_VeTRGR_e_VldtdTransRngSt_Value: accessed-variable=VeTRGR_e_VldtdTransRngSt.Value
              IN_VeTRNR_e_ActualGear_Value: accessed-variable=VeTRNR_e_ActualGear.Value
              IN_VeTRNR_e_TCM_ActiveEVGear_Value: accessed-variable=VeTRNR_e_TCM_ActiveEVGear.Value
              IN_VeTRNR_e_TCM_ActiveHybridGear_Value: accessed-variable=VeTRNR_e_TCM_ActiveHybridGear.Value
              IN_VeTRNR_e_TCM_ActiveXNGear_Value: accessed-variable=VeTRNR_e_TCM_ActiveXNGear.Value
              IN_VeTRNR_e_TargetGear_Value: accessed-variable=VeTRNR_e_TargetGear.Value
              IN_VeVSDR_dn_StratNodot_Value: accessed-variable=VeVSDR_dn_StratNodot.Value
              IN_VeVSDR_n_StratNoFltrd_Value: accessed-variable=VeVSDR_n_StratNoFltrd.Value
          data-send-points:
            32 x access:
              OUT_VeOSMR_i_StgcSequencing_Value: accessed-variable=VeOSMR_i_StgcSequencing.Value
              OUT_VeOSMR_e_SteadyTransSt_Value: accessed-variable=VeOSMR_e_SteadyTransSt.Value
              OUT_VeOSMR_e_ActualGear_Value: accessed-variable=VeOSMR_e_ActualGear.Value
              OUT_VeOSMR_e_TargetGear_Value: accessed-variable=VeOSMR_e_TargetGear.Value
              OUT_VeOSMR_e_HRSR_State_Value: accessed-variable=VeOSMR_e_HRSR_State.Value
              OUT_VeOSMR_b_EnblGearSlctn_Value: accessed-variable=VeOSMR_b_EnblGearSlctn.Value
              OUT_VeOSMR_b_LwrdCreepEna_Value: accessed-variable=VeOSMR_b_LwrdCreepEna.Value
              OUT_VeOSMR_n_TransOutSpd_Value: accessed-variable=VeOSMR_n_TransOutSpd.Value
              OUT_VaOSMR_n_NTurb_FromNo_Value: accessed-variable=VaOSMR_n_NTurb_FromNo.Value
              OUT_VeOSMR_n_TransOutSpdRaw_Value: accessed-variable=VeOSMR_n_TransOutSpdRaw.Value
              OUT_VeOSMR_b_MaxGearOffsetActv_Value: accessed-variable=VeOSMR_b_MaxGearOffsetActv.Value
              OUT_VeOSMR_M_OutTorqReqAccel_Value: accessed-variable=VeOSMR_M_OutTorqReqAccel.Value
              OUT_VeOSMR_P_HVBatt_Bus_Min_Value: accessed-variable=VeOSMR_P_HVBatt_Bus_Min.Value
              OUT_VeOSMR_P_HVBatt_Bus_Max_Value: accessed-variable=VeOSMR_P_HVBatt_Bus_Max.Value
              OUT_VeOSMR_M_ZeroPedalOutTrqFiltd_Value: accessed-variable=VeOSMR_M_ZeroPedalOutTrqFiltd.Value
              OUT_VeOSMR_P_HV_AccPwr_Value: accessed-variable=VeOSMR_P_HV_AccPwr.Value
              OUT_VeOSMR_M_OutTorqReqAccel_Raw_Value: accessed-variable=VeOSMR_M_OutTorqReqAccel_Raw.Value
              OUT_VeOSMR_b_SeriesModeAllowed_Value: accessed-variable=VeOSMR_b_SeriesModeAllowed.Value
              OUT_VeOSMR_b_TempEVDrvMdInhibit_Value: accessed-variable=VeOSMR_b_TempEVDrvMdInhibit.Value
              OUT_VeOSMR_n_TransMinEngSpd_xNiColdMin_Value: accessed-variable=VeOSMR_n_TransMinEngSpd_xNiColdMin.Value
              OUT_VeOSMR_M_OutTrqRsrvIdle_Value: accessed-variable=VeOSMR_M_OutTrqRsrvIdle.Value
              OUT_VeOSMR_b_TCaseN4HiShft_Actv_Value: accessed-variable=VeOSMR_b_TCaseN4HiShft_Actv.Value
              OUT_VeOSMR_b_TcaseShftEffrtRdctn_Actv_Value: accessed-variable=VeOSMR_b_TcaseShftEffrtRdctn_Actv.Value
              OUT_VeOSMR_b_ServEngOffReq_Actv_Value: accessed-variable=VeOSMR_b_ServEngOffReq_Actv.Value
              OUT_VeOSMR_M_TgtTrq_Min_Value: accessed-variable=VeOSMR_M_TgtTrq_Min.Value
              OUT_VeOSMR_b_NVHLimitation_Enbld_Value: accessed-variable=VeOSMR_b_NVHLimitation_Enbld.Value
              OUT_VeOSMR_n_NiMax_NVH_Value: accessed-variable=VeOSMR_n_NiMax_NVH.Value
              OUT_VeOSMR_b_PnLimitActvFlg_Value: accessed-variable=VeOSMR_b_PnLimitActvFlg.Value
              OUT_VaOSMR_P_PShiftMinLim_Value: accessed-variable=VaOSMR_P_PShiftMinLim.Value
              OUT_VaOSMR_P_PShiftMaxLim_Value: accessed-variable=VaOSMR_P_PShiftMaxLim.Value
              OUT_VeOSMR_M_OutTrqReqNetArb_Value: accessed-variable=VeOSMR_M_OutTrqReqNetArb.Value
              OUT_VeOSMR_i_DrvPrg_AutoRevMaxType_Value: accessed-variable=VeOSMR_i_DrvPrg_AutoRevMaxType.Value
          parameter access CALPRM_KaTSXR_r_All_Nt2StratNoRatio_KaTSXR_r_All_Nt2StratNoRatio: accessed-parameter=KaTSXR_r_All_Nt2StratNoRatio.KaTSXR_r_All_Nt2StratNoRatio
          parameter access CALPRM_KeOPTR_r_NiTiFctrMin_KeOPTR_r_NiTiFctrMin: accessed-parameter=KeOPTR_r_NiTiFctrMin.KeOPTR_r_NiTiFctrMin
          parameter access CALPRM_KeTSXR_r_All_FDRratio_KeTSXR_r_All_FDRratio: accessed-parameter=KeTSXR_r_All_FDRratio.KeTSXR_r_All_FDRratio
          written-local-variables:
            32 x access:
              WV_Actual_Gear_write_IRV: accessed-variable=Actual_Gear_write_IRV
              WV_BrkReqTorq_Unconstrained_write_IRV: accessed-variable=BrkReqTorq_Unconstrained_write_IRV
              WV_BrkReqTorq_write_IRV: accessed-variable=BrkReqTorq_write_IRV
              WV_EnblGrSlctn_write_IRV: accessed-variable=EnblGrSlctn_write_IRV
              WV_FixGearRngStsAllwd_write_IRV: accessed-variable=FixGearRngStsAllwd_write_IRV
              WV_FunctionEnableRegister_NonDynSeq_write_IRV: accessed-variable=FunctionEnableRegister_NonDynSeq_write_IRV
              WV_HRSR_State_write_IRV: accessed-variable=HRSR_State_write_IRV
              WV_HV_AccPwr_IRV_IRV: accessed-variable=HV_AccPwr_IRV_IRV
              WV_HardConfigConstraints_Allowed_write_IRV: accessed-variable=HardConfigConstraints_Allowed_write_IRV
              WV_HardConfigConstraints_FixedGear_Allowed_write_IRV: accessed-variable=HardConfigConstraints_FixedGear_Allowed_write_IRV
              WV_IsLockedSt_write_IRV: accessed-variable=IsLockedSt_write_IRV
              WV_LwrdCreepEna_write_IRV: accessed-variable=LwrdCreepEna_write_IRV
              WV_MaxGrArb_write_IRV: accessed-variable=MaxGrArb_write_IRV
              WV_MaxGrOffset_Actv_write_IRV: accessed-variable=MaxGrOffset_Actv_write_IRV
              WV_NTurb_FromNo_write_IRV: accessed-variable=NTurb_FromNo_write_IRV
              WV_NTurb_from_NoExtrap_write_IRV: accessed-variable=NTurb_from_NoExtrap_write_IRV
              WV_Na_Axis_Cpblty_out_write_IRV: accessed-variable=Na_Axis_Cpblty_out_write_IRV
              WV_NiMinLimit_xNiCold_write_IRV: accessed-variable=NiMinLimit_xNiCold_write_IRV
              WV_No_Dot_write_IRV: accessed-variable=No_Dot_write_IRV
              WV_OutTorqReqAccelArb_IRV_IRV: accessed-variable=OutTorqReqAccelArb_IRV_IRV
              WV_OutTorqReqAccelRaw_IRV_IRV: accessed-variable=OutTorqReqAccelRaw_IRV_IRV
              WV_OutTrqReqNetArb_IRV_IRV: accessed-variable=OutTrqReqNetArb_IRV_IRV
              WV_SelectionAllwd_write_IRV: accessed-variable=SelectionAllwd_write_IRV
              WV_Sequence_write_IRV: accessed-variable=Sequence_write_IRV
              WV_StgcInGSIMode_write_IRV: accessed-variable=StgcInGSIMode_write_IRV
              WV_StgcRngStsAllwd_write_IRV: accessed-variable=StgcRngStsAllwd_write_IRV
              WV_StrategicSteadyTransState_write_IRV: accessed-variable=StrategicSteadyTransState_write_IRV
              WV_Target_Gear_GSI_write_IRV: accessed-variable=Target_Gear_GSI_write_IRV
              WV_Target_Gear_write_IRV: accessed-variable=Target_Gear_write_IRV
              WV_TransOutSpdRaw_write_IRV: accessed-variable=TransOutSpdRaw_write_IRV
              WV_TransOutSpd_write_IRV: accessed-variable=TransOutSpd_write_IRV
              WV_VeOSMR_b_1DOptEnbl_IRV: accessed-variable=VeOSMR_b_1DOptEnbl_IRV
        OSMR_MedTED2
          data-receive-point-by-arguments:
            33 x access:
              IN_VaMTQR_M_MtrAMaxCpblty_LT_Value: accessed-variable=VaMTQR_M_MtrAMaxCpblty_LT.Value
              IN_VaMTQR_M_MtrBMaxCpblty_LT_Value: accessed-variable=VaMTQR_M_MtrBMaxCpblty_LT.Value
              IN_VaMTQR_M_MtrCMaxCpblty_LT_Value: accessed-variable=VaMTQR_M_MtrCMaxCpblty_LT.Value
              IN_VaMTQR_n_MtrBCpbltyspd_Value: accessed-variable=VaMTQR_n_MtrBCpbltyspd.Value
              IN_VaMTQR_n_MtrCCpbltyspd_Value: accessed-variable=VaMTQR_n_MtrCCpbltyspd.Value
              IN_VaTINR_n_NiMinForLockUp_Value: accessed-variable=VaTINR_n_NiMinForLockUp.Value
              IN_VaTINR_n_NiMinForLockUpCoast_Value: accessed-variable=VaTINR_n_NiMinForLockUpCoast.Value
              IN_VaTINR_n_NiMinToOpen_Value: accessed-variable=VaTINR_n_NiMinToOpen.Value
              IN_VaTINR_n_NiMinToOpenCoast_Value: accessed-variable=VaTINR_n_NiMinToOpenCoast.Value
              IN_VeAPSR_Pct_AccelPedalEffPosition_Value: accessed-variable=VeAPSR_Pct_AccelPedalEffPosition.Value
              IN_VeATRR_M_ToReqPrdctd_Stgc_Value: accessed-variable=VeATRR_M_ToReqPrdctd_Stgc.Value
              IN_VeEOCR_r_ColdCtrlCostFact_Stgc_Value: accessed-variable=VeEOCR_r_ColdCtrlCostFact_Stgc.Value
              IN_VeESPR_n_EngSpdMaxLim_Value: accessed-variable=VeESPR_n_EngSpdMaxLim.Value
              IN_VeFWDR_e_Tcase_Stat_Value: accessed-variable=VeFWDR_e_Tcase_Stat.Value
              IN_VeHSCR_n_Max_MtrA_Spd_Value: accessed-variable=VeHSCR_n_Max_MtrA_Spd.Value
              IN_VeHSCR_n_Max_MtrB_Spd_Value: accessed-variable=VeHSCR_n_Max_MtrB_Spd.Value
              IN_VeHSCR_n_Max_MtrC_Spd_Value: accessed-variable=VeHSCR_n_Max_MtrC_Spd.Value
              IN_VeHSCR_n_Min_MtrA_Spd_Value: accessed-variable=VeHSCR_n_Min_MtrA_Spd.Value
              IN_VeHSCR_n_Min_MtrB_Spd_Value: accessed-variable=VeHSCR_n_Min_MtrB_Spd.Value
              IN_VeHSCR_n_Min_MtrC_Spd_Value: accessed-variable=VeHSCR_n_Min_MtrC_Spd.Value
              IN_VeMSPR_n_MtrB_Spd_Value: accessed-variable=VeMSPR_n_MtrB_Spd.Value, variation-point={short-label=vpIN_VeMSPR_n_MtrB_Spd_Value, sw-syscond=1}
              IN_VeSRAR_b_Inhibit_NeutralCmnd_Value: accessed-variable=VeSRAR_b_Inhibit_NeutralCmnd.Value
              IN_VeSTRR_b_EngOffAllowed_Value: accessed-variable=VeSTRR_b_EngOffAllowed.Value
              IN_VeSTRR_b_EngOnAllowed_Value: accessed-variable=VeSTRR_b_EngOnAllowed.Value
              IN_VeTINR_i_MaxGearAllwd_Value: accessed-variable=VeTINR_i_MaxGearAllwd.Value
              IN_VeTINR_i_MinGearAllwd_Value: accessed-variable=VeTINR_i_MinGearAllwd.Value
              IN_VeTISR_n_TransMinInputSpd_Value: accessed-variable=VeTISR_n_TransMinInputSpd.Value
              IN_VeTITR_M_PumpTorq_Value: accessed-variable=VeTITR_M_PumpTorq.Value
              IN_VeTMDR_e_LockLowSt_Value: accessed-variable=VeTMDR_e_LockLowSt.Value
              IN_VeTRGR_b_ManualMode_Value: accessed-variable=VeTRGR_b_ManualMode.Value
              IN_VeTRNR_e_TCM_ActiveEVGear_Value: accessed-variable=VeTRNR_e_TCM_ActiveEVGear.Value
              IN_VeTRNR_e_TCM_ActiveHybridGear_Value: accessed-variable=VeTRNR_e_TCM_ActiveHybridGear.Value
              IN_VeTRNR_e_TCM_ActiveXNGear_Value: accessed-variable=VeTRNR_e_TCM_ActiveXNGear.Value
          data-send-points:
            110 x access:
              OUT_VeOSMR_n_TransMinEngSpd_Value: accessed-variable=VeOSMR_n_TransMinEngSpd.Value
              OUT_VeOSMR_n_MtrBSpd_Max_Value: accessed-variable=VeOSMR_n_MtrBSpd_Max.Value
              OUT_VeOSMR_n_MtrBSpd_Min_Value: accessed-variable=VeOSMR_n_MtrBSpd_Min.Value
              OUT_VeOSMR_n_LwrdCreepIdleSpd_Value: accessed-variable=VeOSMR_n_LwrdCreepIdleSpd.Value
              OUT_VeOSMR_b_EngRevLim_Actv_Value: accessed-variable=VeOSMR_b_EngRevLim_Actv.Value
              OUT_VeOSMR_d_StgcRngSts_AllowedMA_Value: accessed-variable=VeOSMR_d_StgcRngSts_AllowedMA.Value
              OUT_VeOSMR_d_StgcRngSts_AllowedN_Value: accessed-variable=VeOSMR_d_StgcRngSts_AllowedN.Value
              OUT_VaOSMR_n_InputSpdMinN_Value: accessed-variable=VaOSMR_n_InputSpdMinN.Value
              OUT_VaOSMR_n_InputSpdMaxN_Value: accessed-variable=VaOSMR_n_InputSpdMaxN.Value
              OUT_VaOSMR_n_InputSpdMinMA_Value: accessed-variable=VaOSMR_n_InputSpdMinMA.Value
              OUT_VaOSMR_n_InputSpdMaxMA_Value: accessed-variable=VaOSMR_n_InputSpdMaxMA.Value
              OUT_VaOSMR_n_InputSpdMinMB_Value: accessed-variable=VaOSMR_n_InputSpdMinMB.Value
              OUT_VaOSMR_n_InputSpdMaxMB_Value: accessed-variable=VaOSMR_n_InputSpdMaxMB.Value
              OUT_VaOSMR_n_NtiMin_MA_Value: accessed-variable=VaOSMR_n_NtiMin_MA.Value
              OUT_VaOSMR_n_NtiMax_MA_Value: accessed-variable=VaOSMR_n_NtiMax_MA.Value
              OUT_VaOSMR_n_NtiMax_MB_Value: accessed-variable=VaOSMR_n_NtiMax_MB.Value
              OUT_VaOSMR_n_NtiMin_MB_Value: accessed-variable=VaOSMR_n_NtiMin_MB.Value
              OUT_VaOSMR_n_NtiMax_N_Value: accessed-variable=VaOSMR_n_NtiMax_N.Value
              OUT_VaOSMR_n_NtiMin_N_Value: accessed-variable=VaOSMR_n_NtiMin_N.Value
              OUT_VaOSMR_n_NtiMax_Gr_Value: accessed-variable=VaOSMR_n_NtiMax_Gr.Value
              OUT_VaOSMR_n_NtiMin_Gr_Value: accessed-variable=VaOSMR_n_NtiMin_Gr.Value
              OUT_VaOSMR_n_NtiMax_EVM_Value: accessed-variable=VaOSMR_n_NtiMax_EVM.Value
              OUT_VaOSMR_n_NtiMin_EVM_Value: accessed-variable=VaOSMR_n_NtiMin_EVM.Value
              OUT_VaOSMR_n_NtiMax_EVN_Value: accessed-variable=VaOSMR_n_NtiMax_EVN.Value
              OUT_VaOSMR_n_NtiMin_EVN_Value: accessed-variable=VaOSMR_n_NtiMin_EVN.Value
              OUT_VeOSMR_n_InputSpdMaxMAAct_Value: accessed-variable=VeOSMR_n_InputSpdMaxMAAct.Value
              OUT_VeOSMR_n_InputSpdMinMAAct_Value: accessed-variable=VeOSMR_n_InputSpdMinMAAct.Value
              OUT_VeOSMR_n_InputSpdMinMBAct_Value: accessed-variable=VeOSMR_n_InputSpdMinMBAct.Value
              OUT_VeOSMR_n_InputSpdMaxMBAct_Value: accessed-variable=VeOSMR_n_InputSpdMaxMBAct.Value
              OUT_VeOSMR_n_InputSpdMinNAct_Value: accessed-variable=VeOSMR_n_InputSpdMinNAct.Value
              OUT_VeOSMR_n_InputSpdMaxNAct_Value: accessed-variable=VeOSMR_n_InputSpdMaxNAct.Value
              OUT_VeOSMR_n_InputSpdMinNTgt_Value: accessed-variable=VeOSMR_n_InputSpdMinNTgt.Value
              OUT_VeOSMR_n_InputSpdMaxNTgt_Value: accessed-variable=VeOSMR_n_InputSpdMaxNTgt.Value
              OUT_VaOSMR_n_InputSpdMinMBNR_Value: accessed-variable=VaOSMR_n_InputSpdMinMBNR.Value
              OUT_VaOSMR_n_InputSpdMaxMBNR_Value: accessed-variable=VaOSMR_n_InputSpdMaxMBNR.Value
              OUT_VaOSMR_i_MinGrPerRngSt_Value: accessed-variable=VaOSMR_i_MinGrPerRngSt.Value
              OUT_VaOSMR_i_MaxGrPerRngSt_Value: accessed-variable=VaOSMR_i_MaxGrPerRngSt.Value
              OUT_VeOSMR_M_OutTorqReqBrake_Value: accessed-variable=VeOSMR_M_OutTorqReqBrake.Value
              OUT_VeOSMR_M_InputAccTorq_Value: accessed-variable=VeOSMR_M_InputAccTorq.Value
              OUT_VaOSMR_n_NC1Min_N_Value: accessed-variable=VaOSMR_n_NC1Min_N.Value
              OUT_VaOSMR_n_NC1Max_N_Value: accessed-variable=VaOSMR_n_NC1Max_N.Value
              OUT_VaOSMR_n_NC1Min_EVN_Value: accessed-variable=VaOSMR_n_NC1Min_EVN.Value
              OUT_VaOSMR_n_NC1Max_EVN_Value: accessed-variable=VaOSMR_n_NC1Max_EVN.Value
              OUT_VaOSMR_n_NC2Max_EVN_Value: accessed-variable=VaOSMR_n_NC2Max_EVN.Value
              OUT_VaOSMR_n_NC2Min_EVN_Value: accessed-variable=VaOSMR_n_NC2Min_EVN.Value
              OUT_VaOSMR_n_NC2Max_N_Value: accessed-variable=VaOSMR_n_NC2Max_N.Value
              OUT_VaOSMR_n_NC2Min_N_Value: accessed-variable=VaOSMR_n_NC2Min_N.Value
              OUT_VeOSMR_b_StgcInGSIMode_Value: accessed-variable=VeOSMR_b_StgcInGSIMode.Value
              OUT_VeOSMR_d_StgcRngSts_AllowedMB_Value: accessed-variable=VeOSMR_d_StgcRngSts_AllowedMB.Value
              OUT_VeOSMR_d_StgcRngSts_AllowedGr_Value: accessed-variable=VeOSMR_d_StgcRngSts_AllowedGr.Value
              OUT_VeOSMR_d_StgcRngSts_AllowedEVM_Value: accessed-variable=VeOSMR_d_StgcRngSts_AllowedEVM.Value
              OUT_VeOSMR_d_StgcRngSts_AllowedEVN_Value: accessed-variable=VeOSMR_d_StgcRngSts_AllowedEVN.Value
              OUT_VeOSMR_d_FxdGrRngSts_AllowedMA_Value: accessed-variable=VeOSMR_d_FxdGrRngSts_AllowedMA.Value
              OUT_VeOSMR_d_FxdGrRngSts_AllowedMB_Value: accessed-variable=VeOSMR_d_FxdGrRngSts_AllowedMB.Value
              OUT_VeOSMR_d_FxdGrRngSts_AllowedN_Value: accessed-variable=VeOSMR_d_FxdGrRngSts_AllowedN.Value
              OUT_VeOSMR_d_FxdGrRngSts_AllowedGr_Value: accessed-variable=VeOSMR_d_FxdGrRngSts_AllowedGr.Value
              OUT_VeOSMR_d_FxdGrRngSts_AllowedEVM_Value: accessed-variable=VeOSMR_d_FxdGrRngSts_AllowedEVM.Value
              OUT_VeOSMR_d_FxdGrRngSts_AllowedEVN_Value: accessed-variable=VeOSMR_d_FxdGrRngSts_AllowedEVN.Value
              OUT_VeOSMR_e_TargetGear_GSI_Value: accessed-variable=VeOSMR_e_TargetGear_GSI.Value
              OUT_VeOSMR_d_SoftCheckAllwd_MA_Value: accessed-variable=VeOSMR_d_SoftCheckAllwd_MA.Value
              OUT_VeOSMR_d_SoftCheckAllwd_MB_Value: accessed-variable=VeOSMR_d_SoftCheckAllwd_MB.Value
              OUT_VeOSMR_d_SoftCheckAllwd_N_Value: accessed-variable=VeOSMR_d_SoftCheckAllwd_N.Value
              OUT_VeOSMR_d_SoftCheckAllwd_Gr_Value: accessed-variable=VeOSMR_d_SoftCheckAllwd_Gr.Value
              OUT_VeOSMR_d_SoftCheckAllwd_EVM_Value: accessed-variable=VeOSMR_d_SoftCheckAllwd_EVM.Value
              OUT_VeOSMR_d_SoftCheckAllwd_EVN_Value: accessed-variable=VeOSMR_d_SoftCheckAllwd_EVN.Value
              OUT_VeOSMR_i_Hybrid_ST2Idx_Value: accessed-variable=VeOSMR_i_Hybrid_ST2Idx.Value
              OUT_VeOSMR_d_ManualAllowedN_Value: accessed-variable=VeOSMR_d_ManualAllowedN.Value
              OUT_VeOSMR_d_ManualAllowedMA_Value: accessed-variable=VeOSMR_d_ManualAllowedMA.Value
              OUT_VeOSMR_d_ManualAllowedMB_Value: accessed-variable=VeOSMR_d_ManualAllowedMB.Value
              OUT_VeOSMR_d_ManualAllowedGr_Value: accessed-variable=VeOSMR_d_ManualAllowedGr.Value
              OUT_VeOSMR_d_ManualAllowedEVN_Value: accessed-variable=VeOSMR_d_ManualAllowedEVN.Value
              OUT_VeOSMR_d_ManualAllowedEVM_Value: accessed-variable=VeOSMR_d_ManualAllowedEVM.Value
              OUT_VaOSMR_d_FinalAllwdOpt_Value: accessed-variable=VaOSMR_d_FinalAllwdOpt.Value
              OUT_VaOSMR_d_FinalAllwdDsrd_Value: accessed-variable=VaOSMR_d_FinalAllwdDsrd.Value
              OUT_VaOSMR_d_FinalAllwdFxdGr_Value: accessed-variable=VaOSMR_d_FinalAllwdFxdGr.Value
              OUT_VeOSMR_b_EngOffAllwdOpt_Value: accessed-variable=VeOSMR_b_EngOffAllwdOpt.Value
              OUT_VeOSMR_b_DisableLaunch_Value: accessed-variable=VeOSMR_b_DisableLaunch.Value
              OUT_VaOSMR_d_HardAllwdRaw_Value: accessed-variable=VaOSMR_d_HardAllwdRaw.Value
              OUT_VeOSMR_Cnt_IdxLength_MA_Value: accessed-variable=VeOSMR_Cnt_IdxLength_MA.Value
              OUT_VeOSMR_Cnt_IdxLength_EVN_Value: accessed-variable=VeOSMR_Cnt_IdxLength_EVN.Value
              OUT_VaOSMR_i_IndexAllowed_Gr_Value: accessed-variable=VaOSMR_i_IndexAllowed_Gr.Value
              OUT_VeOSMR_Cnt_IdxLength_Gr_Value: accessed-variable=VeOSMR_Cnt_IdxLength_Gr.Value
              OUT_VaOSMR_i_IndexAllowed_MB_Value: accessed-variable=VaOSMR_i_IndexAllowed_MB.Value
              OUT_VeOSMR_Cnt_IdxLength_MB_Value: accessed-variable=VeOSMR_Cnt_IdxLength_MB.Value
              OUT_VaOSMR_i_IndexAllowed_N_Value: accessed-variable=VaOSMR_i_IndexAllowed_N.Value
              OUT_VeOSMR_Cnt_IdxLength_N_Value: accessed-variable=VeOSMR_Cnt_IdxLength_N.Value
              OUT_VaOSMR_i_IndexAllowed_MBNR_Value: accessed-variable=VaOSMR_i_IndexAllowed_MBNR.Value
              OUT_VeOSMR_Cnt_IdxLength_MBNR_Value: accessed-variable=VeOSMR_Cnt_IdxLength_MBNR.Value
              OUT_VaOSMR_i_IndexAllowed_MA_Value: accessed-variable=VaOSMR_i_IndexAllowed_MA.Value
              OUT_VaOSMR_i_IndexAllowed_EVM_Value: accessed-variable=VaOSMR_i_IndexAllowed_EVM.Value
              OUT_VeOSMR_Cnt_IdxLength_EVM_Value: accessed-variable=VeOSMR_Cnt_IdxLength_EVM.Value
              OUT_VaOSMR_i_IndexAllowed_EVN_Value: accessed-variable=VaOSMR_i_IndexAllowed_EVN.Value
              OUT_VeOSMR_d_FnctnEnblReg_Value: accessed-variable=VeOSMR_d_FnctnEnblReg.Value
              OUT_VeOSMR_n_InputSpdMinMATgt_Value: accessed-variable=VeOSMR_n_InputSpdMinMATgt.Value
              OUT_VeOSMR_n_InputSpdMaxMATgt_Value: accessed-variable=VeOSMR_n_InputSpdMaxMATgt.Value
              OUT_VeOSMR_n_InputSpdMinMBTgt_Value: accessed-variable=VeOSMR_n_InputSpdMinMBTgt.Value
              OUT_VeOSMR_n_InputSpdMaxMBTgt_Value: accessed-variable=VeOSMR_n_InputSpdMaxMBTgt.Value
              OUT_VeOSMR_n_InputSpdMinM1_ToilDep_Value: accessed-variable=VeOSMR_n_InputSpdMinM1_ToilDep.Value
              OUT_VeOSMR_n_InputSpdMaxM1_ToilDep_Value: accessed-variable=VeOSMR_n_InputSpdMaxM1_ToilDep.Value
              OUT_VeOSMR_n_InputSpdMinM2_ToilDep_Value: accessed-variable=VeOSMR_n_InputSpdMinM2_ToilDep.Value
              OUT_VeOSMR_n_InputSpdMaxM2_ToilDep_Value: accessed-variable=VeOSMR_n_InputSpdMaxM2_ToilDep.Value
              OUT_VeOSMR_n_InputSpdMinM1_Value: accessed-variable=VeOSMR_n_InputSpdMinM1.Value
              OUT_VeOSMR_n_InputSpdMaxM1_Value: accessed-variable=VeOSMR_n_InputSpdMaxM1.Value
              OUT_VeOSMR_n_InputSpdMinM2_Value: accessed-variable=VeOSMR_n_InputSpdMinM2.Value
              OUT_VeOSMR_n_InputSpdMaxM2_Value: accessed-variable=VeOSMR_n_InputSpdMaxM2.Value
              OUT_VeOSMR_n_NoMax_M1_WithWideMargin_Value: accessed-variable=VeOSMR_n_NoMax_M1_WithWideMargin.Value
              OUT_VeOSMR_b_WEDclsdAllwdOpt_Value: accessed-variable=VeOSMR_b_WEDclsdAllwdOpt.Value
              OUT_VeOSMR_P_PoMaxLinConstrn_Value: accessed-variable=VeOSMR_P_PoMaxLinConstrn.Value
              OUT_VeOSMR_n_TransOutSpdSqncd_Value: accessed-variable=VeOSMR_n_TransOutSpdSqncd.Value
              OUT_VeOSMR_n_TransOutSpdRawSqncd_Value: accessed-variable=VeOSMR_n_TransOutSpdRawSqncd.Value
          82 x parameter access:
            CALPRM_HaTSXR_b_EVM_NoEqn1Mtrx_HaTSXR_b_EVM_NoEqn1Mtrx: accessed-parameter=HaTSXR_b_EVM_NoEqn1Mtrx.HaTSXR_b_EVM_NoEqn1Mtrx, variation-point={short-label=vpCALPRM_HaTSXR_b_EVM_NoEqn1Mtrx_HaTSXR_b_EVM_NoEqn1Mtrx, sw-syscond=1}
            CALPRM_HaTSXR_b_EVM_NoEqn2Mtrx_HaTSXR_b_EVM_NoEqn2Mtrx: accessed-parameter=HaTSXR_b_EVM_NoEqn2Mtrx.HaTSXR_b_EVM_NoEqn2Mtrx, variation-point={short-label=vpCALPRM_HaTSXR_b_EVM_NoEqn2Mtrx_HaTSXR_b_EVM_NoEqn2Mtrx, sw-syscond=1}
            CALPRM_HaTSXR_b_EVM_NtiEqn1Mtrx_HaTSXR_b_EVM_NtiEqn1Mtrx: accessed-parameter=HaTSXR_b_EVM_NtiEqn1Mtrx.HaTSXR_b_EVM_NtiEqn1Mtrx, variation-point={short-label=vpCALPRM_HaTSXR_b_EVM_NtiEqn1Mtrx_HaTSXR_b_EVM_NtiEqn1Mtrx, sw-syscond=1}
            CALPRM_HaTSXR_b_EVM_NtiEqn2Mtrx_HaTSXR_b_EVM_NtiEqn2Mtrx: accessed-parameter=HaTSXR_b_EVM_NtiEqn2Mtrx.HaTSXR_b_EVM_NtiEqn2Mtrx, variation-point={short-label=vpCALPRM_HaTSXR_b_EVM_NtiEqn2Mtrx_HaTSXR_b_EVM_NtiEqn2Mtrx, sw-syscond=1}
            CALPRM_HaTSXR_b_EVN_Nc1Eqn2Mtrx_HaTSXR_b_EVN_Nc1Eqn2Mtrx: accessed-parameter=HaTSXR_b_EVN_Nc1Eqn2Mtrx.HaTSXR_b_EVN_Nc1Eqn2Mtrx, variation-point={short-label=vpCALPRM_HaTSXR_b_EVN_Nc1Eqn2Mtrx_HaTSXR_b_EVN_Nc1Eqn2Mtrx, sw-syscond=1}
            CALPRM_HaTSXR_b_EVN_NoEqn1Mtrx_HaTSXR_b_EVN_NoEqn1Mtrx: accessed-parameter=HaTSXR_b_EVN_NoEqn1Mtrx.HaTSXR_b_EVN_NoEqn1Mtrx, variation-point={short-label=vpCALPRM_HaTSXR_b_EVN_NoEqn1Mtrx_HaTSXR_b_EVN_NoEqn1Mtrx, sw-syscond=1}
            CALPRM_HaTSXR_b_EVN_NoEqn2Mtrx_HaTSXR_b_EVN_NoEqn2Mtrx: accessed-parameter=HaTSXR_b_EVN_NoEqn2Mtrx.HaTSXR_b_EVN_NoEqn2Mtrx, variation-point={short-label=vpCALPRM_HaTSXR_b_EVN_NoEqn2Mtrx_HaTSXR_b_EVN_NoEqn2Mtrx, sw-syscond=1}
            CALPRM_HaTSXR_b_EVN_NtiEqn1Mtrx_HaTSXR_b_EVN_NtiEqn1Mtrx: accessed-parameter=HaTSXR_b_EVN_NtiEqn1Mtrx.HaTSXR_b_EVN_NtiEqn1Mtrx, variation-point={short-label=vpCALPRM_HaTSXR_b_EVN_NtiEqn1Mtrx_HaTSXR_b_EVN_NtiEqn1Mtrx, sw-syscond=1}
            CALPRM_HaTSXR_b_EVN_NtiEqn2Mtrx_HaTSXR_b_EVN_NtiEqn2Mtrx: accessed-parameter=HaTSXR_b_EVN_NtiEqn2Mtrx.HaTSXR_b_EVN_NtiEqn2Mtrx, variation-point={short-label=vpCALPRM_HaTSXR_b_EVN_NtiEqn2Mtrx_HaTSXR_b_EVN_NtiEqn2Mtrx, sw-syscond=1}
            CALPRM_HeOPTR_b_FixedGrDpndntRngSt_EVM_HeOPTR_b_FixedGrDpndntRngSt_EVM: accessed-parameter=HeOPTR_b_FixedGrDpndntRngSt_EVM.HeOPTR_b_FixedGrDpndntRngSt_EVM
            CALPRM_HeOPTR_b_FixedGrDpndntRngSt_EVN_HeOPTR_b_FixedGrDpndntRngSt_EVN: accessed-parameter=HeOPTR_b_FixedGrDpndntRngSt_EVN.HeOPTR_b_FixedGrDpndntRngSt_EVN
            CALPRM_HeOPTR_b_FixedGrDpndntRngSt_Gr_HeOPTR_b_FixedGrDpndntRngSt_Gr: accessed-parameter=HeOPTR_b_FixedGrDpndntRngSt_Gr.HeOPTR_b_FixedGrDpndntRngSt_Gr
            CALPRM_HeOPTR_b_FixedGrDpndntRngSt_MA_HeOPTR_b_FixedGrDpndntRngSt_MA: accessed-parameter=HeOPTR_b_FixedGrDpndntRngSt_MA.HeOPTR_b_FixedGrDpndntRngSt_MA
            CALPRM_HeOPTR_b_FixedGrDpndntRngSt_MB_HeOPTR_b_FixedGrDpndntRngSt_MB: accessed-parameter=HeOPTR_b_FixedGrDpndntRngSt_MB.HeOPTR_b_FixedGrDpndntRngSt_MB
            CALPRM_HeOPTR_b_FixedGrDpndntRngSt_N_GA_HeOPTR_b_FixedGrDpndntRngSt_N_GA: accessed-parameter=HeOPTR_b_FixedGrDpndntRngSt_N_GA.HeOPTR_b_FixedGrDpndntRngSt_N_GA
            CALPRM_KaOPTR_b_RGS_Gears_Sel_KaOPTR_b_RGS_Gears_Sel: accessed-parameter=KaOPTR_b_RGS_Gears_Sel.KaOPTR_b_RGS_Gears_Sel
            CALPRM_KaOPTR_b_ZeroRPMAllowPRNDL_KaOPTR_b_ZeroRPMAllowPRNDL: accessed-parameter=KaOPTR_b_ZeroRPMAllowPRNDL.KaOPTR_b_ZeroRPMAllowPRNDL
            CALPRM_KaOPTR_b_ZeroRPMAllowTCase_KaOPTR_b_ZeroRPMAllowTCase: accessed-parameter=KaOPTR_b_ZeroRPMAllowTCase.KaOPTR_b_ZeroRPMAllowTCase
            CALPRM_KaTSXR_r_All_Nt2StratNoRatio_KaTSXR_r_All_Nt2StratNoRatio: accessed-parameter=KaTSXR_r_All_Nt2StratNoRatio.KaTSXR_r_All_Nt2StratNoRatio
            CALPRM_KaTSXR_r_EVM_NaCalcEqnMtrx_KaTSXR_r_EVM_NaCalcEqnMtrx: accessed-parameter=KaTSXR_r_EVM_NaCalcEqnMtrx.KaTSXR_r_EVM_NaCalcEqnMtrx
            CALPRM_KaTSXR_r_EVM_NbCalcEqnMtrx_KaTSXR_r_EVM_NbCalcEqnMtrx: accessed-parameter=KaTSXR_r_EVM_NbCalcEqnMtrx.KaTSXR_r_EVM_NbCalcEqnMtrx
            CALPRM_KaTSXR_r_EVM_Nc1CalcEqnMtrx_KaTSXR_r_EVM_Nc1CalcEqnMtrx: accessed-parameter=KaTSXR_r_EVM_Nc1CalcEqnMtrx.KaTSXR_r_EVM_Nc1CalcEqnMtrx
            CALPRM_KaTSXR_r_EVM_NcCalcEqnMtrx_KaTSXR_r_EVM_NcCalcEqnMtrx: accessed-parameter=KaTSXR_r_EVM_NcCalcEqnMtrx.KaTSXR_r_EVM_NcCalcEqnMtrx
            CALPRM_KaTSXR_r_EVM_NoEqn1Mtrx_KaTSXR_r_EVM_NoEqn1Mtrx: accessed-parameter=KaTSXR_r_EVM_NoEqn1Mtrx.KaTSXR_r_EVM_NoEqn1Mtrx, variation-point={short-label=vpCALPRM_KaTSXR_r_EVM_NoEqn1Mtrx_KaTSXR_r_EVM_NoEqn1Mtrx, sw-syscond=1}
            CALPRM_KaTSXR_r_EVM_NoEqn2Mtrx_KaTSXR_r_EVM_NoEqn2Mtrx: accessed-parameter=KaTSXR_r_EVM_NoEqn2Mtrx.KaTSXR_r_EVM_NoEqn2Mtrx, variation-point={short-label=vpCALPRM_KaTSXR_r_EVM_NoEqn2Mtrx_KaTSXR_r_EVM_NoEqn2Mtrx, sw-syscond=1}
            CALPRM_KaTSXR_r_EVM_NtiEqn1Mtrx_KaTSXR_r_EVM_NtiEqn1Mtrx: accessed-parameter=KaTSXR_r_EVM_NtiEqn1Mtrx.KaTSXR_r_EVM_NtiEqn1Mtrx, variation-point={short-label=vpCALPRM_KaTSXR_r_EVM_NtiEqn1Mtrx_KaTSXR_r_EVM_NtiEqn1Mtrx, sw-syscond=1}
            CALPRM_KaTSXR_r_EVM_NtiEqn2Mtrx_KaTSXR_r_EVM_NtiEqn2Mtrx: accessed-parameter=KaTSXR_r_EVM_NtiEqn2Mtrx.KaTSXR_r_EVM_NtiEqn2Mtrx, variation-point={short-label=vpCALPRM_KaTSXR_r_EVM_NtiEqn2Mtrx_KaTSXR_r_EVM_NtiEqn2Mtrx, sw-syscond=1}
            CALPRM_KaTSXR_r_EVM_TM1_ToConstrn_KaTSXR_r_EVM_TM1_ToConstrn: accessed-parameter=KaTSXR_r_EVM_TM1_ToConstrn.KaTSXR_r_EVM_TM1_ToConstrn
            CALPRM_KaTSXR_r_EVN_NaCalcEqnMtrx_KaTSXR_r_EVN_NaCalcEqnMtrx: accessed-parameter=KaTSXR_r_EVN_NaCalcEqnMtrx.KaTSXR_r_EVN_NaCalcEqnMtrx
            CALPRM_KaTSXR_r_EVN_NbCalcEqnMtrx_KaTSXR_r_EVN_NbCalcEqnMtrx: accessed-parameter=KaTSXR_r_EVN_NbCalcEqnMtrx.KaTSXR_r_EVN_NbCalcEqnMtrx
            CALPRM_KaTSXR_r_EVN_Nc1CalcEqnMtrx_KaTSXR_r_EVN_Nc1CalcEqnMtrx: accessed-parameter=KaTSXR_r_EVN_Nc1CalcEqnMtrx.KaTSXR_r_EVN_Nc1CalcEqnMtrx
            CALPRM_KaTSXR_r_EVN_Nc1Eqn1Mtrx_KaTSXR_r_EVN_Nc1Eqn1Mtrx: accessed-parameter=KaTSXR_r_EVN_Nc1Eqn1Mtrx.KaTSXR_r_EVN_Nc1Eqn1Mtrx, variation-point={short-label=vpCALPRM_KaTSXR_r_EVN_Nc1Eqn1Mtrx_KaTSXR_r_EVN_Nc1Eqn1Mtrx, sw-syscond=1}
            CALPRM_KaTSXR_r_EVN_Nc1Eqn2Mtrx_KaTSXR_r_EVN_Nc1Eqn2Mtrx: accessed-parameter=KaTSXR_r_EVN_Nc1Eqn2Mtrx.KaTSXR_r_EVN_Nc1Eqn2Mtrx, variation-point={short-label=vpCALPRM_KaTSXR_r_EVN_Nc1Eqn2Mtrx_KaTSXR_r_EVN_Nc1Eqn2Mtrx, sw-syscond=1}
            CALPRM_KaTSXR_r_EVN_Nc1TargetEqnMtrx_KaTSXR_r_EVN_Nc1TargetEqnMtrx: accessed-parameter=KaTSXR_r_EVN_Nc1TargetEqnMtrx.KaTSXR_r_EVN_Nc1TargetEqnMtrx
            CALPRM_KaTSXR_r_EVN_NcCalcEqnMtrx_KaTSXR_r_EVN_NcCalcEqnMtrx: accessed-parameter=KaTSXR_r_EVN_NcCalcEqnMtrx.KaTSXR_r_EVN_NcCalcEqnMtrx
            CALPRM_KaTSXR_r_EVN_NoEqn1Mtrx_KaTSXR_r_EVN_NoEqn1Mtrx: accessed-parameter=KaTSXR_r_EVN_NoEqn1Mtrx.KaTSXR_r_EVN_NoEqn1Mtrx, variation-point={short-label=vpCALPRM_KaTSXR_r_EVN_NoEqn1Mtrx_KaTSXR_r_EVN_NoEqn1Mtrx, sw-syscond=1}
            CALPRM_KaTSXR_r_EVN_NoEqn2Mtrx_KaTSXR_r_EVN_NoEqn2Mtrx: accessed-parameter=KaTSXR_r_EVN_NoEqn2Mtrx.KaTSXR_r_EVN_NoEqn2Mtrx, variation-point={short-label=vpCALPRM_KaTSXR_r_EVN_NoEqn2Mtrx_KaTSXR_r_EVN_NoEqn2Mtrx, sw-syscond=1}
            CALPRM_KaTSXR_r_EVN_NtiEqn1Mtrx_KaTSXR_r_EVN_NtiEqn1Mtrx: accessed-parameter=KaTSXR_r_EVN_NtiEqn1Mtrx.KaTSXR_r_EVN_NtiEqn1Mtrx, variation-point={short-label=vpCALPRM_KaTSXR_r_EVN_NtiEqn1Mtrx_KaTSXR_r_EVN_NtiEqn1Mtrx, sw-syscond=1}
            CALPRM_KaTSXR_r_EVN_NtiEqn2Mtrx_KaTSXR_r_EVN_NtiEqn2Mtrx: accessed-parameter=KaTSXR_r_EVN_NtiEqn2Mtrx.KaTSXR_r_EVN_NtiEqn2Mtrx, variation-point={short-label=vpCALPRM_KaTSXR_r_EVN_NtiEqn2Mtrx_KaTSXR_r_EVN_NtiEqn2Mtrx, sw-syscond=1}
            CALPRM_KaTSXR_r_EVN_TM1_ToConstrn_KaTSXR_r_EVN_TM1_ToConstrn: accessed-parameter=KaTSXR_r_EVN_TM1_ToConstrn.KaTSXR_r_EVN_TM1_ToConstrn
            CALPRM_KaTSXR_r_G_NaCalcEqnMtrx_KaTSXR_r_G_NaCalcEqnMtrx: accessed-parameter=KaTSXR_r_G_NaCalcEqnMtrx.KaTSXR_r_G_NaCalcEqnMtrx
            CALPRM_KaTSXR_r_G_NbCalcEqnMtrx_KaTSXR_r_G_NbCalcEqnMtrx: accessed-parameter=KaTSXR_r_G_NbCalcEqnMtrx.KaTSXR_r_G_NbCalcEqnMtrx
            CALPRM_KaTSXR_r_G_Nc1CalcEqnMtrx_KaTSXR_r_G_Nc1CalcEqnMtrx: accessed-parameter=KaTSXR_r_G_Nc1CalcEqnMtrx.KaTSXR_r_G_Nc1CalcEqnMtrx
            CALPRM_KaTSXR_r_G_NcCalcEqnMtrx_KaTSXR_r_G_NcCalcEqnMtrx: accessed-parameter=KaTSXR_r_G_NcCalcEqnMtrx.KaTSXR_r_G_NcCalcEqnMtrx
            CALPRM_KaTSXR_r_G_TM1_ToConstrn_KaTSXR_r_G_TM1_ToConstrn: accessed-parameter=KaTSXR_r_G_TM1_ToConstrn.KaTSXR_r_G_TM1_ToConstrn
            CALPRM_KaTSXR_r_MA_NaCalcEqnMtrx_KaTSXR_r_MA_NaCalcEqnMtrx: accessed-parameter=KaTSXR_r_MA_NaCalcEqnMtrx.KaTSXR_r_MA_NaCalcEqnMtrx
            CALPRM_KaTSXR_r_MA_NbCalcEqnMtrx_KaTSXR_r_MA_NbCalcEqnMtrx: accessed-parameter=KaTSXR_r_MA_NbCalcEqnMtrx.KaTSXR_r_MA_NbCalcEqnMtrx
            CALPRM_KaTSXR_r_MA_Nc1CalcEqnMtrx_KaTSXR_r_MA_Nc1CalcEqnMtrx: accessed-parameter=KaTSXR_r_MA_Nc1CalcEqnMtrx.KaTSXR_r_MA_Nc1CalcEqnMtrx
            CALPRM_KaTSXR_r_MA_NcCalcEqnMtrx_KaTSXR_r_MA_NcCalcEqnMtrx: accessed-parameter=KaTSXR_r_MA_NcCalcEqnMtrx.KaTSXR_r_MA_NcCalcEqnMtrx
            CALPRM_KaTSXR_r_MA_TM1_ToConstrn_KaTSXR_r_MA_TM1_ToConstrn: accessed-parameter=KaTSXR_r_MA_TM1_ToConstrn.KaTSXR_r_MA_TM1_ToConstrn
            CALPRM_KaTSXR_r_MB_NaCalcEqnMtrx_KaTSXR_r_MB_NaCalcEqnMtrx: accessed-parameter=KaTSXR_r_MB_NaCalcEqnMtrx.KaTSXR_r_MB_NaCalcEqnMtrx
            CALPRM_KaTSXR_r_MB_NbCalcEqnMtrx_KaTSXR_r_MB_NbCalcEqnMtrx: accessed-parameter=KaTSXR_r_MB_NbCalcEqnMtrx.KaTSXR_r_MB_NbCalcEqnMtrx
            CALPRM_KaTSXR_r_MB_Nc1CalcEqnMtrx_KaTSXR_r_MB_Nc1CalcEqnMtrx: accessed-parameter=KaTSXR_r_MB_Nc1CalcEqnMtrx.KaTSXR_r_MB_Nc1CalcEqnMtrx
            CALPRM_KaTSXR_r_MB_NcCalcEqnMtrx_KaTSXR_r_MB_NcCalcEqnMtrx: accessed-parameter=KaTSXR_r_MB_NcCalcEqnMtrx.KaTSXR_r_MB_NcCalcEqnMtrx
            CALPRM_KaTSXR_r_MB_TM1_ToConstrn_KaTSXR_r_MB_TM1_ToConstrn: accessed-parameter=KaTSXR_r_MB_TM1_ToConstrn.KaTSXR_r_MB_TM1_ToConstrn
            CALPRM_KaTSXR_r_N_NaCalcEqnMtrx_KaTSXR_r_N_NaCalcEqnMtrx: accessed-parameter=KaTSXR_r_N_NaCalcEqnMtrx.KaTSXR_r_N_NaCalcEqnMtrx, variation-point={short-label=vpCALPRM_KaTSXR_r_N_NaCalcEqnMtrx_KaTSXR_r_N_NaCalcEqnMtrx, sw-syscond=1}
            CALPRM_KaTSXR_r_N_NbCalcEqnMtrx_KaTSXR_r_N_NbCalcEqnMtrx: accessed-parameter=KaTSXR_r_N_NbCalcEqnMtrx.KaTSXR_r_N_NbCalcEqnMtrx, variation-point={short-label=vpCALPRM_KaTSXR_r_N_NbCalcEqnMtrx_KaTSXR_r_N_NbCalcEqnMtrx, sw-syscond=1}
            CALPRM_KaTSXR_r_N_Nc1CalcEqnMtrx_KaTSXR_r_N_Nc1CalcEqnMtrx: accessed-parameter=KaTSXR_r_N_Nc1CalcEqnMtrx.KaTSXR_r_N_Nc1CalcEqnMtrx, variation-point={short-label=vpCALPRM_KaTSXR_r_N_Nc1CalcEqnMtrx_KaTSXR_r_N_Nc1CalcEqnMtrx, sw-syscond=1}
            CALPRM_KaTSXR_r_N_Nc1TargetEqnMtrx_KaTSXR_r_N_Nc1TargetEqnMtrx: accessed-parameter=KaTSXR_r_N_Nc1TargetEqnMtrx.KaTSXR_r_N_Nc1TargetEqnMtrx, variation-point={short-label=vpCALPRM_KaTSXR_r_N_Nc1TargetEqnMtrx_KaTSXR_r_N_Nc1TargetEqnMtrx, sw-syscond=1}
            CALPRM_KaTSXR_r_N_NcCalcEqnMtrx_KaTSXR_r_N_NcCalcEqnMtrx: accessed-parameter=KaTSXR_r_N_NcCalcEqnMtrx.KaTSXR_r_N_NcCalcEqnMtrx, variation-point={short-label=vpCALPRM_KaTSXR_r_N_NcCalcEqnMtrx_KaTSXR_r_N_NcCalcEqnMtrx, sw-syscond=1}
            CALPRM_KaTSXR_r_N_TM1_ToConstrn_KaTSXR_r_N_TM1_ToConstrn: accessed-parameter=KaTSXR_r_N_TM1_ToConstrn.KaTSXR_r_N_TM1_ToConstrn, variation-point={short-label=vpCALPRM_KaTSXR_r_N_TM1_ToConstrn_KaTSXR_r_N_TM1_ToConstrn, sw-syscond=1}
            CALPRM_KeOPTR_M_P2ZeroIdle_2Pdl_BrkTrq_LSP_KeOPTR_M_P2ZeroIdle_2Pdl_BrkTrq_LSP: accessed-parameter=KeOPTR_M_P2ZeroIdle_2Pdl_BrkTrq_LSP.KeOPTR_M_P2ZeroIdle_2Pdl_BrkTrq_LSP
            CALPRM_KeOPTR_M_P2ZeroIdle_2Pdl_BrkTrq_RSP_KeOPTR_M_P2ZeroIdle_2Pdl_BrkTrq_RSP: accessed-parameter=KeOPTR_M_P2ZeroIdle_2Pdl_BrkTrq_RSP.KeOPTR_M_P2ZeroIdle_2Pdl_BrkTrq_RSP
            CALPRM_KeOPTR_M_P2ZeroIdle_BrkTrqMin_RSP_OS_KeOPTR_M_P2ZeroIdle_BrkTrqMin_RSP_OS: accessed-parameter=KeOPTR_M_P2ZeroIdle_BrkTrqMin_RSP_OS.KeOPTR_M_P2ZeroIdle_BrkTrqMin_RSP_OS
            CALPRM_KeOPTR_Pct_P2ZeroIdle_2Pdl_Acl_LSP_KeOPTR_Pct_P2ZeroIdle_2Pdl_Acl_LSP: accessed-parameter=KeOPTR_Pct_P2ZeroIdle_2Pdl_Acl_LSP.KeOPTR_Pct_P2ZeroIdle_2Pdl_Acl_LSP
            CALPRM_KeOPTR_Pct_P2ZeroIdle_2Pdl_Acl_RSP_KeOPTR_Pct_P2ZeroIdle_2Pdl_Acl_RSP: accessed-parameter=KeOPTR_Pct_P2ZeroIdle_2Pdl_Acl_RSP.KeOPTR_Pct_P2ZeroIdle_2Pdl_Acl_RSP
            CALPRM_KeOPTR_b_RGS_Threshold_Disable_KeOPTR_b_RGS_Threshold_Disable: accessed-parameter=KeOPTR_b_RGS_Threshold_Disable.KeOPTR_b_RGS_Threshold_Disable
            CALPRM_KeOPTR_n_P2Idle_ZeroRPM_KeOPTR_n_P2Idle_ZeroRPM: accessed-parameter=KeOPTR_n_P2Idle_ZeroRPM.KeOPTR_n_P2Idle_ZeroRPM
            CALPRM_KeOPTR_n_P2MinIdle_TransMinSpd_LSP_KeOPTR_n_P2MinIdle_TransMinSpd_LSP: accessed-parameter=KeOPTR_n_P2MinIdle_TransMinSpd_LSP.KeOPTR_n_P2MinIdle_TransMinSpd_LSP
            CALPRM_KeOPTR_n_P2MinIdle_TransMinSpd_RSP_KeOPTR_n_P2MinIdle_TransMinSpd_RSP: accessed-parameter=KeOPTR_n_P2MinIdle_TransMinSpd_RSP.KeOPTR_n_P2MinIdle_TransMinSpd_RSP
            CALPRM_KeOPTR_n_P2ZeroIdle_NoMax_LSP_KeOPTR_n_P2ZeroIdle_NoMax_LSP: accessed-parameter=KeOPTR_n_P2ZeroIdle_NoMax_LSP.KeOPTR_n_P2ZeroIdle_NoMax_LSP
            CALPRM_KeOPTR_n_P2ZeroIdle_NoMax_RSP_KeOPTR_n_P2ZeroIdle_NoMax_RSP: accessed-parameter=KeOPTR_n_P2ZeroIdle_NoMax_RSP.KeOPTR_n_P2ZeroIdle_NoMax_RSP
            CALPRM_KeOPTR_n_RGS_ActivationThreshold_KeOPTR_n_RGS_ActivationThreshold: accessed-parameter=KeOPTR_n_RGS_ActivationThreshold.KeOPTR_n_RGS_ActivationThreshold
            CALPRM_KeOPTR_n_RGS_IdleSpd_KeOPTR_n_RGS_IdleSpd: accessed-parameter=KeOPTR_n_RGS_IdleSpd.KeOPTR_n_RGS_IdleSpd
            CALPRM_KeOPTR_t_BrkTrq_TstDer_CutOffT_KeOPTR_t_BrkTrq_TstDer_CutOffT: accessed-parameter=KeOPTR_t_BrkTrq_TstDer_CutOffT.KeOPTR_t_BrkTrq_TstDer_CutOffT
            CALPRM_KeOPTR_t_DelayTimeToggle_KeOPTR_t_DelayTimeToggle: accessed-parameter=KeOPTR_t_DelayTimeToggle.KeOPTR_t_DelayTimeToggle
            CALPRM_KeOPTR_t_RGS_Delay_KeOPTR_t_RGS_Delay: accessed-parameter=KeOPTR_t_RGS_Delay.KeOPTR_t_RGS_Delay
            CALPRM_KeOPTR_t_RGS_DelayTimeNTurb_KeOPTR_t_RGS_DelayTimeNTurb: accessed-parameter=KeOPTR_t_RGS_DelayTimeNTurb.KeOPTR_t_RGS_DelayTimeNTurb
            CALPRM_KtOPTR_M_P2ZeroIdle_BrkTrqThres_KtOPTR_M_P2ZeroIdle_BrkTrqThres: accessed-parameter=KtOPTR_M_P2ZeroIdle_BrkTrqThres.KtOPTR_M_P2ZeroIdle_BrkTrqThres
            CALPRM_KtOPTR_n_P2IdleSpd_KtOPTR_n_P2IdleSpd: accessed-parameter=KtOPTR_n_P2IdleSpd.KtOPTR_n_P2IdleSpd
            CALPRM_KxOPTR_M_P2ZeroIdle_BrkTrqThres_KxOPTR_M_P2ZeroIdle_BrkTrqThres: accessed-parameter=KxOPTR_M_P2ZeroIdle_BrkTrqThres.KxOPTR_M_P2ZeroIdle_BrkTrqThres
            CALPRM_KxOPTR_n_P2IdleSpd_KxOPTR_n_P2IdleSpd: accessed-parameter=KxOPTR_n_P2IdleSpd.KxOPTR_n_P2IdleSpd
          read-local-variables:
            23 x access:
              RV_Actual_Gear_write_IRV: accessed-variable=Actual_Gear_write_IRV
              RV_BrkReqTorq_Unconstrained_write_IRV: accessed-variable=BrkReqTorq_Unconstrained_write_IRV
              RV_BrkReqTorq_write_IRV: accessed-variable=BrkReqTorq_write_IRV
              RV_EnblGrSlctn_write_IRV: accessed-variable=EnblGrSlctn_write_IRV
              RV_FixGearRngStsAllwd_write_IRV: accessed-variable=FixGearRngStsAllwd_write_IRV, variation-point={short-label=vpRV_FixGearRngStsAllwd_write_IRV, sw-syscond=1}
              RV_FunctionEnableRegister_NonDynSeq_write_IRV: accessed-variable=FunctionEnableRegister_NonDynSeq_write_IRV
              RV_HRSR_State_write_IRV: accessed-variable=HRSR_State_write_IRV, variation-point={short-label=vpRV_HRSR_State_write_IRV, sw-syscond=1}
              RV_HardConfigConstraints_Allowed_write_IRV: accessed-variable=HardConfigConstraints_Allowed_write_IRV
              RV_HardConfigConstraints_FixedGear_Allowed_write_IRV: accessed-variable=HardConfigConstraints_FixedGear_Allowed_write_IRV
              RV_IsLockedSt_write_IRV: accessed-variable=IsLockedSt_write_IRV
              RV_MaxGrArb_write_IRV: accessed-variable=MaxGrArb_write_IRV
              RV_MaxGrOffset_Actv_write_IRV: accessed-variable=MaxGrOffset_Actv_write_IRV
              RV_NTurb_from_NoExtrap_write_IRV: accessed-variable=NTurb_from_NoExtrap_write_IRV
              RV_Na_Axis_Cpblty_out_write_IRV: accessed-variable=Na_Axis_Cpblty_out_write_IRV
              RV_No_Dot_write_IRV: accessed-variable=No_Dot_write_IRV
              RV_SelectionAllwd_write_IRV: accessed-variable=SelectionAllwd_write_IRV
              RV_StgcInGSIMode_write_IRV: accessed-variable=StgcInGSIMode_write_IRV
              RV_StgcRngStsAllwd_write_IRV: accessed-variable=StgcRngStsAllwd_write_IRV, variation-point={short-label=vpRV_StgcRngStsAllwd_write_IRV, sw-syscond=1}
              RV_StrategicSteadyTransState_write_IRV: accessed-variable=StrategicSteadyTransState_write_IRV
              RV_Target_Gear_GSI_write_IRV: accessed-variable=Target_Gear_GSI_write_IRV
              RV_Target_Gear_write_IRV: accessed-variable=Target_Gear_write_IRV
              RV_TransOutSpdRaw_write_IRV: accessed-variable=TransOutSpdRaw_write_IRV
              RV_TransOutSpd_write_IRV: accessed-variable=TransOutSpd_write_IRV
          written-local-variables:
            4 x access:
              WV_NiMin_write_IRV: accessed-variable=NiMin_write_IRV
              WV_StgcStAllowed_MA_write_IRV: accessed-variable=StgcStAllowed_MA_write_IRV
              WV_StgcStAllowed_N_write_IRV: accessed-variable=StgcStAllowed_N_write_IRV
              WV_ToMax_LinConstrn_IRV: accessed-variable=ToMax_LinConstrn_IRV
        OSMR_MedTED3
          data-receive-point-by-arguments:
            48 x access:
              IN_VaETQR_M_EngCapabilityMax_Value: accessed-variable=VaETQR_M_EngCapabilityMax.Value
              IN_VaETQR_M_EngCapabilityMinOff_Value: accessed-variable=VaETQR_M_EngCapabilityMinOff.Value
              IN_VaETQR_n_EngCapability_Value: accessed-variable=VaETQR_n_EngCapability.Value
              IN_VaOEVR_M_PrevToFOpt_EVM_Value: accessed-variable=VaOEVR_M_PrevToFOpt_EVM.Value
              IN_VaOEVR_M_PrevToFOpt_EVN_Value: accessed-variable=VaOEVR_M_PrevToFOpt_EVN.Value
              IN_VaOEVR_M_PrevToROpt_EVM_Value: accessed-variable=VaOEVR_M_PrevToROpt_EVM.Value
              IN_VaOEVR_M_PrevToROpt_EVN_Value: accessed-variable=VaOEVR_M_PrevToROpt_EVN.Value
              IN_VaOGRR_M_PrevToFOpt_GB_Value: accessed-variable=VaOGRR_M_PrevToFOpt_GB.Value
              IN_VaOGRR_M_PrevToROpt_GB_Value: accessed-variable=VaOGRR_M_PrevToROpt_GB.Value
              IN_VaOMAR_M_PrevToFOpt_MA_Value: accessed-variable=VaOMAR_M_PrevToFOpt_MA.Value
              IN_VaOMAR_M_PrevToROpt_MA_Value: accessed-variable=VaOMAR_M_PrevToROpt_MA.Value
              IN_VaOMBR_M_PrevToFOpt_MB_Value: accessed-variable=VaOMBR_M_PrevToFOpt_MB.Value
              IN_VaOMBR_M_PrevToROpt_MB_Value: accessed-variable=VaOMBR_M_PrevToROpt_MB.Value
              IN_VaOMNR_M_PrevToFOpt_N_Value: accessed-variable=VaOMNR_M_PrevToFOpt_N.Value, variation-point={short-label=vpIN_VaOMNR_M_PrevToFOpt_N_Value, sw-syscond=1}
              IN_VaOMNR_M_PrevToROpt_N_Value: accessed-variable=VaOMNR_M_PrevToROpt_N.Value, variation-point={short-label=vpIN_VaOMNR_M_PrevToROpt_N_Value, sw-syscond=1}
              IN_VeADCR_P_PwrRsrv4EngmtRaw_Value: accessed-variable=VeADCR_P_PwrRsrv4EngmtRaw.Value
              IN_VeAPSR_Pct_AccelPedalEffPosition_Value: accessed-variable=VeAPSR_Pct_AccelPedalEffPosition.Value
              IN_VeBACR_P_BattPwrShift_Stgc_Value: accessed-variable=VeBACR_P_BattPwrShift_Stgc.Value
              IN_VeBACR_P_BattPwrShift_ZeroPdl_Value: accessed-variable=VeBACR_P_BattPwrShift_ZeroPdl.Value
              IN_VeBACR_r_CostFactSOCNeg_Stgc_Value: accessed-variable=VeBACR_r_CostFactSOCNeg_Stgc.Value
              IN_VeBACR_r_CostFactSOCPos_Stgc_Value: accessed-variable=VeBACR_r_CostFactSOCPos_Stgc.Value
              IN_VeBCPR_M_BeltCapMaxPrll_Value: accessed-variable=VeBCPR_M_BeltCapMaxPrll.Value
              IN_VeBCPR_M_BeltCapMaxSer_Eff_Value: accessed-variable=VeBCPR_M_BeltCapMaxSer_Eff.Value
              IN_VeBCPR_M_BeltCapMinPrll_Value: accessed-variable=VeBCPR_M_BeltCapMinPrll.Value
              IN_VeBCPR_M_BeltCapMinSer_Eff_Value: accessed-variable=VeBCPR_M_BeltCapMinSer_Eff.Value
              IN_VeEOCR_M_Ti_ColdCtrl_Stgc_Value: accessed-variable=VeEOCR_M_Ti_ColdCtrl_Stgc.Value
              IN_VeEOCR_n_Ni_ColdCtrl_Value: accessed-variable=VeEOCR_n_Ni_ColdCtrl.Value
              IN_VeEOCR_r_ColdCtrlCostFact_Stgc_Value: accessed-variable=VeEOCR_r_ColdCtrlCostFact_Stgc.Value
              IN_VeOHSR_b_EngDsrd_Value: accessed-variable=VeOHSR_b_EngDsrd.Value
              IN_VeOHSR_e_RngDsrd_Value: accessed-variable=VeOHSR_e_RngDsrd.Value
              IN_VeOHSR_e_SGrDsrd_Value: accessed-variable=VeOHSR_e_SGrDsrd.Value
              IN_VeOHSR_e_SGrDsrd_EngOn_Value: accessed-variable=VeOHSR_e_SGrDsrd_EngOn.Value
              IN_VeSCCR_M_FrntAxlAdhMax_Value: accessed-variable=VeSCCR_M_FrntAxlAdhMax.Value
              IN_VeSCCR_M_FrntAxlAdhMin_Value: accessed-variable=VeSCCR_M_FrntAxlAdhMin.Value
              IN_VeSCCR_M_FrntAxlStrtgcMax_OL_Value: accessed-variable=VeSCCR_M_FrntAxlStrtgcMax_OL.Value, variation-point={short-label=vpIN_VeSCCR_M_FrntAxlStrtgcMax_OL_Value, sw-syscond=1}
              IN_VeSCCR_M_FrntAxlStrtgcMin_OL_Value: accessed-variable=VeSCCR_M_FrntAxlStrtgcMin_OL.Value, variation-point={short-label=vpIN_VeSCCR_M_FrntAxlStrtgcMin_OL_Value, sw-syscond=1}
              IN_VeSCCR_M_RrAxlAdhMax_Value: accessed-variable=VeSCCR_M_RrAxlAdhMax.Value
              IN_VeSCCR_M_RrAxlAdhMin_Value: accessed-variable=VeSCCR_M_RrAxlAdhMin.Value
              IN_VeSCCR_M_RrAxlStrtgcMax_OL_Value: accessed-variable=VeSCCR_M_RrAxlStrtgcMax_OL.Value, variation-point={short-label=vpIN_VeSCCR_M_RrAxlStrtgcMax_OL_Value, sw-syscond=1}
              IN_VeSCCR_M_RrAxlStrtgcMin_OL_Value: accessed-variable=VeSCCR_M_RrAxlStrtgcMin_OL.Value, variation-point={short-label=vpIN_VeSCCR_M_RrAxlStrtgcMin_OL_Value, sw-syscond=1}
              IN_VeSCCR_b_PerfAWDFlag_Value: accessed-variable=VeSCCR_b_PerfAWDFlag.Value, variation-point={short-label=vpIN_VeSCCR_b_PerfAWDFlag_Value, sw-syscond=1}
              IN_VeSRAR_b_limitInputTrq_Value: accessed-variable=VeSRAR_b_limitInputTrq.Value
              IN_VeSTRR_e_HybStrtrSt_Value: accessed-variable=VeSTRR_e_HybStrtrSt.Value
              IN_VeWTAR_M_FrntAxlMaxRq_Value: accessed-variable=VeWTAR_M_FrntAxlMaxRq.Value
              IN_VeWTAR_M_FrntAxlMinRq_Value: accessed-variable=VeWTAR_M_FrntAxlMinRq.Value
              IN_VeWTAR_M_RrAxlMaxRq_Value: accessed-variable=VeWTAR_M_RrAxlMaxRq.Value
              IN_VeWTAR_M_RrAxlMinRq_Value: accessed-variable=VeWTAR_M_RrAxlMinRq.Value
              IN_VeWTAR_r_PRNDL_Coeff_Value: accessed-variable=VeWTAR_r_PRNDL_Coeff.Value
          data-send-points:
            47 x access:
              OUT_VeOSMR_M_OutTrqReqNet_Value: accessed-variable=VeOSMR_M_OutTrqReqNet.Value
              OUT_VaOSMR_n_EngCapability_Value: accessed-variable=VaOSMR_n_EngCapability.Value
              OUT_VaOSMR_M_EngCapabilityMinOff_Value: accessed-variable=VaOSMR_M_EngCapabilityMinOff.Value
              OUT_VaOSMR_M_EngCapabilityMaxLmtd_Value: accessed-variable=VaOSMR_M_EngCapabilityMaxLmtd.Value
              OUT_VeOSMR_b_StgcNot_In_Transition_Value: accessed-variable=VeOSMR_b_StgcNot_In_Transition.Value
              OUT_VeOSMR_e_Current_RngSt_Value: accessed-variable=VeOSMR_e_Current_RngSt.Value
              OUT_VeOSMR_e_CurrentGear_Value: accessed-variable=VeOSMR_e_CurrentGear.Value
              OUT_VeOSMR_e_PrevDsrd_RngSt_Value: accessed-variable=VeOSMR_e_PrevDsrd_RngSt.Value
              OUT_VeOSMR_e_DesiredGear_Value: accessed-variable=VeOSMR_e_DesiredGear.Value
              OUT_VeOSMR_M_OutTrqReqArb_MA_Value: accessed-variable=VeOSMR_M_OutTrqReqArb_MA.Value
              OUT_VeOSMR_M_OutTrqReqArb_MB_Value: accessed-variable=VeOSMR_M_OutTrqReqArb_MB.Value
              OUT_VeOSMR_M_OutTrqReqArb_N_Value: accessed-variable=VeOSMR_M_OutTrqReqArb_N.Value
              OUT_VeOSMR_M_ToFront4x4_Max_Value: accessed-variable=VeOSMR_M_ToFront4x4_Max.Value
              OUT_VeOSMR_M_ToFront4x4_Min_Value: accessed-variable=VeOSMR_M_ToFront4x4_Min.Value
              OUT_VeOSMR_M_ToRear4x4_Max_Value: accessed-variable=VeOSMR_M_ToRear4x4_Max.Value
              OUT_VeOSMR_M_ToRear4x4_Min_Value: accessed-variable=VeOSMR_M_ToRear4x4_Min.Value
              OUT_VeOSMR_M_OutTrqReqNetArbSqncd_Value: accessed-variable=VeOSMR_M_OutTrqReqNetArbSqncd.Value
              OUT_VeOSMR_M_OutTrqReqArb_MBNR_Value: accessed-variable=VeOSMR_M_OutTrqReqArb_MBNR.Value
              OUT_VeOSMR_r_CostFactSOCNeg_Stgc_Value: accessed-variable=VeOSMR_r_CostFactSOCNeg_Stgc.Value
              OUT_VeOSMR_r_CostFactSOCPos_Stgc_Value: accessed-variable=VeOSMR_r_CostFactSOCPos_Stgc.Value
              OUT_VeOSMR_P_BattPwrShift_Stgc_Value: accessed-variable=VeOSMR_P_BattPwrShift_Stgc.Value
              OUT_VeOSMR_b_1DOptEnbl_Value: accessed-variable=VeOSMR_b_1DOptEnbl.Value
              OUT_VeOSMR_n_Ni_ColdCtrl_Value: accessed-variable=VeOSMR_n_Ni_ColdCtrl.Value
              OUT_VeOSMR_M_Ti_ColdCtrl_Stgc_Value: accessed-variable=VeOSMR_M_Ti_ColdCtrl_Stgc.Value
              OUT_VeOSMR_r_ColdCtrlCostFact_Stgc_Value: accessed-variable=VeOSMR_r_ColdCtrlCostFact_Stgc.Value
              OUT_VeOSMR_n_NiMinIdlNoFlyZone_Value: accessed-variable=VeOSMR_n_NiMinIdlNoFlyZone.Value
              OUT_VeOSMR_n_NiMaxIdlNoFlyZone_Value: accessed-variable=VeOSMR_n_NiMaxIdlNoFlyZone.Value
              OUT_VeOSMR_P_DrvrPdlCostOffsetNeg_Value: accessed-variable=VeOSMR_P_DrvrPdlCostOffsetNeg.Value
              OUT_VeOSMR_r_DrvrPdlCostGainNeg_Value: accessed-variable=VeOSMR_r_DrvrPdlCostGainNeg.Value
              OUT_VeOSMR_P_DrvrPdlCostOffsetPos_Value: accessed-variable=VeOSMR_P_DrvrPdlCostOffsetPos.Value
              OUT_VeOSMR_r_DrvrPdlCostGainPos_Value: accessed-variable=VeOSMR_r_DrvrPdlCostGainPos.Value
              OUT_VeOSMR_b_StgcRIPEnblOutTorqAccel_Value: accessed-variable=VeOSMR_b_StgcRIPEnblOutTorqAccel.Value
              OUT_VeOSMR_b_StgcRIPEnblOutTorqNet_Value: accessed-variable=VeOSMR_b_StgcRIPEnblOutTorqNet.Value
              OUT_VeOSMR_r_StgcRIPratioOutTorqAccel_Value: accessed-variable=VeOSMR_r_StgcRIPratioOutTorqAccel.Value
              OUT_VeOSMR_r_StgcRIPratioOutTorqNet_Value: accessed-variable=VeOSMR_r_StgcRIPratioOutTorqNet.Value
              OUT_VaOSMR_M_ToFToRLimOL_Value: accessed-variable=VaOSMR_M_ToFToRLimOL.Value
              OUT_VaOSMR_k_MeshLoss2ndOrderCoeff_Value: accessed-variable=VaOSMR_k_MeshLoss2ndOrderCoeff.Value
              OUT_VaOSMR_k_MeshLoss1stOrderCoeff_Value: accessed-variable=VaOSMR_k_MeshLoss1stOrderCoeff.Value
              OUT_VaOSMR_k_MeshLoss0thOrderCoeff_Value: accessed-variable=VaOSMR_k_MeshLoss0thOrderCoeff.Value
              OUT_VaOSMR_k_MeshLoss2ndOrderCoeffEV_Value: accessed-variable=VaOSMR_k_MeshLoss2ndOrderCoeffEV.Value
              OUT_VaOSMR_k_MeshLoss1stOrderCoeffEV_Value: accessed-variable=VaOSMR_k_MeshLoss1stOrderCoeffEV.Value
              OUT_VaOSMR_k_MeshLoss0thOrderCoeffEV_Value: accessed-variable=VaOSMR_k_MeshLoss0thOrderCoeffEV.Value
              OUT_VeOSMR_P_PwrRsrv4EngmtRaw_Value: accessed-variable=VeOSMR_P_PwrRsrv4EngmtRaw.Value
              OUT_VeOSMR_M_BeltCapMaxPrll_Value: accessed-variable=VeOSMR_M_BeltCapMaxPrll.Value
              OUT_VeOSMR_M_BeltCapMinPrll_Value: accessed-variable=VeOSMR_M_BeltCapMinPrll.Value
              OUT_VeOSMR_M_BeltCapMaxSer_Eff_Value: accessed-variable=VeOSMR_M_BeltCapMaxSer_Eff.Value
              OUT_VeOSMR_M_BeltCapMinSer_Eff_Value: accessed-variable=VeOSMR_M_BeltCapMinSer_Eff.Value
          21 x parameter access:
            CALPRM_HeHSCR_b_ForceDrive_HeHSCR_b_ForceDrive: accessed-parameter=HeHSCR_b_ForceDrive.HeHSCR_b_ForceDrive
            CALPRM_HeHSCR_b_ToMaxMinArbtBEV_HeHSCR_b_ToMaxMinArbtBEV: accessed-parameter=HeHSCR_b_ToMaxMinArbtBEV.HeHSCR_b_ToMaxMinArbtBEV
            CALPRM_KeHSCR_M_Adher_Limiting_KeHSCR_M_Adher_Limiting: accessed-parameter=KeHSCR_M_Adher_Limiting.KeHSCR_M_Adher_Limiting
            CALPRM_KeHSCR_M_Adherence_LSP_KeHSCR_M_Adherence_LSP: accessed-parameter=KeHSCR_M_Adherence_LSP.KeHSCR_M_Adherence_LSP
            CALPRM_KeHSCR_M_Adherence_RSP_KeHSCR_M_Adherence_RSP: accessed-parameter=KeHSCR_M_Adherence_RSP.KeHSCR_M_Adherence_RSP
            CALPRM_KeHSCR_M_LowMuRmpEndLmt_KeHSCR_M_LowMuRmpEndLmt: accessed-parameter=KeHSCR_M_LowMuRmpEndLmt.KeHSCR_M_LowMuRmpEndLmt
            CALPRM_KeHSCR_b_UseFiltFrntLowMu_KeHSCR_b_UseFiltFrntLowMu: accessed-parameter=KeHSCR_b_UseFiltFrntLowMu.KeHSCR_b_UseFiltFrntLowMu
            CALPRM_KeHSCR_b_UseFiltRearLowMu_KeHSCR_b_UseFiltRearLowMu: accessed-parameter=KeHSCR_b_UseFiltRearLowMu.KeHSCR_b_UseFiltRearLowMu
            CALPRM_KeHSCR_b_UseLowMuLmtArbt_KeHSCR_b_UseLowMuLmtArbt: accessed-parameter=KeHSCR_b_UseLowMuLmtArbt.KeHSCR_b_UseLowMuLmtArbt
            CALPRM_KeHSCR_dM_LowMuFact_LD_KeHSCR_dM_LowMuFact_LD: accessed-parameter=KeHSCR_dM_LowMuFact_LD.KeHSCR_dM_LowMuFact_LD
            CALPRM_KeHSCR_dM_LowMuRmpOutFrnt_KeHSCR_dM_LowMuRmpOutFrnt: accessed-parameter=KeHSCR_dM_LowMuRmpOutFrnt.KeHSCR_dM_LowMuRmpOutFrnt
            CALPRM_KeHSCR_dM_LowMuRmpOutRr_KeHSCR_dM_LowMuRmpOutRr: accessed-parameter=KeHSCR_dM_LowMuRmpOutRr.KeHSCR_dM_LowMuRmpOutRr
            CALPRM_KeHSCR_k_AdherenceFilt_KeHSCR_k_AdherenceFilt: accessed-parameter=KeHSCR_k_AdherenceFilt.KeHSCR_k_AdherenceFilt
            CALPRM_KeHSCR_k_FiltCoeffFrnt_LowMu_KeHSCR_k_FiltCoeffFrnt_LowMu: accessed-parameter=KeHSCR_k_FiltCoeffFrnt_LowMu.KeHSCR_k_FiltCoeffFrnt_LowMu
            CALPRM_KeHSCR_k_FiltCoeffRear_LowMu_KeHSCR_k_FiltCoeffRear_LowMu: accessed-parameter=KeHSCR_k_FiltCoeffRear_LowMu.KeHSCR_k_FiltCoeffRear_LowMu
            CALPRM_KeHSCR_n_LowMuEndFrntTrq_KeHSCR_n_LowMuEndFrntTrq: accessed-parameter=KeHSCR_n_LowMuEndFrntTrq.KeHSCR_n_LowMuEndFrntTrq
            CALPRM_KeHSCR_n_LowMuEndRearTrq_KeHSCR_n_LowMuEndRearTrq: accessed-parameter=KeHSCR_n_LowMuEndRearTrq.KeHSCR_n_LowMuEndRearTrq
            CALPRM_KtHSCR_K_LowSpdDnyRgnFrntMinTrq_KtHSCR_K_LowSpdDnyRgnFrntMinTrq: accessed-parameter=KtHSCR_K_LowSpdDnyRgnFrntMinTrq.KtHSCR_K_LowSpdDnyRgnFrntMinTrq
            CALPRM_KtHSCR_K_LowSpdDnyRgnRrMinTrq_KtHSCR_K_LowSpdDnyRgnRrMinTrq: accessed-parameter=KtHSCR_K_LowSpdDnyRgnRrMinTrq.KtHSCR_K_LowSpdDnyRgnRrMinTrq
            CALPRM_KxHSCR_K_LowSpdDnyRgnFrntMinTrq_KxHSCR_K_LowSpdDnyRgnFrntMinTrq: accessed-parameter=KxHSCR_K_LowSpdDnyRgnFrntMinTrq.KxHSCR_K_LowSpdDnyRgnFrntMinTrq
            CALPRM_KxHSCR_K_LowSpdDnyRgnRrMinTrq_KxHSCR_K_LowSpdDnyRgnRrMinTrq: accessed-parameter=KxHSCR_K_LowSpdDnyRgnRrMinTrq.KxHSCR_K_LowSpdDnyRgnRrMinTrq
          read-local-variables:
            13 x access:
              RV_Actual_Gear_write_IRV: accessed-variable=Actual_Gear_write_IRV
              RV_BrkReqTorq_write_IRV: accessed-variable=BrkReqTorq_write_IRV
              RV_FunctionEnableRegister_NonDynSeq_write_IRV: accessed-variable=FunctionEnableRegister_NonDynSeq_write_IRV
              RV_HRSR_State_write_IRV: accessed-variable=HRSR_State_write_IRV
              RV_HV_AccPwr_IRV_IRV: accessed-variable=HV_AccPwr_IRV_IRV
              RV_OutTorqReqAccelArb_IRV_IRV: accessed-variable=OutTorqReqAccelArb_IRV_IRV
              RV_OutTorqReqAccelRaw_IRV_IRV: accessed-variable=OutTorqReqAccelRaw_IRV_IRV
              RV_OutTrqReqNetArb_IRV_IRV: accessed-variable=OutTrqReqNetArb_IRV_IRV
              RV_StrategicSteadyTransState_write_IRV: accessed-variable=StrategicSteadyTransState_write_IRV
              RV_Target_Gear_write_IRV: accessed-variable=Target_Gear_write_IRV
              RV_ToMax_LinConstrn_IRV: accessed-variable=ToMax_LinConstrn_IRV
              RV_TransOutSpd_write_IRV: accessed-variable=TransOutSpd_write_IRV
              RV_VeOSMR_b_1DOptEnbl_IRV: accessed-variable=VeOSMR_b_1DOptEnbl_IRV
        OSMR_MedTED4
          data-receive-point-by-arguments:
            7 x access:
              IN_VeBPCR_T_BatModTmp_Value: accessed-variable=VeBPCR_T_BatModTmp.Value
              IN_VeINVR_T_MtrA_InvrtrTemp_Value: accessed-variable=VeINVR_T_MtrA_InvrtrTemp.Value
              IN_VeINVR_T_MtrA_Temp_Value: accessed-variable=VeINVR_T_MtrA_Temp.Value
              IN_VeINVR_T_MtrB_InvrtrTemp_Value: accessed-variable=VeINVR_T_MtrB_InvrtrTemp.Value
              IN_VeINVR_T_MtrB_Temp_Value: accessed-variable=VeINVR_T_MtrB_Temp.Value
              IN_VeINVR_T_MtrC_InvrtrTemp_Value: accessed-variable=VeINVR_T_MtrC_InvrtrTemp.Value
              IN_VeINVR_T_MtrC_Temp_Value: accessed-variable=VeINVR_T_MtrC_Temp.Value
          data-send-points:
            4 x access:
              OUT_VeOSMR_r_MachAPwrLossCostFactor_Value: accessed-variable=VeOSMR_r_MachAPwrLossCostFactor.Value
              OUT_VeOSMR_r_MachBPwrLossCostFactor_Value: accessed-variable=VeOSMR_r_MachBPwrLossCostFactor.Value
              OUT_VeOSMR_r_MachCPwrLossCostFactor_Value: accessed-variable=VeOSMR_r_MachCPwrLossCostFactor.Value
              OUT_VeOSMR_r_BattPwrLossCostFactor_Value: accessed-variable=VeOSMR_r_BattPwrLossCostFactor.Value
          14 x parameter access:
            CALPRM_KtOPTR_r_BattTmpThermalCntrl_KtOPTR_r_BattTmpThermalCntrl: accessed-parameter=KtOPTR_r_BattTmpThermalCntrl.KtOPTR_r_BattTmpThermalCntrl
            CALPRM_KtOPTR_r_INVR_A_ThermalCntrl_KtOPTR_r_INVR_A_ThermalCntrl: accessed-parameter=KtOPTR_r_INVR_A_ThermalCntrl.KtOPTR_r_INVR_A_ThermalCntrl
            CALPRM_KtOPTR_r_INVR_B_ThermalCntrl_KtOPTR_r_INVR_B_ThermalCntrl: accessed-parameter=KtOPTR_r_INVR_B_ThermalCntrl.KtOPTR_r_INVR_B_ThermalCntrl
            CALPRM_KtOPTR_r_INVR_C_ThermalCntrl_KtOPTR_r_INVR_C_ThermalCntrl: accessed-parameter=KtOPTR_r_INVR_C_ThermalCntrl.KtOPTR_r_INVR_C_ThermalCntrl
            CALPRM_KtOPTR_r_Mtr_A_ThermalCntrl_KtOPTR_r_Mtr_A_ThermalCntrl: accessed-parameter=KtOPTR_r_Mtr_A_ThermalCntrl.KtOPTR_r_Mtr_A_ThermalCntrl
            CALPRM_KtOPTR_r_Mtr_B_ThermalCntrl_KtOPTR_r_Mtr_B_ThermalCntrl: accessed-parameter=KtOPTR_r_Mtr_B_ThermalCntrl.KtOPTR_r_Mtr_B_ThermalCntrl
            CALPRM_KtOPTR_r_Mtr_C_ThermalCntrl_KtOPTR_r_Mtr_C_ThermalCntrl: accessed-parameter=KtOPTR_r_Mtr_C_ThermalCntrl.KtOPTR_r_Mtr_C_ThermalCntrl
            CALPRM_KxOPTR_r_BattTmpThermalCntrl_KxOPTR_r_BattTmpThermalCntrl: accessed-parameter=KxOPTR_r_BattTmpThermalCntrl.KxOPTR_r_BattTmpThermalCntrl
            CALPRM_KxOPTR_r_INVR_A_ThermalCntrl_KxOPTR_r_INVR_A_ThermalCntrl: accessed-parameter=KxOPTR_r_INVR_A_ThermalCntrl.KxOPTR_r_INVR_A_ThermalCntrl
            CALPRM_KxOPTR_r_INVR_B_ThermalCntrl_KxOPTR_r_INVR_B_ThermalCntrl: accessed-parameter=KxOPTR_r_INVR_B_ThermalCntrl.KxOPTR_r_INVR_B_ThermalCntrl
            CALPRM_KxOPTR_r_INVR_C_ThermalCntrl_KxOPTR_r_INVR_C_ThermalCntrl: accessed-parameter=KxOPTR_r_INVR_C_ThermalCntrl.KxOPTR_r_INVR_C_ThermalCntrl
            CALPRM_KxOPTR_r_Mtr_A_ThermalCntrl_KxOPTR_r_Mtr_A_ThermalCntrl: accessed-parameter=KxOPTR_r_Mtr_A_ThermalCntrl.KxOPTR_r_Mtr_A_ThermalCntrl
            CALPRM_KxOPTR_r_Mtr_B_ThermalCntrl_KxOPTR_r_Mtr_B_ThermalCntrl: accessed-parameter=KxOPTR_r_Mtr_B_ThermalCntrl.KxOPTR_r_Mtr_B_ThermalCntrl
            CALPRM_KxOPTR_r_Mtr_C_ThermalCntrl_KxOPTR_r_Mtr_C_ThermalCntrl: accessed-parameter=KxOPTR_r_Mtr_C_ThermalCntrl.KxOPTR_r_Mtr_C_ThermalCntrl
      62 x variation point proxy:
        Variant_HSCR_TorqueFloor_1: category=CONDITION, condition-access=0
        Variant_HSCR_UseAdherenceLim_1: category=CONDITION, condition-access=1
        Variant_OSMR_EnableCatHeatingReq: category=CONDITION, condition-access=0
        Variant_OSMR_EnableCompBsdSerMdArbReq: category=CONDITION, condition-access=0
        Variant_OSMR_EnableDrivabilityReq: category=CONDITION, condition-access=0
        Variant_OSMR_EnableDynSeq: category=CONDITION, condition-access=0
        Variant_OSMR_EnblAccRsrv: category=CONDITION, condition-access=1
        Variant_OSMR_EnblDCTGr: category=CONDITION, condition-access=0
        Variant_OSMR_EnblEboostReq: category=CONDITION, condition-access=1
        Variant_OSMR_EnblEngCalc: category=CONDITION, condition-access=0
        Variant_OSMR_EnblFxdGrAllwdPath: category=CONDITION, condition-access=0
        Variant_OSMR_EnblIdlTrqRsrv: category=CONDITION, condition-access=0
        Variant_OSMR_EnblLwrdCrpArb: category=CONDITION, condition-access=0
        Variant_OSMR_EnblMaxGrOffset: category=CONDITION, condition-access=0
        Variant_OSMR_EnblNiMinLimitCalc: category=CONDITION, condition-access=0
        Variant_OSMR_EnblPreEmptEngStrtReq: category=CONDITION, condition-access=0
        Variant_OSMR_EnblSRAROverride: category=CONDITION, condition-access=0
        Variant_OSMR_EnblServEngOffReq: category=CONDITION, condition-access=0
        Variant_OSMR_EnblSteadyStateArb: category=CONDITION, condition-access=1
        Variant_OSMR_EnblStgcGSIMode: category=CONDITION, condition-access=0
        Variant_OSMR_EnblStrtStpReq: category=CONDITION, condition-access=0
        Variant_OSMR_EnblSysConstrEVM: category=CONDITION, condition-access=1
        Variant_OSMR_EnblSysConstrEVN: category=CONDITION, condition-access=1
        Variant_OSMR_EnblSysConstrGA: category=CONDITION, condition-access=0
        Variant_OSMR_EnblSysConstrGB: category=CONDITION, condition-access=0
        Variant_OSMR_EnblSysConstrMA: category=CONDITION, condition-access=0
        Variant_OSMR_EnblSysConstrMB: category=CONDITION, condition-access=0
        Variant_OSMR_EnblSysConstrN: category=CONDITION, condition-access=0
        Variant_OSMR_EnblTCaseShiftReqs: category=CONDITION, condition-access=0
        Variant_OSMR_EnblTransOvrdReq: category=CONDITION, condition-access=0
        Variant_OSMR_EnblWED_AllwdStates: category=CONDITION, condition-access=1
        Variant_OSMR_FUNC_PxPy_TSXR_DCT_Matrix: category=CONDITION, condition-access=0
        Variant_OSMR_InhbReq_HardAllwd_AvlGrs_Enbl: category=CONDITION, condition-access=0
        Variant_OSMR_MBNRActive: category=CONDITION, condition-access=0
        Variant_OSMR_NiMinLockupCoastEnbl: category=CONDITION, condition-access=1
        Variant_OSMR_NtiUseTransMinSpeedMtrA: category=CONDITION, condition-access=0
        Variant_OSMR_NtiUseTransMinSpeedMtrB: category=CONDITION, condition-access=0
        Variant_OSMR_NtiUseTransMinSpeedMtrC: category=CONDITION, condition-access=0
        Variant_OSMR_NturbBsd_NbMin: category=CONDITION, condition-access=0
        Variant_OSMR_UseNC1MaxCal: category=CONDITION, condition-access=0
        Variant_OSMR_UseNbLaunchArb: category=CONDITION, condition-access=0
        Variant_OSMR_UseRawEngSpdsForTactLmts: category=CONDITION, condition-access=0
        Variant_OSMR_UseTransMinSpeedMtrA: category=CONDITION, condition-access=0
        Variant_OSMR_UseTransMinSpeedMtrB: category=CONDITION, condition-access=0
        Variant_OSMR_UseTransMinSpeedMtrC: category=CONDITION, condition-access=0
        Variant_OSMR_UseUncorrectedMtrBSpd: category=CONDITION, condition-access=0
        Variant_OSMR_b_StgcRIPEnbl: category=CONDITION, condition-access=1
        XeTSXR_b_GA_NaFixRatioNi: category=VALUE, value-access=boolean-value-variation-point=0
        XeTSXR_b_GA_NbFixRatioNi: category=VALUE, value-access=boolean-value-variation-point=0
        XeTSXR_b_GA_NcFixRatioNi: category=VALUE, value-access=boolean-value-variation-point=0
        XeTSXR_b_G_NaFixRatioNi: category=VALUE, value-access=boolean-value-variation-point=0
        XeTSXR_b_G_NbFixRatioNi: category=VALUE, value-access=boolean-value-variation-point=0
        XeTSXR_b_G_NcFixRatioNi: category=VALUE, value-access=boolean-value-variation-point=0
        XeTSXR_b_MA_NaFixRatioNi: category=VALUE, value-access=boolean-value-variation-point=0
        XeTSXR_b_MA_NbFixRatioNi: category=VALUE, value-access=boolean-value-variation-point=0
        XeTSXR_b_MA_NcFixRatioNi: category=VALUE, value-access=boolean-value-variation-point=0
        XeTSXR_b_MB_NaFixRatioNi: category=VALUE, value-access=boolean-value-variation-point=0
        XeTSXR_b_MB_NbFixRatioNi: category=VALUE, value-access=boolean-value-variation-point=0
        XeTSXR_b_MB_NcFixRatioNi: category=VALUE, value-access=boolean-value-variation-point=0
        XeTSXR_b_N_NaFixRatioNi: category=VALUE, value-access=boolean-value-variation-point=0
        XeTSXR_b_N_NbFixRatioNi: category=VALUE, value-access=boolean-value-variation-point=0
        XeTSXR_b_N_NcFixRatioNi: category=VALUE, value-access=boolean-value-variation-point=0
