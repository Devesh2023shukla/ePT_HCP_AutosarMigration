[part 2 of 2: package /STELLANTIS/EPT/COMSWCs]
AUTOSAR XML (schema 4-2-2)
package /STELLANTIS/EPT/COMSWCs  (continued)
  application sw component type SR2B_COREBEV  (continued)
    behavior IB_SR2B_COREBEV: data-type-mapping=[msADTtoIDTMapping, ADTtoIDTMapping], handle-termination-and-restart=NO-SUPPORT
      37 x timing event, all with period=0.005:
        Event_FastTEF: start-on-event=SR2B_COREBEV_FastTEF
        Event_TESR2B_AGSM_FD_2_FD3_Pkt: start-on-event=SR2B_AGSM_FD_2_FD3_Time
        Event_TESR2B_BCM_FD_10_FD3_Pkt: start-on-event=SR2B_BCM_FD_10_FD3_Time
        Event_TESR2B_BCM_FD_12_FD3_Pkt: start-on-event=SR2B_BCM_FD_12_FD3_Time
        Event_TESR2B_BCM_FD_13_FD3_Pkt: start-on-event=SR2B_BCM_FD_13_FD3_Time
        Event_TESR2B_BCM_FD_2_FD3_Pkt: start-on-event=SR2B_BCM_FD_2_FD3_Time
        Event_TESR2B_BRAKE_FD_{1..7}_FD3_Pkt: start-on-event=SR2B_BRAKE_FD_{1..7}_FD3_Time
        Event_TESR2B_ENGINE_HYBD_FD_1_FD3_Pkt: start-on-event=SR2B_ENGINE_HYBD_FD_1_FD3_Time
        Event_TESR2B_IPC_VEHICLE_SETUP_FD3_Pkt: start-on-event=SR2B_IPC_VEHICLE_SETUP_FD3_Time
        Event_TESR2B_TELEMATIC_FD_5_FD3_Pkt: start-on-event=SR2B_TELEMATIC_FD_5_FD3_Time
        Event_TESR2B_APM_VDCM_FD11_Pkt: start-on-event=SR2B_APM_VDCM_FD11_Time
        Event_TESR2B_BATTERY_HV_POWERLIMITS_FD11_Pkt: start-on-event=SR2B_BATTERY_HV_POWERLIMITS_FD11_Time
        Event_TESR2B_BATTERY_HV_STATUS1_FD11_Pkt: start-on-event=SR2B_BATTERY_HV_STATUS1_FD11_Time
        Event_TESR2B_HV_CHARGER1_FD11_Pkt: start-on-event=SR2B_HV_CHARGER1_FD11_Time
        Event_TESR2B_ADAS_FD_INFO_FD14_Pkt: start-on-event=SR2B_ADAS_FD_INFO_FD14_Time
        Event_TESR2B_BRAKE_FD_1_FD14_Pkt: start-on-event=SR2B_BRAKE_FD_1_FD14_Time
        Event_TESR2B_BRAKE_FD_2_FD14_Pkt: start-on-event=SR2B_BRAKE_FD_2_FD14_Time
        Event_TESR2B_BRAKE_FD_6_FD14_Pkt: start-on-event=SR2B_BRAKE_FD_6_FD14_Time
        Event_TESR2B_BRAKE_FD_7_FD14_Pkt: start-on-event=SR2B_BRAKE_FD_7_FD14_Time
        Event_TESR2B_EPS_FD_1_FD14_Pkt: start-on-event=SR2B_EPS_FD_1_FD14_Time
        Event_TESR2B_ORC_FD_3_FD14_Pkt: start-on-event=SR2B_ORC_FD_3_FD14_Time
        Event_TESR2B_AGSM_FD_2_FD16_Pkt: start-on-event=SR2B_AGSM_FD_2_FD16_Time
        Event_TESR2B_ELSDM_FD_1_FD16_Pkt: start-on-event=SR2B_ELSDM_FD_1_FD16_Time
        Event_TESR2B_MCPA_PROPULSION_FD16_Pkt: start-on-event=SR2B_MCPA_PROPULSION_FD16_Time
        Event_TESR2B_MCPB_PROPULSION_FD16_Pkt: start-on-event=SR2B_MCPB_PROPULSION_FD16_Time
        Event_TESR2B_APM_VDCM_FD5_Pkt: start-on-event=SR2B_APM_VDCM_FD5_Time
        Event_TESR2B_BATTERY_HV_POWERLIMITS_FD5_Pkt: start-on-event=SR2B_BATTERY_HV_POWERLIMITS_FD5_Time
        Event_TESR2B_BATTERY_HV_STATUS1_FD5_Pkt: start-on-event=SR2B_BATTERY_HV_STATUS1_FD5_Time
        Event_TESR2B_HV_CHARGER1_FD5_Pkt: start-on-event=SR2B_HV_CHARGER1_FD5_Time
        Event_TESR2B_MCPA_PROPULSION_FD5_Pkt: start-on-event=SR2B_MCPA_PROPULSION_FD5_Time
        Event_TESR2B_MCPB_PROPULSION_FD5_Pkt: start-on-event=SR2B_MCPB_PROPULSION_FD5_Time
      init event Event_SR2B_COREBEV_ac_Init: start-on-event=SR2B_COREBEV_ac_Init
      data received event Event_DRESR2B_AGSM_FD_2_FD3_Pkt: start-on-event=SR2B_AGSM_FD_2_FD3_Received, data=VeSR2B_h_COMRX_AGSM_FD_2_FD3_Pkt.COMRX_AGSM_FD_2_FD3_Pkt
      data receive error event Event_DEESR2B_AGSM_FD_2_FD3_Pkt: start-on-event=SR2B_AGSM_FD_2_FD3_Error, data=VeSR2B_h_COMRX_AGSM_FD_2_FD3_Pkt.COMRX_AGSM_FD_2_FD3_Pkt
      data received event Event_DRESR2B_BCM_FD_10_FD3_Pkt: start-on-event=SR2B_BCM_FD_10_FD3_Received, data=VeSR2B_h_COMRX_BCM_FD_10_FD3_Pkt.COMRX_BCM_FD_10_FD3_Pkt
      data receive error event Event_DEESR2B_BCM_FD_10_FD3_Pkt: start-on-event=SR2B_BCM_FD_10_FD3_Error, data=VeSR2B_h_COMRX_BCM_FD_10_FD3_Pkt.COMRX_BCM_FD_10_FD3_Pkt
      data received event Event_DRESR2B_BCM_FD_12_FD3_Pkt: start-on-event=SR2B_BCM_FD_12_FD3_Received, data=VeSR2B_h_COMRX_BCM_FD_12_FD3_Pkt.COMRX_BCM_FD_12_FD3_Pkt
      data receive error event Event_DEESR2B_BCM_FD_12_FD3_Pkt: start-on-event=SR2B_BCM_FD_12_FD3_Error, data=VeSR2B_h_COMRX_BCM_FD_12_FD3_Pkt.COMRX_BCM_FD_12_FD3_Pkt
      data received event Event_DRESR2B_BCM_FD_13_FD3_Pkt: start-on-event=SR2B_BCM_FD_13_FD3_Received, data=VeSR2B_h_COMRX_BCM_FD_13_FD3_Pkt.COMRX_BCM_FD_13_FD3_Pkt
      data receive error event Event_DEESR2B_BCM_FD_13_FD3_Pkt: start-on-event=SR2B_BCM_FD_13_FD3_Error, data=VeSR2B_h_COMRX_BCM_FD_13_FD3_Pkt.COMRX_BCM_FD_13_FD3_Pkt
      data received event Event_DRESR2B_BCM_FD_2_FD3_Pkt: start-on-event=SR2B_BCM_FD_2_FD3_Received, data=VeSR2B_h_COMRX_BCM_FD_2_FD3_Pkt.COMRX_BCM_FD_2_FD3_Pkt
      data receive error event Event_DEESR2B_BCM_FD_2_FD3_Pkt: start-on-event=SR2B_BCM_FD_2_FD3_Error, data=VeSR2B_h_COMRX_BCM_FD_2_FD3_Pkt.COMRX_BCM_FD_2_FD3_Pkt
      data received event Event_DRESR2B_BRAKE_FD_1_FD3_Pkt: start-on-event=SR2B_BRAKE_FD_1_FD3_Received, data=VeSR2B_h_COMRX_BRAKE_FD_1_FD3_Pkt.COMRX_BRAKE_FD_1_FD3_Pkt
      data receive error event Event_DEESR2B_BRAKE_FD_1_FD3_Pkt: start-on-event=SR2B_BRAKE_FD_1_FD3_Error, data=VeSR2B_h_COMRX_BRAKE_FD_1_FD3_Pkt.COMRX_BRAKE_FD_1_FD3_Pkt
      data received event Event_DRESR2B_BRAKE_FD_2_FD3_Pkt: start-on-event=SR2B_BRAKE_FD_2_FD3_Received, data=VeSR2B_h_COMRX_BRAKE_FD_2_FD3_Pkt.COMRX_BRAKE_FD_2_FD3_Pkt
      data receive error event Event_DEESR2B_BRAKE_FD_2_FD3_Pkt: start-on-event=SR2B_BRAKE_FD_2_FD3_Error, data=VeSR2B_h_COMRX_BRAKE_FD_2_FD3_Pkt.COMRX_BRAKE_FD_2_FD3_Pkt
      data received event Event_DRESR2B_BRAKE_FD_3_FD3_Pkt: start-on-event=SR2B_BRAKE_FD_3_FD3_Received, data=VeSR2B_h_COMRX_BRAKE_FD_3_FD3_Pkt.COMRX_BRAKE_FD_3_FD3_Pkt
      data receive error event Event_DEESR2B_BRAKE_FD_3_FD3_Pkt: start-on-event=SR2B_BRAKE_FD_3_FD3_Error, data=VeSR2B_h_COMRX_BRAKE_FD_3_FD3_Pkt.COMRX_BRAKE_FD_3_FD3_Pkt
      data received event Event_DRESR2B_BRAKE_FD_4_FD3_Pkt: start-on-event=SR2B_BRAKE_FD_4_FD3_Received, data=VeSR2B_h_COMRX_BRAKE_FD_4_FD3_Pkt.COMRX_BRAKE_FD_4_FD3_Pkt
      data receive error event Event_DEESR2B_BRAKE_FD_4_FD3_Pkt: start-on-event=SR2B_BRAKE_FD_4_FD3_Error, data=VeSR2B_h_COMRX_BRAKE_FD_4_FD3_Pkt.COMRX_BRAKE_FD_4_FD3_Pkt
      data received event Event_DRESR2B_BRAKE_FD_5_FD3_Pkt: start-on-event=SR2B_BRAKE_FD_5_FD3_Received, data=VeSR2B_h_COMRX_BRAKE_FD_5_FD3_Pkt.COMRX_BRAKE_FD_5_FD3_Pkt
      data receive error event Event_DEESR2B_BRAKE_FD_5_FD3_Pkt: start-on-event=SR2B_BRAKE_FD_5_FD3_Error, data=VeSR2B_h_COMRX_BRAKE_FD_5_FD3_Pkt.COMRX_BRAKE_FD_5_FD3_Pkt
      data received event Event_DRESR2B_BRAKE_FD_6_FD3_Pkt: start-on-event=SR2B_BRAKE_FD_6_FD3_Received, data=VeSR2B_h_COMRX_BRAKE_FD_6_FD3_Pkt.COMRX_BRAKE_FD_6_FD3_Pkt
      data receive error event Event_DEESR2B_BRAKE_FD_6_FD3_Pkt: start-on-event=SR2B_BRAKE_FD_6_FD3_Error, data=VeSR2B_h_COMRX_BRAKE_FD_6_FD3_Pkt.COMRX_BRAKE_FD_6_FD3_Pkt
      data received event Event_DRESR2B_BRAKE_FD_7_FD3_Pkt: start-on-event=SR2B_BRAKE_FD_7_FD3_Received, data=VeSR2B_h_COMRX_BRAKE_FD_7_FD3_Pkt.COMRX_BRAKE_FD_7_FD3_Pkt
      data receive error event Event_DEESR2B_BRAKE_FD_7_FD3_Pkt: start-on-event=SR2B_BRAKE_FD_7_FD3_Error, data=VeSR2B_h_COMRX_BRAKE_FD_7_FD3_Pkt.COMRX_BRAKE_FD_7_FD3_Pkt
      data received event Event_DRESR2B_ENGINE_HYBD_FD_1_FD3_Pkt: start-on-event=SR2B_ENGINE_HYBD_FD_1_FD3_Received, data=VeSR2B_h_COMRX_ENGINE_HYBD_FD_1_FD3_Pkt.COMRX_ENGINE_HYBD_FD_1_FD3_Pkt
      data receive error event Event_DEESR2B_ENGINE_HYBD_FD_1_FD3_Pkt: start-on-event=SR2B_ENGINE_HYBD_FD_1_FD3_Error, data=VeSR2B_h_COMRX_ENGINE_HYBD_FD_1_FD3_Pkt.COMRX_ENGINE_HYBD_FD_1_FD3_Pkt
      data received event Event_DRESR2B_IPC_VEHICLE_SETUP_FD3_Pkt: start-on-event=SR2B_IPC_VEHICLE_SETUP_FD3_Received, data=VeSR2B_h_COMRX_IPC_VEHICLE_SETUP_FD3_Pkt.COMRX_IPC_VEHICLE_SETUP_FD3_Pkt
      data receive error event Event_DEESR2B_IPC_VEHICLE_SETUP_FD3_Pkt: start-on-event=SR2B_IPC_VEHICLE_SETUP_FD3_Error, data=VeSR2B_h_COMRX_IPC_VEHICLE_SETUP_FD3_Pkt.COMRX_IPC_VEHICLE_SETUP_FD3_Pkt
      data received event Event_DRESR2B_TELEMATIC_FD_5_FD3_Pkt: start-on-event=SR2B_TELEMATIC_FD_5_FD3_Received, data=VeSR2B_h_COMRX_TELEMATIC_FD_5_FD3_Pkt.COMRX_TELEMATIC_FD_5_FD3_Pkt
      data receive error event Event_DEESR2B_TELEMATIC_FD_5_FD3_Pkt: start-on-event=SR2B_TELEMATIC_FD_5_FD3_Error, data=VeSR2B_h_COMRX_TELEMATIC_FD_5_FD3_Pkt.COMRX_TELEMATIC_FD_5_FD3_Pkt
      data received event Event_DRESR2B_APM_VDCM_FD11_Pkt: start-on-event=SR2B_APM_VDCM_FD11_Received, data=VeSR2B_h_COMRX_APM_VDCM_FD11_Pkt.COMRX_APM_VDCM_FD11_Pkt
      data receive error event Event_DEESR2B_APM_VDCM_FD11_Pkt: start-on-event=SR2B_APM_VDCM_FD11_Error, data=VeSR2B_h_COMRX_APM_VDCM_FD11_Pkt.COMRX_APM_VDCM_FD11_Pkt
      data received event Event_DRESR2B_BATTERY_HV_POWERLIMITS_FD11_Pkt: start-on-event=SR2B_BATTERY_HV_POWERLIMITS_FD11_Received, data=VeSR2B_h_COMRX_BATTERY_HV_POWERLIMITS_FD11_Pkt.COMRX_BATTERY_HV_POWERLIMITS_FD11_Pkt
      data receive error event Event_DEESR2B_BATTERY_HV_POWERLIMITS_FD11_Pkt: start-on-event=SR2B_BATTERY_HV_POWERLIMITS_FD11_Error, data=VeSR2B_h_COMRX_BATTERY_HV_POWERLIMITS_FD11_Pkt.COMRX_BATTERY_HV_POWERLIMITS_FD11_Pkt
      data received event Event_DRESR2B_BATTERY_HV_STATUS1_FD11_Pkt: start-on-event=SR2B_BATTERY_HV_STATUS1_FD11_Received, data=VeSR2B_h_COMRX_BATTERY_HV_STATUS1_FD11_Pkt.COMRX_BATTERY_HV_STATUS1_FD11_Pkt
      data receive error event Event_DEESR2B_BATTERY_HV_STATUS1_FD11_Pkt: start-on-event=SR2B_BATTERY_HV_STATUS1_FD11_Error, data=VeSR2B_h_COMRX_BATTERY_HV_STATUS1_FD11_Pkt.COMRX_BATTERY_HV_STATUS1_FD11_Pkt
      data received event Event_DRESR2B_HV_CHARGER1_FD11_Pkt: start-on-event=SR2B_HV_CHARGER1_FD11_Received, data=VeSR2B_h_COMRX_HV_CHARGER1_FD11_Pkt.COMRX_HV_CHARGER1_FD11_Pkt
      data receive error event Event_DEESR2B_HV_CHARGER1_FD11_Pkt: start-on-event=SR2B_HV_CHARGER1_FD11_Error, data=VeSR2B_h_COMRX_HV_CHARGER1_FD11_Pkt.COMRX_HV_CHARGER1_FD11_Pkt
      data received event Event_DRESR2B_ADAS_FD_INFO_FD14_Pkt: start-on-event=SR2B_ADAS_FD_INFO_FD14_Received, data=VeSR2B_h_COMRX_ADAS_FD_INFO_FD14_Pkt.COMRX_ADAS_FD_INFO_FD14_Pkt
      data receive error event Event_DEESR2B_ADAS_FD_INFO_FD14_Pkt: start-on-event=SR2B_ADAS_FD_INFO_FD14_Error, data=VeSR2B_h_COMRX_ADAS_FD_INFO_FD14_Pkt.COMRX_ADAS_FD_INFO_FD14_Pkt
      data received event Event_DRESR2B_BRAKE_FD_1_FD14_Pkt: start-on-event=SR2B_BRAKE_FD_1_FD14_Received, data=VeSR2B_h_COMRX_BRAKE_FD_1_FD14_Pkt.COMRX_BRAKE_FD_1_FD14_Pkt
      data receive error event Event_DEESR2B_BRAKE_FD_1_FD14_Pkt: start-on-event=SR2B_BRAKE_FD_1_FD14_Error, data=VeSR2B_h_COMRX_BRAKE_FD_1_FD14_Pkt.COMRX_BRAKE_FD_1_FD14_Pkt
      data received event Event_DRESR2B_BRAKE_FD_2_FD14_Pkt: start-on-event=SR2B_BRAKE_FD_2_FD14_Received, data=VeSR2B_h_COMRX_BRAKE_FD_2_FD14_Pkt.COMRX_BRAKE_FD_2_FD14_Pkt
      data receive error event Event_DEESR2B_BRAKE_FD_2_FD14_Pkt: start-on-event=SR2B_BRAKE_FD_2_FD14_Error, data=VeSR2B_h_COMRX_BRAKE_FD_2_FD14_Pkt.COMRX_BRAKE_FD_2_FD14_Pkt
      data received event Event_DRESR2B_BRAKE_FD_6_FD14_Pkt: start-on-event=SR2B_BRAKE_FD_6_FD14_Received, data=VeSR2B_h_COMRX_BRAKE_FD_6_FD14_Pkt.COMRX_BRAKE_FD_6_FD14_Pkt
      data receive error event Event_DEESR2B_BRAKE_FD_6_FD14_Pkt: start-on-event=SR2B_BRAKE_FD_6_FD14_Error, data=VeSR2B_h_COMRX_BRAKE_FD_6_FD14_Pkt.COMRX_BRAKE_FD_6_FD14_Pkt
      data received event Event_DRESR2B_BRAKE_FD_7_FD14_Pkt: start-on-event=SR2B_BRAKE_FD_7_FD14_Received, data=VeSR2B_h_COMRX_BRAKE_FD_7_FD14_Pkt.COMRX_BRAKE_FD_7_FD14_Pkt
      data receive error event Event_DEESR2B_BRAKE_FD_7_FD14_Pkt: start-on-event=SR2B_BRAKE_FD_7_FD14_Error, data=VeSR2B_h_COMRX_BRAKE_FD_7_FD14_Pkt.COMRX_BRAKE_FD_7_FD14_Pkt
      data received event Event_DRESR2B_EPS_FD_1_FD14_Pkt: start-on-event=SR2B_EPS_FD_1_FD14_Received, data=VeSR2B_h_COMRX_EPS_FD_1_FD14_Pkt.COMRX_EPS_FD_1_FD14_Pkt
      data receive error event Event_DEESR2B_EPS_FD_1_FD14_Pkt: start-on-event=SR2B_EPS_FD_1_FD14_Error, data=VeSR2B_h_COMRX_EPS_FD_1_FD14_Pkt.COMRX_EPS_FD_1_FD14_Pkt
      data received event Event_DRESR2B_ORC_FD_3_FD14_Pkt: start-on-event=SR2B_ORC_FD_3_FD14_Received, data=VeSR2B_h_COMRX_ORC_FD_3_FD14_Pkt.COMRX_ORC_FD_3_FD14_Pkt
      data receive error event Event_DEESR2B_ORC_FD_3_FD14_Pkt: start-on-event=SR2B_ORC_FD_3_FD14_Error, data=VeSR2B_h_COMRX_ORC_FD_3_FD14_Pkt.COMRX_ORC_FD_3_FD14_Pkt
      data received event Event_DRESR2B_AGSM_FD_2_FD16_Pkt: start-on-event=SR2B_AGSM_FD_2_FD16_Received, data=VeSR2B_h_COMRX_AGSM_FD_2_FD16_Pkt.COMRX_AGSM_FD_2_FD16_Pkt
      data receive error event Event_DEESR2B_AGSM_FD_2_FD16_Pkt: start-on-event=SR2B_AGSM_FD_2_FD16_Error, data=VeSR2B_h_COMRX_AGSM_FD_2_FD16_Pkt.COMRX_AGSM_FD_2_FD16_Pkt
      data received event Event_DRESR2B_ELSDM_FD_1_FD16_Pkt: start-on-event=SR2B_ELSDM_FD_1_FD16_Received, data=VeSR2B_h_COMRX_ELSDM_FD_1_FD16_Pkt.COMRX_ELSDM_FD_1_FD16_Pkt
      data receive error event Event_DEESR2B_ELSDM_FD_1_FD16_Pkt: start-on-event=SR2B_ELSDM_FD_1_FD16_Error, data=VeSR2B_h_COMRX_ELSDM_FD_1_FD16_Pkt.COMRX_ELSDM_FD_1_FD16_Pkt
      data received event Event_DRESR2B_MCPA_PROPULSION_FD16_Pkt: start-on-event=SR2B_MCPA_PROPULSION_FD16_Received, data=VeSR2B_h_COMRX_MCPA_PROPULSION_FD16_Pkt.COMRX_MCPA_PROPULSION_FD16_Pkt
      data receive error event Event_DEESR2B_MCPA_PROPULSION_FD16_Pkt: start-on-event=SR2B_MCPA_PROPULSION_FD16_Error, data=VeSR2B_h_COMRX_MCPA_PROPULSION_FD16_Pkt.COMRX_MCPA_PROPULSION_FD16_Pkt
      data received event Event_DRESR2B_MCPB_PROPULSION_FD16_Pkt: start-on-event=SR2B_MCPB_PROPULSION_FD16_Received, data=VeSR2B_h_COMRX_MCPB_PROPULSION_FD16_Pkt.COMRX_MCPB_PROPULSION_FD16_Pkt
      data receive error event Event_DEESR2B_MCPB_PROPULSION_FD16_Pkt: start-on-event=SR2B_MCPB_PROPULSION_FD16_Error, data=VeSR2B_h_COMRX_MCPB_PROPULSION_FD16_Pkt.COMRX_MCPB_PROPULSION_FD16_Pkt
      data received event Event_DRESR2B_APM_VDCM_FD5_Pkt: start-on-event=SR2B_APM_VDCM_FD5_Received, data=VeSR2B_h_COMRX_APM_VDCM_FD5_Pkt.COMRX_APM_VDCM_FD5_Pkt
      data receive error event Event_DEESR2B_APM_VDCM_FD5_Pkt: start-on-event=SR2B_APM_VDCM_FD5_Error, data=VeSR2B_h_COMRX_APM_VDCM_FD5_Pkt.COMRX_APM_VDCM_FD5_Pkt
      data received event Event_DRESR2B_BATTERY_HV_POWERLIMITS_FD5_Pkt: start-on-event=SR2B_BATTERY_HV_POWERLIMITS_FD5_Received, data=VeSR2B_h_COMRX_BATTERY_HV_POWERLIMITS_FD5_Pkt.COMRX_BATTERY_HV_POWERLIMITS_FD5_Pkt
      data receive error event Event_DEESR2B_BATTERY_HV_POWERLIMITS_FD5_Pkt: start-on-event=SR2B_BATTERY_HV_POWERLIMITS_FD5_Error, data=VeSR2B_h_COMRX_BATTERY_HV_POWERLIMITS_FD5_Pkt.COMRX_BATTERY_HV_POWERLIMITS_FD5_Pkt
      data received event Event_DRESR2B_BATTERY_HV_STATUS1_FD5_Pkt: start-on-event=SR2B_BATTERY_HV_STATUS1_FD5_Received, data=VeSR2B_h_COMRX_BATTERY_HV_STATUS1_FD5_Pkt.COMRX_BATTERY_HV_STATUS1_FD5_Pkt
      data receive error event Event_DEESR2B_BATTERY_HV_STATUS1_FD5_Pkt: start-on-event=SR2B_BATTERY_HV_STATUS1_FD5_Error, data=VeSR2B_h_COMRX_BATTERY_HV_STATUS1_FD5_Pkt.COMRX_BATTERY_HV_STATUS1_FD5_Pkt
      data received event Event_DRESR2B_HV_CHARGER1_FD5_Pkt: start-on-event=SR2B_HV_CHARGER1_FD5_Received, data=VeSR2B_h_COMRX_HV_CHARGER1_FD5_Pkt.COMRX_HV_CHARGER1_FD5_Pkt
      data receive error event Event_DEESR2B_HV_CHARGER1_FD5_Pkt: start-on-event=SR2B_HV_CHARGER1_FD5_Error, data=VeSR2B_h_COMRX_HV_CHARGER1_FD5_Pkt.COMRX_HV_CHARGER1_FD5_Pkt
      data received event Event_DRESR2B_MCPA_PROPULSION_FD5_Pkt: start-on-event=SR2B_MCPA_PROPULSION_FD5_Received, data=VeSR2B_h_COMRX_MCPA_PROPULSION_FD5_Pkt.COMRX_MCPA_PROPULSION_FD5_Pkt
      data receive error event Event_DEESR2B_MCPA_PROPULSION_FD5_Pkt: start-on-event=SR2B_MCPA_PROPULSION_FD5_Error, data=VeSR2B_h_COMRX_MCPA_PROPULSION_FD5_Pkt.COMRX_MCPA_PROPULSION_FD5_Pkt
      data received event Event_DRESR2B_MCPB_PROPULSION_FD5_Pkt: start-on-event=SR2B_MCPB_PROPULSION_FD5_Received, data=VeSR2B_h_COMRX_MCPB_PROPULSION_FD5_Pkt.COMRX_MCPB_PROPULSION_FD5_Pkt
      data receive error event Event_DEESR2B_MCPB_PROPULSION_FD5_Pkt: start-on-event=SR2B_MCPB_PROPULSION_FD5_Error, data=VeSR2B_h_COMRX_MCPB_PROPULSION_FD5_Pkt.COMRX_MCPB_PROPULSION_FD5_Pkt
      explicit-inter-runnable-variables:
        110 x data, all with category=VALUE, sw-calibration-access=READ-ONLY, init-value=0:
          VeSR2B_b_MM_Enbl_write1_IRV: type=Boolean
          VeSR2N_Cnt_ADAS_FD_INFO_FD14_MM_Cntr_write_IRV: type=UInt8
          VeSR2N_b_ADAS_FD_INFO_FD14_MM_Faild_write_IRV: type=Boolean
          VeSR2B_b_DevlpmtToolEnbld_write1_IRV: type=Boolean
          VeSR2N_b_ADAS_FD_INFO_FD14_NewEvent_write_IRV: type=Boolean
          VeSR2N_Cnt_AGSM_FD_2_FD16_MM_Cntr_write_IRV: type=UInt8
          VeSR2N_b_AGSM_FD_2_FD16_MM_Faild_write_IRV: type=Boolean
          VeSR2N_b_AGSM_FD_2_FD16_NewEvent_write_IRV: type=Boolean
          VeSR2N_Cnt_AGSM_FD_2_FD3_MM_Cntr_write_IRV: type=UInt8
          VeSR2N_b_AGSM_FD_2_FD3_MM_Faild_write_IRV: type=Boolean
          VeSR2N_b_AGSM_FD_2_FD3_NewEvent_write_IRV: type=Boolean
          VeSR2N_Cnt_APM_VDCM_FD11_MM_Cntr_write_IRV: type=UInt8
          VeSR2N_b_APM_VDCM_FD11_MM_Faild_write_IRV: type=Boolean
          VeSR2N_b_APM_VDCM_FD11_NewEvent_write_IRV: type=Boolean
          VeSR2N_Cnt_APM_VDCM_FD5_MM_Cntr_write_IRV: type=UInt8
          VeSR2N_b_APM_VDCM_FD5_MM_Faild_write_IRV: type=Boolean
          VeSR2N_b_APM_VDCM_FD5_NewEvent_write_IRV: type=Boolean
          VeSR2N_Cnt_BATTERY_HV_POWERLIMITS_FD11_MM_Cntr_write_IRV: type=UInt8
          VeSR2N_b_BATTERY_HV_POWERLIMITS_FD11_MM_Faild_write_IRV: type=Boolean
          VeSR2N_b_BATTERY_HV_POWERLIMITS_FD11_NewEvent_write_IRV: type=Boolean
          VeSR2N_Cnt_BATTERY_HV_POWERLIMITS_FD5_MM_Cntr_write_IRV: type=UInt8
          VeSR2N_b_BATTERY_HV_POWERLIMITS_FD5_MM_Faild_write_IRV: type=Boolean
          VeSR2N_b_BATTERY_HV_POWERLIMITS_FD5_NewEvent_write_IRV: type=Boolean
          VeSR2N_Cnt_BATTERY_HV_STATUS1_FD11_MM_Cntr_write_IRV: type=UInt8
          VeSR2N_b_BATTERY_HV_STATUS1_FD11_MM_Faild_write_IRV: type=Boolean
          VeSR2N_b_BATTERY_HV_STATUS1_FD11_NewEvent_write_IRV: type=Boolean
          VeSR2N_Cnt_BATTERY_HV_STATUS1_FD5_MM_Cntr_write_IRV: type=UInt8
          VeSR2N_b_BATTERY_HV_STATUS1_FD5_MM_Faild_write_IRV: type=Boolean
          VeSR2N_b_BATTERY_HV_STATUS1_FD5_NewEvent_write_IRV: type=Boolean
          VeSR2N_Cnt_BCM_FD_10_FD3_MM_Cntr_write_IRV: type=UInt8
          VeSR2N_b_BCM_FD_10_FD3_MM_Faild_write_IRV: type=Boolean
          VeSR2N_b_BCM_FD_10_FD3_NewEvent_write_IRV: type=Boolean
          VeSR2N_Cnt_BCM_FD_12_FD3_MM_Cntr_write_IRV: type=UInt8
          VeSR2N_b_BCM_FD_12_FD3_MM_Faild_write_IRV: type=Boolean
          VeSR2N_b_BCM_FD_12_FD3_NewEvent_write_IRV: type=Boolean
          VeSR2N_Cnt_BCM_FD_13_FD3_MM_Cntr_write_IRV: type=UInt8
          VeSR2N_b_BCM_FD_13_FD3_MM_Faild_write_IRV: type=Boolean
          VeSR2N_b_BCM_FD_13_FD3_NewEvent_write_IRV: type=Boolean
          VeSR2N_Cnt_BCM_FD_2_FD3_MM_Cntr_write_IRV: type=UInt8
          VeSR2N_b_BCM_FD_2_FD3_MM_Faild_write_IRV: type=Boolean
          VeSR2N_b_BCM_FD_2_FD3_NewEvent_write_IRV: type=Boolean
          VeSR2N_Cnt_BRAKE_FD_1_FD14_MM_Cntr_write_IRV: type=UInt8
          VeSR2N_b_BRAKE_FD_1_FD14_MM_Faild_write_IRV: type=Boolean
          VeSR2N_b_BRAKE_FD_1_FD14_NewEvent_write_IRV: type=Boolean
          VeSR2N_Cnt_BRAKE_FD_1_FD3_MM_Cntr_write_IRV: type=UInt8
          VeSR2N_b_BRAKE_FD_1_FD3_MM_Faild_write_IRV: type=Boolean
          VeSR2N_b_BRAKE_FD_1_FD3_NewEvent_write_IRV: type=Boolean
          VeSR2N_Cnt_BRAKE_FD_2_FD14_MM_Cntr_write_IRV: type=UInt8
          VeSR2N_b_BRAKE_FD_2_FD14_MM_Faild_write_IRV: type=Boolean
          VeSR2N_b_BRAKE_FD_2_FD14_NewEvent_write_IRV: type=Boolean
          VeSR2N_Cnt_BRAKE_FD_2_FD3_MM_Cntr_write_IRV: type=UInt8
          VeSR2N_b_BRAKE_FD_2_FD3_MM_Faild_write_IRV: type=Boolean
          VeSR2N_b_BRAKE_FD_2_FD3_NewEvent_write_IRV: type=Boolean
          VeSR2N_Cnt_BRAKE_FD_3_FD3_MM_Cntr_write_IRV: type=UInt8
          VeSR2N_b_BRAKE_FD_3_FD3_MM_Faild_write_IRV: type=Boolean
          VeSR2N_b_BRAKE_FD_3_FD3_NewEvent_write_IRV: type=Boolean
          VeSR2N_Cnt_BRAKE_FD_4_FD3_MM_Cntr_write_IRV: type=UInt8
          VeSR2N_b_BRAKE_FD_4_FD3_MM_Faild_write_IRV: type=Boolean
          VeSR2N_b_BRAKE_FD_4_FD3_NewEvent_write_IRV: type=Boolean
          VeSR2N_Cnt_BRAKE_FD_5_FD3_MM_Cntr_write_IRV: type=UInt8
          VeSR2N_b_BRAKE_FD_5_FD3_MM_Faild_write_IRV: type=Boolean
          VeSR2N_b_BRAKE_FD_5_FD3_NewEvent_write_IRV: type=Boolean
          VeSR2N_Cnt_BRAKE_FD_6_FD14_MM_Cntr_write_IRV: type=UInt8
          VeSR2N_b_BRAKE_FD_6_FD14_MM_Faild_write_IRV: type=Boolean
          VeSR2N_b_BRAKE_FD_6_FD14_NewEvent_write_IRV: type=Boolean
          VeSR2N_Cnt_BRAKE_FD_6_FD3_MM_Cntr_write_IRV: type=UInt8
          VeSR2N_b_BRAKE_FD_6_FD3_MM_Faild_write_IRV: type=Boolean
          VeSR2N_b_BRAKE_FD_6_FD3_NewEvent_write_IRV: type=Boolean
          VeSR2N_Cnt_BRAKE_FD_7_FD14_MM_Cntr_write_IRV: type=UInt8
          VeSR2N_b_BRAKE_FD_7_FD14_MM_Faild_write_IRV: type=Boolean
          VeSR2N_b_BRAKE_FD_7_FD14_NewEvent_write_IRV: type=Boolean
          VeSR2N_Cnt_BRAKE_FD_7_FD3_MM_Cntr_write_IRV: type=UInt8
          VeSR2N_b_BRAKE_FD_7_FD3_MM_Faild_write_IRV: type=Boolean
          VeSR2N_b_BRAKE_FD_7_FD3_NewEvent_write_IRV: type=Boolean
          VeSR2N_Cnt_ELSDM_FD_1_FD16_MM_Cntr_write_IRV: type=UInt8
          VeSR2N_b_ELSDM_FD_1_FD16_MM_Faild_write_IRV: type=Boolean
          VeSR2N_b_ELSDM_FD_1_FD16_NewEvent_write_IRV: type=Boolean
          VeSR2N_Cnt_ENGINE_HYBD_FD_1_FD3_MM_Cntr_write_IRV: type=UInt8
          VeSR2N_b_ENGINE_HYBD_FD_1_FD3_MM_Faild_write_IRV: type=Boolean
          VeSR2N_b_ENGINE_HYBD_FD_1_FD3_NewEvent_write_IRV: type=Boolean
          VeSR2N_Cnt_EPS_FD_1_FD14_MM_Cntr_write_IRV: type=UInt8
          VeSR2N_b_EPS_FD_1_FD14_MM_Faild_write_IRV: type=Boolean
          VeSR2N_b_EPS_FD_1_FD14_NewEvent_write_IRV: type=Boolean
          VeSR2N_Cnt_HV_CHARGER1_FD11_MM_Cntr_write_IRV: type=UInt8
          VeSR2N_b_HV_CHARGER1_FD11_MM_Faild_write_IRV: type=Boolean
          VeSR2N_b_HV_CHARGER1_FD11_NewEvent_write_IRV: type=Boolean
          VeSR2N_Cnt_HV_CHARGER1_FD5_MM_Cntr_write_IRV: type=UInt8
          VeSR2N_b_HV_CHARGER1_FD5_MM_Faild_write_IRV: type=Boolean
          VeSR2N_b_HV_CHARGER1_FD5_NewEvent_write_IRV: type=Boolean
          VeSR2N_Cnt_IPC_VEHICLE_SETUP_FD3_MM_Cntr_write_IRV: type=UInt8
          VeSR2N_b_IPC_VEHICLE_SETUP_FD3_MM_Faild_write_IRV: type=Boolean
          VeSR2N_b_IPC_VEHICLE_SETUP_FD3_NewEvent_write_IRV: type=Boolean
          VeSR2N_Cnt_MCPA_PROPULSION_FD16_MM_Cntr_write_IRV: type=UInt8
          VeSR2N_b_MCPA_PROPULSION_FD16_MM_Faild_write_IRV: type=Boolean
          VeSR2N_b_MCPA_PROPULSION_FD16_NewEvent_write_IRV: type=Boolean
          VeSR2N_Cnt_MCPA_PROPULSION_FD5_MM_Cntr_write_IRV: type=UInt8
          VeSR2N_b_MCPA_PROPULSION_FD5_MM_Faild_write_IRV: type=Boolean
          VeSR2N_b_MCPA_PROPULSION_FD5_NewEvent_write_IRV: type=Boolean
          VeSR2N_Cnt_MCPB_PROPULSION_FD16_MM_Cntr_write_IRV: type=UInt8
          VeSR2N_b_MCPB_PROPULSION_FD16_MM_Faild_write_IRV: type=Boolean
          VeSR2N_b_MCPB_PROPULSION_FD16_NewEvent_write_IRV: type=Boolean
          VeSR2N_Cnt_MCPB_PROPULSION_FD5_MM_Cntr_write_IRV: type=UInt8
          VeSR2N_b_MCPB_PROPULSION_FD5_MM_Faild_write_IRV: type=Boolean
          VeSR2N_b_MCPB_PROPULSION_FD5_NewEvent_write_IRV: type=Boolean
          VeSR2N_Cnt_ORC_FD_3_FD14_MM_Cntr_write_IRV: type=UInt8
          VeSR2N_b_ORC_FD_3_FD14_MM_Faild_write_IRV: type=Boolean
          VeSR2N_b_ORC_FD_3_FD14_NewEvent_write_IRV: type=Boolean
          VeSR2N_Cnt_TELEMATIC_FD_5_FD3_MM_Cntr_write_IRV: type=UInt8
          VeSR2N_b_TELEMATIC_FD_5_FD3_MM_Faild_write_IRV: type=Boolean
          VeSR2N_b_TELEMATIC_FD_5_FD3_NewEvent_write_IRV: type=Boolean
      110 x runnable:
        SR2B_COREBEV_ac_Init
          data-send-points:
            access OUT_VeSCMR_e_Lv2KeySts_Value: accessed-variable=VeSCMR_e_Lv2KeySts.Value
          written-local-variables:
            access WV_VeSR2B_b_MM_Enbl_write1_IRV: accessed-variable=VeSR2B_b_MM_Enbl_write1_IRV
            access WV_VeSR2B_b_DevlpmtToolEnbld_write1_IRV: accessed-variable=VeSR2B_b_DevlpmtToolEnbld_write1_IRV
        SR2B_COREBEV_FastTEF
          data-receive-point-by-arguments:
            26 x access:
              IN_VeCANR_b_CurrBusOffSt_FD11_VeCANR_b_CurrBusOffSt_FD11: accessed-variable=VeCANR_b_CurrBusOffSt_FD11.VeCANR_b_CurrBusOffSt_FD11
              IN_VeCANR_b_CurrBusOffSt_FD14_VeCANR_b_CurrBusOffSt_FD14: accessed-variable=VeCANR_b_CurrBusOffSt_FD14.VeCANR_b_CurrBusOffSt_FD14
              IN_VeCANR_b_CurrBusOffSt_FD16_VeCANR_b_CurrBusOffSt_FD16: accessed-variable=VeCANR_b_CurrBusOffSt_FD16.VeCANR_b_CurrBusOffSt_FD16
              IN_VeCANR_b_CurrBusOffSt_FD3_VeCANR_b_CurrBusOffSt_FD3: accessed-variable=VeCANR_b_CurrBusOffSt_FD3.VeCANR_b_CurrBusOffSt_FD3
              IN_VeCANR_b_CurrBusOffSt_FD5_VeCANR_b_CurrBusOffSt_FD5: accessed-variable=VeCANR_b_CurrBusOffSt_FD5.VeCANR_b_CurrBusOffSt_FD5
              IN_VeCANR_b_LOC_AGSM_FD16_VeCANR_b_LOC_AGSM_FD16: accessed-variable=VeCANR_b_LOC_AGSM_FD16.VeCANR_b_LOC_AGSM_FD16
              IN_VeCANR_b_LOC_AGSM_FD3_VeCANR_b_LOC_AGSM_FD3: accessed-variable=VeCANR_b_LOC_AGSM_FD3.VeCANR_b_LOC_AGSM_FD3
              IN_VeCANR_b_LOC_BCM_FD3_VeCANR_b_LOC_BCM_FD3: accessed-variable=VeCANR_b_LOC_BCM_FD3.VeCANR_b_LOC_BCM_FD3
              IN_VeCANR_b_LOC_BPCM_FD11_VeCANR_b_LOC_BPCM_FD11: accessed-variable=VeCANR_b_LOC_BPCM_FD11.VeCANR_b_LOC_BPCM_FD11
              IN_VeCANR_b_LOC_BSM_FD14_VeCANR_b_LOC_BSM_FD14: accessed-variable=VeCANR_b_LOC_BSM_FD14.VeCANR_b_LOC_BSM_FD14
              IN_VeCANR_b_LOC_BSM_FD3_VeCANR_b_LOC_BSM_FD3: accessed-variable=VeCANR_b_LOC_BSM_FD3.VeCANR_b_LOC_BSM_FD3
              IN_VeCANR_b_LOC_CADM_FD14_VeCANR_b_LOC_CADM_FD14: accessed-variable=VeCANR_b_LOC_CADM_FD14.VeCANR_b_LOC_CADM_FD14
              IN_VeCANR_b_LOC_ECM_FD3_VeCANR_b_LOC_ECM_FD3: accessed-variable=VeCANR_b_LOC_ECM_FD3.VeCANR_b_LOC_ECM_FD3
              IN_VeCANR_b_LOC_IDCM_FD11_VeCANR_b_LOC_IDCM_FD11: accessed-variable=VeCANR_b_LOC_IDCM_FD11.VeCANR_b_LOC_IDCM_FD11
              IN_VeCANR_b_LOC_IPC_FD3_VeCANR_b_LOC_IPC_FD3: accessed-variable=VeCANR_b_LOC_IPC_FD3.VeCANR_b_LOC_IPC_FD3
              IN_VeCANR_b_LOC_MCPA_FD16_VeCANR_b_LOC_MCPA_FD16: accessed-variable=VeCANR_b_LOC_MCPA_FD16.VeCANR_b_LOC_MCPA_FD16
              IN_VeCANR_b_LOC_MCPB_FD16_VeCANR_b_LOC_MCPB_FD16: accessed-variable=VeCANR_b_LOC_MCPB_FD16.VeCANR_b_LOC_MCPB_FD16
              IN_VeCANR_b_LOC_SGCP_FD16_VeCANR_b_LOC_SGCP_FD16: accessed-variable=VeCANR_b_LOC_SGCP_FD16.VeCANR_b_LOC_SGCP_FD16
              IN_VeCANR_b_LOC_SGW_FD3_VeCANR_b_LOC_SGW_FD3: accessed-variable=VeCANR_b_LOC_SGW_FD3.VeCANR_b_LOC_SGW_FD3
              IN_VeCANR_b_Trns_DrvMdReqTO_VeCANR_b_Trns_DrvMdReqTO: accessed-variable=VeCANR_b_Trns_DrvMdReqTO.VeCANR_b_Trns_DrvMdReqTO
              IN_VeCANR_e_Trns_DrvMdReq_VeCANR_e_Trns_DrvMdReq: accessed-variable=VeCANR_e_Trns_DrvMdReq.VeCANR_e_Trns_DrvMdReq
              IN_VePRXR_b_ProxiCC_Value: accessed-variable=VePRXR_b_ProxiCC.Value
              IN_VePRXR_b_ProxiSpdLimiter_Value: accessed-variable=VePRXR_b_ProxiSpdLimiter.Value
              IN_VePRXR_b_ProxiSts_Value: accessed-variable=VePRXR_b_ProxiSts.Value
              IN_VePRXR_e_ProxiACC_Value: accessed-variable=VePRXR_e_ProxiACC.Value
              IN_VePRXR_l_WhlRadius_Value: accessed-variable=VePRXR_l_WhlRadius.Value
          data-send-points:
            26 x access:
              OUT_VeSCMR_b_Lv2CANBusOff_CANC_Value: accessed-variable=VeSCMR_b_Lv2CANBusOff_CANC.Value
              OUT_VeSCMR_b_Lv2CANBusOff_CANC11_Value: accessed-variable=VeSCMR_b_Lv2CANBusOff_CANC11.Value
              OUT_VeSCMR_b_Lv2CANBusOff_CANC2_Value: accessed-variable=VeSCMR_b_Lv2CANBusOff_CANC2.Value
              OUT_VeSCMR_b_Lv2CANBusOff_EPT2_Value: accessed-variable=VeSCMR_b_Lv2CANBusOff_EPT2.Value
              OUT_VeSCMR_b_Lv2CANBusOff_EPT_Value: accessed-variable=VeSCMR_b_Lv2CANBusOff_EPT.Value
              OUT_VeSCMR_b_Lv2LOC_APM_EPT_Value: accessed-variable=VeSCMR_b_Lv2LOC_APM_EPT.Value
              OUT_VeSCMR_b_Lv2LOC_BCM_CANC_Value: accessed-variable=VeSCMR_b_Lv2LOC_BCM_CANC.Value
              OUT_VeSCMR_b_Lv2LOC_BPCM_EPT_Value: accessed-variable=VeSCMR_b_Lv2LOC_BPCM_EPT.Value
              OUT_VeSCMR_b_Lv2LOC_BSM_CANC_Value: accessed-variable=VeSCMR_b_Lv2LOC_BSM_CANC.Value
              OUT_VeSCMR_b_Lv2LOC_BSM_CANC2_Value: accessed-variable=VeSCMR_b_Lv2LOC_BSM_CANC2.Value
              OUT_VeSCMR_b_Lv2LOC_CADM_CANC2_Value: accessed-variable=VeSCMR_b_Lv2LOC_CADM_CANC2.Value
              OUT_VeSCMR_b_Lv2LOC_ECM_CANC_Value: accessed-variable=VeSCMR_b_Lv2LOC_ECM_CANC.Value
              OUT_VeSCMR_b_Lv2LOC_ESM_CANC_Value: accessed-variable=VeSCMR_b_Lv2LOC_ESM_CANC.Value
              OUT_VeSCMR_b_Lv2LOC_ESM_CANC11_Value: accessed-variable=VeSCMR_b_Lv2LOC_ESM_CANC11.Value
              OUT_VeSCMR_b_Lv2LOC_IPC_CANC_Value: accessed-variable=VeSCMR_b_Lv2LOC_IPC_CANC.Value
              OUT_VeSCMR_b_Lv2LOC_MCPA_CANC11_Value: accessed-variable=VeSCMR_b_Lv2LOC_MCPA_CANC11.Value
              OUT_VeSCMR_b_Lv2LOC_MCPB_CANC11_Value: accessed-variable=VeSCMR_b_Lv2LOC_MCPB_CANC11.Value
              OUT_VeSCMR_b_Lv2LOC_SGCP_CANC11_Value: accessed-variable=VeSCMR_b_Lv2LOC_SGCP_CANC11.Value
              OUT_VeSCMR_b_Lv2LOC_SGW_CANC_Value: accessed-variable=VeSCMR_b_Lv2LOC_SGW_CANC.Value
              OUT_VeSCMR_b_Lv2ProxiCC_Value: accessed-variable=VeSCMR_b_Lv2ProxiCC.Value
              OUT_VeSCMR_b_Lv2ProxiSpdLimiter_Value: accessed-variable=VeSCMR_b_Lv2ProxiSpdLimiter.Value
              OUT_VeSCMR_b_Lv2TireSizeFA_Value: accessed-variable=VeSCMR_b_Lv2TireSizeFA.Value
              OUT_VeSCMR_l_Lv2TireSize_Value: accessed-variable=VeSCMR_l_Lv2TireSize.Value
              OUT_VeSCMR_e_Lv2VehACC_Stat_Value: accessed-variable=VeSCMR_e_Lv2VehACC_Stat.Value
              OUT_VeSCMR_e_Lv2Trns_DrvMdReq_Value: accessed-variable=VeSCMR_e_Lv2Trns_DrvMdReq.Value
              OUT_VeSCMR_b_Lv2Trns_DrvMdReq_FA_Value: accessed-variable=VeSCMR_b_Lv2Trns_DrvMdReq_FA.Value
          written-local-variables:
            access WV_VeSR2B_b_DevlpmtToolEnbld_write1_IRV: accessed-variable=VeSR2B_b_DevlpmtToolEnbld_write1_IRV
            access WV_VeSR2B_b_MM_Enbl_write1_IRV: accessed-variable=VeSR2B_b_MM_Enbl_write1_IRV
        SR2B_AGSM_FD_2_FD3_Received
          data-receive-point-by-arguments:
            access IN_VeRxPDU_AGSM_FD_2_FD3_E2E_Sts_E2ECheckSts: accessed-variable=VeRxPDU_AGSM_FD_2_FD3_E2E_Sts.E2ECheckSts
            access IN_VeRxPDU_AGSM_FD_2_FD3_E2E_Sts_OpRetVal: accessed-variable=VeRxPDU_AGSM_FD_2_FD3_E2E_Sts.OpRetVal
            access IN_VeSR2B_h_COMRX_AGSM_FD_2_FD3_Pkt_COMRX_AGSM_FD_2_FD3_Pkt: accessed-variable=VeSR2B_h_COMRX_AGSM_FD_2_FD3_Pkt.COMRX_AGSM_FD_2_FD3_Pkt
          read-local-variables:
            access RV_VeSR2B_b_DevlpmtToolEnbld_write1_IRV: accessed-variable=VeSR2B_b_DevlpmtToolEnbld_write1_IRV
            access RV_VeSR2N_Cnt_AGSM_FD_2_FD3_MM_Cntr_write_IRV: accessed-variable=VeSR2N_Cnt_AGSM_FD_2_FD3_MM_Cntr_write_IRV
            access RV_VeSR2N_b_AGSM_FD_2_FD3_MM_Faild_write_IRV: accessed-variable=VeSR2N_b_AGSM_FD_2_FD3_MM_Faild_write_IRV
          written-local-variables:
            access WV_VeSR2N_Cnt_AGSM_FD_2_FD3_MM_Cntr_write_IRV: accessed-variable=VeSR2N_Cnt_AGSM_FD_2_FD3_MM_Cntr_write_IRV
            access WV_VeSR2N_b_AGSM_FD_2_FD3_MM_Faild_write_IRV: accessed-variable=VeSR2N_b_AGSM_FD_2_FD3_MM_Faild_write_IRV
            access WV_VeSR2N_b_AGSM_FD_2_FD3_NewEvent_write_IRV: accessed-variable=VeSR2N_b_AGSM_FD_2_FD3_NewEvent_write_IRV
        SR2B_AGSM_FD_2_FD3_Error
          read-local-variables:
            access RV_VeSR2B_b_MM_Enbl_write1_IRV: accessed-variable=VeSR2B_b_MM_Enbl_write1_IRV
          written-local-variables:
            access WV_VeSR2N_Cnt_AGSM_FD_2_FD3_MM_Cntr_write_IRV: accessed-variable=VeSR2N_Cnt_AGSM_FD_2_FD3_MM_Cntr_write_IRV
            access WV_VeSR2N_b_AGSM_FD_2_FD3_MM_Faild_write_IRV: accessed-variable=VeSR2N_b_AGSM_FD_2_FD3_MM_Faild_write_IRV
            access WV_VeSR2N_b_AGSM_FD_2_FD3_NewEvent_write_IRV: accessed-variable=VeSR2N_b_AGSM_FD_2_FD3_NewEvent_write_IRV
        SR2B_AGSM_FD_2_FD3_Time
          data-send-points:
            6 x access:
              OUT_VeSCMR_b_Lv2PrmryPRNDDispFailSts_Value: accessed-variable=VeSCMR_b_Lv2PrmryPRNDDispFailSts.Value
              OUT_VeSCMR_b_Lv2PrmryPRNDDispFailSts_FA_Value: accessed-variable=VeSCMR_b_Lv2PrmryPRNDDispFailSts_FA.Value
              OUT_VeSCMR_b_Lv2Prmry_PRNDFailSts_Value: accessed-variable=VeSCMR_b_Lv2Prmry_PRNDFailSts.Value
              OUT_VeSCMR_b_Lv2Prmry_PRNDFailSts_FA_Value: accessed-variable=VeSCMR_b_Lv2Prmry_PRNDFailSts_FA.Value
              OUT_VeSCMR_e_Lv2DrvRqShftROT_Prmry_Value: accessed-variable=VeSCMR_e_Lv2DrvRqShftROT_Prmry.Value
              OUT_VeSCMR_b_Lv2DrvRqShftROT_Prmry_FA_Value: accessed-variable=VeSCMR_b_Lv2DrvRqShftROT_Prmry_FA.Value
          read-local-variables:
            access RV_VeSR2N_b_AGSM_FD_2_FD3_MM_Faild_write_IRV: accessed-variable=VeSR2N_b_AGSM_FD_2_FD3_MM_Faild_write_IRV
            access RV_VeSR2N_b_AGSM_FD_2_FD3_NewEvent_write_IRV: accessed-variable=VeSR2N_b_AGSM_FD_2_FD3_NewEvent_write_IRV
          written-local-variables:
            access WV_VeSR2N_b_AGSM_FD_2_FD3_NewEvent_write_IRV: accessed-variable=VeSR2N_b_AGSM_FD_2_FD3_NewEvent_write_IRV
        SR2B_BCM_FD_10_FD3_Received
          data-receive-point-by-arguments:
            access IN_VeRxPDU_BCM_FD_10_FD3_E2E_Sts_E2ECheckSts: accessed-variable=VeRxPDU_BCM_FD_10_FD3_E2E_Sts.E2ECheckSts
            access IN_VeRxPDU_BCM_FD_10_FD3_E2E_Sts_OpRetVal: accessed-variable=VeRxPDU_BCM_FD_10_FD3_E2E_Sts.OpRetVal
            access IN_VeSR2B_h_COMRX_BCM_FD_10_FD3_Pkt_COMRX_BCM_FD_10_FD3_Pkt: accessed-variable=VeSR2B_h_COMRX_BCM_FD_10_FD3_Pkt.COMRX_BCM_FD_10_FD3_Pkt
          read-local-variables:
            access RV_VeSR2B_b_DevlpmtToolEnbld_write1_IRV: accessed-variable=VeSR2B_b_DevlpmtToolEnbld_write1_IRV
            access RV_VeSR2N_Cnt_BCM_FD_10_FD3_MM_Cntr_write_IRV: accessed-variable=VeSR2N_Cnt_BCM_FD_10_FD3_MM_Cntr_write_IRV
            access RV_VeSR2N_b_BCM_FD_10_FD3_MM_Faild_write_IRV: accessed-variable=VeSR2N_b_BCM_FD_10_FD3_MM_Faild_write_IRV
          written-local-variables:
            access WV_VeSR2N_Cnt_BCM_FD_10_FD3_MM_Cntr_write_IRV: accessed-variable=VeSR2N_Cnt_BCM_FD_10_FD3_MM_Cntr_write_IRV
            access WV_VeSR2N_b_BCM_FD_10_FD3_MM_Faild_write_IRV: accessed-variable=VeSR2N_b_BCM_FD_10_FD3_MM_Faild_write_IRV
            access WV_VeSR2N_b_BCM_FD_10_FD3_NewEvent_write_IRV: accessed-variable=VeSR2N_b_BCM_FD_10_FD3_NewEvent_write_IRV
        SR2B_BCM_FD_10_FD3_Error
          read-local-variables:
            access RV_VeSR2B_b_MM_Enbl_write1_IRV: accessed-variable=VeSR2B_b_MM_Enbl_write1_IRV
          written-local-variables:
            access WV_VeSR2N_Cnt_BCM_FD_10_FD3_MM_Cntr_write_IRV: accessed-variable=VeSR2N_Cnt_BCM_FD_10_FD3_MM_Cntr_write_IRV
            access WV_VeSR2N_b_BCM_FD_10_FD3_MM_Faild_write_IRV: accessed-variable=VeSR2N_b_BCM_FD_10_FD3_MM_Faild_write_IRV
            access WV_VeSR2N_b_BCM_FD_10_FD3_NewEvent_write_IRV: accessed-variable=VeSR2N_b_BCM_FD_10_FD3_NewEvent_write_IRV
        SR2B_BCM_FD_10_FD3_Time
          data-send-points:
            access OUT_VeSCMR_e_Lv2KeySts_Value: accessed-variable=VeSCMR_e_Lv2KeySts.Value
            access OUT_VeSCMR_b_Lv2KeySts_FA_Value: accessed-variable=VeSCMR_b_Lv2KeySts_FA.Value
          read-local-variables:
            access RV_VeSR2N_b_BCM_FD_10_FD3_MM_Faild_write_IRV: accessed-variable=VeSR2N_b_BCM_FD_10_FD3_MM_Faild_write_IRV
            access RV_VeSR2N_b_BCM_FD_10_FD3_NewEvent_write_IRV: accessed-variable=VeSR2N_b_BCM_FD_10_FD3_NewEvent_write_IRV
          written-local-variables:
            access WV_VeSR2N_b_BCM_FD_10_FD3_NewEvent_write_IRV: accessed-variable=VeSR2N_b_BCM_FD_10_FD3_NewEvent_write_IRV
        SR2B_BCM_FD_12_FD3_Received
          data-receive-point-by-arguments:
            access IN_VeRxPDU_BCM_FD_12_FD3_E2E_Sts_E2ECheckSts: accessed-variable=VeRxPDU_BCM_FD_12_FD3_E2E_Sts.E2ECheckSts
            access IN_VeRxPDU_BCM_FD_12_FD3_E2E_Sts_OpRetVal: accessed-variable=VeRxPDU_BCM_FD_12_FD3_E2E_Sts.OpRetVal
            access IN_VeSR2B_h_COMRX_BCM_FD_12_FD3_Pkt_COMRX_BCM_FD_12_FD3_Pkt: accessed-variable=VeSR2B_h_COMRX_BCM_FD_12_FD3_Pkt.COMRX_BCM_FD_12_FD3_Pkt
          read-local-variables:
            access RV_VeSR2B_b_DevlpmtToolEnbld_write1_IRV: accessed-variable=VeSR2B_b_DevlpmtToolEnbld_write1_IRV
            access RV_VeSR2N_Cnt_BCM_FD_12_FD3_MM_Cntr_write_IRV: accessed-variable=VeSR2N_Cnt_BCM_FD_12_FD3_MM_Cntr_write_IRV
            access RV_VeSR2N_b_BCM_FD_12_FD3_MM_Faild_write_IRV: accessed-variable=VeSR2N_b_BCM_FD_12_FD3_MM_Faild_write_IRV
          written-local-variables:
            access WV_VeSR2N_Cnt_BCM_FD_12_FD3_MM_Cntr_write_IRV: accessed-variable=VeSR2N_Cnt_BCM_FD_12_FD3_MM_Cntr_write_IRV
            access WV_VeSR2N_b_BCM_FD_12_FD3_MM_Faild_write_IRV: accessed-variable=VeSR2N_b_BCM_FD_12_FD3_MM_Faild_write_IRV
            access WV_VeSR2N_b_BCM_FD_12_FD3_NewEvent_write_IRV: accessed-variable=VeSR2N_b_BCM_FD_12_FD3_NewEvent_write_IRV
        SR2B_BCM_FD_12_FD3_Error
          read-local-variables:
            access RV_VeSR2B_b_MM_Enbl_write1_IRV: accessed-variable=VeSR2B_b_MM_Enbl_write1_IRV
          written-local-variables:
            access WV_VeSR2N_Cnt_BCM_FD_12_FD3_MM_Cntr_write_IRV: accessed-variable=VeSR2N_Cnt_BCM_FD_12_FD3_MM_Cntr_write_IRV
            access WV_VeSR2N_b_BCM_FD_12_FD3_MM_Faild_write_IRV: accessed-variable=VeSR2N_b_BCM_FD_12_FD3_MM_Faild_write_IRV
            access WV_VeSR2N_b_BCM_FD_12_FD3_NewEvent_write_IRV: accessed-variable=VeSR2N_b_BCM_FD_12_FD3_NewEvent_write_IRV
        SR2B_BCM_FD_12_FD3_Time
          data-send-points:
            access OUT_VeSCMR_e_Lv2GlobDrvMdRq_BCM_Value: accessed-variable=VeSCMR_e_Lv2GlobDrvMdRq_BCM.Value
            access OUT_VeSCMR_b_Lv2GlobDrvMdRq_BCM_FA_Value: accessed-variable=VeSCMR_b_Lv2GlobDrvMdRq_BCM_FA.Value
          read-local-variables:
            access RV_VeSR2N_b_BCM_FD_12_FD3_MM_Faild_write_IRV: accessed-variable=VeSR2N_b_BCM_FD_12_FD3_MM_Faild_write_IRV
            access RV_VeSR2N_b_BCM_FD_12_FD3_NewEvent_write_IRV: accessed-variable=VeSR2N_b_BCM_FD_12_FD3_NewEvent_write_IRV
          written-local-variables:
            access WV_VeSR2N_b_BCM_FD_12_FD3_NewEvent_write_IRV: accessed-variable=VeSR2N_b_BCM_FD_12_FD3_NewEvent_write_IRV
        SR2B_BCM_FD_13_FD3_Received
          data-receive-point-by-arguments:
            access IN_VeRxPDU_BCM_FD_13_FD3_E2E_Sts_E2ECheckSts: accessed-variable=VeRxPDU_BCM_FD_13_FD3_E2E_Sts.E2ECheckSts
            access IN_VeRxPDU_BCM_FD_13_FD3_E2E_Sts_OpRetVal: accessed-variable=VeRxPDU_BCM_FD_13_FD3_E2E_Sts.OpRetVal
            access IN_VeSR2B_h_COMRX_BCM_FD_13_FD3_Pkt_COMRX_BCM_FD_13_FD3_Pkt: accessed-variable=VeSR2B_h_COMRX_BCM_FD_13_FD3_Pkt.COMRX_BCM_FD_13_FD3_Pkt
          read-local-variables:
            access RV_VeSR2B_b_DevlpmtToolEnbld_write1_IRV: accessed-variable=VeSR2B_b_DevlpmtToolEnbld_write1_IRV
            access RV_VeSR2N_Cnt_BCM_FD_13_FD3_MM_Cntr_write_IRV: accessed-variable=VeSR2N_Cnt_BCM_FD_13_FD3_MM_Cntr_write_IRV
            access RV_VeSR2N_b_BCM_FD_13_FD3_MM_Faild_write_IRV: accessed-variable=VeSR2N_b_BCM_FD_13_FD3_MM_Faild_write_IRV
          written-local-variables:
            access WV_VeSR2N_Cnt_BCM_FD_13_FD3_MM_Cntr_write_IRV: accessed-variable=VeSR2N_Cnt_BCM_FD_13_FD3_MM_Cntr_write_IRV
            access WV_VeSR2N_b_BCM_FD_13_FD3_MM_Faild_write_IRV: accessed-variable=VeSR2N_b_BCM_FD_13_FD3_MM_Faild_write_IRV
            access WV_VeSR2N_b_BCM_FD_13_FD3_NewEvent_write_IRV: accessed-variable=VeSR2N_b_BCM_FD_13_FD3_NewEvent_write_IRV
        SR2B_BCM_FD_13_FD3_Error
          read-local-variables:
            access RV_VeSR2B_b_MM_Enbl_write1_IRV: accessed-variable=VeSR2B_b_MM_Enbl_write1_IRV
          written-local-variables:
            access WV_VeSR2N_Cnt_BCM_FD_13_FD3_MM_Cntr_write_IRV: accessed-variable=VeSR2N_Cnt_BCM_FD_13_FD3_MM_Cntr_write_IRV
            access WV_VeSR2N_b_BCM_FD_13_FD3_MM_Faild_write_IRV: accessed-variable=VeSR2N_b_BCM_FD_13_FD3_MM_Faild_write_IRV
            access WV_VeSR2N_b_BCM_FD_13_FD3_NewEvent_write_IRV: accessed-variable=VeSR2N_b_BCM_FD_13_FD3_NewEvent_write_IRV
        SR2B_BCM_FD_13_FD3_Time
          data-send-points:
            8 x access:
              OUT_VeSCMR_b_Lv2ACC_OnOff_Value: accessed-variable=VeSCMR_b_Lv2ACC_OnOff.Value
              OUT_VeSCMR_b_Lv2SCCM_CRS_CTRL_FA_Value: accessed-variable=VeSCMR_b_Lv2SCCM_CRS_CTRL_FA.Value
              OUT_VeSCMR_b_Lv2CrusAccel_Value: accessed-variable=VeSCMR_b_Lv2CrusAccel.Value
              OUT_VeSCMR_b_Lv2Crus_FailSts_Value: accessed-variable=VeSCMR_b_Lv2Crus_FailSts.Value
              OUT_VeSCMR_b_Lv2CrusOnOff_Value: accessed-variable=VeSCMR_b_Lv2CrusOnOff.Value
              OUT_VeSCMR_b_Lv2CrusCancel_Value: accessed-variable=VeSCMR_b_Lv2CrusCancel.Value
              OUT_VeSCMR_b_Lv2CrusDecel_Value: accessed-variable=VeSCMR_b_Lv2CrusDecel.Value
              OUT_VeSCMR_b_Lv2CrusResume_Value: accessed-variable=VeSCMR_b_Lv2CrusResume.Value
          read-local-variables:
            access RV_VeSR2N_b_BCM_FD_13_FD3_MM_Faild_write_IRV: accessed-variable=VeSR2N_b_BCM_FD_13_FD3_MM_Faild_write_IRV
            access RV_VeSR2N_b_BCM_FD_13_FD3_NewEvent_write_IRV: accessed-variable=VeSR2N_b_BCM_FD_13_FD3_NewEvent_write_IRV
          written-local-variables:
            access WV_VeSR2N_b_BCM_FD_13_FD3_NewEvent_write_IRV: accessed-variable=VeSR2N_b_BCM_FD_13_FD3_NewEvent_write_IRV
        SR2B_BCM_FD_2_FD3_Received
          data-receive-point-by-arguments:
            access IN_VeRxPDU_BCM_FD_2_FD3_E2E_Sts_E2ECheckSts: accessed-variable=VeRxPDU_BCM_FD_2_FD3_E2E_Sts.E2ECheckSts
            access IN_VeRxPDU_BCM_FD_2_FD3_E2E_Sts_OpRetVal: accessed-variable=VeRxPDU_BCM_FD_2_FD3_E2E_Sts.OpRetVal
            access IN_VeSR2B_h_COMRX_BCM_FD_2_FD3_Pkt_COMRX_BCM_FD_2_FD3_Pkt: accessed-variable=VeSR2B_h_COMRX_BCM_FD_2_FD3_Pkt.COMRX_BCM_FD_2_FD3_Pkt
          read-local-variables:
            access RV_VeSR2B_b_DevlpmtToolEnbld_write1_IRV: accessed-variable=VeSR2B_b_DevlpmtToolEnbld_write1_IRV
            access RV_VeSR2N_Cnt_BCM_FD_2_FD3_MM_Cntr_write_IRV: accessed-variable=VeSR2N_Cnt_BCM_FD_2_FD3_MM_Cntr_write_IRV
            access RV_VeSR2N_b_BCM_FD_2_FD3_MM_Faild_write_IRV: accessed-variable=VeSR2N_b_BCM_FD_2_FD3_MM_Faild_write_IRV
          written-local-variables:
            access WV_VeSR2N_Cnt_BCM_FD_2_FD3_MM_Cntr_write_IRV: accessed-variable=VeSR2N_Cnt_BCM_FD_2_FD3_MM_Cntr_write_IRV
            access WV_VeSR2N_b_BCM_FD_2_FD3_MM_Faild_write_IRV: accessed-variable=VeSR2N_b_BCM_FD_2_FD3_MM_Faild_write_IRV
            access WV_VeSR2N_b_BCM_FD_2_FD3_NewEvent_write_IRV: accessed-variable=VeSR2N_b_BCM_FD_2_FD3_NewEvent_write_IRV
        SR2B_BCM_FD_2_FD3_Error
          read-local-variables:
            access RV_VeSR2B_b_MM_Enbl_write1_IRV: accessed-variable=VeSR2B_b_MM_Enbl_write1_IRV
          written-local-variables:
            access WV_VeSR2N_Cnt_BCM_FD_2_FD3_MM_Cntr_write_IRV: accessed-variable=VeSR2N_Cnt_BCM_FD_2_FD3_MM_Cntr_write_IRV
            access WV_VeSR2N_b_BCM_FD_2_FD3_MM_Faild_write_IRV: accessed-variable=VeSR2N_b_BCM_FD_2_FD3_MM_Faild_write_IRV
            access WV_VeSR2N_b_BCM_FD_2_FD3_NewEvent_write_IRV: accessed-variable=VeSR2N_b_BCM_FD_2_FD3_NewEvent_write_IRV
        SR2B_BCM_FD_2_FD3_Time
          data-send-points:
            4 x access:
              OUT_VeSCMR_y_Lv2OperationalModeSts_Value: accessed-variable=VeSCMR_y_Lv2OperationalModeSts.Value
              OUT_VeSCMR_b_Lv2OperationalModeSts_FA_Value: accessed-variable=VeSCMR_b_Lv2OperationalModeSts_FA.Value
              OUT_VeSCMR_b_Lv2RmtStrtActv_Value: accessed-variable=VeSCMR_b_Lv2RmtStrtActv.Value
              OUT_VeSCMR_b_Lv2RmtStrtActv_FA_Value: accessed-variable=VeSCMR_b_Lv2RmtStrtActv_FA.Value
          read-local-variables:
            access RV_VeSR2N_b_BCM_FD_2_FD3_MM_Faild_write_IRV: accessed-variable=VeSR2N_b_BCM_FD_2_FD3_MM_Faild_write_IRV
            access RV_VeSR2N_b_BCM_FD_2_FD3_NewEvent_write_IRV: accessed-variable=VeSR2N_b_BCM_FD_2_FD3_NewEvent_write_IRV
          written-local-variables:
            access WV_VeSR2N_b_BCM_FD_2_FD3_NewEvent_write_IRV: accessed-variable=VeSR2N_b_BCM_FD_2_FD3_NewEvent_write_IRV
        SR2B_BRAKE_FD_1_FD3_Received
          data-receive-point-by-arguments:
            access IN_VeRxPDU_BRAKE_FD_1_FD3_E2E_Sts_E2ECheckSts: accessed-variable=VeRxPDU_BRAKE_FD_1_FD3_E2E_Sts.E2ECheckSts
            access IN_VeRxPDU_BRAKE_FD_1_FD3_E2E_Sts_OpRetVal: accessed-variable=VeRxPDU_BRAKE_FD_1_FD3_E2E_Sts.OpRetVal
            access IN_VeSR2B_h_COMRX_BRAKE_FD_1_FD3_Pkt_COMRX_BRAKE_FD_1_FD3_Pkt: accessed-variable=VeSR2B_h_COMRX_BRAKE_FD_1_FD3_Pkt.COMRX_BRAKE_FD_1_FD3_Pkt
          read-local-variables:
            access RV_VeSR2B_b_DevlpmtToolEnbld_write1_IRV: accessed-variable=VeSR2B_b_DevlpmtToolEnbld_write1_IRV
            access RV_VeSR2N_Cnt_BRAKE_FD_1_FD3_MM_Cntr_write_IRV: accessed-variable=VeSR2N_Cnt_BRAKE_FD_1_FD3_MM_Cntr_write_IRV
            access RV_VeSR2N_b_BRAKE_FD_1_FD3_MM_Faild_write_IRV: accessed-variable=VeSR2N_b_BRAKE_FD_1_FD3_MM_Faild_write_IRV
          written-local-variables:
            access WV_VeSR2N_Cnt_BRAKE_FD_1_FD3_MM_Cntr_write_IRV: accessed-variable=VeSR2N_Cnt_BRAKE_FD_1_FD3_MM_Cntr_write_IRV
            access WV_VeSR2N_b_BRAKE_FD_1_FD3_MM_Faild_write_IRV: accessed-variable=VeSR2N_b_BRAKE_FD_1_FD3_MM_Faild_write_IRV
            access WV_VeSR2N_b_BRAKE_FD_1_FD3_NewEvent_write_IRV: accessed-variable=VeSR2N_b_BRAKE_FD_1_FD3_NewEvent_write_IRV
        SR2B_BRAKE_FD_1_FD3_Error
          read-local-variables:
            access RV_VeSR2B_b_MM_Enbl_write1_IRV: accessed-variable=VeSR2B_b_MM_Enbl_write1_IRV
          written-local-variables:
            access WV_VeSR2N_Cnt_BRAKE_FD_1_FD3_MM_Cntr_write_IRV: accessed-variable=VeSR2N_Cnt_BRAKE_FD_1_FD3_MM_Cntr_write_IRV
            access WV_VeSR2N_b_BRAKE_FD_1_FD3_MM_Faild_write_IRV: accessed-variable=VeSR2N_b_BRAKE_FD_1_FD3_MM_Faild_write_IRV
            access WV_VeSR2N_b_BRAKE_FD_1_FD3_NewEvent_write_IRV: accessed-variable=VeSR2N_b_BRAKE_FD_1_FD3_NewEvent_write_IRV
        SR2B_BRAKE_FD_1_FD3_Time
          data-send-points:
            4 x access:
              OUT_VeSCMR_M_Lv2BrkTrq_Value: accessed-variable=VeSCMR_M_Lv2BrkTrq.Value
              OUT_VeSCMR_b_Lv2BrkTrq_FA_Value: accessed-variable=VeSCMR_b_Lv2BrkTrq_FA.Value
              OUT_VeSCMR_M_Lv2BrkTrqDriver_Value: accessed-variable=VeSCMR_M_Lv2BrkTrqDriver.Value
              OUT_VeSCMR_b_Lv2BrkTrqDriver_FA_Value: accessed-variable=VeSCMR_b_Lv2BrkTrqDriver_FA.Value
          read-local-variables:
            access RV_VeSR2N_b_BRAKE_FD_1_FD3_MM_Faild_write_IRV: accessed-variable=VeSR2N_b_BRAKE_FD_1_FD3_MM_Faild_write_IRV
            access RV_VeSR2N_b_BRAKE_FD_1_FD3_NewEvent_write_IRV: accessed-variable=VeSR2N_b_BRAKE_FD_1_FD3_NewEvent_write_IRV
          written-local-variables:
            access WV_VeSR2N_b_BRAKE_FD_1_FD3_NewEvent_write_IRV: accessed-variable=VeSR2N_b_BRAKE_FD_1_FD3_NewEvent_write_IRV
        SR2B_BRAKE_FD_2_FD3_Received
          data-receive-point-by-arguments:
            access IN_VeRxPDU_BRAKE_FD_2_FD3_E2E_Sts_E2ECheckSts: accessed-variable=VeRxPDU_BRAKE_FD_2_FD3_E2E_Sts.E2ECheckSts
            access IN_VeRxPDU_BRAKE_FD_2_FD3_E2E_Sts_OpRetVal: accessed-variable=VeRxPDU_BRAKE_FD_2_FD3_E2E_Sts.OpRetVal
            access IN_VeSR2B_h_COMRX_BRAKE_FD_2_FD3_Pkt_COMRX_BRAKE_FD_2_FD3_Pkt: accessed-variable=VeSR2B_h_COMRX_BRAKE_FD_2_FD3_Pkt.COMRX_BRAKE_FD_2_FD3_Pkt
          read-local-variables:
            access RV_VeSR2B_b_DevlpmtToolEnbld_write1_IRV: accessed-variable=VeSR2B_b_DevlpmtToolEnbld_write1_IRV
            access RV_VeSR2N_Cnt_BRAKE_FD_2_FD3_MM_Cntr_write_IRV: accessed-variable=VeSR2N_Cnt_BRAKE_FD_2_FD3_MM_Cntr_write_IRV
            access RV_VeSR2N_b_BRAKE_FD_2_FD3_MM_Faild_write_IRV: accessed-variable=VeSR2N_b_BRAKE_FD_2_FD3_MM_Faild_write_IRV
          written-local-variables:
            access WV_VeSR2N_Cnt_BRAKE_FD_2_FD3_MM_Cntr_write_IRV: accessed-variable=VeSR2N_Cnt_BRAKE_FD_2_FD3_MM_Cntr_write_IRV
            access WV_VeSR2N_b_BRAKE_FD_2_FD3_MM_Faild_write_IRV: accessed-variable=VeSR2N_b_BRAKE_FD_2_FD3_MM_Faild_write_IRV
            access WV_VeSR2N_b_BRAKE_FD_2_FD3_NewEvent_write_IRV: accessed-variable=VeSR2N_b_BRAKE_FD_2_FD3_NewEvent_write_IRV
        SR2B_BRAKE_FD_2_FD3_Error
          read-local-variables:
            access RV_VeSR2B_b_MM_Enbl_write1_IRV: accessed-variable=VeSR2B_b_MM_Enbl_write1_IRV
          written-local-variables:
            access WV_VeSR2N_Cnt_BRAKE_FD_2_FD3_MM_Cntr_write_IRV: accessed-variable=VeSR2N_Cnt_BRAKE_FD_2_FD3_MM_Cntr_write_IRV
            access WV_VeSR2N_b_BRAKE_FD_2_FD3_MM_Faild_write_IRV: accessed-variable=VeSR2N_b_BRAKE_FD_2_FD3_MM_Faild_write_IRV
            access WV_VeSR2N_b_BRAKE_FD_2_FD3_NewEvent_write_IRV: accessed-variable=VeSR2N_b_BRAKE_FD_2_FD3_NewEvent_write_IRV
        SR2B_BRAKE_FD_2_FD3_Time
          data-send-points:
            16 x access:
              OUT_VeSCMR_b_Lv2ABSActive_Value: accessed-variable=VeSCMR_b_Lv2ABSActive.Value
              OUT_VeSCMR_b_Lv2ABSActive_FA_Value: accessed-variable=VeSCMR_b_Lv2ABSActive_FA.Value
              OUT_VeSCMR_e_Lv2BrkMaxRgnReady_Value: accessed-variable=VeSCMR_e_Lv2BrkMaxRgnReady.Value
              OUT_VeSCMR_b_Lv2BrkMaxRgnReady_FA_Value: accessed-variable=VeSCMR_b_Lv2BrkMaxRgnReady_FA.Value
              OUT_VeSCMR_p_Lv2BrakeBoostPressure_Value: accessed-variable=VeSCMR_p_Lv2BrakeBoostPressure.Value
              OUT_VeSCMR_b_Lv2BrkBoostPressure_FA_Value: accessed-variable=VeSCMR_b_Lv2BrkBoostPressure_FA.Value
              OUT_VeSCMR_b_Lv2ESC_Active_Value: accessed-variable=VeSCMR_b_Lv2ESC_Active.Value
              OUT_VeSCMR_b_Lv2ESC_Active_FA_Value: accessed-variable=VeSCMR_b_Lv2ESC_Active_FA.Value
              OUT_VeSCMR_e_Lv2ParkingGearShiftReq_BSM_Value: accessed-variable=VeSCMR_e_Lv2ParkingGearShiftReq_BSM.Value
              OUT_VeSCMR_b_Lv2ParkingGearShiftReq_BSM_FA_Value: accessed-variable=VeSCMR_b_Lv2ParkingGearShiftReq_BSM_FA.Value
              OUT_VeSCMR_v_Lv2VehSpdCANC_Value: accessed-variable=VeSCMR_v_Lv2VehSpdCANC.Value
              OUT_VeSCMR_b_Lv2VehSpdCANC_FA_Value: accessed-variable=VeSCMR_b_Lv2VehSpdCANC_FA.Value
              OUT_VeSCMR_n_Lv2WhlFL_RPS_Value: accessed-variable=VeSCMR_n_Lv2WhlFL_RPS.Value
              OUT_VeSCMR_b_Lv2WhlFL_RPS_FA_Value: accessed-variable=VeSCMR_b_Lv2WhlFL_RPS_FA.Value
              OUT_VeSCMR_n_Lv2WhlFR_RPS_Value: accessed-variable=VeSCMR_n_Lv2WhlFR_RPS.Value
              OUT_VeSCMR_b_Lv2WhlFR_RPS_FA_Value: accessed-variable=VeSCMR_b_Lv2WhlFR_RPS_FA.Value
          read-local-variables:
            access RV_VeSR2N_b_BRAKE_FD_2_FD3_MM_Faild_write_IRV: accessed-variable=VeSR2N_b_BRAKE_FD_2_FD3_MM_Faild_write_IRV
            access RV_VeSR2N_b_BRAKE_FD_2_FD3_NewEvent_write_IRV: accessed-variable=VeSR2N_b_BRAKE_FD_2_FD3_NewEvent_write_IRV
          written-local-variables:
            access WV_VeSR2N_b_BRAKE_FD_2_FD3_NewEvent_write_IRV: accessed-variable=VeSR2N_b_BRAKE_FD_2_FD3_NewEvent_write_IRV
        SR2B_BRAKE_FD_3_FD3_Received
          data-receive-point-by-arguments:
            access IN_VeRxPDU_BRAKE_FD_3_FD3_E2E_Sts_E2ECheckSts: accessed-variable=VeRxPDU_BRAKE_FD_3_FD3_E2E_Sts.E2ECheckSts
            access IN_VeRxPDU_BRAKE_FD_3_FD3_E2E_Sts_OpRetVal: accessed-variable=VeRxPDU_BRAKE_FD_3_FD3_E2E_Sts.OpRetVal
            access IN_VeSR2B_h_COMRX_BRAKE_FD_3_FD3_Pkt_COMRX_BRAKE_FD_3_FD3_Pkt: accessed-variable=VeSR2B_h_COMRX_BRAKE_FD_3_FD3_Pkt.COMRX_BRAKE_FD_3_FD3_Pkt
          read-local-variables:
            access RV_VeSR2B_b_DevlpmtToolEnbld_write1_IRV: accessed-variable=VeSR2B_b_DevlpmtToolEnbld_write1_IRV
            access RV_VeSR2N_Cnt_BRAKE_FD_3_FD3_MM_Cntr_write_IRV: accessed-variable=VeSR2N_Cnt_BRAKE_FD_3_FD3_MM_Cntr_write_IRV
            access RV_VeSR2N_b_BRAKE_FD_3_FD3_MM_Faild_write_IRV: accessed-variable=VeSR2N_b_BRAKE_FD_3_FD3_MM_Faild_write_IRV
          written-local-variables:
            access WV_VeSR2N_Cnt_BRAKE_FD_3_FD3_MM_Cntr_write_IRV: accessed-variable=VeSR2N_Cnt_BRAKE_FD_3_FD3_MM_Cntr_write_IRV
            access WV_VeSR2N_b_BRAKE_FD_3_FD3_MM_Faild_write_IRV: accessed-variable=VeSR2N_b_BRAKE_FD_3_FD3_MM_Faild_write_IRV
            access WV_VeSR2N_b_BRAKE_FD_3_FD3_NewEvent_write_IRV: accessed-variable=VeSR2N_b_BRAKE_FD_3_FD3_NewEvent_write_IRV
        SR2B_BRAKE_FD_3_FD3_Error
          read-local-variables:
            access RV_VeSR2B_b_MM_Enbl_write1_IRV: accessed-variable=VeSR2B_b_MM_Enbl_write1_IRV
          written-local-variables:
            access WV_VeSR2N_Cnt_BRAKE_FD_3_FD3_MM_Cntr_write_IRV: accessed-variable=VeSR2N_Cnt_BRAKE_FD_3_FD3_MM_Cntr_write_IRV
            access WV_VeSR2N_b_BRAKE_FD_3_FD3_MM_Faild_write_IRV: accessed-variable=VeSR2N_b_BRAKE_FD_3_FD3_MM_Faild_write_IRV
            access WV_VeSR2N_b_BRAKE_FD_3_FD3_NewEvent_write_IRV: accessed-variable=VeSR2N_b_BRAKE_FD_3_FD3_NewEvent_write_IRV
        SR2B_BRAKE_FD_3_FD3_Time
          data-send-points:
            24 x access:
              OUT_VeSCMR_e_Lv2WhlDirFL_Stat_Value: accessed-variable=VeSCMR_e_Lv2WhlDirFL_Stat.Value
              OUT_VeSCMR_b_Lv2WhlDirFL_Stat_FA_Value: accessed-variable=VeSCMR_b_Lv2WhlDirFL_Stat_FA.Value
              OUT_VeSCMR_b_Lv2WhlSensFailFL_Value: accessed-variable=VeSCMR_b_Lv2WhlSensFailFL.Value
              OUT_VeSCMR_b_Lv2WhlSensFailFL_FA_Value: accessed-variable=VeSCMR_b_Lv2WhlSensFailFL_FA.Value
              OUT_VeSCMR_n_Lv2WhlFL_Spd_Value: accessed-variable=VeSCMR_n_Lv2WhlFL_Spd.Value
              OUT_VeSCMR_b_Lv2WhlFL_Spd_FA_Value: accessed-variable=VeSCMR_b_Lv2WhlFL_Spd_FA.Value
              OUT_VeSCMR_e_Lv2WhlDirRL_Stat_Value: accessed-variable=VeSCMR_e_Lv2WhlDirRL_Stat.Value
              OUT_VeSCMR_b_Lv2WhlDirRL_Stat_FA_Value: accessed-variable=VeSCMR_b_Lv2WhlDirRL_Stat_FA.Value
              OUT_VeSCMR_b_Lv2WhlSensFailRL_Value: accessed-variable=VeSCMR_b_Lv2WhlSensFailRL.Value
              OUT_VeSCMR_b_Lv2WhlSensFailRL_FA_Value: accessed-variable=VeSCMR_b_Lv2WhlSensFailRL_FA.Value
              OUT_VeSCMR_n_Lv2WhlRL_Spd_Value: accessed-variable=VeSCMR_n_Lv2WhlRL_Spd.Value
              OUT_VeSCMR_b_Lv2WhlRL_Spd_FA_Value: accessed-variable=VeSCMR_b_Lv2WhlRL_Spd_FA.Value
              OUT_VeSCMR_e_Lv2WhlDirFR_Stat_Value: accessed-variable=VeSCMR_e_Lv2WhlDirFR_Stat.Value
              OUT_VeSCMR_b_Lv2WhlDirFR_Stat_FA_Value: accessed-variable=VeSCMR_b_Lv2WhlDirFR_Stat_FA.Value
              OUT_VeSCMR_b_Lv2WhlSensFailFR_Value: accessed-variable=VeSCMR_b_Lv2WhlSensFailFR.Value
              OUT_VeSCMR_b_Lv2WhlSensFailFR_FA_Value: accessed-variable=VeSCMR_b_Lv2WhlSensFailFR_FA.Value
              OUT_VeSCMR_n_Lv2WhlFR_Spd_Value: accessed-variable=VeSCMR_n_Lv2WhlFR_Spd.Value
              OUT_VeSCMR_b_Lv2WhlFR_Spd_FA_Value: accessed-variable=VeSCMR_b_Lv2WhlFR_Spd_FA.Value
              OUT_VeSCMR_e_Lv2WhlDirRR_Stat_Value: accessed-variable=VeSCMR_e_Lv2WhlDirRR_Stat.Value
              OUT_VeSCMR_b_Lv2WhlDirRR_Stat_FA_Value: accessed-variable=VeSCMR_b_Lv2WhlDirRR_Stat_FA.Value
              OUT_VeSCMR_b_Lv2WhlSensFailRR_Value: accessed-variable=VeSCMR_b_Lv2WhlSensFailRR.Value
              OUT_VeSCMR_b_Lv2WhlSensFailRR_FA_Value: accessed-variable=VeSCMR_b_Lv2WhlSensFailRR_FA.Value
              OUT_VeSCMR_n_Lv2WhlRR_Spd_Value: accessed-variable=VeSCMR_n_Lv2WhlRR_Spd.Value
              OUT_VeSCMR_b_Lv2WhlRR_Spd_FA_Value: accessed-variable=VeSCMR_b_Lv2WhlRR_Spd_FA.Value
          read-local-variables:
            access RV_VeSR2N_b_BRAKE_FD_3_FD3_MM_Faild_write_IRV: accessed-variable=VeSR2N_b_BRAKE_FD_3_FD3_MM_Faild_write_IRV
            access RV_VeSR2N_b_BRAKE_FD_3_FD3_NewEvent_write_IRV: accessed-variable=VeSR2N_b_BRAKE_FD_3_FD3_NewEvent_write_IRV
          written-local-variables:
            access WV_VeSR2N_b_BRAKE_FD_3_FD3_NewEvent_write_IRV: accessed-variable=VeSR2N_b_BRAKE_FD_3_FD3_NewEvent_write_IRV
        SR2B_BRAKE_FD_4_FD3_Received
          data-receive-point-by-arguments:
            access IN_VeRxPDU_BRAKE_FD_4_FD3_E2E_Sts_E2ECheckSts: accessed-variable=VeRxPDU_BRAKE_FD_4_FD3_E2E_Sts.E2ECheckSts
            access IN_VeRxPDU_BRAKE_FD_4_FD3_E2E_Sts_OpRetVal: accessed-variable=VeRxPDU_BRAKE_FD_4_FD3_E2E_Sts.OpRetVal
            access IN_VeSR2B_h_COMRX_BRAKE_FD_4_FD3_Pkt_COMRX_BRAKE_FD_4_FD3_Pkt: accessed-variable=VeSR2B_h_COMRX_BRAKE_FD_4_FD3_Pkt.COMRX_BRAKE_FD_4_FD3_Pkt
          read-local-variables:
            access RV_VeSR2B_b_DevlpmtToolEnbld_write1_IRV: accessed-variable=VeSR2B_b_DevlpmtToolEnbld_write1_IRV
            access RV_VeSR2N_Cnt_BRAKE_FD_4_FD3_MM_Cntr_write_IRV: accessed-variable=VeSR2N_Cnt_BRAKE_FD_4_FD3_MM_Cntr_write_IRV
            access RV_VeSR2N_b_BRAKE_FD_4_FD3_MM_Faild_write_IRV: accessed-variable=VeSR2N_b_BRAKE_FD_4_FD3_MM_Faild_write_IRV
          written-local-variables:
            access WV_VeSR2N_Cnt_BRAKE_FD_4_FD3_MM_Cntr_write_IRV: accessed-variable=VeSR2N_Cnt_BRAKE_FD_4_FD3_MM_Cntr_write_IRV
            access WV_VeSR2N_b_BRAKE_FD_4_FD3_MM_Faild_write_IRV: accessed-variable=VeSR2N_b_BRAKE_FD_4_FD3_MM_Faild_write_IRV
            access WV_VeSR2N_b_BRAKE_FD_4_FD3_NewEvent_write_IRV: accessed-variable=VeSR2N_b_BRAKE_FD_4_FD3_NewEvent_write_IRV
        SR2B_BRAKE_FD_4_FD3_Error
          read-local-variables:
            access RV_VeSR2B_b_MM_Enbl_write1_IRV: accessed-variable=VeSR2B_b_MM_Enbl_write1_IRV
          written-local-variables:
            access WV_VeSR2N_Cnt_BRAKE_FD_4_FD3_MM_Cntr_write_IRV: accessed-variable=VeSR2N_Cnt_BRAKE_FD_4_FD3_MM_Cntr_write_IRV
            access WV_VeSR2N_b_BRAKE_FD_4_FD3_MM_Faild_write_IRV: accessed-variable=VeSR2N_b_BRAKE_FD_4_FD3_MM_Faild_write_IRV
            access WV_VeSR2N_b_BRAKE_FD_4_FD3_NewEvent_write_IRV: accessed-variable=VeSR2N_b_BRAKE_FD_4_FD3_NewEvent_write_IRV
        SR2B_BRAKE_FD_4_FD3_Time
          data-send-points:
            5 x access:
              OUT_VeSCMR_b_Lv2ASRActive_Value: accessed-variable=VeSCMR_b_Lv2ASRActive.Value
              OUT_VeSCMR_b_Lv2ASR_MSRActv_FA_Value: accessed-variable=VeSCMR_b_Lv2ASR_MSRActv_FA.Value
              OUT_VeSCMR_e_Lv2EPB_HoldSts_Value: accessed-variable=VeSCMR_e_Lv2EPB_HoldSts.Value
              OUT_VeSCMR_b_Lv2EPB_HoldSts_FA_Value: accessed-variable=VeSCMR_b_Lv2EPB_HoldSts_FA.Value
              OUT_VeSCMR_b_Lv2MSRActive_Value: accessed-variable=VeSCMR_b_Lv2MSRActive.Value
          read-local-variables:
            access RV_VeSR2N_b_BRAKE_FD_4_FD3_MM_Faild_write_IRV: accessed-variable=VeSR2N_b_BRAKE_FD_4_FD3_MM_Faild_write_IRV
            access RV_VeSR2N_b_BRAKE_FD_4_FD3_NewEvent_write_IRV: accessed-variable=VeSR2N_b_BRAKE_FD_4_FD3_NewEvent_write_IRV
          written-local-variables:
            access WV_VeSR2N_b_BRAKE_FD_4_FD3_NewEvent_write_IRV: accessed-variable=VeSR2N_b_BRAKE_FD_4_FD3_NewEvent_write_IRV
        SR2B_BRAKE_FD_5_FD3_Received
          data-receive-point-by-arguments:
            access IN_VeRxPDU_BRAKE_FD_5_FD3_E2E_Sts_E2ECheckSts: accessed-variable=VeRxPDU_BRAKE_FD_5_FD3_E2E_Sts.E2ECheckSts
            access IN_VeRxPDU_BRAKE_FD_5_FD3_E2E_Sts_OpRetVal: accessed-variable=VeRxPDU_BRAKE_FD_5_FD3_E2E_Sts.OpRetVal
            access IN_VeSR2B_h_COMRX_BRAKE_FD_5_FD3_Pkt_COMRX_BRAKE_FD_5_FD3_Pkt: accessed-variable=VeSR2B_h_COMRX_BRAKE_FD_5_FD3_Pkt.COMRX_BRAKE_FD_5_FD3_Pkt
          read-local-variables:
            access RV_VeSR2B_b_DevlpmtToolEnbld_write1_IRV: accessed-variable=VeSR2B_b_DevlpmtToolEnbld_write1_IRV
            access RV_VeSR2N_Cnt_BRAKE_FD_5_FD3_MM_Cntr_write_IRV: accessed-variable=VeSR2N_Cnt_BRAKE_FD_5_FD3_MM_Cntr_write_IRV
            access RV_VeSR2N_b_BRAKE_FD_5_FD3_MM_Faild_write_IRV: accessed-variable=VeSR2N_b_BRAKE_FD_5_FD3_MM_Faild_write_IRV
          written-local-variables:
            access WV_VeSR2N_Cnt_BRAKE_FD_5_FD3_MM_Cntr_write_IRV: accessed-variable=VeSR2N_Cnt_BRAKE_FD_5_FD3_MM_Cntr_write_IRV
            access WV_VeSR2N_b_BRAKE_FD_5_FD3_MM_Faild_write_IRV: accessed-variable=VeSR2N_b_BRAKE_FD_5_FD3_MM_Faild_write_IRV
            access WV_VeSR2N_b_BRAKE_FD_5_FD3_NewEvent_write_IRV: accessed-variable=VeSR2N_b_BRAKE_FD_5_FD3_NewEvent_write_IRV
        SR2B_BRAKE_FD_5_FD3_Error
          read-local-variables:
            access RV_VeSR2B_b_MM_Enbl_write1_IRV: accessed-variable=VeSR2B_b_MM_Enbl_write1_IRV
          written-local-variables:
            access WV_VeSR2N_Cnt_BRAKE_FD_5_FD3_MM_Cntr_write_IRV: accessed-variable=VeSR2N_Cnt_BRAKE_FD_5_FD3_MM_Cntr_write_IRV
            access WV_VeSR2N_b_BRAKE_FD_5_FD3_MM_Faild_write_IRV: accessed-variable=VeSR2N_b_BRAKE_FD_5_FD3_MM_Faild_write_IRV
            access WV_VeSR2N_b_BRAKE_FD_5_FD3_NewEvent_write_IRV: accessed-variable=VeSR2N_b_BRAKE_FD_5_FD3_NewEvent_write_IRV
        SR2B_BRAKE_FD_5_FD3_Time
          data-send-points:
            10 x access:
              OUT_VeSCMR_b_Lv2ABSFailSts_Value: accessed-variable=VeSCMR_b_Lv2ABSFailSts.Value
              OUT_VeSCMR_b_Lv2ABSFailSts_FA_Value: accessed-variable=VeSCMR_b_Lv2ABSFailSts_FA.Value
              OUT_VeSCMR_b_Lv2ACC_Engaged_Value: accessed-variable=VeSCMR_b_Lv2ACC_Engaged.Value
              OUT_VeSCMR_b_Lv2ACC_Engaged_FA_Value: accessed-variable=VeSCMR_b_Lv2ACC_Engaged_FA.Value
              OUT_VeSCMR_b_Lv2ESC_FailSts_Value: accessed-variable=VeSCMR_b_Lv2ESC_FailSts.Value
              OUT_VeSCMR_b_Lv2ESC_FailSts_FA_Value: accessed-variable=VeSCMR_b_Lv2ESC_FailSts_FA.Value
              OUT_VeSCMR_b_Lv2Function2Sts_Value: accessed-variable=VeSCMR_b_Lv2Function2Sts.Value
              OUT_VeSCMR_b_Lv2Function2Sts_FA_Value: accessed-variable=VeSCMR_b_Lv2Function2Sts_FA.Value
              OUT_VeSCMR_b_Lv2RollsModeAct_Value: accessed-variable=VeSCMR_b_Lv2RollsModeAct.Value
              OUT_VeSCMR_b_Lv2RollsModeAct_FA_Value: accessed-variable=VeSCMR_b_Lv2RollsModeAct_FA.Value
          read-local-variables:
            access RV_VeSR2N_b_BRAKE_FD_5_FD3_MM_Faild_write_IRV: accessed-variable=VeSR2N_b_BRAKE_FD_5_FD3_MM_Faild_write_IRV
            access RV_VeSR2N_b_BRAKE_FD_5_FD3_NewEvent_write_IRV: accessed-variable=VeSR2N_b_BRAKE_FD_5_FD3_NewEvent_write_IRV
          written-local-variables:
            access WV_VeSR2N_b_BRAKE_FD_5_FD3_NewEvent_write_IRV: accessed-variable=VeSR2N_b_BRAKE_FD_5_FD3_NewEvent_write_IRV
        SR2B_BRAKE_FD_6_FD3_Received
          data-receive-point-by-arguments:
            access IN_VeRxPDU_BRAKE_FD_6_FD3_E2E_Sts_E2ECheckSts: accessed-variable=VeRxPDU_BRAKE_FD_6_FD3_E2E_Sts.E2ECheckSts
            access IN_VeRxPDU_BRAKE_FD_6_FD3_E2E_Sts_OpRetVal: accessed-variable=VeRxPDU_BRAKE_FD_6_FD3_E2E_Sts.OpRetVal
            access IN_VeSR2B_h_COMRX_BRAKE_FD_6_FD3_Pkt_COMRX_BRAKE_FD_6_FD3_Pkt: accessed-variable=VeSR2B_h_COMRX_BRAKE_FD_6_FD3_Pkt.COMRX_BRAKE_FD_6_FD3_Pkt
          read-local-variables:
            access RV_VeSR2B_b_DevlpmtToolEnbld_write1_IRV: accessed-variable=VeSR2B_b_DevlpmtToolEnbld_write1_IRV
            access RV_VeSR2N_Cnt_BRAKE_FD_6_FD3_MM_Cntr_write_IRV: accessed-variable=VeSR2N_Cnt_BRAKE_FD_6_FD3_MM_Cntr_write_IRV
            access RV_VeSR2N_b_BRAKE_FD_6_FD3_MM_Faild_write_IRV: accessed-variable=VeSR2N_b_BRAKE_FD_6_FD3_MM_Faild_write_IRV
          written-local-variables:
            access WV_VeSR2N_Cnt_BRAKE_FD_6_FD3_MM_Cntr_write_IRV: accessed-variable=VeSR2N_Cnt_BRAKE_FD_6_FD3_MM_Cntr_write_IRV
            access WV_VeSR2N_b_BRAKE_FD_6_FD3_MM_Faild_write_IRV: accessed-variable=VeSR2N_b_BRAKE_FD_6_FD3_MM_Faild_write_IRV
            access WV_VeSR2N_b_BRAKE_FD_6_FD3_NewEvent_write_IRV: accessed-variable=VeSR2N_b_BRAKE_FD_6_FD3_NewEvent_write_IRV
        SR2B_BRAKE_FD_6_FD3_Error
          read-local-variables:
            access RV_VeSR2B_b_MM_Enbl_write1_IRV: accessed-variable=VeSR2B_b_MM_Enbl_write1_IRV
          written-local-variables:
            access WV_VeSR2N_Cnt_BRAKE_FD_6_FD3_MM_Cntr_write_IRV: accessed-variable=VeSR2N_Cnt_BRAKE_FD_6_FD3_MM_Cntr_write_IRV
            access WV_VeSR2N_b_BRAKE_FD_6_FD3_MM_Faild_write_IRV: accessed-variable=VeSR2N_b_BRAKE_FD_6_FD3_MM_Faild_write_IRV
            access WV_VeSR2N_b_BRAKE_FD_6_FD3_NewEvent_write_IRV: accessed-variable=VeSR2N_b_BRAKE_FD_6_FD3_NewEvent_write_IRV
        SR2B_BRAKE_FD_6_FD3_Time
          data-send-points:
            14 x access:
              OUT_VeSCMR_b_Lv2FrntAxlMaxRq_BSM_Value: accessed-variable=VeSCMR_b_Lv2FrntAxlMaxRq_BSM.Value
              OUT_VeSCMR_b_Lv2FrntAxlMaxRq_BSM_FA_Value: accessed-variable=VeSCMR_b_Lv2FrntAxlMaxRq_BSM_FA.Value
              OUT_VeSCMR_b_Lv2FrntAxlMinRq_BSM_Value: accessed-variable=VeSCMR_b_Lv2FrntAxlMinRq_BSM.Value
              OUT_VeSCMR_b_Lv2FrntAxlMinRq_BSM_FA_Value: accessed-variable=VeSCMR_b_Lv2FrntAxlMinRq_BSM_FA.Value
              OUT_VeSCMR_M_Lv2FrntAxlRq_BSM_Value: accessed-variable=VeSCMR_M_Lv2FrntAxlRq_BSM.Value
              OUT_VeSCMR_b_Lv2FrntAxlRq_BSM_FA_Value: accessed-variable=VeSCMR_b_Lv2FrntAxlRq_BSM_FA.Value
              OUT_VeSCMR_b_Lv2RrAxlMaxRq_BSM_Value: accessed-variable=VeSCMR_b_Lv2RrAxlMaxRq_BSM.Value
              OUT_VeSCMR_b_Lv2RrAxlMaxRq_BSM_FA_Value: accessed-variable=VeSCMR_b_Lv2RrAxlMaxRq_BSM_FA.Value
              OUT_VeSCMR_b_Lv2RrAxlMinRq_BSM_Value: accessed-variable=VeSCMR_b_Lv2RrAxlMinRq_BSM.Value
              OUT_VeSCMR_b_Lv2RrAxlMinRq_BSM_FA_Value: accessed-variable=VeSCMR_b_Lv2RrAxlMinRq_BSM_FA.Value
              OUT_VeSCMR_M_Lv2RrAxlRq_BSM_Value: accessed-variable=VeSCMR_M_Lv2RrAxlRq_BSM.Value
              OUT_VeSCMR_b_Lv2RrAxlRq_BSM_FA_Value: accessed-variable=VeSCMR_b_Lv2RrAxlRq_BSM_FA.Value
              OUT_VeSCMR_M_Lv2RgnBrkAxTrqReq_Value: accessed-variable=VeSCMR_M_Lv2RgnBrkAxTrqReq.Value
              OUT_VeSCMR_b_Lv2RgnBrkAxTrqReq_FA_Value: accessed-variable=VeSCMR_b_Lv2RgnBrkAxTrqReq_FA.Value
          read-local-variables:
            access RV_VeSR2N_b_BRAKE_FD_6_FD3_MM_Faild_write_IRV: accessed-variable=VeSR2N_b_BRAKE_FD_6_FD3_MM_Faild_write_IRV
            access RV_VeSR2N_b_BRAKE_FD_6_FD3_NewEvent_write_IRV: accessed-variable=VeSR2N_b_BRAKE_FD_6_FD3_NewEvent_write_IRV
          written-local-variables:
            access WV_VeSR2N_b_BRAKE_FD_6_FD3_NewEvent_write_IRV: accessed-variable=VeSR2N_b_BRAKE_FD_6_FD3_NewEvent_write_IRV
        SR2B_BRAKE_FD_7_FD3_Received
          data-receive-point-by-arguments:
            access IN_VeRxPDU_BRAKE_FD_7_FD3_E2E_Sts_E2ECheckSts: accessed-variable=VeRxPDU_BRAKE_FD_7_FD3_E2E_Sts.E2ECheckSts
            access IN_VeRxPDU_BRAKE_FD_7_FD3_E2E_Sts_OpRetVal: accessed-variable=VeRxPDU_BRAKE_FD_7_FD3_E2E_Sts.OpRetVal
            access IN_VeSR2B_h_COMRX_BRAKE_FD_7_FD3_Pkt_COMRX_BRAKE_FD_7_FD3_Pkt: accessed-variable=VeSR2B_h_COMRX_BRAKE_FD_7_FD3_Pkt.COMRX_BRAKE_FD_7_FD3_Pkt
          read-local-variables:
            access RV_VeSR2B_b_DevlpmtToolEnbld_write1_IRV: accessed-variable=VeSR2B_b_DevlpmtToolEnbld_write1_IRV
            access RV_VeSR2N_Cnt_BRAKE_FD_7_FD3_MM_Cntr_write_IRV: accessed-variable=VeSR2N_Cnt_BRAKE_FD_7_FD3_MM_Cntr_write_IRV
            access RV_VeSR2N_b_BRAKE_FD_7_FD3_MM_Faild_write_IRV: accessed-variable=VeSR2N_b_BRAKE_FD_7_FD3_MM_Faild_write_IRV
          written-local-variables:
            access WV_VeSR2N_Cnt_BRAKE_FD_7_FD3_MM_Cntr_write_IRV: accessed-variable=VeSR2N_Cnt_BRAKE_FD_7_FD3_MM_Cntr_write_IRV
            access WV_VeSR2N_b_BRAKE_FD_7_FD3_MM_Faild_write_IRV: accessed-variable=VeSR2N_b_BRAKE_FD_7_FD3_MM_Faild_write_IRV
            access WV_VeSR2N_b_BRAKE_FD_7_FD3_NewEvent_write_IRV: accessed-variable=VeSR2N_b_BRAKE_FD_7_FD3_NewEvent_write_IRV
        SR2B_BRAKE_FD_7_FD3_Error
          read-local-variables:
            access RV_VeSR2B_b_MM_Enbl_write1_IRV: accessed-variable=VeSR2B_b_MM_Enbl_write1_IRV
          written-local-variables:
            access WV_VeSR2N_Cnt_BRAKE_FD_7_FD3_MM_Cntr_write_IRV: accessed-variable=VeSR2N_Cnt_BRAKE_FD_7_FD3_MM_Cntr_write_IRV
            access WV_VeSR2N_b_BRAKE_FD_7_FD3_MM_Faild_write_IRV: accessed-variable=VeSR2N_b_BRAKE_FD_7_FD3_MM_Faild_write_IRV
            access WV_VeSR2N_b_BRAKE_FD_7_FD3_NewEvent_write_IRV: accessed-variable=VeSR2N_b_BRAKE_FD_7_FD3_NewEvent_write_IRV
        SR2B_BRAKE_FD_7_FD3_Time
          data-send-points:
            6 x access:
              OUT_VeSCMR_Pct_Lv2BrkTravelSts_Value: accessed-variable=VeSCMR_Pct_Lv2BrkTravelSts.Value
              OUT_VeSCMR_b_Lv2BrkTravelSts_FA_Value: accessed-variable=VeSCMR_b_Lv2BrkTravelSts_FA.Value
              OUT_VeSCMR_b_Lv2BrkPdl_Flt_Value: accessed-variable=VeSCMR_b_Lv2BrkPdl_Flt.Value
              OUT_VeSCMR_b_Lv2BrkPdl_Flt_FA_Value: accessed-variable=VeSCMR_b_Lv2BrkPdl_Flt_FA.Value
              OUT_VeSCMR_e_Lv2BrkPdlStat_Value: accessed-variable=VeSCMR_e_Lv2BrkPdlStat.Value
              OUT_VeSCMR_b_Lv2BrkPdlStat_FA_Value: accessed-variable=VeSCMR_b_Lv2BrkPdlStat_FA.Value
          read-local-variables:
            access RV_VeSR2N_b_BRAKE_FD_7_FD3_MM_Faild_write_IRV: accessed-variable=VeSR2N_b_BRAKE_FD_7_FD3_MM_Faild_write_IRV
            access RV_VeSR2N_b_BRAKE_FD_7_FD3_NewEvent_write_IRV: accessed-variable=VeSR2N_b_BRAKE_FD_7_FD3_NewEvent_write_IRV
          written-local-variables:
            access WV_VeSR2N_b_BRAKE_FD_7_FD3_NewEvent_write_IRV: accessed-variable=VeSR2N_b_BRAKE_FD_7_FD3_NewEvent_write_IRV
        SR2B_ENGINE_HYBD_FD_1_FD3_Received
          data-receive-point-by-arguments:
            access IN_VeRxPDU_ENGINE_HYBD_FD_1_FD3_E2E_Sts_E2ECheckSts: accessed-variable=VeRxPDU_ENGINE_HYBD_FD_1_FD3_E2E_Sts.E2ECheckSts
            access IN_VeRxPDU_ENGINE_HYBD_FD_1_FD3_E2E_Sts_OpRetVal: accessed-variable=VeRxPDU_ENGINE_HYBD_FD_1_FD3_E2E_Sts.OpRetVal
            access IN_VeSR2B_h_COMRX_ENGINE_HYBD_FD_1_FD3_Pkt_COMRX_ENGINE_HYBD_FD_1_FD3_Pkt: accessed-variable=VeSR2B_h_COMRX_ENGINE_HYBD_FD_1_FD3_Pkt.COMRX_ENGINE_HYBD_FD_1_FD3_Pkt
          read-local-variables:
            access RV_VeSR2B_b_DevlpmtToolEnbld_write1_IRV: accessed-variable=VeSR2B_b_DevlpmtToolEnbld_write1_IRV
            access RV_VeSR2N_Cnt_ENGINE_HYBD_FD_1_FD3_MM_Cntr_write_IRV: accessed-variable=VeSR2N_Cnt_ENGINE_HYBD_FD_1_FD3_MM_Cntr_write_IRV
            access RV_VeSR2N_b_ENGINE_HYBD_FD_1_FD3_MM_Faild_write_IRV: accessed-variable=VeSR2N_b_ENGINE_HYBD_FD_1_FD3_MM_Faild_write_IRV
          written-local-variables:
            access WV_VeSR2N_Cnt_ENGINE_HYBD_FD_1_FD3_MM_Cntr_write_IRV: accessed-variable=VeSR2N_Cnt_ENGINE_HYBD_FD_1_FD3_MM_Cntr_write_IRV
            access WV_VeSR2N_b_ENGINE_HYBD_FD_1_FD3_MM_Faild_write_IRV: accessed-variable=VeSR2N_b_ENGINE_HYBD_FD_1_FD3_MM_Faild_write_IRV
            access WV_VeSR2N_b_ENGINE_HYBD_FD_1_FD3_NewEvent_write_IRV: accessed-variable=VeSR2N_b_ENGINE_HYBD_FD_1_FD3_NewEvent_write_IRV
        SR2B_ENGINE_HYBD_FD_1_FD3_Error
          read-local-variables:
            access RV_VeSR2B_b_MM_Enbl_write1_IRV: accessed-variable=VeSR2B_b_MM_Enbl_write1_IRV
          written-local-variables:
            access WV_VeSR2N_Cnt_ENGINE_HYBD_FD_1_FD3_MM_Cntr_write_IRV: accessed-variable=VeSR2N_Cnt_ENGINE_HYBD_FD_1_FD3_MM_Cntr_write_IRV
            access WV_VeSR2N_b_ENGINE_HYBD_FD_1_FD3_MM_Faild_write_IRV: accessed-variable=VeSR2N_b_ENGINE_HYBD_FD_1_FD3_MM_Faild_write_IRV
            access WV_VeSR2N_b_ENGINE_HYBD_FD_1_FD3_NewEvent_write_IRV: accessed-variable=VeSR2N_b_ENGINE_HYBD_FD_1_FD3_NewEvent_write_IRV
        SR2B_ENGINE_HYBD_FD_1_FD3_Time
          data-send-points:
            access OUT_VeSCMR_e_Lv2ESS_EngStateEE_Value: accessed-variable=VeSCMR_e_Lv2ESS_EngStateEE.Value
            access OUT_VeSCMR_b_Lv2ESS_EngStateEE_FA_Value: accessed-variable=VeSCMR_b_Lv2ESS_EngStateEE_FA.Value
          read-local-variables:
            access RV_VeSR2N_b_ENGINE_HYBD_FD_1_FD3_MM_Faild_write_IRV: accessed-variable=VeSR2N_b_ENGINE_HYBD_FD_1_FD3_MM_Faild_write_IRV
            access RV_VeSR2N_b_ENGINE_HYBD_FD_1_FD3_NewEvent_write_IRV: accessed-variable=VeSR2N_b_ENGINE_HYBD_FD_1_FD3_NewEvent_write_IRV
          written-local-variables:
            access WV_VeSR2N_b_ENGINE_HYBD_FD_1_FD3_NewEvent_write_IRV: accessed-variable=VeSR2N_b_ENGINE_HYBD_FD_1_FD3_NewEvent_write_IRV
        SR2B_IPC_VEHICLE_SETUP_FD3_Received
          data-receive-point-by-arguments:
            access IN_VeRxPDU_IPC_VEHICLE_SETUP_FD3_E2E_Sts_E2ECheckSts: accessed-variable=VeRxPDU_IPC_VEHICLE_SETUP_FD3_E2E_Sts.E2ECheckSts
            access IN_VeRxPDU_IPC_VEHICLE_SETUP_FD3_E2E_Sts_OpRetVal: accessed-variable=VeRxPDU_IPC_VEHICLE_SETUP_FD3_E2E_Sts.OpRetVal
            access IN_VeSR2B_h_COMRX_IPC_VEHICLE_SETUP_FD3_Pkt_COMRX_IPC_VEHICLE_SETUP_FD3_Pkt: accessed-variable=VeSR2B_h_COMRX_IPC_VEHICLE_SETUP_FD3_Pkt.COMRX_IPC_VEHICLE_SETUP_FD3_Pkt
          read-local-variables:
            access RV_VeSR2B_b_DevlpmtToolEnbld_write1_IRV: accessed-variable=VeSR2B_b_DevlpmtToolEnbld_write1_IRV
            access RV_VeSR2N_Cnt_IPC_VEHICLE_SETUP_FD3_MM_Cntr_write_IRV: accessed-variable=VeSR2N_Cnt_IPC_VEHICLE_SETUP_FD3_MM_Cntr_write_IRV
            access RV_VeSR2N_b_IPC_VEHICLE_SETUP_FD3_MM_Faild_write_IRV: accessed-variable=VeSR2N_b_IPC_VEHICLE_SETUP_FD3_MM_Faild_write_IRV
          written-local-variables:
            access WV_VeSR2N_Cnt_IPC_VEHICLE_SETUP_FD3_MM_Cntr_write_IRV: accessed-variable=VeSR2N_Cnt_IPC_VEHICLE_SETUP_FD3_MM_Cntr_write_IRV
            access WV_VeSR2N_b_IPC_VEHICLE_SETUP_FD3_MM_Faild_write_IRV: accessed-variable=VeSR2N_b_IPC_VEHICLE_SETUP_FD3_MM_Faild_write_IRV
            access WV_VeSR2N_b_IPC_VEHICLE_SETUP_FD3_NewEvent_write_IRV: accessed-variable=VeSR2N_b_IPC_VEHICLE_SETUP_FD3_NewEvent_write_IRV
        SR2B_IPC_VEHICLE_SETUP_FD3_Error
          read-local-variables:
            access RV_VeSR2B_b_MM_Enbl_write1_IRV: accessed-variable=VeSR2B_b_MM_Enbl_write1_IRV
          written-local-variables:
            access WV_VeSR2N_Cnt_IPC_VEHICLE_SETUP_FD3_MM_Cntr_write_IRV: accessed-variable=VeSR2N_Cnt_IPC_VEHICLE_SETUP_FD3_MM_Cntr_write_IRV
            access WV_VeSR2N_b_IPC_VEHICLE_SETUP_FD3_MM_Faild_write_IRV: accessed-variable=VeSR2N_b_IPC_VEHICLE_SETUP_FD3_MM_Faild_write_IRV
            access WV_VeSR2N_b_IPC_VEHICLE_SETUP_FD3_NewEvent_write_IRV: accessed-variable=VeSR2N_b_IPC_VEHICLE_SETUP_FD3_NewEvent_write_IRV
        SR2B_IPC_VEHICLE_SETUP_FD3_Time
          data-send-points:
            access OUT_VeSCMR_b_Lv2SpeedUnit_Value: accessed-variable=VeSCMR_b_Lv2SpeedUnit.Value
            access OUT_VeSCMR_b_Lv2SpeedUnit_FA_Value: accessed-variable=VeSCMR_b_Lv2SpeedUnit_FA.Value
          read-local-variables:
            access RV_VeSR2N_b_IPC_VEHICLE_SETUP_FD3_MM_Faild_write_IRV: accessed-variable=VeSR2N_b_IPC_VEHICLE_SETUP_FD3_MM_Faild_write_IRV
            access RV_VeSR2N_b_IPC_VEHICLE_SETUP_FD3_NewEvent_write_IRV: accessed-variable=VeSR2N_b_IPC_VEHICLE_SETUP_FD3_NewEvent_write_IRV
          written-local-variables:
            access WV_VeSR2N_b_IPC_VEHICLE_SETUP_FD3_NewEvent_write_IRV: accessed-variable=VeSR2N_b_IPC_VEHICLE_SETUP_FD3_NewEvent_write_IRV
        SR2B_TELEMATIC_FD_5_FD3_Received
          data-receive-point-by-arguments:
            access IN_VeRxPDU_TELEMATIC_FD_5_FD3_E2E_Sts_E2ECheckSts: accessed-variable=VeRxPDU_TELEMATIC_FD_5_FD3_E2E_Sts.E2ECheckSts
            access IN_VeRxPDU_TELEMATIC_FD_5_FD3_E2E_Sts_OpRetVal: accessed-variable=VeRxPDU_TELEMATIC_FD_5_FD3_E2E_Sts.OpRetVal
            access IN_VeSR2B_h_COMRX_TELEMATIC_FD_5_FD3_Pkt_COMRX_TELEMATIC_FD_5_FD3_Pkt: accessed-variable=VeSR2B_h_COMRX_TELEMATIC_FD_5_FD3_Pkt.COMRX_TELEMATIC_FD_5_FD3_Pkt
          read-local-variables:
            access RV_VeSR2B_b_DevlpmtToolEnbld_write1_IRV: accessed-variable=VeSR2B_b_DevlpmtToolEnbld_write1_IRV
            access RV_VeSR2N_Cnt_TELEMATIC_FD_5_FD3_MM_Cntr_write_IRV: accessed-variable=VeSR2N_Cnt_TELEMATIC_FD_5_FD3_MM_Cntr_write_IRV
            access RV_VeSR2N_b_TELEMATIC_FD_5_FD3_MM_Faild_write_IRV: accessed-variable=VeSR2N_b_TELEMATIC_FD_5_FD3_MM_Faild_write_IRV
          written-local-variables:
            access WV_VeSR2N_Cnt_TELEMATIC_FD_5_FD3_MM_Cntr_write_IRV: accessed-variable=VeSR2N_Cnt_TELEMATIC_FD_5_FD3_MM_Cntr_write_IRV
            access WV_VeSR2N_b_TELEMATIC_FD_5_FD3_MM_Faild_write_IRV: accessed-variable=VeSR2N_b_TELEMATIC_FD_5_FD3_MM_Faild_write_IRV
            access WV_VeSR2N_b_TELEMATIC_FD_5_FD3_NewEvent_write_IRV: accessed-variable=VeSR2N_b_TELEMATIC_FD_5_FD3_NewEvent_write_IRV
        SR2B_TELEMATIC_FD_5_FD3_Error
          read-local-variables:
            access RV_VeSR2B_b_MM_Enbl_write1_IRV: accessed-variable=VeSR2B_b_MM_Enbl_write1_IRV
          written-local-variables:
            access WV_VeSR2N_Cnt_TELEMATIC_FD_5_FD3_MM_Cntr_write_IRV: accessed-variable=VeSR2N_Cnt_TELEMATIC_FD_5_FD3_MM_Cntr_write_IRV
            access WV_VeSR2N_b_TELEMATIC_FD_5_FD3_MM_Faild_write_IRV: accessed-variable=VeSR2N_b_TELEMATIC_FD_5_FD3_MM_Faild_write_IRV
            access WV_VeSR2N_b_TELEMATIC_FD_5_FD3_NewEvent_write_IRV: accessed-variable=VeSR2N_b_TELEMATIC_FD_5_FD3_NewEvent_write_IRV
        SR2B_TELEMATIC_FD_5_FD3_Time
          data-send-points:
            access OUT_VeSCMR_e_Lv2GlobDrvMdRq_Value: accessed-variable=VeSCMR_e_Lv2GlobDrvMdRq.Value
            access OUT_VeSCMR_b_Lv2GlobDrvMdRq_FA_Value: accessed-variable=VeSCMR_b_Lv2GlobDrvMdRq_FA.Value
          read-local-variables:
            access RV_VeSR2N_b_TELEMATIC_FD_5_FD3_MM_Faild_write_IRV: accessed-variable=VeSR2N_b_TELEMATIC_FD_5_FD3_MM_Faild_write_IRV
            access RV_VeSR2N_b_TELEMATIC_FD_5_FD3_NewEvent_write_IRV: accessed-variable=VeSR2N_b_TELEMATIC_FD_5_FD3_NewEvent_write_IRV
          written-local-variables:
            access WV_VeSR2N_b_TELEMATIC_FD_5_FD3_NewEvent_write_IRV: accessed-variable=VeSR2N_b_TELEMATIC_FD_5_FD3_NewEvent_write_IRV
        SR2B_APM_VDCM_FD11_Received
          data-receive-point-by-arguments:
            access IN_VeRxPDU_APM_VDCM_FD11_E2E_Sts_E2ECheckSts: accessed-variable=VeRxPDU_APM_VDCM_FD11_E2E_Sts.E2ECheckSts
            access IN_VeRxPDU_APM_VDCM_FD11_E2E_Sts_OpRetVal: accessed-variable=VeRxPDU_APM_VDCM_FD11_E2E_Sts.OpRetVal
            access IN_VeSR2B_h_COMRX_APM_VDCM_FD11_Pkt_COMRX_APM_VDCM_FD11_Pkt: accessed-variable=VeSR2B_h_COMRX_APM_VDCM_FD11_Pkt.COMRX_APM_VDCM_FD11_Pkt
          read-local-variables:
            access RV_VeSR2B_b_DevlpmtToolEnbld_write1_IRV: accessed-variable=VeSR2B_b_DevlpmtToolEnbld_write1_IRV
            access RV_VeSR2N_Cnt_APM_VDCM_FD11_MM_Cntr_write_IRV: accessed-variable=VeSR2N_Cnt_APM_VDCM_FD11_MM_Cntr_write_IRV
            access RV_VeSR2N_b_APM_VDCM_FD11_MM_Faild_write_IRV: accessed-variable=VeSR2N_b_APM_VDCM_FD11_MM_Faild_write_IRV
          written-local-variables:
            access WV_VeSR2N_Cnt_APM_VDCM_FD11_MM_Cntr_write_IRV: accessed-variable=VeSR2N_Cnt_APM_VDCM_FD11_MM_Cntr_write_IRV
            access WV_VeSR2N_b_APM_VDCM_FD11_MM_Faild_write_IRV: accessed-variable=VeSR2N_b_APM_VDCM_FD11_MM_Faild_write_IRV
            access WV_VeSR2N_b_APM_VDCM_FD11_NewEvent_write_IRV: accessed-variable=VeSR2N_b_APM_VDCM_FD11_NewEvent_write_IRV
        SR2B_APM_VDCM_FD11_Error
          read-local-variables:
            access RV_VeSR2B_b_MM_Enbl_write1_IRV: accessed-variable=VeSR2B_b_MM_Enbl_write1_IRV
          written-local-variables:
            access WV_VeSR2N_Cnt_APM_VDCM_FD11_MM_Cntr_write_IRV: accessed-variable=VeSR2N_Cnt_APM_VDCM_FD11_MM_Cntr_write_IRV
            access WV_VeSR2N_b_APM_VDCM_FD11_MM_Faild_write_IRV: accessed-variable=VeSR2N_b_APM_VDCM_FD11_MM_Faild_write_IRV
            access WV_VeSR2N_b_APM_VDCM_FD11_NewEvent_write_IRV: accessed-variable=VeSR2N_b_APM_VDCM_FD11_NewEvent_write_IRV
        SR2B_APM_VDCM_FD11_Time
          data-send-points:
            10 x access:
              OUT_VeSR2B_y_APM_CtrlSts_Fbk_FD11_Value: accessed-variable=VeSR2B_y_APM_CtrlSts_Fbk_FD11.Value
              OUT_VeSR2B_y_APM_CtrlSts_Fbk_FD11_SigSts_Value: accessed-variable=VeSR2B_y_APM_CtrlSts_Fbk_FD11_SigSts.Value
              OUT_VeSR2B_y_APM_FailureReason_FD11_Value: accessed-variable=VeSR2B_y_APM_FailureReason_FD11.Value
              OUT_VeSR2B_y_APM_FailureReason_FD11_SigSts_Value: accessed-variable=VeSR2B_y_APM_FailureReason_FD11_SigSts.Value
              OUT_VeSR2B_y_APM_FailureType_FD11_Value: accessed-variable=VeSR2B_y_APM_FailureType_FD11.Value
              OUT_VeSR2B_y_APM_FailureType_FD11_SigSts_Value: accessed-variable=VeSR2B_y_APM_FailureType_FD11_SigSts.Value
              OUT_VeSR2B_U_APM_HV_V_Fbk_FD11_Value: accessed-variable=VeSR2B_U_APM_HV_V_Fbk_FD11.Value
              OUT_VeSR2B_y_APM_HV_V_Fbk_FD11_SigSts_Value: accessed-variable=VeSR2B_y_APM_HV_V_Fbk_FD11_SigSts.Value
              OUT_VeSR2B_U_APM_LV_V_Fbk_FD11_Value: accessed-variable=VeSR2B_U_APM_LV_V_Fbk_FD11.Value
              OUT_VeSR2B_y_APM_LV_V_Fbk_FD11_SigSts_Value: accessed-variable=VeSR2B_y_APM_LV_V_Fbk_FD11_SigSts.Value
          read-local-variables:
            access RV_VeSR2N_b_APM_VDCM_FD11_MM_Faild_write_IRV: accessed-variable=VeSR2N_b_APM_VDCM_FD11_MM_Faild_write_IRV
            access RV_VeSR2N_b_APM_VDCM_FD11_NewEvent_write_IRV: accessed-variable=VeSR2N_b_APM_VDCM_FD11_NewEvent_write_IRV
          written-local-variables:
            access WV_VeSR2N_b_APM_VDCM_FD11_NewEvent_write_IRV: accessed-variable=VeSR2N_b_APM_VDCM_FD11_NewEvent_write_IRV
        SR2B_BATTERY_HV_POWERLIMITS_FD11_Received
          data-receive-point-by-arguments:
            access IN_VeRxPDU_BATTERY_HV_POWERLIMITS_FD11_E2E_Sts_E2ECheckSts: accessed-variable=VeRxPDU_BATTERY_HV_POWERLIMITS_FD11_E2E_Sts.E2ECheckSts
            access IN_VeRxPDU_BATTERY_HV_POWERLIMITS_FD11_E2E_Sts_OpRetVal: accessed-variable=VeRxPDU_BATTERY_HV_POWERLIMITS_FD11_E2E_Sts.OpRetVal
            access IN_VeSR2B_h_COMRX_BATTERY_HV_POWERLIMITS_FD11_Pkt_COMRX_BATTERY_HV_POWERLIMITS_FD11_Pkt: accessed-variable=VeSR2B_h_COMRX_BATTERY_HV_POWERLIMITS_FD11_Pkt.COMRX_BATTERY_HV_POWERLIMITS_FD11_Pkt
          read-local-variables:
            access RV_VeSR2B_b_DevlpmtToolEnbld_write1_IRV: accessed-variable=VeSR2B_b_DevlpmtToolEnbld_write1_IRV
            access RV_VeSR2N_Cnt_BATTERY_HV_POWERLIMITS_FD11_MM_Cntr_write_IRV: accessed-variable=VeSR2N_Cnt_BATTERY_HV_POWERLIMITS_FD11_MM_Cntr_write_IRV
            access RV_VeSR2N_b_BATTERY_HV_POWERLIMITS_FD11_MM_Faild_write_IRV: accessed-variable=VeSR2N_b_BATTERY_HV_POWERLIMITS_FD11_MM_Faild_write_IRV
          written-local-variables:
            access WV_VeSR2N_Cnt_BATTERY_HV_POWERLIMITS_FD11_MM_Cntr_write_IRV: accessed-variable=VeSR2N_Cnt_BATTERY_HV_POWERLIMITS_FD11_MM_Cntr_write_IRV
            access WV_VeSR2N_b_BATTERY_HV_POWERLIMITS_FD11_MM_Faild_write_IRV: accessed-variable=VeSR2N_b_BATTERY_HV_POWERLIMITS_FD11_MM_Faild_write_IRV
            access WV_VeSR2N_b_BATTERY_HV_POWERLIMITS_FD11_NewEvent_write_IRV: accessed-variable=VeSR2N_b_BATTERY_HV_POWERLIMITS_FD11_NewEvent_write_IRV
        SR2B_BATTERY_HV_POWERLIMITS_FD11_Error
          read-local-variables:
            access RV_VeSR2B_b_MM_Enbl_write1_IRV: accessed-variable=VeSR2B_b_MM_Enbl_write1_IRV
          written-local-variables:
            access WV_VeSR2N_Cnt_BATTERY_HV_POWERLIMITS_FD11_MM_Cntr_write_IRV: accessed-variable=VeSR2N_Cnt_BATTERY_HV_POWERLIMITS_FD11_MM_Cntr_write_IRV
            access WV_VeSR2N_b_BATTERY_HV_POWERLIMITS_FD11_MM_Faild_write_IRV: accessed-variable=VeSR2N_b_BATTERY_HV_POWERLIMITS_FD11_MM_Faild_write_IRV
            access WV_VeSR2N_b_BATTERY_HV_POWERLIMITS_FD11_NewEvent_write_IRV: accessed-variable=VeSR2N_b_BATTERY_HV_POWERLIMITS_FD11_NewEvent_write_IRV
        SR2B_BATTERY_HV_POWERLIMITS_FD11_Time
          data-send-points:
            4 x access:
              OUT_VeSR2B_b_BPCMCntctrsMTOWrn_FD11_Value: accessed-variable=VeSR2B_b_BPCMCntctrsMTOWrn_FD11.Value
              OUT_VeSR2B_y_BPCMCntctrsMTOWrn_FD11_SigSts_Value: accessed-variable=VeSR2B_y_BPCMCntctrsMTOWrn_FD11_SigSts.Value
              OUT_VeSR2B_b_BPCMCntctrsSTOWrn_FD11_Value: accessed-variable=VeSR2B_b_BPCMCntctrsSTOWrn_FD11.Value
              OUT_VeSR2B_y_BPCMCntctrsSTOWrn_FD11_SigSts_Value: accessed-variable=VeSR2B_y_BPCMCntctrsSTOWrn_FD11_SigSts.Value
          read-local-variables:
            access RV_VeSR2N_b_BATTERY_HV_POWERLIMITS_FD11_MM_Faild_write_IRV: accessed-variable=VeSR2N_b_BATTERY_HV_POWERLIMITS_FD11_MM_Faild_write_IRV
            access RV_VeSR2N_b_BATTERY_HV_POWERLIMITS_FD11_NewEvent_write_IRV: accessed-variable=VeSR2N_b_BATTERY_HV_POWERLIMITS_FD11_NewEvent_write_IRV
          written-local-variables:
            access WV_VeSR2N_b_BATTERY_HV_POWERLIMITS_FD11_NewEvent_write_IRV: accessed-variable=VeSR2N_b_BATTERY_HV_POWERLIMITS_FD11_NewEvent_write_IRV
        SR2B_BATTERY_HV_STATUS1_FD11_Received
          data-receive-point-by-arguments:
            access IN_VeRxPDU_BATTERY_HV_STATUS1_FD11_E2E_Sts_E2ECheckSts: accessed-variable=VeRxPDU_BATTERY_HV_STATUS1_FD11_E2E_Sts.E2ECheckSts
            access IN_VeRxPDU_BATTERY_HV_STATUS1_FD11_E2E_Sts_OpRetVal: accessed-variable=VeRxPDU_BATTERY_HV_STATUS1_FD11_E2E_Sts.OpRetVal
            access IN_VeSR2B_h_COMRX_BATTERY_HV_STATUS1_FD11_Pkt_COMRX_BATTERY_HV_STATUS1_FD11_Pkt: accessed-variable=VeSR2B_h_COMRX_BATTERY_HV_STATUS1_FD11_Pkt.COMRX_BATTERY_HV_STATUS1_FD11_Pkt
          read-local-variables:
            access RV_VeSR2B_b_DevlpmtToolEnbld_write1_IRV: accessed-variable=VeSR2B_b_DevlpmtToolEnbld_write1_IRV
            access RV_VeSR2N_Cnt_BATTERY_HV_STATUS1_FD11_MM_Cntr_write_IRV: accessed-variable=VeSR2N_Cnt_BATTERY_HV_STATUS1_FD11_MM_Cntr_write_IRV
            access RV_VeSR2N_b_BATTERY_HV_STATUS1_FD11_MM_Faild_write_IRV: accessed-variable=VeSR2N_b_BATTERY_HV_STATUS1_FD11_MM_Faild_write_IRV
          written-local-variables:
            access WV_VeSR2N_Cnt_BATTERY_HV_STATUS1_FD11_MM_Cntr_write_IRV: accessed-variable=VeSR2N_Cnt_BATTERY_HV_STATUS1_FD11_MM_Cntr_write_IRV
            access WV_VeSR2N_b_BATTERY_HV_STATUS1_FD11_MM_Faild_write_IRV: accessed-variable=VeSR2N_b_BATTERY_HV_STATUS1_FD11_MM_Faild_write_IRV
            access WV_VeSR2N_b_BATTERY_HV_STATUS1_FD11_NewEvent_write_IRV: accessed-variable=VeSR2N_b_BATTERY_HV_STATUS1_FD11_NewEvent_write_IRV
        SR2B_BATTERY_HV_STATUS1_FD11_Error
          read-local-variables:
            access RV_VeSR2B_b_MM_Enbl_write1_IRV: accessed-variable=VeSR2B_b_MM_Enbl_write1_IRV
          written-local-variables:
            access WV_VeSR2N_Cnt_BATTERY_HV_STATUS1_FD11_MM_Cntr_write_IRV: accessed-variable=VeSR2N_Cnt_BATTERY_HV_STATUS1_FD11_MM_Cntr_write_IRV
            access WV_VeSR2N_b_BATTERY_HV_STATUS1_FD11_MM_Faild_write_IRV: accessed-variable=VeSR2N_b_BATTERY_HV_STATUS1_FD11_MM_Faild_write_IRV
            access WV_VeSR2N_b_BATTERY_HV_STATUS1_FD11_NewEvent_write_IRV: accessed-variable=VeSR2N_b_BATTERY_HV_STATUS1_FD11_NewEvent_write_IRV
        SR2B_BATTERY_HV_STATUS1_FD11_Time
          data-send-points:
            12 x access:
              OUT_VeSR2B_I_BPCM_HV_Current_FD11_Value: accessed-variable=VeSR2B_I_BPCM_HV_Current_FD11.Value
              OUT_VeSR2B_y_BPCM_HV_Current_FD11_SigSts_Value: accessed-variable=VeSR2B_y_BPCM_HV_Current_FD11_SigSts.Value
              OUT_VeSR2B_U_BPCM_HV_IntVolt_FD11_Value: accessed-variable=VeSR2B_U_BPCM_HV_IntVolt_FD11.Value
              OUT_VeSR2B_y_BPCM_HV_IntVolt_FD11_SigSts_Value: accessed-variable=VeSR2B_y_BPCM_HV_IntVolt_FD11_SigSts.Value
              OUT_VeSR2B_Pct_BPCM_HV_SOC_FD11_Value: accessed-variable=VeSR2B_Pct_BPCM_HV_SOC_FD11.Value
              OUT_VeSR2B_y_BPCM_HV_SOC_FD11_SigSts_Value: accessed-variable=VeSR2B_y_BPCM_HV_SOC_FD11_SigSts.Value
              OUT_VeSR2B_T_BPCM_HV_Temp_Max_FD11_Value: accessed-variable=VeSR2B_T_BPCM_HV_Temp_Max_FD11.Value
              OUT_VeSR2B_y_BPCM_HV_Temp_Max_FD11_SigSts_Value: accessed-variable=VeSR2B_y_BPCM_HV_Temp_Max_FD11_SigSts.Value
              OUT_VeSR2B_T_BPCM_HV_Temp_Min_FD11_Value: accessed-variable=VeSR2B_T_BPCM_HV_Temp_Min_FD11.Value
              OUT_VeSR2B_y_BPCM_HV_Temp_Min_FD11_SigSts_Value: accessed-variable=VeSR2B_y_BPCM_HV_Temp_Min_FD11_SigSts.Value
              OUT_VeSR2B_y_BPCM_HV_TracBusStsFD11_Value: accessed-variable=VeSR2B_y_BPCM_HV_TracBusStsFD11.Value
              OUT_VeSR2B_y_BPCM_HV_TracBusStsFD11_SigSts_Value: accessed-variable=VeSR2B_y_BPCM_HV_TracBusStsFD11_SigSts.Value
          read-local-variables:
            access RV_VeSR2N_b_BATTERY_HV_STATUS1_FD11_MM_Faild_write_IRV: accessed-variable=VeSR2N_b_BATTERY_HV_STATUS1_FD11_MM_Faild_write_IRV
            access RV_VeSR2N_b_BATTERY_HV_STATUS1_FD11_NewEvent_write_IRV: accessed-variable=VeSR2N_b_BATTERY_HV_STATUS1_FD11_NewEvent_write_IRV
          written-local-variables:
            access WV_VeSR2N_b_BATTERY_HV_STATUS1_FD11_NewEvent_write_IRV: accessed-variable=VeSR2N_b_BATTERY_HV_STATUS1_FD11_NewEvent_write_IRV
        SR2B_HV_CHARGER1_FD11_Received
          data-receive-point-by-arguments:
            access IN_VeRxPDU_HV_CHARGER1_FD11_E2E_Sts_E2ECheckSts: accessed-variable=VeRxPDU_HV_CHARGER1_FD11_E2E_Sts.E2ECheckSts
            access IN_VeRxPDU_HV_CHARGER1_FD11_E2E_Sts_OpRetVal: accessed-variable=VeRxPDU_HV_CHARGER1_FD11_E2E_Sts.OpRetVal
            access IN_VeSR2B_h_COMRX_HV_CHARGER1_FD11_Pkt_COMRX_HV_CHARGER1_FD11_Pkt: accessed-variable=VeSR2B_h_COMRX_HV_CHARGER1_FD11_Pkt.COMRX_HV_CHARGER1_FD11_Pkt
          read-local-variables:
            access RV_VeSR2B_b_DevlpmtToolEnbld_write1_IRV: accessed-variable=VeSR2B_b_DevlpmtToolEnbld_write1_IRV
            access RV_VeSR2N_Cnt_HV_CHARGER1_FD11_MM_Cntr_write_IRV: accessed-variable=VeSR2N_Cnt_HV_CHARGER1_FD11_MM_Cntr_write_IRV
            access RV_VeSR2N_b_HV_CHARGER1_FD11_MM_Faild_write_IRV: accessed-variable=VeSR2N_b_HV_CHARGER1_FD11_MM_Faild_write_IRV
          written-local-variables:
            access WV_VeSR2N_Cnt_HV_CHARGER1_FD11_MM_Cntr_write_IRV: accessed-variable=VeSR2N_Cnt_HV_CHARGER1_FD11_MM_Cntr_write_IRV
            access WV_VeSR2N_b_HV_CHARGER1_FD11_MM_Faild_write_IRV: accessed-variable=VeSR2N_b_HV_CHARGER1_FD11_MM_Faild_write_IRV
            access WV_VeSR2N_b_HV_CHARGER1_FD11_NewEvent_write_IRV: accessed-variable=VeSR2N_b_HV_CHARGER1_FD11_NewEvent_write_IRV
        SR2B_HV_CHARGER1_FD11_Error
          read-local-variables:
            access RV_VeSR2B_b_MM_Enbl_write1_IRV: accessed-variable=VeSR2B_b_MM_Enbl_write1_IRV
          written-local-variables:
            access WV_VeSR2N_Cnt_HV_CHARGER1_FD11_MM_Cntr_write_IRV: accessed-variable=VeSR2N_Cnt_HV_CHARGER1_FD11_MM_Cntr_write_IRV
            access WV_VeSR2N_b_HV_CHARGER1_FD11_MM_Faild_write_IRV: accessed-variable=VeSR2N_b_HV_CHARGER1_FD11_MM_Faild_write_IRV
            access WV_VeSR2N_b_HV_CHARGER1_FD11_NewEvent_write_IRV: accessed-variable=VeSR2N_b_HV_CHARGER1_FD11_NewEvent_write_IRV
        SR2B_HV_CHARGER1_FD11_Time
          data-send-points:
            access OUT_VeSR2B_y_ProximitySts_FD11_Value: accessed-variable=VeSR2B_y_ProximitySts_FD11.Value
            access OUT_VeSR2B_y_ProximitySts_FD11_SigSts_Value: accessed-variable=VeSR2B_y_ProximitySts_FD11_SigSts.Value
          read-local-variables:
            access RV_VeSR2N_b_HV_CHARGER1_FD11_MM_Faild_write_IRV: accessed-variable=VeSR2N_b_HV_CHARGER1_FD11_MM_Faild_write_IRV
            access RV_VeSR2N_b_HV_CHARGER1_FD11_NewEvent_write_IRV: accessed-variable=VeSR2N_b_HV_CHARGER1_FD11_NewEvent_write_IRV
          written-local-variables:
            access WV_VeSR2N_b_HV_CHARGER1_FD11_NewEvent_write_IRV: accessed-variable=VeSR2N_b_HV_CHARGER1_FD11_NewEvent_write_IRV
        SR2B_ADAS_FD_INFO_FD14_Received
          data-receive-point-by-arguments:
            access IN_VeRxPDU_ADAS_FD_INFO_FD14_E2E_Sts_E2ECheckSts: accessed-variable=VeRxPDU_ADAS_FD_INFO_FD14_E2E_Sts.E2ECheckSts
            access IN_VeRxPDU_ADAS_FD_INFO_FD14_E2E_Sts_OpRetVal: accessed-variable=VeRxPDU_ADAS_FD_INFO_FD14_E2E_Sts.OpRetVal
            access IN_VeSR2B_h_COMRX_ADAS_FD_INFO_FD14_Pkt_COMRX_ADAS_FD_INFO_FD14_Pkt: accessed-variable=VeSR2B_h_COMRX_ADAS_FD_INFO_FD14_Pkt.COMRX_ADAS_FD_INFO_FD14_Pkt
          read-local-variables:
            access RV_VeSR2B_b_DevlpmtToolEnbld_write1_IRV: accessed-variable=VeSR2B_b_DevlpmtToolEnbld_write1_IRV
            access RV_VeSR2N_Cnt_ADAS_FD_INFO_FD14_MM_Cntr_write_IRV: accessed-variable=VeSR2N_Cnt_ADAS_FD_INFO_FD14_MM_Cntr_write_IRV
            access RV_VeSR2N_b_ADAS_FD_INFO_FD14_MM_Faild_write_IRV: accessed-variable=VeSR2N_b_ADAS_FD_INFO_FD14_MM_Faild_write_IRV
          written-local-variables:
            access WV_VeSR2N_Cnt_ADAS_FD_INFO_FD14_MM_Cntr_write_IRV: accessed-variable=VeSR2N_Cnt_ADAS_FD_INFO_FD14_MM_Cntr_write_IRV
            access WV_VeSR2N_b_ADAS_FD_INFO_FD14_MM_Faild_write_IRV: accessed-variable=VeSR2N_b_ADAS_FD_INFO_FD14_MM_Faild_write_IRV
            access WV_VeSR2N_b_ADAS_FD_INFO_FD14_NewEvent_write_IRV: accessed-variable=VeSR2N_b_ADAS_FD_INFO_FD14_NewEvent_write_IRV
        SR2B_ADAS_FD_INFO_FD14_Error
          read-local-variables:
            access RV_VeSR2B_b_MM_Enbl_write1_IRV: accessed-variable=VeSR2B_b_MM_Enbl_write1_IRV
          written-local-variables:
            access WV_VeSR2N_Cnt_ADAS_FD_INFO_FD14_MM_Cntr_write_IRV: accessed-variable=VeSR2N_Cnt_ADAS_FD_INFO_FD14_MM_Cntr_write_IRV
            access WV_VeSR2N_b_ADAS_FD_INFO_FD14_MM_Faild_write_IRV: accessed-variable=VeSR2N_b_ADAS_FD_INFO_FD14_MM_Faild_write_IRV
            access WV_VeSR2N_b_ADAS_FD_INFO_FD14_NewEvent_write_IRV: accessed-variable=VeSR2N_b_ADAS_FD_INFO_FD14_NewEvent_write_IRV
        SR2B_ADAS_FD_INFO_FD14_Time
          data-send-points:
            6 x access:
              OUT_VeSCMR_e_Lv2ACC_SystemSts_Value: accessed-variable=VeSCMR_e_Lv2ACC_SystemSts.Value
              OUT_VeSCMR_b_Lv2ACC_SystemSts_FA_Value: accessed-variable=VeSCMR_b_Lv2ACC_SystemSts_FA.Value
              OUT_VeSCMR_M_Lv2ACC_WhlTrq_ADAS_Value: accessed-variable=VeSCMR_M_Lv2ACC_WhlTrq_ADAS.Value
              OUT_VeSCMR_b_Lv2ACC_WhlTrq_ADAS_FA_Value: accessed-variable=VeSCMR_b_Lv2ACC_WhlTrq_ADAS_FA.Value
              OUT_VeSCMR_b_Lv2ACC_WhlTrqEnbld_Value: accessed-variable=VeSCMR_b_Lv2ACC_WhlTrqEnbld.Value
              OUT_VeSCMR_b_Lv2ACC_WhlTrqEnbld_FA_Value: accessed-variable=VeSCMR_b_Lv2ACC_WhlTrqEnbld_FA.Value
          read-local-variables:
            access RV_VeSR2N_b_ADAS_FD_INFO_FD14_MM_Faild_write_IRV: accessed-variable=VeSR2N_b_ADAS_FD_INFO_FD14_MM_Faild_write_IRV
            access RV_VeSR2N_b_ADAS_FD_INFO_FD14_NewEvent_write_IRV: accessed-variable=VeSR2N_b_ADAS_FD_INFO_FD14_NewEvent_write_IRV
          written-local-variables:
            access WV_VeSR2N_b_ADAS_FD_INFO_FD14_NewEvent_write_IRV: accessed-variable=VeSR2N_b_ADAS_FD_INFO_FD14_NewEvent_write_IRV
        SR2B_BRAKE_FD_1_FD14_Received
          data-receive-point-by-arguments:
            access IN_VeRxPDU_BRAKE_FD_1_FD14_E2E_Sts_E2ECheckSts: accessed-variable=VeRxPDU_BRAKE_FD_1_FD14_E2E_Sts.E2ECheckSts
            access IN_VeRxPDU_BRAKE_FD_1_FD14_E2E_Sts_OpRetVal: accessed-variable=VeRxPDU_BRAKE_FD_1_FD14_E2E_Sts.OpRetVal
            access IN_VeSR2B_h_COMRX_BRAKE_FD_1_FD14_Pkt_COMRX_BRAKE_FD_1_FD14_Pkt: accessed-variable=VeSR2B_h_COMRX_BRAKE_FD_1_FD14_Pkt.COMRX_BRAKE_FD_1_FD14_Pkt
          read-local-variables:
            access RV_VeSR2B_b_DevlpmtToolEnbld_write1_IRV: accessed-variable=VeSR2B_b_DevlpmtToolEnbld_write1_IRV
            access RV_VeSR2N_Cnt_BRAKE_FD_1_FD14_MM_Cntr_write_IRV: accessed-variable=VeSR2N_Cnt_BRAKE_FD_1_FD14_MM_Cntr_write_IRV
            access RV_VeSR2N_b_BRAKE_FD_1_FD14_MM_Faild_write_IRV: accessed-variable=VeSR2N_b_BRAKE_FD_1_FD14_MM_Faild_write_IRV
          written-local-variables:
            access WV_VeSR2N_Cnt_BRAKE_FD_1_FD14_MM_Cntr_write_IRV: accessed-variable=VeSR2N_Cnt_BRAKE_FD_1_FD14_MM_Cntr_write_IRV
            access WV_VeSR2N_b_BRAKE_FD_1_FD14_MM_Faild_write_IRV: accessed-variable=VeSR2N_b_BRAKE_FD_1_FD14_MM_Faild_write_IRV
            access WV_VeSR2N_b_BRAKE_FD_1_FD14_NewEvent_write_IRV: accessed-variable=VeSR2N_b_BRAKE_FD_1_FD14_NewEvent_write_IRV
        SR2B_BRAKE_FD_1_FD14_Error
          read-local-variables:
            access RV_VeSR2B_b_MM_Enbl_write1_IRV: accessed-variable=VeSR2B_b_MM_Enbl_write1_IRV
          written-local-variables:
            access WV_VeSR2N_Cnt_BRAKE_FD_1_FD14_MM_Cntr_write_IRV: accessed-variable=VeSR2N_Cnt_BRAKE_FD_1_FD14_MM_Cntr_write_IRV
            access WV_VeSR2N_b_BRAKE_FD_1_FD14_MM_Faild_write_IRV: accessed-variable=VeSR2N_b_BRAKE_FD_1_FD14_MM_Faild_write_IRV
            access WV_VeSR2N_b_BRAKE_FD_1_FD14_NewEvent_write_IRV: accessed-variable=VeSR2N_b_BRAKE_FD_1_FD14_NewEvent_write_IRV
        SR2B_BRAKE_FD_1_FD14_Time
          data-send-points:
            4 x access:
              OUT_VeSCMR_M_Lv2BrkTrqCANC2_Value: accessed-variable=VeSCMR_M_Lv2BrkTrqCANC2.Value
              OUT_VeSCMR_b_Lv2BrkTrqCANC2_FA_Value: accessed-variable=VeSCMR_b_Lv2BrkTrqCANC2_FA.Value
              OUT_VeSCMR_M_Lv2BrkTrqDriverCANC2_Value: accessed-variable=VeSCMR_M_Lv2BrkTrqDriverCANC2.Value
              OUT_VeSCMR_b_Lv2BrkTrqDriverCANC2_FA_Value: accessed-variable=VeSCMR_b_Lv2BrkTrqDriverCANC2_FA.Value
          read-local-variables:
            access RV_VeSR2N_b_BRAKE_FD_1_FD14_MM_Faild_write_IRV: accessed-variable=VeSR2N_b_BRAKE_FD_1_FD14_MM_Faild_write_IRV
            access RV_VeSR2N_b_BRAKE_FD_1_FD14_NewEvent_write_IRV: accessed-variable=VeSR2N_b_BRAKE_FD_1_FD14_NewEvent_write_IRV
          written-local-variables:
            access WV_VeSR2N_b_BRAKE_FD_1_FD14_NewEvent_write_IRV: accessed-variable=VeSR2N_b_BRAKE_FD_1_FD14_NewEvent_write_IRV
        SR2B_BRAKE_FD_2_FD14_Received
          data-receive-point-by-arguments:
            access IN_VeRxPDU_BRAKE_FD_2_FD14_E2E_Sts_E2ECheckSts: accessed-variable=VeRxPDU_BRAKE_FD_2_FD14_E2E_Sts.E2ECheckSts
            access IN_VeRxPDU_BRAKE_FD_2_FD14_E2E_Sts_OpRetVal: accessed-variable=VeRxPDU_BRAKE_FD_2_FD14_E2E_Sts.OpRetVal
            access IN_VeSR2B_h_COMRX_BRAKE_FD_2_FD14_Pkt_COMRX_BRAKE_FD_2_FD14_Pkt: accessed-variable=VeSR2B_h_COMRX_BRAKE_FD_2_FD14_Pkt.COMRX_BRAKE_FD_2_FD14_Pkt
          read-local-variables:
            access RV_VeSR2B_b_DevlpmtToolEnbld_write1_IRV: accessed-variable=VeSR2B_b_DevlpmtToolEnbld_write1_IRV
            access RV_VeSR2N_Cnt_BRAKE_FD_2_FD14_MM_Cntr_write_IRV: accessed-variable=VeSR2N_Cnt_BRAKE_FD_2_FD14_MM_Cntr_write_IRV
            access RV_VeSR2N_b_BRAKE_FD_2_FD14_MM_Faild_write_IRV: accessed-variable=VeSR2N_b_BRAKE_FD_2_FD14_MM_Faild_write_IRV
          written-local-variables:
            access WV_VeSR2N_Cnt_BRAKE_FD_2_FD14_MM_Cntr_write_IRV: accessed-variable=VeSR2N_Cnt_BRAKE_FD_2_FD14_MM_Cntr_write_IRV
            access WV_VeSR2N_b_BRAKE_FD_2_FD14_MM_Faild_write_IRV: accessed-variable=VeSR2N_b_BRAKE_FD_2_FD14_MM_Faild_write_IRV
            access WV_VeSR2N_b_BRAKE_FD_2_FD14_NewEvent_write_IRV: accessed-variable=VeSR2N_b_BRAKE_FD_2_FD14_NewEvent_write_IRV
        SR2B_BRAKE_FD_2_FD14_Error
          read-local-variables:
            access RV_VeSR2B_b_MM_Enbl_write1_IRV: accessed-variable=VeSR2B_b_MM_Enbl_write1_IRV
          written-local-variables:
            access WV_VeSR2N_Cnt_BRAKE_FD_2_FD14_MM_Cntr_write_IRV: accessed-variable=VeSR2N_Cnt_BRAKE_FD_2_FD14_MM_Cntr_write_IRV
            access WV_VeSR2N_b_BRAKE_FD_2_FD14_MM_Faild_write_IRV: accessed-variable=VeSR2N_b_BRAKE_FD_2_FD14_MM_Faild_write_IRV
            access WV_VeSR2N_b_BRAKE_FD_2_FD14_NewEvent_write_IRV: accessed-variable=VeSR2N_b_BRAKE_FD_2_FD14_NewEvent_write_IRV
        SR2B_BRAKE_FD_2_FD14_Time
          data-send-points:
            10 x access:
              OUT_VeSCMR_p_Lv2BrakeBoostPressureCANC2_Value: accessed-variable=VeSCMR_p_Lv2BrakeBoostPressureCANC2.Value
              OUT_VeSCMR_b_Lv2BrkBoostPressureCANC2_FA_Value: accessed-variable=VeSCMR_b_Lv2BrkBoostPressureCANC2_FA.Value
              OUT_VeSCMR_e_Lv2Brk_Stat_Value: accessed-variable=VeSCMR_e_Lv2Brk_Stat.Value
              OUT_VeSCMR_b_Lv2Brk_Stat_FA_Value: accessed-variable=VeSCMR_b_Lv2Brk_Stat_FA.Value
              OUT_VeSCMR_v_Lv2VehSpdCANC2_Value: accessed-variable=VeSCMR_v_Lv2VehSpdCANC2.Value
              OUT_VeSCMR_b_Lv2VehSpdCANC2_FA_Value: accessed-variable=VeSCMR_b_Lv2VehSpdCANC2_FA.Value
              OUT_VeSCMR_n_Lv2WhlFL_RPS_CANC2_Value: accessed-variable=VeSCMR_n_Lv2WhlFL_RPS_CANC2.Value
              OUT_VeSCMR_b_Lv2WhlFL_RPS_CANC2_FA_Value: accessed-variable=VeSCMR_b_Lv2WhlFL_RPS_CANC2_FA.Value
              OUT_VeSCMR_n_Lv2WhlFR_RPS_CANC2_Value: accessed-variable=VeSCMR_n_Lv2WhlFR_RPS_CANC2.Value
              OUT_VeSCMR_b_Lv2WhlFR_RPS_CANC2_FA_Value: accessed-variable=VeSCMR_b_Lv2WhlFR_RPS_CANC2_FA.Value
          read-local-variables:
            access RV_VeSR2N_b_BRAKE_FD_2_FD14_MM_Faild_write_IRV: accessed-variable=VeSR2N_b_BRAKE_FD_2_FD14_MM_Faild_write_IRV
            access RV_VeSR2N_b_BRAKE_FD_2_FD14_NewEvent_write_IRV: accessed-variable=VeSR2N_b_BRAKE_FD_2_FD14_NewEvent_write_IRV
          written-local-variables:
            access WV_VeSR2N_b_BRAKE_FD_2_FD14_NewEvent_write_IRV: accessed-variable=VeSR2N_b_BRAKE_FD_2_FD14_NewEvent_write_IRV
        SR2B_BRAKE_FD_6_FD14_Received
          data-receive-point-by-arguments:
            access IN_VeRxPDU_BRAKE_FD_6_FD14_E2E_Sts_E2ECheckSts: accessed-variable=VeRxPDU_BRAKE_FD_6_FD14_E2E_Sts.E2ECheckSts
            access IN_VeRxPDU_BRAKE_FD_6_FD14_E2E_Sts_OpRetVal: accessed-variable=VeRxPDU_BRAKE_FD_6_FD14_E2E_Sts.OpRetVal
            access IN_VeSR2B_h_COMRX_BRAKE_FD_6_FD14_Pkt_COMRX_BRAKE_FD_6_FD14_Pkt: accessed-variable=VeSR2B_h_COMRX_BRAKE_FD_6_FD14_Pkt.COMRX_BRAKE_FD_6_FD14_Pkt
          read-local-variables:
            access RV_VeSR2B_b_DevlpmtToolEnbld_write1_IRV: accessed-variable=VeSR2B_b_DevlpmtToolEnbld_write1_IRV
            access RV_VeSR2N_Cnt_BRAKE_FD_6_FD14_MM_Cntr_write_IRV: accessed-variable=VeSR2N_Cnt_BRAKE_FD_6_FD14_MM_Cntr_write_IRV
            access RV_VeSR2N_b_BRAKE_FD_6_FD14_MM_Faild_write_IRV: accessed-variable=VeSR2N_b_BRAKE_FD_6_FD14_MM_Faild_write_IRV
          written-local-variables:
            access WV_VeSR2N_Cnt_BRAKE_FD_6_FD14_MM_Cntr_write_IRV: accessed-variable=VeSR2N_Cnt_BRAKE_FD_6_FD14_MM_Cntr_write_IRV
            access WV_VeSR2N_b_BRAKE_FD_6_FD14_MM_Faild_write_IRV: accessed-variable=VeSR2N_b_BRAKE_FD_6_FD14_MM_Faild_write_IRV
            access WV_VeSR2N_b_BRAKE_FD_6_FD14_NewEvent_write_IRV: accessed-variable=VeSR2N_b_BRAKE_FD_6_FD14_NewEvent_write_IRV
        SR2B_BRAKE_FD_6_FD14_Error
          read-local-variables:
            access RV_VeSR2B_b_MM_Enbl_write1_IRV: accessed-variable=VeSR2B_b_MM_Enbl_write1_IRV
          written-local-variables:
            access WV_VeSR2N_Cnt_BRAKE_FD_6_FD14_MM_Cntr_write_IRV: accessed-variable=VeSR2N_Cnt_BRAKE_FD_6_FD14_MM_Cntr_write_IRV
            access WV_VeSR2N_b_BRAKE_FD_6_FD14_MM_Faild_write_IRV: accessed-variable=VeSR2N_b_BRAKE_FD_6_FD14_MM_Faild_write_IRV
            access WV_VeSR2N_b_BRAKE_FD_6_FD14_NewEvent_write_IRV: accessed-variable=VeSR2N_b_BRAKE_FD_6_FD14_NewEvent_write_IRV
        SR2B_BRAKE_FD_6_FD14_Time
          data-send-points:
            14 x access:
              OUT_VeSCMR_M_Lv2ACC_WhlTrq_Value: accessed-variable=VeSCMR_M_Lv2ACC_WhlTrq.Value
              OUT_VeSCMR_b_Lv2ACC_WhlTrq_FA_Value: accessed-variable=VeSCMR_b_Lv2ACC_WhlTrq_FA.Value
              OUT_VeSCMR_b_Lv2FrntAxlMaxRqCANC2_BSM_Value: accessed-variable=VeSCMR_b_Lv2FrntAxlMaxRqCANC2_BSM.Value
              OUT_VeSCMR_b_Lv2FrntAxlMaxRqCANC2_BSM_FA_Value: accessed-variable=VeSCMR_b_Lv2FrntAxlMaxRqCANC2_BSM_FA.Value
              OUT_VeSCMR_b_Lv2FrntAxlMinRqCANC2_BSM_Value: accessed-variable=VeSCMR_b_Lv2FrntAxlMinRqCANC2_BSM.Value
              OUT_VeSCMR_b_Lv2FrntAxlMinRqCANC2_BSM_FA_Value: accessed-variable=VeSCMR_b_Lv2FrntAxlMinRqCANC2_BSM_FA.Value
              OUT_VeSCMR_M_Lv2FrntAxlRqCANC2_BSM_Value: accessed-variable=VeSCMR_M_Lv2FrntAxlRqCANC2_BSM.Value
              OUT_VeSCMR_b_Lv2FrntAxlRqCANC2_BSM_FA_Value: accessed-variable=VeSCMR_b_Lv2FrntAxlRqCANC2_BSM_FA.Value
              OUT_VeSCMR_b_Lv2RrAxlMaxRqCANC2_BSM_Value: accessed-variable=VeSCMR_b_Lv2RrAxlMaxRqCANC2_BSM.Value
              OUT_VeSCMR_b_Lv2RrAxlMaxRqCANC2_BSM_FA_Value: accessed-variable=VeSCMR_b_Lv2RrAxlMaxRqCANC2_BSM_FA.Value
              OUT_VeSCMR_b_Lv2RrAxlMinRqCANC2_BSM_Value: accessed-variable=VeSCMR_b_Lv2RrAxlMinRqCANC2_BSM.Value
              OUT_VeSCMR_b_Lv2RrAxlMinRqCANC2_BSM_FA_Value: accessed-variable=VeSCMR_b_Lv2RrAxlMinRqCANC2_BSM_FA.Value
              OUT_VeSCMR_M_Lv2RrAxlRqCANC2_BSM_Value: accessed-variable=VeSCMR_M_Lv2RrAxlRqCANC2_BSM.Value
              OUT_VeSCMR_b_Lv2RrAxlRqCANC2_BSM_FA_Value: accessed-variable=VeSCMR_b_Lv2RrAxlRqCANC2_BSM_FA.Value
          read-local-variables:
            access RV_VeSR2N_b_BRAKE_FD_6_FD14_MM_Faild_write_IRV: accessed-variable=VeSR2N_b_BRAKE_FD_6_FD14_MM_Faild_write_IRV
            access RV_VeSR2N_b_BRAKE_FD_6_FD14_NewEvent_write_IRV: accessed-variable=VeSR2N_b_BRAKE_FD_6_FD14_NewEvent_write_IRV
          written-local-variables:
            access WV_VeSR2N_b_BRAKE_FD_6_FD14_NewEvent_write_IRV: accessed-variable=VeSR2N_b_BRAKE_FD_6_FD14_NewEvent_write_IRV
        SR2B_BRAKE_FD_7_FD14_Received
          data-receive-point-by-arguments:
            access IN_VeRxPDU_BRAKE_FD_7_FD14_E2E_Sts_E2ECheckSts: accessed-variable=VeRxPDU_BRAKE_FD_7_FD14_E2E_Sts.E2ECheckSts
            access IN_VeRxPDU_BRAKE_FD_7_FD14_E2E_Sts_OpRetVal: accessed-variable=VeRxPDU_BRAKE_FD_7_FD14_E2E_Sts.OpRetVal
            access IN_VeSR2B_h_COMRX_BRAKE_FD_7_FD14_Pkt_COMRX_BRAKE_FD_7_FD14_Pkt: accessed-variable=VeSR2B_h_COMRX_BRAKE_FD_7_FD14_Pkt.COMRX_BRAKE_FD_7_FD14_Pkt
          read-local-variables:
            access RV_VeSR2B_b_DevlpmtToolEnbld_write1_IRV: accessed-variable=VeSR2B_b_DevlpmtToolEnbld_write1_IRV
            access RV_VeSR2N_Cnt_BRAKE_FD_7_FD14_MM_Cntr_write_IRV: accessed-variable=VeSR2N_Cnt_BRAKE_FD_7_FD14_MM_Cntr_write_IRV
            access RV_VeSR2N_b_BRAKE_FD_7_FD14_MM_Faild_write_IRV: accessed-variable=VeSR2N_b_BRAKE_FD_7_FD14_MM_Faild_write_IRV
          written-local-variables:
            access WV_VeSR2N_Cnt_BRAKE_FD_7_FD14_MM_Cntr_write_IRV: accessed-variable=VeSR2N_Cnt_BRAKE_FD_7_FD14_MM_Cntr_write_IRV
            access WV_VeSR2N_b_BRAKE_FD_7_FD14_MM_Faild_write_IRV: accessed-variable=VeSR2N_b_BRAKE_FD_7_FD14_MM_Faild_write_IRV
            access WV_VeSR2N_b_BRAKE_FD_7_FD14_NewEvent_write_IRV: accessed-variable=VeSR2N_b_BRAKE_FD_7_FD14_NewEvent_write_IRV
        SR2B_BRAKE_FD_7_FD14_Error
          read-local-variables:
            access RV_VeSR2B_b_MM_Enbl_write1_IRV: accessed-variable=VeSR2B_b_MM_Enbl_write1_IRV
          written-local-variables:
            access WV_VeSR2N_Cnt_BRAKE_FD_7_FD14_MM_Cntr_write_IRV: accessed-variable=VeSR2N_Cnt_BRAKE_FD_7_FD14_MM_Cntr_write_IRV
            access WV_VeSR2N_b_BRAKE_FD_7_FD14_MM_Faild_write_IRV: accessed-variable=VeSR2N_b_BRAKE_FD_7_FD14_MM_Faild_write_IRV
            access WV_VeSR2N_b_BRAKE_FD_7_FD14_NewEvent_write_IRV: accessed-variable=VeSR2N_b_BRAKE_FD_7_FD14_NewEvent_write_IRV
        SR2B_BRAKE_FD_7_FD14_Time
          data-send-points:
            4 x access:
              OUT_VeSCMR_Pct_Lv2BrkTravelStsCANC2_Value: accessed-variable=VeSCMR_Pct_Lv2BrkTravelStsCANC2.Value
              OUT_VeSCMR_b_Lv2BrkTravelStsCANC2_FA_Value: accessed-variable=VeSCMR_b_Lv2BrkTravelStsCANC2_FA.Value
              OUT_VeSCMR_e_Lv2BrkPdlStatCANC2_Value: accessed-variable=VeSCMR_e_Lv2BrkPdlStatCANC2.Value
              OUT_VeSCMR_b_Lv2BrkPdlStatCANC2_FA_Value: accessed-variable=VeSCMR_b_Lv2BrkPdlStatCANC2_FA.Value
          read-local-variables:
            access RV_VeSR2N_b_BRAKE_FD_7_FD14_MM_Faild_write_IRV: accessed-variable=VeSR2N_b_BRAKE_FD_7_FD14_MM_Faild_write_IRV
            access RV_VeSR2N_b_BRAKE_FD_7_FD14_NewEvent_write_IRV: accessed-variable=VeSR2N_b_BRAKE_FD_7_FD14_NewEvent_write_IRV
          written-local-variables:
            access WV_VeSR2N_b_BRAKE_FD_7_FD14_NewEvent_write_IRV: accessed-variable=VeSR2N_b_BRAKE_FD_7_FD14_NewEvent_write_IRV
        SR2B_EPS_FD_1_FD14_Received
          data-receive-point-by-arguments:
            access IN_VeRxPDU_EPS_FD_1_FD14_E2E_Sts_E2ECheckSts: accessed-variable=VeRxPDU_EPS_FD_1_FD14_E2E_Sts.E2ECheckSts
            access IN_VeRxPDU_EPS_FD_1_FD14_E2E_Sts_OpRetVal: accessed-variable=VeRxPDU_EPS_FD_1_FD14_E2E_Sts.OpRetVal
            access IN_VeSR2B_h_COMRX_EPS_FD_1_FD14_Pkt_COMRX_EPS_FD_1_FD14_Pkt: accessed-variable=VeSR2B_h_COMRX_EPS_FD_1_FD14_Pkt.COMRX_EPS_FD_1_FD14_Pkt
          read-local-variables:
            access RV_VeSR2B_b_DevlpmtToolEnbld_write1_IRV: accessed-variable=VeSR2B_b_DevlpmtToolEnbld_write1_IRV
            access RV_VeSR2N_Cnt_EPS_FD_1_FD14_MM_Cntr_write_IRV: accessed-variable=VeSR2N_Cnt_EPS_FD_1_FD14_MM_Cntr_write_IRV
            access RV_VeSR2N_b_EPS_FD_1_FD14_MM_Faild_write_IRV: accessed-variable=VeSR2N_b_EPS_FD_1_FD14_MM_Faild_write_IRV
          written-local-variables:
            access WV_VeSR2N_Cnt_EPS_FD_1_FD14_MM_Cntr_write_IRV: accessed-variable=VeSR2N_Cnt_EPS_FD_1_FD14_MM_Cntr_write_IRV
            access WV_VeSR2N_b_EPS_FD_1_FD14_MM_Faild_write_IRV: accessed-variable=VeSR2N_b_EPS_FD_1_FD14_MM_Faild_write_IRV
            access WV_VeSR2N_b_EPS_FD_1_FD14_NewEvent_write_IRV: accessed-variable=VeSR2N_b_EPS_FD_1_FD14_NewEvent_write_IRV
        SR2B_EPS_FD_1_FD14_Error
          read-local-variables:
            access RV_VeSR2B_b_MM_Enbl_write1_IRV: accessed-variable=VeSR2B_b_MM_Enbl_write1_IRV
          written-local-variables:
            access WV_VeSR2N_Cnt_EPS_FD_1_FD14_MM_Cntr_write_IRV: accessed-variable=VeSR2N_Cnt_EPS_FD_1_FD14_MM_Cntr_write_IRV
            access WV_VeSR2N_b_EPS_FD_1_FD14_MM_Faild_write_IRV: accessed-variable=VeSR2N_b_EPS_FD_1_FD14_MM_Faild_write_IRV
            access WV_VeSR2N_b_EPS_FD_1_FD14_NewEvent_write_IRV: accessed-variable=VeSR2N_b_EPS_FD_1_FD14_NewEvent_write_IRV
        SR2B_EPS_FD_1_FD14_Time
          data-send-points:
            access OUT_VeSCMR_phi_Lv2LwsAngle_Value: accessed-variable=VeSCMR_phi_Lv2LwsAngle.Value
            access OUT_VeSCMR_b_Lv2LwsAngle_FA_Value: accessed-variable=VeSCMR_b_Lv2LwsAngle_FA.Value
          read-local-variables:
            access RV_VeSR2N_b_EPS_FD_1_FD14_MM_Faild_write_IRV: accessed-variable=VeSR2N_b_EPS_FD_1_FD14_MM_Faild_write_IRV
            access RV_VeSR2N_b_EPS_FD_1_FD14_NewEvent_write_IRV: accessed-variable=VeSR2N_b_EPS_FD_1_FD14_NewEvent_write_IRV
          written-local-variables:
            access WV_VeSR2N_b_EPS_FD_1_FD14_NewEvent_write_IRV: accessed-variable=VeSR2N_b_EPS_FD_1_FD14_NewEvent_write_IRV
        SR2B_ORC_FD_3_FD14_Received
          data-receive-point-by-arguments:
            access IN_VeRxPDU_ORC_FD_3_FD14_E2E_Sts_E2ECheckSts: accessed-variable=VeRxPDU_ORC_FD_3_FD14_E2E_Sts.E2ECheckSts
            access IN_VeRxPDU_ORC_FD_3_FD14_E2E_Sts_OpRetVal: accessed-variable=VeRxPDU_ORC_FD_3_FD14_E2E_Sts.OpRetVal
            access IN_VeSR2B_h_COMRX_ORC_FD_3_FD14_Pkt_COMRX_ORC_FD_3_FD14_Pkt: accessed-variable=VeSR2B_h_COMRX_ORC_FD_3_FD14_Pkt.COMRX_ORC_FD_3_FD14_Pkt
          read-local-variables:
            access RV_VeSR2B_b_DevlpmtToolEnbld_write1_IRV: accessed-variable=VeSR2B_b_DevlpmtToolEnbld_write1_IRV
            access RV_VeSR2N_Cnt_ORC_FD_3_FD14_MM_Cntr_write_IRV: accessed-variable=VeSR2N_Cnt_ORC_FD_3_FD14_MM_Cntr_write_IRV
            access RV_VeSR2N_b_ORC_FD_3_FD14_MM_Faild_write_IRV: accessed-variable=VeSR2N_b_ORC_FD_3_FD14_MM_Faild_write_IRV
          written-local-variables:
            access WV_VeSR2N_Cnt_ORC_FD_3_FD14_MM_Cntr_write_IRV: accessed-variable=VeSR2N_Cnt_ORC_FD_3_FD14_MM_Cntr_write_IRV
            access WV_VeSR2N_b_ORC_FD_3_FD14_MM_Faild_write_IRV: accessed-variable=VeSR2N_b_ORC_FD_3_FD14_MM_Faild_write_IRV
            access WV_VeSR2N_b_ORC_FD_3_FD14_NewEvent_write_IRV: accessed-variable=VeSR2N_b_ORC_FD_3_FD14_NewEvent_write_IRV
        SR2B_ORC_FD_3_FD14_Error
          read-local-variables:
            access RV_VeSR2B_b_MM_Enbl_write1_IRV: accessed-variable=VeSR2B_b_MM_Enbl_write1_IRV
          written-local-variables:
            access WV_VeSR2N_Cnt_ORC_FD_3_FD14_MM_Cntr_write_IRV: accessed-variable=VeSR2N_Cnt_ORC_FD_3_FD14_MM_Cntr_write_IRV
            access WV_VeSR2N_b_ORC_FD_3_FD14_MM_Faild_write_IRV: accessed-variable=VeSR2N_b_ORC_FD_3_FD14_MM_Faild_write_IRV
            access WV_VeSR2N_b_ORC_FD_3_FD14_NewEvent_write_IRV: accessed-variable=VeSR2N_b_ORC_FD_3_FD14_NewEvent_write_IRV
        SR2B_ORC_FD_3_FD14_Time
          data-send-points:
            12 x access:
              OUT_VeSCMR_a_Lv2LatAcceleration_Value: accessed-variable=VeSCMR_a_Lv2LatAcceleration.Value
              OUT_VeSCMR_b_Lv2LatAcceleration_FA_Value: accessed-variable=VeSCMR_b_Lv2LatAcceleration_FA.Value
              OUT_VeSCMR_b_Lv2LatAccelerationFailSts_Value: accessed-variable=VeSCMR_b_Lv2LatAccelerationFailSts.Value
              OUT_VeSCMR_b_Lv2LatAccelerationFailSts_FA_Value: accessed-variable=VeSCMR_b_Lv2LatAccelerationFailSts_FA.Value
              OUT_VeSCMR_a_Lv2LongAcceleration_Value: accessed-variable=VeSCMR_a_Lv2LongAcceleration.Value
              OUT_VeSCMR_b_Lv2LongAcceleration_FA_Value: accessed-variable=VeSCMR_b_Lv2LongAcceleration_FA.Value
              OUT_VeSCMR_b_Lv2LongAccelerationFailSts_Value: accessed-variable=VeSCMR_b_Lv2LongAccelerationFailSts.Value
              OUT_VeSCMR_b_Lv2LongAccelerationFailSts_FA_Value: accessed-variable=VeSCMR_b_Lv2LongAccelerationFailSts_FA.Value
              OUT_VeSCMR_dphi_Lv2YawRate_Value: accessed-variable=VeSCMR_dphi_Lv2YawRate.Value
              OUT_VeSCMR_b_Lv2YawRate_FA_Value: accessed-variable=VeSCMR_b_Lv2YawRate_FA.Value
              OUT_VeSCMR_b_Lv2YawRateFailSts_Value: accessed-variable=VeSCMR_b_Lv2YawRateFailSts.Value
              OUT_VeSCMR_b_Lv2YawRateFailSts_FA_Value: accessed-variable=VeSCMR_b_Lv2YawRateFailSts_FA.Value
          read-local-variables:
            access RV_VeSR2N_b_ORC_FD_3_FD14_MM_Faild_write_IRV: accessed-variable=VeSR2N_b_ORC_FD_3_FD14_MM_Faild_write_IRV
            access RV_VeSR2N_b_ORC_FD_3_FD14_NewEvent_write_IRV: accessed-variable=VeSR2N_b_ORC_FD_3_FD14_NewEvent_write_IRV
          written-local-variables:
            access WV_VeSR2N_b_ORC_FD_3_FD14_NewEvent_write_IRV: accessed-variable=VeSR2N_b_ORC_FD_3_FD14_NewEvent_write_IRV
        SR2B_AGSM_FD_2_FD16_Received
          data-receive-point-by-arguments:
            access IN_VeRxPDU_AGSM_FD_2_FD16_E2E_Sts_E2ECheckSts: accessed-variable=VeRxPDU_AGSM_FD_2_FD16_E2E_Sts.E2ECheckSts
            access IN_VeRxPDU_AGSM_FD_2_FD16_E2E_Sts_OpRetVal: accessed-variable=VeRxPDU_AGSM_FD_2_FD16_E2E_Sts.OpRetVal
            access IN_VeSR2B_h_COMRX_AGSM_FD_2_FD16_Pkt_COMRX_AGSM_FD_2_FD16_Pkt: accessed-variable=VeSR2B_h_COMRX_AGSM_FD_2_FD16_Pkt.COMRX_AGSM_FD_2_FD16_Pkt
          read-local-variables:
            access RV_VeSR2B_b_DevlpmtToolEnbld_write1_IRV: accessed-variable=VeSR2B_b_DevlpmtToolEnbld_write1_IRV
            access RV_VeSR2N_Cnt_AGSM_FD_2_FD16_MM_Cntr_write_IRV: accessed-variable=VeSR2N_Cnt_AGSM_FD_2_FD16_MM_Cntr_write_IRV
            access RV_VeSR2N_b_AGSM_FD_2_FD16_MM_Faild_write_IRV: accessed-variable=VeSR2N_b_AGSM_FD_2_FD16_MM_Faild_write_IRV
          written-local-variables:
            access WV_VeSR2N_Cnt_AGSM_FD_2_FD16_MM_Cntr_write_IRV: accessed-variable=VeSR2N_Cnt_AGSM_FD_2_FD16_MM_Cntr_write_IRV
            access WV_VeSR2N_b_AGSM_FD_2_FD16_MM_Faild_write_IRV: accessed-variable=VeSR2N_b_AGSM_FD_2_FD16_MM_Faild_write_IRV
            access WV_VeSR2N_b_AGSM_FD_2_FD16_NewEvent_write_IRV: accessed-variable=VeSR2N_b_AGSM_FD_2_FD16_NewEvent_write_IRV
        SR2B_AGSM_FD_2_FD16_Error
          read-local-variables:
            access RV_VeSR2B_b_MM_Enbl_write1_IRV: accessed-variable=VeSR2B_b_MM_Enbl_write1_IRV
          written-local-variables:
            access WV_VeSR2N_Cnt_AGSM_FD_2_FD16_MM_Cntr_write_IRV: accessed-variable=VeSR2N_Cnt_AGSM_FD_2_FD16_MM_Cntr_write_IRV
            access WV_VeSR2N_b_AGSM_FD_2_FD16_MM_Faild_write_IRV: accessed-variable=VeSR2N_b_AGSM_FD_2_FD16_MM_Faild_write_IRV
            access WV_VeSR2N_b_AGSM_FD_2_FD16_NewEvent_write_IRV: accessed-variable=VeSR2N_b_AGSM_FD_2_FD16_NewEvent_write_IRV
        SR2B_AGSM_FD_2_FD16_Time
          data-send-points:
            6 x access:
              OUT_VeSCMR_b_Lv2ScndryPRNDDispFailSts_Value: accessed-variable=VeSCMR_b_Lv2ScndryPRNDDispFailSts.Value
              OUT_VeSCMR_b_Lv2ScndryPRNDDispFailSts_FA_Value: accessed-variable=VeSCMR_b_Lv2ScndryPRNDDispFailSts_FA.Value
              OUT_VeSCMR_b_Lv2Scndry_PRNDFailSts_Value: accessed-variable=VeSCMR_b_Lv2Scndry_PRNDFailSts.Value
              OUT_VeSCMR_b_Lv2Scndry_PRNDFailSts_FA_Value: accessed-variable=VeSCMR_b_Lv2Scndry_PRNDFailSts_FA.Value
              OUT_VeSCMR_e_Lv2DrvRqShftROT_Scndry_Value: accessed-variable=VeSCMR_e_Lv2DrvRqShftROT_Scndry.Value
              OUT_VeSCMR_b_Lv2DrvRqShftROT_Scndry_FA_Value: accessed-variable=VeSCMR_b_Lv2DrvRqShftROT_Scndry_FA.Value
          read-local-variables:
            access RV_VeSR2N_b_AGSM_FD_2_FD16_MM_Faild_write_IRV: accessed-variable=VeSR2N_b_AGSM_FD_2_FD16_MM_Faild_write_IRV
            access RV_VeSR2N_b_AGSM_FD_2_FD16_NewEvent_write_IRV: accessed-variable=VeSR2N_b_AGSM_FD_2_FD16_NewEvent_write_IRV
          written-local-variables:
            access WV_VeSR2N_b_AGSM_FD_2_FD16_NewEvent_write_IRV: accessed-variable=VeSR2N_b_AGSM_FD_2_FD16_NewEvent_write_IRV
        SR2B_ELSDM_FD_1_FD16_Received
          data-receive-point-by-arguments:
            access IN_VeRxPDU_ELSDM_FD_1_FD16_E2E_Sts_E2ECheckSts: accessed-variable=VeRxPDU_ELSDM_FD_1_FD16_E2E_Sts.E2ECheckSts
            access IN_VeRxPDU_ELSDM_FD_1_FD16_E2E_Sts_OpRetVal: accessed-variable=VeRxPDU_ELSDM_FD_1_FD16_E2E_Sts.OpRetVal
            access IN_VeSR2B_h_COMRX_ELSDM_FD_1_FD16_Pkt_COMRX_ELSDM_FD_1_FD16_Pkt: accessed-variable=VeSR2B_h_COMRX_ELSDM_FD_1_FD16_Pkt.COMRX_ELSDM_FD_1_FD16_Pkt
          read-local-variables:
            access RV_VeSR2B_b_DevlpmtToolEnbld_write1_IRV: accessed-variable=VeSR2B_b_DevlpmtToolEnbld_write1_IRV
            access RV_VeSR2N_Cnt_ELSDM_FD_1_FD16_MM_Cntr_write_IRV: accessed-variable=VeSR2N_Cnt_ELSDM_FD_1_FD16_MM_Cntr_write_IRV
            access RV_VeSR2N_b_ELSDM_FD_1_FD16_MM_Faild_write_IRV: accessed-variable=VeSR2N_b_ELSDM_FD_1_FD16_MM_Faild_write_IRV
          written-local-variables:
            access WV_VeSR2N_Cnt_ELSDM_FD_1_FD16_MM_Cntr_write_IRV: accessed-variable=VeSR2N_Cnt_ELSDM_FD_1_FD16_MM_Cntr_write_IRV
            access WV_VeSR2N_b_ELSDM_FD_1_FD16_MM_Faild_write_IRV: accessed-variable=VeSR2N_b_ELSDM_FD_1_FD16_MM_Faild_write_IRV
            access WV_VeSR2N_b_ELSDM_FD_1_FD16_NewEvent_write_IRV: accessed-variable=VeSR2N_b_ELSDM_FD_1_FD16_NewEvent_write_IRV
        SR2B_ELSDM_FD_1_FD16_Error
          read-local-variables:
            access RV_VeSR2B_b_MM_Enbl_write1_IRV: accessed-variable=VeSR2B_b_MM_Enbl_write1_IRV
          written-local-variables:
            access WV_VeSR2N_Cnt_ELSDM_FD_1_FD16_MM_Cntr_write_IRV: accessed-variable=VeSR2N_Cnt_ELSDM_FD_1_FD16_MM_Cntr_write_IRV
            access WV_VeSR2N_b_ELSDM_FD_1_FD16_MM_Faild_write_IRV: accessed-variable=VeSR2N_b_ELSDM_FD_1_FD16_MM_Faild_write_IRV
            access WV_VeSR2N_b_ELSDM_FD_1_FD16_NewEvent_write_IRV: accessed-variable=VeSR2N_b_ELSDM_FD_1_FD16_NewEvent_write_IRV
        SR2B_ELSDM_FD_1_FD16_Time
          data-send-points:
            14 x access:
              OUT_VeSCMR_y_Lv2GearShiftType_Value: accessed-variable=VeSCMR_y_Lv2GearShiftType.Value
              OUT_VeSCMR_b_Lv2GearShiftType_FA_Value: accessed-variable=VeSCMR_b_Lv2GearShiftType_FA.Value
              OUT_VeSCMR_y_Lv2MRGB_Current_Gr_Value: accessed-variable=VeSCMR_y_Lv2MRGB_Current_Gr.Value
              OUT_VeSCMR_b_Lv2MRGB_Current_Gr_FA_Value: accessed-variable=VeSCMR_b_Lv2MRGB_Current_Gr_FA.Value
              OUT_VeSCMR_y_Lv2MRGB_Target_Gr_Value: accessed-variable=VeSCMR_y_Lv2MRGB_Target_Gr.Value
              OUT_VeSCMR_b_Lv2MRGB_Target_Gr_FA_Value: accessed-variable=VeSCMR_b_Lv2MRGB_Target_Gr_FA.Value
              OUT_VeSCMR_M_Lv2RrLkTrq_Value: accessed-variable=VeSCMR_M_Lv2RrLkTrq.Value
              OUT_VeSCMR_b_Lv2RrLkTrq_FA_Value: accessed-variable=VeSCMR_b_Lv2RrLkTrq_FA.Value
              OUT_VeSCMR_e_Lv2RrSysStat_Value: accessed-variable=VeSCMR_e_Lv2RrSysStat.Value
              OUT_VeSCMR_b_Lv2RrSysStat_FA_Value: accessed-variable=VeSCMR_b_Lv2RrSysStat_FA.Value
              OUT_VeSCMR_T_Lv2RrTemp_Avl_Value: accessed-variable=VeSCMR_T_Lv2RrTemp_Avl.Value
              OUT_VeSCMR_b_Lv2RrTemp_Avl_FA_Value: accessed-variable=VeSCMR_b_Lv2RrTemp_Avl_FA.Value
              OUT_VeSCMR_r_Lv2TransTrqRatio_Value: accessed-variable=VeSCMR_r_Lv2TransTrqRatio.Value
              OUT_VeSCMR_b_Lv2TransTrqRatio_FA_Value: accessed-variable=VeSCMR_b_Lv2TransTrqRatio_FA.Value
          read-local-variables:
            access RV_VeSR2N_b_ELSDM_FD_1_FD16_MM_Faild_write_IRV: accessed-variable=VeSR2N_b_ELSDM_FD_1_FD16_MM_Faild_write_IRV
            access RV_VeSR2N_b_ELSDM_FD_1_FD16_NewEvent_write_IRV: accessed-variable=VeSR2N_b_ELSDM_FD_1_FD16_NewEvent_write_IRV
          written-local-variables:
            access WV_VeSR2N_b_ELSDM_FD_1_FD16_NewEvent_write_IRV: accessed-variable=VeSR2N_b_ELSDM_FD_1_FD16_NewEvent_write_IRV
        SR2B_MCPA_PROPULSION_FD16_Received
          data-receive-point-by-arguments:
            access IN_VeRxPDU_MCPA_PROPULSION_FD16_E2E_Sts_E2ECheckSts: accessed-variable=VeRxPDU_MCPA_PROPULSION_FD16_E2E_Sts.E2ECheckSts
            access IN_VeRxPDU_MCPA_PROPULSION_FD16_E2E_Sts_OpRetVal: accessed-variable=VeRxPDU_MCPA_PROPULSION_FD16_E2E_Sts.OpRetVal
            access IN_VeSR2B_h_COMRX_MCPA_PROPULSION_FD16_Pkt_COMRX_MCPA_PROPULSION_FD16_Pkt: accessed-variable=VeSR2B_h_COMRX_MCPA_PROPULSION_FD16_Pkt.COMRX_MCPA_PROPULSION_FD16_Pkt
          read-local-variables:
            access RV_VeSR2B_b_DevlpmtToolEnbld_write1_IRV: accessed-variable=VeSR2B_b_DevlpmtToolEnbld_write1_IRV
            access RV_VeSR2N_Cnt_MCPA_PROPULSION_FD16_MM_Cntr_write_IRV: accessed-variable=VeSR2N_Cnt_MCPA_PROPULSION_FD16_MM_Cntr_write_IRV
            access RV_VeSR2N_b_MCPA_PROPULSION_FD16_MM_Faild_write_IRV: accessed-variable=VeSR2N_b_MCPA_PROPULSION_FD16_MM_Faild_write_IRV
          written-local-variables:
            access WV_VeSR2N_Cnt_MCPA_PROPULSION_FD16_MM_Cntr_write_IRV: accessed-variable=VeSR2N_Cnt_MCPA_PROPULSION_FD16_MM_Cntr_write_IRV
            access WV_VeSR2N_b_MCPA_PROPULSION_FD16_MM_Faild_write_IRV: accessed-variable=VeSR2N_b_MCPA_PROPULSION_FD16_MM_Faild_write_IRV
            access WV_VeSR2N_b_MCPA_PROPULSION_FD16_NewEvent_write_IRV: accessed-variable=VeSR2N_b_MCPA_PROPULSION_FD16_NewEvent_write_IRV
        SR2B_MCPA_PROPULSION_FD16_Error
          read-local-variables:
            access RV_VeSR2B_b_MM_Enbl_write1_IRV: accessed-variable=VeSR2B_b_MM_Enbl_write1_IRV
          written-local-variables:
            access WV_VeSR2N_Cnt_MCPA_PROPULSION_FD16_MM_Cntr_write_IRV: accessed-variable=VeSR2N_Cnt_MCPA_PROPULSION_FD16_MM_Cntr_write_IRV
            access WV_VeSR2N_b_MCPA_PROPULSION_FD16_MM_Faild_write_IRV: accessed-variable=VeSR2N_b_MCPA_PROPULSION_FD16_MM_Faild_write_IRV
            access WV_VeSR2N_b_MCPA_PROPULSION_FD16_NewEvent_write_IRV: accessed-variable=VeSR2N_b_MCPA_PROPULSION_FD16_NewEvent_write_IRV
        SR2B_MCPA_PROPULSION_FD16_Time
          data-send-points:
            20 x access:
              OUT_VeSR2B_b_MCPA_HV_CnctrOpn_Req_P_FD16_Value: accessed-variable=VeSR2B_b_MCPA_HV_CnctrOpn_Req_P_FD16.Value
              OUT_VeSR2B_y_MCPA_HV_CnctrOpn_Req_P_FD16_SigSts_Value: accessed-variable=VeSR2B_y_MCPA_HV_CnctrOpn_Req_P_FD16_SigSts.Value
              OUT_VeSR2B_M_MCPA_MaxTorq_P_FD16_Value: accessed-variable=VeSR2B_M_MCPA_MaxTorq_P_FD16.Value
              OUT_VeSR2B_y_MCPA_MaxTorq_P_FD16_SigSts_Value: accessed-variable=VeSR2B_y_MCPA_MaxTorq_P_FD16_SigSts.Value
              OUT_VeSR2B_M_MCPA_MinTorq_P_FD16_Value: accessed-variable=VeSR2B_M_MCPA_MinTorq_P_FD16.Value
              OUT_VeSR2B_y_MCPA_MinTorq_P_FD16_SigSts_Value: accessed-variable=VeSR2B_y_MCPA_MinTorq_P_FD16_SigSts.Value
              OUT_VeSR2B_n_MCPA_RPM_P_FD16_Value: accessed-variable=VeSR2B_n_MCPA_RPM_P_FD16.Value
              OUT_VeSR2B_y_MCPA_RPM_P_FD16_SigSts_Value: accessed-variable=VeSR2B_y_MCPA_RPM_P_FD16_SigSts.Value
              OUT_VeSR2B_b_MCPA_RPM_V_P_FD16_Value: accessed-variable=VeSR2B_b_MCPA_RPM_V_P_FD16.Value
              OUT_VeSR2B_y_MCPA_RPM_V_P_FD16_SigSts_Value: accessed-variable=VeSR2B_y_MCPA_RPM_V_P_FD16_SigSts.Value
              OUT_VeSR2B_T_MCPA_Temp_P_FD16_Value: accessed-variable=VeSR2B_T_MCPA_Temp_P_FD16.Value
              OUT_VeSR2B_y_MCPA_Temp_P_FD16_SigSts_Value: accessed-variable=VeSR2B_y_MCPA_Temp_P_FD16_SigSts.Value
              OUT_VeSR2B_M_MCPA_TorqAchved_AEMD_P_FD16_Value: accessed-variable=VeSR2B_M_MCPA_TorqAchved_AEMD_P_FD16.Value
              OUT_VeSR2B_y_MCPA_TorqAchved_AEMD_P_FD16_SigSts_Value: accessed-variable=VeSR2B_y_MCPA_TorqAchved_AEMD_P_FD16_SigSts.Value
              OUT_VeSR2B_b_MCPA_TrqAchvd_AEMD_V_P_FD16_Value: accessed-variable=VeSR2B_b_MCPA_TrqAchvd_AEMD_V_P_FD16.Value
              OUT_VeSR2B_y_MCPA_TrqAchvd_AEMD_V_P_FD16_SigSts_Value: accessed-variable=VeSR2B_y_MCPA_TrqAchvd_AEMD_V_P_FD16_SigSts.Value
              OUT_VeSR2B_M_MCPA_Torque_Achieved_P_FD16_Value: accessed-variable=VeSR2B_M_MCPA_Torque_Achieved_P_FD16.Value
              OUT_VeSR2B_y_MCPA_Torque_Achieved_P_FD16_SigSts_Value: accessed-variable=VeSR2B_y_MCPA_Torque_Achieved_P_FD16_SigSts.Value
              OUT_VeSR2B_b_MCPA_Torque_Achved_V_P_FD16_Value: accessed-variable=VeSR2B_b_MCPA_Torque_Achved_V_P_FD16.Value
              OUT_VeSR2B_y_MCPA_Torque_Achved_V_P_FD16_SigSts_Value: accessed-variable=VeSR2B_y_MCPA_Torque_Achved_V_P_FD16_SigSts.Value
          read-local-variables:
            access RV_VeSR2N_b_MCPA_PROPULSION_FD16_MM_Faild_write_IRV: accessed-variable=VeSR2N_b_MCPA_PROPULSION_FD16_MM_Faild_write_IRV
            access RV_VeSR2N_b_MCPA_PROPULSION_FD16_NewEvent_write_IRV: accessed-variable=VeSR2N_b_MCPA_PROPULSION_FD16_NewEvent_write_IRV
          written-local-variables:
            access WV_VeSR2N_b_MCPA_PROPULSION_FD16_NewEvent_write_IRV: accessed-variable=VeSR2N_b_MCPA_PROPULSION_FD16_NewEvent_write_IRV
        SR2B_MCPB_PROPULSION_FD16_Received
          data-receive-point-by-arguments:
            access IN_VeRxPDU_MCPB_PROPULSION_FD16_E2E_Sts_E2ECheckSts: accessed-variable=VeRxPDU_MCPB_PROPULSION_FD16_E2E_Sts.E2ECheckSts
            access IN_VeRxPDU_MCPB_PROPULSION_FD16_E2E_Sts_OpRetVal: accessed-variable=VeRxPDU_MCPB_PROPULSION_FD16_E2E_Sts.OpRetVal
            access IN_VeSR2B_h_COMRX_MCPB_PROPULSION_FD16_Pkt_COMRX_MCPB_PROPULSION_FD16_Pkt: accessed-variable=VeSR2B_h_COMRX_MCPB_PROPULSION_FD16_Pkt.COMRX_MCPB_PROPULSION_FD16_Pkt
          read-local-variables:
            access RV_VeSR2B_b_DevlpmtToolEnbld_write1_IRV: accessed-variable=VeSR2B_b_DevlpmtToolEnbld_write1_IRV
            access RV_VeSR2N_Cnt_MCPB_PROPULSION_FD16_MM_Cntr_write_IRV: accessed-variable=VeSR2N_Cnt_MCPB_PROPULSION_FD16_MM_Cntr_write_IRV
            access RV_VeSR2N_b_MCPB_PROPULSION_FD16_MM_Faild_write_IRV: accessed-variable=VeSR2N_b_MCPB_PROPULSION_FD16_MM_Faild_write_IRV
          written-local-variables:
            access WV_VeSR2N_Cnt_MCPB_PROPULSION_FD16_MM_Cntr_write_IRV: accessed-variable=VeSR2N_Cnt_MCPB_PROPULSION_FD16_MM_Cntr_write_IRV
            access WV_VeSR2N_b_MCPB_PROPULSION_FD16_MM_Faild_write_IRV: accessed-variable=VeSR2N_b_MCPB_PROPULSION_FD16_MM_Faild_write_IRV
            access WV_VeSR2N_b_MCPB_PROPULSION_FD16_NewEvent_write_IRV: accessed-variable=VeSR2N_b_MCPB_PROPULSION_FD16_NewEvent_write_IRV
        SR2B_MCPB_PROPULSION_FD16_Error
          read-local-variables:
            access RV_VeSR2B_b_MM_Enbl_write1_IRV: accessed-variable=VeSR2B_b_MM_Enbl_write1_IRV
          written-local-variables:
            access WV_VeSR2N_Cnt_MCPB_PROPULSION_FD16_MM_Cntr_write_IRV: accessed-variable=VeSR2N_Cnt_MCPB_PROPULSION_FD16_MM_Cntr_write_IRV
            access WV_VeSR2N_b_MCPB_PROPULSION_FD16_MM_Faild_write_IRV: accessed-variable=VeSR2N_b_MCPB_PROPULSION_FD16_MM_Faild_write_IRV
            access WV_VeSR2N_b_MCPB_PROPULSION_FD16_NewEvent_write_IRV: accessed-variable=VeSR2N_b_MCPB_PROPULSION_FD16_NewEvent_write_IRV
        SR2B_MCPB_PROPULSION_FD16_Time
          data-send-points:
            22 x access:
              OUT_VeSR2B_b_MCPB_HV_CnctrOpn_Req_P_FD16_Value: accessed-variable=VeSR2B_b_MCPB_HV_CnctrOpn_Req_P_FD16.Value
              OUT_VeSR2B_y_MCPB_HV_CnctrOpn_Req_P_FD16_SigSts_Value: accessed-variable=VeSR2B_y_MCPB_HV_CnctrOpn_Req_P_FD16_SigSts.Value
              OUT_VeSR2B_M_MCPB_MaxTorq_P_FD16_Value: accessed-variable=VeSR2B_M_MCPB_MaxTorq_P_FD16.Value
              OUT_VeSR2B_y_MCPB_MaxTorq_P_FD16_SigSts_Value: accessed-variable=VeSR2B_y_MCPB_MaxTorq_P_FD16_SigSts.Value
              OUT_VeSR2B_M_MCPB_MinTorq_P_FD16_Value: accessed-variable=VeSR2B_M_MCPB_MinTorq_P_FD16.Value
              OUT_VeSR2B_y_MCPB_MinTorq_P_FD16_SigSts_Value: accessed-variable=VeSR2B_y_MCPB_MinTorq_P_FD16_SigSts.Value
              OUT_VeSR2B_y_MCPB_MtrIndex_P_FD16_Value: accessed-variable=VeSR2B_y_MCPB_MtrIndex_P_FD16.Value
              OUT_VeSR2B_y_MCPB_MtrIndex_P_FD16_SigSts_Value: accessed-variable=VeSR2B_y_MCPB_MtrIndex_P_FD16_SigSts.Value
              OUT_VeSR2B_n_MCPB_RPM_P_FD16_Value: accessed-variable=VeSR2B_n_MCPB_RPM_P_FD16.Value
              OUT_VeSR2B_y_MCPB_RPM_P_FD16_SigSts_Value: accessed-variable=VeSR2B_y_MCPB_RPM_P_FD16_SigSts.Value
              OUT_VeSR2B_b_MCPB_RPM_V_P_FD16_Value: accessed-variable=VeSR2B_b_MCPB_RPM_V_P_FD16.Value
              OUT_VeSR2B_y_MCPB_RPM_V_P_FD16_SigSts_Value: accessed-variable=VeSR2B_y_MCPB_RPM_V_P_FD16_SigSts.Value
              OUT_VeSR2B_y_MCPB_Temp_P_FD16_Value: accessed-variable=VeSR2B_y_MCPB_Temp_P_FD16.Value
              OUT_VeSR2B_y_MCPB_Temp_P_FD16_SigSts_Value: accessed-variable=VeSR2B_y_MCPB_Temp_P_FD16_SigSts.Value
              OUT_VeSR2B_M_MCPB_TorqAchved_AEMD_P_FD16_Value: accessed-variable=VeSR2B_M_MCPB_TorqAchved_AEMD_P_FD16.Value
              OUT_VeSR2B_y_MCPB_TorqAchved_AEMD_P_FD16_SigSts_Value: accessed-variable=VeSR2B_y_MCPB_TorqAchved_AEMD_P_FD16_SigSts.Value
              OUT_VeSR2B_b_MCPB_TrqAchvd_AEMD_V_P_FD16_Value: accessed-variable=VeSR2B_b_MCPB_TrqAchvd_AEMD_V_P_FD16.Value
              OUT_VeSR2B_y_MCPB_TrqAchvd_AEMD_V_P_FD16_SigSts_Value: accessed-variable=VeSR2B_y_MCPB_TrqAchvd_AEMD_V_P_FD16_SigSts.Value
              OUT_VeSR2B_M_MCPB_Torque_Achieved_P_FD16_Value: accessed-variable=VeSR2B_M_MCPB_Torque_Achieved_P_FD16.Value
              OUT_VeSR2B_y_MCPB_Torque_Achieved_P_FD16_SigSts_Value: accessed-variable=VeSR2B_y_MCPB_Torque_Achieved_P_FD16_SigSts.Value
              OUT_VeSR2B_b_MCPB_Torque_Achved_V_P_FD16_Value: accessed-variable=VeSR2B_b_MCPB_Torque_Achved_V_P_FD16.Value
              OUT_VeSR2B_y_MCPB_Torque_Achved_V_P_FD16_SigSts_Value: accessed-variable=VeSR2B_y_MCPB_Torque_Achved_V_P_FD16_SigSts.Value
          read-local-variables:
            access RV_VeSR2N_b_MCPB_PROPULSION_FD16_MM_Faild_write_IRV: accessed-variable=VeSR2N_b_MCPB_PROPULSION_FD16_MM_Faild_write_IRV
            access RV_VeSR2N_b_MCPB_PROPULSION_FD16_NewEvent_write_IRV: accessed-variable=VeSR2N_b_MCPB_PROPULSION_FD16_NewEvent_write_IRV
          written-local-variables:
            access WV_VeSR2N_b_MCPB_PROPULSION_FD16_NewEvent_write_IRV: accessed-variable=VeSR2N_b_MCPB_PROPULSION_FD16_NewEvent_write_IRV
        SR2B_APM_VDCM_FD5_Received
          data-receive-point-by-arguments:
            access IN_VeRxPDU_APM_VDCM_FD5_E2E_Sts_E2ECheckSts: accessed-variable=VeRxPDU_APM_VDCM_FD5_E2E_Sts.E2ECheckSts
            access IN_VeRxPDU_APM_VDCM_FD5_E2E_Sts_OpRetVal: accessed-variable=VeRxPDU_APM_VDCM_FD5_E2E_Sts.OpRetVal
            access IN_VeSR2B_h_COMRX_APM_VDCM_FD5_Pkt_COMRX_APM_VDCM_FD5_Pkt: accessed-variable=VeSR2B_h_COMRX_APM_VDCM_FD5_Pkt.COMRX_APM_VDCM_FD5_Pkt
          read-local-variables:
            access RV_VeSR2B_b_DevlpmtToolEnbld_write1_IRV: accessed-variable=VeSR2B_b_DevlpmtToolEnbld_write1_IRV
            access RV_VeSR2N_Cnt_APM_VDCM_FD5_MM_Cntr_write_IRV: accessed-variable=VeSR2N_Cnt_APM_VDCM_FD5_MM_Cntr_write_IRV
            access RV_VeSR2N_b_APM_VDCM_FD5_MM_Faild_write_IRV: accessed-variable=VeSR2N_b_APM_VDCM_FD5_MM_Faild_write_IRV
          written-local-variables:
            access WV_VeSR2N_Cnt_APM_VDCM_FD5_MM_Cntr_write_IRV: accessed-variable=VeSR2N_Cnt_APM_VDCM_FD5_MM_Cntr_write_IRV
            access WV_VeSR2N_b_APM_VDCM_FD5_MM_Faild_write_IRV: accessed-variable=VeSR2N_b_APM_VDCM_FD5_MM_Faild_write_IRV
            access WV_VeSR2N_b_APM_VDCM_FD5_NewEvent_write_IRV: accessed-variable=VeSR2N_b_APM_VDCM_FD5_NewEvent_write_IRV
        SR2B_APM_VDCM_FD5_Error
          read-local-variables:
            access RV_VeSR2B_b_MM_Enbl_write1_IRV: accessed-variable=VeSR2B_b_MM_Enbl_write1_IRV
          written-local-variables:
            access WV_VeSR2N_Cnt_APM_VDCM_FD5_MM_Cntr_write_IRV: accessed-variable=VeSR2N_Cnt_APM_VDCM_FD5_MM_Cntr_write_IRV
            access WV_VeSR2N_b_APM_VDCM_FD5_MM_Faild_write_IRV: accessed-variable=VeSR2N_b_APM_VDCM_FD5_MM_Faild_write_IRV
            access WV_VeSR2N_b_APM_VDCM_FD5_NewEvent_write_IRV: accessed-variable=VeSR2N_b_APM_VDCM_FD5_NewEvent_write_IRV
        SR2B_APM_VDCM_FD5_Time
          data-send-points:
            10 x access:
              OUT_VeSR2B_y_APM_CtrlSts_Fbk_FD5_Value: accessed-variable=VeSR2B_y_APM_CtrlSts_Fbk_FD5.Value
              OUT_VeSR2B_y_APM_CtrlSts_Fbk_FD5_SigSts_Value: accessed-variable=VeSR2B_y_APM_CtrlSts_Fbk_FD5_SigSts.Value
              OUT_VeSR2B_y_APM_FailureReason_FD5_Value: accessed-variable=VeSR2B_y_APM_FailureReason_FD5.Value
              OUT_VeSR2B_y_APM_FailureReason_FD5_SigSts_Value: accessed-variable=VeSR2B_y_APM_FailureReason_FD5_SigSts.Value
              OUT_VeSR2B_y_APM_FailureType_FD5_Value: accessed-variable=VeSR2B_y_APM_FailureType_FD5.Value
              OUT_VeSR2B_y_APM_FailureType_FD5_SigSts_Value: accessed-variable=VeSR2B_y_APM_FailureType_FD5_SigSts.Value
              OUT_VeSR2B_U_APM_HV_V_Fbk_FD5_Value: accessed-variable=VeSR2B_U_APM_HV_V_Fbk_FD5.Value
              OUT_VeSR2B_y_APM_HV_V_Fbk_FD5_SigSts_Value: accessed-variable=VeSR2B_y_APM_HV_V_Fbk_FD5_SigSts.Value
              OUT_VeSR2B_U_APM_LV_V_Fbk_FD5_Value: accessed-variable=VeSR2B_U_APM_LV_V_Fbk_FD5.Value
              OUT_VeSR2B_y_APM_LV_V_Fbk_FD5_SigSts_Value: accessed-variable=VeSR2B_y_APM_LV_V_Fbk_FD5_SigSts.Value
          read-local-variables:
            access RV_VeSR2N_b_APM_VDCM_FD5_MM_Faild_write_IRV: accessed-variable=VeSR2N_b_APM_VDCM_FD5_MM_Faild_write_IRV
            access RV_VeSR2N_b_APM_VDCM_FD5_NewEvent_write_IRV: accessed-variable=VeSR2N_b_APM_VDCM_FD5_NewEvent_write_IRV
          written-local-variables:
            access WV_VeSR2N_b_APM_VDCM_FD5_NewEvent_write_IRV: accessed-variable=VeSR2N_b_APM_VDCM_FD5_NewEvent_write_IRV
        SR2B_BATTERY_HV_POWERLIMITS_FD5_Received
          data-receive-point-by-arguments:
            access IN_VeRxPDU_BATTERY_HV_POWERLIMITS_FD5_E2E_Sts_E2ECheckSts: accessed-variable=VeRxPDU_BATTERY_HV_POWERLIMITS_FD5_E2E_Sts.E2ECheckSts
            access IN_VeRxPDU_BATTERY_HV_POWERLIMITS_FD5_E2E_Sts_OpRetVal: accessed-variable=VeRxPDU_BATTERY_HV_POWERLIMITS_FD5_E2E_Sts.OpRetVal
            access IN_VeSR2B_h_COMRX_BATTERY_HV_POWERLIMITS_FD5_Pkt_COMRX_BATTERY_HV_POWERLIMITS_FD5_Pkt: accessed-variable=VeSR2B_h_COMRX_BATTERY_HV_POWERLIMITS_FD5_Pkt.COMRX_BATTERY_HV_POWERLIMITS_FD5_Pkt
          read-local-variables:
            access RV_VeSR2B_b_DevlpmtToolEnbld_write1_IRV: accessed-variable=VeSR2B_b_DevlpmtToolEnbld_write1_IRV
            access RV_VeSR2N_Cnt_BATTERY_HV_POWERLIMITS_FD5_MM_Cntr_write_IRV: accessed-variable=VeSR2N_Cnt_BATTERY_HV_POWERLIMITS_FD5_MM_Cntr_write_IRV
            access RV_VeSR2N_b_BATTERY_HV_POWERLIMITS_FD5_MM_Faild_write_IRV: accessed-variable=VeSR2N_b_BATTERY_HV_POWERLIMITS_FD5_MM_Faild_write_IRV
          written-local-variables:
            access WV_VeSR2N_Cnt_BATTERY_HV_POWERLIMITS_FD5_MM_Cntr_write_IRV: accessed-variable=VeSR2N_Cnt_BATTERY_HV_POWERLIMITS_FD5_MM_Cntr_write_IRV
            access WV_VeSR2N_b_BATTERY_HV_POWERLIMITS_FD5_MM_Faild_write_IRV: accessed-variable=VeSR2N_b_BATTERY_HV_POWERLIMITS_FD5_MM_Faild_write_IRV
            access WV_VeSR2N_b_BATTERY_HV_POWERLIMITS_FD5_NewEvent_write_IRV: accessed-variable=VeSR2N_b_BATTERY_HV_POWERLIMITS_FD5_NewEvent_write_IRV
        SR2B_BATTERY_HV_POWERLIMITS_FD5_Error
          read-local-variables:
            access RV_VeSR2B_b_MM_Enbl_write1_IRV: accessed-variable=VeSR2B_b_MM_Enbl_write1_IRV
          written-local-variables:
            access WV_VeSR2N_Cnt_BATTERY_HV_POWERLIMITS_FD5_MM_Cntr_write_IRV: accessed-variable=VeSR2N_Cnt_BATTERY_HV_POWERLIMITS_FD5_MM_Cntr_write_IRV
            access WV_VeSR2N_b_BATTERY_HV_POWERLIMITS_FD5_MM_Faild_write_IRV: accessed-variable=VeSR2N_b_BATTERY_HV_POWERLIMITS_FD5_MM_Faild_write_IRV
            access WV_VeSR2N_b_BATTERY_HV_POWERLIMITS_FD5_NewEvent_write_IRV: accessed-variable=VeSR2N_b_BATTERY_HV_POWERLIMITS_FD5_NewEvent_write_IRV
        SR2B_BATTERY_HV_POWERLIMITS_FD5_Time
          data-send-points:
            4 x access:
              OUT_VeSR2B_b_BPCMCntctrsMTOWrn_FD5_Value: accessed-variable=VeSR2B_b_BPCMCntctrsMTOWrn_FD5.Value
              OUT_VeSR2B_y_BPCMCntctrsMTOWrn_FD5_SigSts_Value: accessed-variable=VeSR2B_y_BPCMCntctrsMTOWrn_FD5_SigSts.Value
              OUT_VeSR2B_b_BPCMCntctrsSTOWrn_FD5_Value: accessed-variable=VeSR2B_b_BPCMCntctrsSTOWrn_FD5.Value
              OUT_VeSR2B_y_BPCMCntctrsSTOWrn_FD5_SigSts_Value: accessed-variable=VeSR2B_y_BPCMCntctrsSTOWrn_FD5_SigSts.Value
          read-local-variables:
            access RV_VeSR2N_b_BATTERY_HV_POWERLIMITS_FD5_MM_Faild_write_IRV: accessed-variable=VeSR2N_b_BATTERY_HV_POWERLIMITS_FD5_MM_Faild_write_IRV
            access RV_VeSR2N_b_BATTERY_HV_POWERLIMITS_FD5_NewEvent_write_IRV: accessed-variable=VeSR2N_b_BATTERY_HV_POWERLIMITS_FD5_NewEvent_write_IRV
          written-local-variables:
            access WV_VeSR2N_b_BATTERY_HV_POWERLIMITS_FD5_NewEvent_write_IRV: accessed-variable=VeSR2N_b_BATTERY_HV_POWERLIMITS_FD5_NewEvent_write_IRV
        SR2B_BATTERY_HV_STATUS1_FD5_Received
          data-receive-point-by-arguments:
            access IN_VeRxPDU_BATTERY_HV_STATUS1_FD5_E2E_Sts_E2ECheckSts: accessed-variable=VeRxPDU_BATTERY_HV_STATUS1_FD5_E2E_Sts.E2ECheckSts
            access IN_VeRxPDU_BATTERY_HV_STATUS1_FD5_E2E_Sts_OpRetVal: accessed-variable=VeRxPDU_BATTERY_HV_STATUS1_FD5_E2E_Sts.OpRetVal
            access IN_VeSR2B_h_COMRX_BATTERY_HV_STATUS1_FD5_Pkt_COMRX_BATTERY_HV_STATUS1_FD5_Pkt: accessed-variable=VeSR2B_h_COMRX_BATTERY_HV_STATUS1_FD5_Pkt.COMRX_BATTERY_HV_STATUS1_FD5_Pkt
          read-local-variables:
            access RV_VeSR2B_b_DevlpmtToolEnbld_write1_IRV: accessed-variable=VeSR2B_b_DevlpmtToolEnbld_write1_IRV
            access RV_VeSR2N_Cnt_BATTERY_HV_STATUS1_FD5_MM_Cntr_write_IRV: accessed-variable=VeSR2N_Cnt_BATTERY_HV_STATUS1_FD5_MM_Cntr_write_IRV
            access RV_VeSR2N_b_BATTERY_HV_STATUS1_FD5_MM_Faild_write_IRV: accessed-variable=VeSR2N_b_BATTERY_HV_STATUS1_FD5_MM_Faild_write_IRV
          written-local-variables:
            access WV_VeSR2N_Cnt_BATTERY_HV_STATUS1_FD5_MM_Cntr_write_IRV: accessed-variable=VeSR2N_Cnt_BATTERY_HV_STATUS1_FD5_MM_Cntr_write_IRV
            access WV_VeSR2N_b_BATTERY_HV_STATUS1_FD5_MM_Faild_write_IRV: accessed-variable=VeSR2N_b_BATTERY_HV_STATUS1_FD5_MM_Faild_write_IRV
            access WV_VeSR2N_b_BATTERY_HV_STATUS1_FD5_NewEvent_write_IRV: accessed-variable=VeSR2N_b_BATTERY_HV_STATUS1_FD5_NewEvent_write_IRV
        SR2B_BATTERY_HV_STATUS1_FD5_Error
          read-local-variables:
            access RV_VeSR2B_b_MM_Enbl_write1_IRV: accessed-variable=VeSR2B_b_MM_Enbl_write1_IRV
          written-local-variables:
            access WV_VeSR2N_Cnt_BATTERY_HV_STATUS1_FD5_MM_Cntr_write_IRV: accessed-variable=VeSR2N_Cnt_BATTERY_HV_STATUS1_FD5_MM_Cntr_write_IRV
            access WV_VeSR2N_b_BATTERY_HV_STATUS1_FD5_MM_Faild_write_IRV: accessed-variable=VeSR2N_b_BATTERY_HV_STATUS1_FD5_MM_Faild_write_IRV
            access WV_VeSR2N_b_BATTERY_HV_STATUS1_FD5_NewEvent_write_IRV: accessed-variable=VeSR2N_b_BATTERY_HV_STATUS1_FD5_NewEvent_write_IRV
        SR2B_BATTERY_HV_STATUS1_FD5_Time
          data-send-points:
            12 x access:
              OUT_VeSR2B_I_BPCM_HV_Current_FD5_Value: accessed-variable=VeSR2B_I_BPCM_HV_Current_FD5.Value
              OUT_VeSR2B_y_BPCM_HV_Current_FD5_SigSts_Value: accessed-variable=VeSR2B_y_BPCM_HV_Current_FD5_SigSts.Value
              OUT_VeSR2B_U_BPCM_HV_IntVolt_FD5_Value: accessed-variable=VeSR2B_U_BPCM_HV_IntVolt_FD5.Value
              OUT_VeSR2B_y_BPCM_HV_IntVolt_FD5_SigSts_Value: accessed-variable=VeSR2B_y_BPCM_HV_IntVolt_FD5_SigSts.Value
              OUT_VeSR2B_Pct_BPCM_HV_SOC_FD5_Value: accessed-variable=VeSR2B_Pct_BPCM_HV_SOC_FD5.Value
              OUT_VeSR2B_y_BPCM_HV_SOC_FD5_SigSts_Value: accessed-variable=VeSR2B_y_BPCM_HV_SOC_FD5_SigSts.Value
              OUT_VeSR2B_T_BPCM_HV_Temp_Max_FD5_Value: accessed-variable=VeSR2B_T_BPCM_HV_Temp_Max_FD5.Value
              OUT_VeSR2B_y_BPCM_HV_Temp_Max_FD5_SigSts_Value: accessed-variable=VeSR2B_y_BPCM_HV_Temp_Max_FD5_SigSts.Value
              OUT_VeSR2B_T_BPCM_HV_Temp_Min_FD5_Value: accessed-variable=VeSR2B_T_BPCM_HV_Temp_Min_FD5.Value
              OUT_VeSR2B_y_BPCM_HV_Temp_Min_FD5_SigSts_Value: accessed-variable=VeSR2B_y_BPCM_HV_Temp_Min_FD5_SigSts.Value
              OUT_VeSR2B_y_BPCM_HV_TracBusStsFD5_Value: accessed-variable=VeSR2B_y_BPCM_HV_TracBusStsFD5.Value
              OUT_VeSR2B_y_BPCM_HV_TracBusStsFD5_SigSts_Value: accessed-variable=VeSR2B_y_BPCM_HV_TracBusStsFD5_SigSts.Value
          read-local-variables:
            access RV_VeSR2N_b_BATTERY_HV_STATUS1_FD5_MM_Faild_write_IRV: accessed-variable=VeSR2N_b_BATTERY_HV_STATUS1_FD5_MM_Faild_write_IRV
            access RV_VeSR2N_b_BATTERY_HV_STATUS1_FD5_NewEvent_write_IRV: accessed-variable=VeSR2N_b_BATTERY_HV_STATUS1_FD5_NewEvent_write_IRV
          written-local-variables:
            access WV_VeSR2N_b_BATTERY_HV_STATUS1_FD5_NewEvent_write_IRV: accessed-variable=VeSR2N_b_BATTERY_HV_STATUS1_FD5_NewEvent_write_IRV
        SR2B_HV_CHARGER1_FD5_Received
          data-receive-point-by-arguments:
            access IN_VeRxPDU_HV_CHARGER1_FD5_E2E_Sts_E2ECheckSts: accessed-variable=VeRxPDU_HV_CHARGER1_FD5_E2E_Sts.E2ECheckSts
            access IN_VeRxPDU_HV_CHARGER1_FD5_E2E_Sts_OpRetVal: accessed-variable=VeRxPDU_HV_CHARGER1_FD5_E2E_Sts.OpRetVal
            access IN_VeSR2B_h_COMRX_HV_CHARGER1_FD5_Pkt_COMRX_HV_CHARGER1_FD5_Pkt: accessed-variable=VeSR2B_h_COMRX_HV_CHARGER1_FD5_Pkt.COMRX_HV_CHARGER1_FD5_Pkt
          read-local-variables:
            access RV_VeSR2B_b_DevlpmtToolEnbld_write1_IRV: accessed-variable=VeSR2B_b_DevlpmtToolEnbld_write1_IRV
            access RV_VeSR2N_Cnt_HV_CHARGER1_FD5_MM_Cntr_write_IRV: accessed-variable=VeSR2N_Cnt_HV_CHARGER1_FD5_MM_Cntr_write_IRV
            access RV_VeSR2N_b_HV_CHARGER1_FD5_MM_Faild_write_IRV: accessed-variable=VeSR2N_b_HV_CHARGER1_FD5_MM_Faild_write_IRV
          written-local-variables:
            access WV_VeSR2N_Cnt_HV_CHARGER1_FD5_MM_Cntr_write_IRV: accessed-variable=VeSR2N_Cnt_HV_CHARGER1_FD5_MM_Cntr_write_IRV
            access WV_VeSR2N_b_HV_CHARGER1_FD5_MM_Faild_write_IRV: accessed-variable=VeSR2N_b_HV_CHARGER1_FD5_MM_Faild_write_IRV
            access WV_VeSR2N_b_HV_CHARGER1_FD5_NewEvent_write_IRV: accessed-variable=VeSR2N_b_HV_CHARGER1_FD5_NewEvent_write_IRV
        SR2B_HV_CHARGER1_FD5_Error
          read-local-variables:
            access RV_VeSR2B_b_MM_Enbl_write1_IRV: accessed-variable=VeSR2B_b_MM_Enbl_write1_IRV
          written-local-variables:
            access WV_VeSR2N_Cnt_HV_CHARGER1_FD5_MM_Cntr_write_IRV: accessed-variable=VeSR2N_Cnt_HV_CHARGER1_FD5_MM_Cntr_write_IRV
            access WV_VeSR2N_b_HV_CHARGER1_FD5_MM_Faild_write_IRV: accessed-variable=VeSR2N_b_HV_CHARGER1_FD5_MM_Faild_write_IRV
            access WV_VeSR2N_b_HV_CHARGER1_FD5_NewEvent_write_IRV: accessed-variable=VeSR2N_b_HV_CHARGER1_FD5_NewEvent_write_IRV
        SR2B_HV_CHARGER1_FD5_Time
          data-send-points:
            access OUT_VeSR2B_y_ProximitySts_FD5_Value: accessed-variable=VeSR2B_y_ProximitySts_FD5.Value
            access OUT_VeSR2B_y_ProximitySts_FD5_SigSts_Value: accessed-variable=VeSR2B_y_ProximitySts_FD5_SigSts.Value
          read-local-variables:
            access RV_VeSR2N_b_HV_CHARGER1_FD5_MM_Faild_write_IRV: accessed-variable=VeSR2N_b_HV_CHARGER1_FD5_MM_Faild_write_IRV
            access RV_VeSR2N_b_HV_CHARGER1_FD5_NewEvent_write_IRV: accessed-variable=VeSR2N_b_HV_CHARGER1_FD5_NewEvent_write_IRV
          written-local-variables:
            access WV_VeSR2N_b_HV_CHARGER1_FD5_NewEvent_write_IRV: accessed-variable=VeSR2N_b_HV_CHARGER1_FD5_NewEvent_write_IRV
        SR2B_MCPA_PROPULSION_FD5_Received
          data-receive-point-by-arguments:
            access IN_VeRxPDU_MCPA_PROPULSION_FD5_E2E_Sts_E2ECheckSts: accessed-variable=VeRxPDU_MCPA_PROPULSION_FD5_E2E_Sts.E2ECheckSts
            access IN_VeRxPDU_MCPA_PROPULSION_FD5_E2E_Sts_OpRetVal: accessed-variable=VeRxPDU_MCPA_PROPULSION_FD5_E2E_Sts.OpRetVal
            access IN_VeSR2B_h_COMRX_MCPA_PROPULSION_FD5_Pkt_COMRX_MCPA_PROPULSION_FD5_Pkt: accessed-variable=VeSR2B_h_COMRX_MCPA_PROPULSION_FD5_Pkt.COMRX_MCPA_PROPULSION_FD5_Pkt
          read-local-variables:
            access RV_VeSR2B_b_DevlpmtToolEnbld_write1_IRV: accessed-variable=VeSR2B_b_DevlpmtToolEnbld_write1_IRV
            access RV_VeSR2N_Cnt_MCPA_PROPULSION_FD5_MM_Cntr_write_IRV: accessed-variable=VeSR2N_Cnt_MCPA_PROPULSION_FD5_MM_Cntr_write_IRV
            access RV_VeSR2N_b_MCPA_PROPULSION_FD5_MM_Faild_write_IRV: accessed-variable=VeSR2N_b_MCPA_PROPULSION_FD5_MM_Faild_write_IRV
          written-local-variables:
            access WV_VeSR2N_Cnt_MCPA_PROPULSION_FD5_MM_Cntr_write_IRV: accessed-variable=VeSR2N_Cnt_MCPA_PROPULSION_FD5_MM_Cntr_write_IRV
            access WV_VeSR2N_b_MCPA_PROPULSION_FD5_MM_Faild_write_IRV: accessed-variable=VeSR2N_b_MCPA_PROPULSION_FD5_MM_Faild_write_IRV
            access WV_VeSR2N_b_MCPA_PROPULSION_FD5_NewEvent_write_IRV: accessed-variable=VeSR2N_b_MCPA_PROPULSION_FD5_NewEvent_write_IRV
        SR2B_MCPA_PROPULSION_FD5_Error
          read-local-variables:
            access RV_VeSR2B_b_MM_Enbl_write1_IRV: accessed-variable=VeSR2B_b_MM_Enbl_write1_IRV
          written-local-variables:
            access WV_VeSR2N_Cnt_MCPA_PROPULSION_FD5_MM_Cntr_write_IRV: accessed-variable=VeSR2N_Cnt_MCPA_PROPULSION_FD5_MM_Cntr_write_IRV
            access WV_VeSR2N_b_MCPA_PROPULSION_FD5_MM_Faild_write_IRV: accessed-variable=VeSR2N_b_MCPA_PROPULSION_FD5_MM_Faild_write_IRV
            access WV_VeSR2N_b_MCPA_PROPULSION_FD5_NewEvent_write_IRV: accessed-variable=VeSR2N_b_MCPA_PROPULSION_FD5_NewEvent_write_IRV
        SR2B_MCPA_PROPULSION_FD5_Time
          data-send-points:
            20 x access:
              OUT_VeSR2B_b_MCPA_HV_CnctrOpnRqPFD5_Value: accessed-variable=VeSR2B_b_MCPA_HV_CnctrOpnRqPFD5.Value
              OUT_VeSR2B_y_MCPA_HV_CnctrOpnRqPFD5_SigSts_Value: accessed-variable=VeSR2B_y_MCPA_HV_CnctrOpnRqPFD5_SigSts.Value
              OUT_VeSR2B_M_MCPA_MaxTorq_P_FD5_Value: accessed-variable=VeSR2B_M_MCPA_MaxTorq_P_FD5.Value
              OUT_VeSR2B_y_MCPA_MaxTorq_P_FD5_SigSts_Value: accessed-variable=VeSR2B_y_MCPA_MaxTorq_P_FD5_SigSts.Value
              OUT_VeSR2B_M_MCPA_MinTorq_P_FD5_Value: accessed-variable=VeSR2B_M_MCPA_MinTorq_P_FD5.Value
              OUT_VeSR2B_y_MCPA_MinTorq_P_FD5_SigSts_Value: accessed-variable=VeSR2B_y_MCPA_MinTorq_P_FD5_SigSts.Value
              OUT_VeSR2B_n_MCPA_RPM_P_FD5_Value: accessed-variable=VeSR2B_n_MCPA_RPM_P_FD5.Value
              OUT_VeSR2B_y_MCPA_RPM_P_FD5_SigSts_Value: accessed-variable=VeSR2B_y_MCPA_RPM_P_FD5_SigSts.Value
              OUT_VeSR2B_b_MCPA_RPM_V_P_FD5_Value: accessed-variable=VeSR2B_b_MCPA_RPM_V_P_FD5.Value
              OUT_VeSR2B_y_MCPA_RPM_V_P_FD5_SigSts_Value: accessed-variable=VeSR2B_y_MCPA_RPM_V_P_FD5_SigSts.Value
              OUT_VeSR2B_T_MCPA_Temp_P_FD5_Value: accessed-variable=VeSR2B_T_MCPA_Temp_P_FD5.Value
              OUT_VeSR2B_y_MCPA_Temp_P_FD5_SigSts_Value: accessed-variable=VeSR2B_y_MCPA_Temp_P_FD5_SigSts.Value
              OUT_VeSR2B_M_MCPA_TrqAchvdAEMDPFD5_Value: accessed-variable=VeSR2B_M_MCPA_TrqAchvdAEMDPFD5.Value
              OUT_VeSR2B_y_MCPA_TrqAchvdAEMDPFD5_SigSts_Value: accessed-variable=VeSR2B_y_MCPA_TrqAchvdAEMDPFD5_SigSts.Value
              OUT_VeSR2B_b_MCPA_TrqAchvdAEMDVPFD5_Value: accessed-variable=VeSR2B_b_MCPA_TrqAchvdAEMDVPFD5.Value
              OUT_VeSR2B_y_MCPA_TrqAchvdAEMDVPFD5_SigSts_Value: accessed-variable=VeSR2B_y_MCPA_TrqAchvdAEMDVPFD5_SigSts.Value
              OUT_VeSR2B_M_MCPA_Torque_AchvdPFD5_Value: accessed-variable=VeSR2B_M_MCPA_Torque_AchvdPFD5.Value
              OUT_VeSR2B_y_MCPA_Torque_AchvdPFD5_SigSts_Value: accessed-variable=VeSR2B_y_MCPA_Torque_AchvdPFD5_SigSts.Value
              OUT_VeSR2B_b_MCPA_Trque_AchvdVPFD5_Value: accessed-variable=VeSR2B_b_MCPA_Trque_AchvdVPFD5.Value
              OUT_VeSR2B_y_MCPA_Trque_AchvdVPFD5_SigSts_Value: accessed-variable=VeSR2B_y_MCPA_Trque_AchvdVPFD5_SigSts.Value
          read-local-variables:
            access RV_VeSR2N_b_MCPA_PROPULSION_FD5_MM_Faild_write_IRV: accessed-variable=VeSR2N_b_MCPA_PROPULSION_FD5_MM_Faild_write_IRV
            access RV_VeSR2N_b_MCPA_PROPULSION_FD5_NewEvent_write_IRV: accessed-variable=VeSR2N_b_MCPA_PROPULSION_FD5_NewEvent_write_IRV
          written-local-variables:
            access WV_VeSR2N_b_MCPA_PROPULSION_FD5_NewEvent_write_IRV: accessed-variable=VeSR2N_b_MCPA_PROPULSION_FD5_NewEvent_write_IRV
        SR2B_MCPB_PROPULSION_FD5_Received
          data-receive-point-by-arguments:
            access IN_VeRxPDU_MCPB_PROPULSION_FD5_E2E_Sts_E2ECheckSts: accessed-variable=VeRxPDU_MCPB_PROPULSION_FD5_E2E_Sts.E2ECheckSts
            access IN_VeRxPDU_MCPB_PROPULSION_FD5_E2E_Sts_OpRetVal: accessed-variable=VeRxPDU_MCPB_PROPULSION_FD5_E2E_Sts.OpRetVal
            access IN_VeSR2B_h_COMRX_MCPB_PROPULSION_FD5_Pkt_COMRX_MCPB_PROPULSION_FD5_Pkt: accessed-variable=VeSR2B_h_COMRX_MCPB_PROPULSION_FD5_Pkt.COMRX_MCPB_PROPULSION_FD5_Pkt
          read-local-variables:
            access RV_VeSR2B_b_DevlpmtToolEnbld_write1_IRV: accessed-variable=VeSR2B_b_DevlpmtToolEnbld_write1_IRV
            access RV_VeSR2N_Cnt_MCPB_PROPULSION_FD5_MM_Cntr_write_IRV: accessed-variable=VeSR2N_Cnt_MCPB_PROPULSION_FD5_MM_Cntr_write_IRV
            access RV_VeSR2N_b_MCPB_PROPULSION_FD5_MM_Faild_write_IRV: accessed-variable=VeSR2N_b_MCPB_PROPULSION_FD5_MM_Faild_write_IRV
          written-local-variables:
            access WV_VeSR2N_Cnt_MCPB_PROPULSION_FD5_MM_Cntr_write_IRV: accessed-variable=VeSR2N_Cnt_MCPB_PROPULSION_FD5_MM_Cntr_write_IRV
            access WV_VeSR2N_b_MCPB_PROPULSION_FD5_MM_Faild_write_IRV: accessed-variable=VeSR2N_b_MCPB_PROPULSION_FD5_MM_Faild_write_IRV
            access WV_VeSR2N_b_MCPB_PROPULSION_FD5_NewEvent_write_IRV: accessed-variable=VeSR2N_b_MCPB_PROPULSION_FD5_NewEvent_write_IRV
        SR2B_MCPB_PROPULSION_FD5_Error
          read-local-variables:
            access RV_VeSR2B_b_MM_Enbl_write1_IRV: accessed-variable=VeSR2B_b_MM_Enbl_write1_IRV
          written-local-variables:
            access WV_VeSR2N_Cnt_MCPB_PROPULSION_FD5_MM_Cntr_write_IRV: accessed-variable=VeSR2N_Cnt_MCPB_PROPULSION_FD5_MM_Cntr_write_IRV
            access WV_VeSR2N_b_MCPB_PROPULSION_FD5_MM_Faild_write_IRV: accessed-variable=VeSR2N_b_MCPB_PROPULSION_FD5_MM_Faild_write_IRV
            access WV_VeSR2N_b_MCPB_PROPULSION_FD5_NewEvent_write_IRV: accessed-variable=VeSR2N_b_MCPB_PROPULSION_FD5_NewEvent_write_IRV
        SR2B_MCPB_PROPULSION_FD5_Time
          data-send-points:
            22 x access:
              OUT_VeSR2B_b_MCPB_HV_CnctrOpnRqPFD5_Value: accessed-variable=VeSR2B_b_MCPB_HV_CnctrOpnRqPFD5.Value
              OUT_VeSR2B_y_MCPB_HV_CnctrOpnRqPFD5_SigSts_Value: accessed-variable=VeSR2B_y_MCPB_HV_CnctrOpnRqPFD5_SigSts.Value
              OUT_VeSR2B_M_MCPB_MaxTorq_P_FD5_Value: accessed-variable=VeSR2B_M_MCPB_MaxTorq_P_FD5.Value
              OUT_VeSR2B_y_MCPB_MaxTorq_P_FD5_SigSts_Value: accessed-variable=VeSR2B_y_MCPB_MaxTorq_P_FD5_SigSts.Value
              OUT_VeSR2B_M_MCPB_MinTorq_P_FD5_Value: accessed-variable=VeSR2B_M_MCPB_MinTorq_P_FD5.Value
              OUT_VeSR2B_y_MCPB_MinTorq_P_FD5_SigSts_Value: accessed-variable=VeSR2B_y_MCPB_MinTorq_P_FD5_SigSts.Value
              OUT_VeSR2B_y_MCPB_MtrIndex_P_FD5_Value: accessed-variable=VeSR2B_y_MCPB_MtrIndex_P_FD5.Value
              OUT_VeSR2B_y_MCPB_MtrIndex_P_FD5_SigSts_Value: accessed-variable=VeSR2B_y_MCPB_MtrIndex_P_FD5_SigSts.Value
              OUT_VeSR2B_n_MCPB_RPM_P_FD5_Value: accessed-variable=VeSR2B_n_MCPB_RPM_P_FD5.Value
              OUT_VeSR2B_y_MCPB_RPM_P_FD5_SigSts_Value: accessed-variable=VeSR2B_y_MCPB_RPM_P_FD5_SigSts.Value
              OUT_VeSR2B_b_MCPB_RPM_V_P_FD5_Value: accessed-variable=VeSR2B_b_MCPB_RPM_V_P_FD5.Value
              OUT_VeSR2B_y_MCPB_RPM_V_P_FD5_SigSts_Value: accessed-variable=VeSR2B_y_MCPB_RPM_V_P_FD5_SigSts.Value
              OUT_VeSR2B_y_MCPB_Temp_P_FD5_Value: accessed-variable=VeSR2B_y_MCPB_Temp_P_FD5.Value
              OUT_VeSR2B_y_MCPB_Temp_P_FD5_SigSts_Value: accessed-variable=VeSR2B_y_MCPB_Temp_P_FD5_SigSts.Value
              OUT_VeSR2B_M_MCPB_TrqAchvd_AEMDPFD5_Value: accessed-variable=VeSR2B_M_MCPB_TrqAchvd_AEMDPFD5.Value
              OUT_VeSR2B_y_MCPB_TrqAchvd_AEMDPFD5_SigSts_Value: accessed-variable=VeSR2B_y_MCPB_TrqAchvd_AEMDPFD5_SigSts.Value
              OUT_VeSR2B_b_MCPB_TrqAchvdAEMDVPFD5_Value: accessed-variable=VeSR2B_b_MCPB_TrqAchvdAEMDVPFD5.Value
              OUT_VeSR2B_y_MCPB_TrqAchvdAEMDVPFD5_SigSts_Value: accessed-variable=VeSR2B_y_MCPB_TrqAchvdAEMDVPFD5_SigSts.Value
              OUT_VeSR2B_M_MCPB_Trq_Achved_P_FD5_Value: accessed-variable=VeSR2B_M_MCPB_Trq_Achved_P_FD5.Value
              OUT_VeSR2B_y_MCPB_Trq_Achved_P_FD5_SigSts_Value: accessed-variable=VeSR2B_y_MCPB_Trq_Achved_P_FD5_SigSts.Value
              OUT_VeSR2B_b_MCPB_Trq_Achved_V_PFD5_Value: accessed-variable=VeSR2B_b_MCPB_Trq_Achved_V_PFD5.Value
              OUT_VeSR2B_y_MCPB_Trq_Achved_V_PFD5_SigSts_Value: accessed-variable=VeSR2B_y_MCPB_Trq_Achved_V_PFD5_SigSts.Value
          read-local-variables:
            access RV_VeSR2N_b_MCPB_PROPULSION_FD5_MM_Faild_write_IRV: accessed-variable=VeSR2N_b_MCPB_PROPULSION_FD5_MM_Faild_write_IRV
            access RV_VeSR2N_b_MCPB_PROPULSION_FD5_NewEvent_write_IRV: accessed-variable=VeSR2N_b_MCPB_PROPULSION_FD5_NewEvent_write_IRV
          written-local-variables:
            access WV_VeSR2N_b_MCPB_PROPULSION_FD5_NewEvent_write_IRV: accessed-variable=VeSR2N_b_MCPB_PROPULSION_FD5_NewEvent_write_IRV
