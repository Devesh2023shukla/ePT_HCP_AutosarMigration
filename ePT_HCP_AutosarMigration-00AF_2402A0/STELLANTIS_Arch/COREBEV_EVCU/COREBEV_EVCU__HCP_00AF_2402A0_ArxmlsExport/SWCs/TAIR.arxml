[part 2 of 2: package /STELLANTIS/EPT/ASWCs]
AUTOSAR XML (schema 4-2-2)
package /STELLANTIS/EPT/ASWCs  (continued)
  application sw component type TAIR  (continued)
    behavior IB_TAIR: data-type-mapping=msADTtoIDTMapping, handle-termination-and-restart=NO-SUPPORT  (continued)
      188 x runnable:
        TAIR_ac_Init
          data-send-points:
            51 x access:
              OUT_VeTAIR_e_RadFab_IO_Cnt_Value: accessed-variable=VeTAIR_e_RadFab_IO_Cnt.Value
              OUT_VeTAIR_e_CompStat_Value: accessed-variable=VeTAIR_e_CompStat.Value
              OUT_VeTAIR_e_CompFltStat_Value: accessed-variable=VeTAIR_e_CompFltStat.Value
              OUT_VeTAIR_e_CompSpdTgt_IO_CntrlSt_Value: accessed-variable=VeTAIR_e_CompSpdTgt_IO_CntrlSt.Value
              OUT_VeTAIR_e_ECM_AC_ClutchSts_Value: accessed-variable=VeTAIR_e_ECM_AC_ClutchSts.Value
              OUT_VeTAIR_e_DVC_HTCV_CalibStrt_Value: accessed-variable=VeTAIR_e_DVC_HTCV_CalibStrt.Value
              OUT_VeTAIR_e_HT_Shtoff_VlvCmd_IO_CntrlSt_Value: accessed-variable=VeTAIR_e_HT_Shtoff_VlvCmd_IO_CntrlSt.Value
              OUT_VeTAIR_e_Ft_SO_VlvCmd_IO_Cnt_Value: accessed-variable=VeTAIR_e_Ft_SO_VlvCmd_IO_Cnt.Value
              OUT_VeTAIR_e_Chlr_SO_VlvCmd_IO_Cnt_Value: accessed-variable=VeTAIR_e_Chlr_SO_VlvCmd_IO_Cnt.Value
              OUT_VeTAIR_e_HT_CabVlvCmd_IO_Cnt_Value: accessed-variable=VeTAIR_e_HT_CabVlvCmd_IO_Cnt.Value
              OUT_VeTAIR_e_FrWyVlv_CalSts_Value: accessed-variable=VeTAIR_e_FrWyVlv_CalSts.Value
              OUT_VeTAIR_e_FrWyVlv_ErrSts_Value: accessed-variable=VeTAIR_e_FrWyVlv_ErrSts.Value
              OUT_VeTAIR_e_CPV_IO_Cnt_Value: accessed-variable=VeTAIR_e_CPV_IO_Cnt.Value
              OUT_VeTAIR_e_EXV_CalStat_Value: accessed-variable=VeTAIR_e_EXV_CalStat.Value
              OUT_VeTAIR_e_EXV_Sts_Value: accessed-variable=VeTAIR_e_EXV_Sts.Value
              OUT_VeTAIR_e_EXV_Err_Value: accessed-variable=VeTAIR_e_EXV_Err.Value
              OUT_VeTAIR_e_LTR_BypsVlv_CalSts_Value: accessed-variable=VeTAIR_e_LTR_BypsVlv_CalSts.Value
              OUT_VeTAIR_e_LTR_BypsVlv_ErrSts_Value: accessed-variable=VeTAIR_e_LTR_BypsVlv_ErrSts.Value
              OUT_VeTAIR_e_HTL_BypsVlv_CalSts_Value: accessed-variable=VeTAIR_e_HTL_BypsVlv_CalSts.Value
              OUT_VeTAIR_e_HTL_BypsVlv_ErrSts_Value: accessed-variable=VeTAIR_e_HTL_BypsVlv_ErrSts.Value
              OUT_VeTAIR_e_EXV_IO_CntrlSt_Value: accessed-variable=VeTAIR_e_EXV_IO_CntrlSt.Value
              OUT_VeTAIR_e_LT_Shtoff_VlvCmd_IO_CntrlSt_Value: accessed-variable=VeTAIR_e_LT_Shtoff_VlvCmd_IO_CntrlSt.Value
              OUT_VeTAIR_e_LTR_BypsVlv_IO_CntrlSt_Value: accessed-variable=VeTAIR_e_LTR_BypsVlv_IO_CntrlSt.Value
              OUT_VeTAIR_e_HTL_BypsVlv_IO_CntrlSt_Value: accessed-variable=VeTAIR_e_HTL_BypsVlv_IO_CntrlSt.Value
              OUT_VeTAIR_e_EEXV_CalStat_Value: accessed-variable=VeTAIR_e_EEXV_CalStat.Value
              OUT_VeTAIR_e_EEXV_Sts_Value: accessed-variable=VeTAIR_e_EEXV_Sts.Value
              OUT_VeTAIR_e_EEXV_Err_Value: accessed-variable=VeTAIR_e_EEXV_Err.Value
              OUT_VeTAIR_e_OEXV_CalStat_Value: accessed-variable=VeTAIR_e_OEXV_CalStat.Value
              OUT_VeTAIR_e_OEXV_Sts_Value: accessed-variable=VeTAIR_e_OEXV_Sts.Value
              OUT_VeTAIR_e_OEXV_Err_Value: accessed-variable=VeTAIR_e_OEXV_Err.Value
              OUT_VeTAIR_e_AGS_ErrFdb_Value: accessed-variable=VeTAIR_e_AGS_ErrFdb.Value
              OUT_VeTAIR_e_AGS_CalibrationSts_Value: accessed-variable=VeTAIR_e_AGS_CalibrationSts.Value
              OUT_VeTAIR_e_AGS2_ErrFdb_Value: accessed-variable=VeTAIR_e_AGS2_ErrFdb.Value
              OUT_VeTAIR_e_AGS2_CalibrationSts_Value: accessed-variable=VeTAIR_e_AGS2_CalibrationSts.Value
              OUT_VeTAIR_e_AGS2_CurrPos_Value: accessed-variable=VeTAIR_e_AGS2_CurrPos.Value
              OUT_VeTAIR_e_AGS_CurrPos_Value: accessed-variable=VeTAIR_e_AGS_CurrPos.Value
              OUT_VeTAIR_e_AGS_IO_CntrlSt_Value: accessed-variable=VeTAIR_e_AGS_IO_CntrlSt.Value
              OUT_VeTAIR_e_AGS_PstnCmnd_Value: accessed-variable=VeTAIR_e_AGS_PstnCmnd.Value
              OUT_VeTAIR_e_AGS2_IO_CntrlSt_Value: accessed-variable=VeTAIR_e_AGS2_IO_CntrlSt.Value
              OUT_VeTAIR_e_AGS2_PstnCmnd_Value: accessed-variable=VeTAIR_e_AGS2_PstnCmnd.Value
              OUT_VeTAIR_e_EEXV_IO_CntrlSt_Value: accessed-variable=VeTAIR_e_EEXV_IO_CntrlSt.Value
              OUT_VeTAIR_e_OEXV_IO_CntrlSt_Value: accessed-variable=VeTAIR_e_OEXV_IO_CntrlSt.Value
              OUT_VeTAIR_e_HTRBV_Err_Ecu_Value: accessed-variable=VeTAIR_e_HTRBV_Err_Ecu.Value
              OUT_VeTAIR_e_HTRBV_Err_Motor_Value: accessed-variable=VeTAIR_e_HTRBV_Err_Motor.Value
              OUT_VeTAIR_e_HTRBV_Err_Voltage_Value: accessed-variable=VeTAIR_e_HTRBV_Err_Voltage.Value
              OUT_VeTAIR_e_HTRBV_ErrLinCom_Value: accessed-variable=VeTAIR_e_HTRBV_ErrLinCom.Value
              OUT_VeTAIR_e_HTRBV_ErrPosition_Value: accessed-variable=VeTAIR_e_HTRBV_ErrPosition.Value
              OUT_VeTAIR_e_HTRBV_SystemState_Value: accessed-variable=VeTAIR_e_HTRBV_SystemState.Value
              OUT_VeTAIR_e_CPV2_ErrSts_Value: accessed-variable=VeTAIR_e_CPV2_ErrSts.Value
              OUT_VeTAIR_e_CPV2_CalSts_Value: accessed-variable=VeTAIR_e_CPV2_CalSts.Value
              OUT_VeTAIR_e_RearDefrostSts_Value: accessed-variable=VeTAIR_e_RearDefrostSts.Value
        TAIR_PwrOn
          data-send-points:
            235 x access:
              OUT_VeTAIR_Pct_ECM_RadFanReq_Value: accessed-variable=VeTAIR_Pct_ECM_RadFanReq.Value
              OUT_VeTAIR_Pct_RadFanSts_Value: accessed-variable=VeTAIR_Pct_RadFanSts.Value
              OUT_VeTAIR_b_RadFanSts_FA_Value: accessed-variable=VeTAIR_b_RadFanSts_FA.Value
              OUT_VeTAIR_e_RadFab_IO_Cnt_Value: accessed-variable=VeTAIR_e_RadFab_IO_Cnt.Value
              OUT_VeTAIR_Pct_DVC_RadFanCmd_Value: accessed-variable=VeTAIR_Pct_DVC_RadFanCmd.Value
              OUT_VeTAIR_b_RadFanHndShk_dsbld_Value: accessed-variable=VeTAIR_b_RadFanHndShk_dsbld.Value
              OUT_VeTAIR_n_CompSpdFdb_Value: accessed-variable=VeTAIR_n_CompSpdFdb.Value
              OUT_VeTAIR_b_CompSpdFdb_FA_Value: accessed-variable=VeTAIR_b_CompSpdFdb_FA.Value
              OUT_VeTAIR_P_AC_CompElecPwr_Value: accessed-variable=VeTAIR_P_AC_CompElecPwr.Value
              OUT_VeTAIR_b_AC_CompElecPwr_FA_Value: accessed-variable=VeTAIR_b_AC_CompElecPwr_FA.Value
              OUT_VeTAIR_p_HghRfrgtPres_Value: accessed-variable=VeTAIR_p_HghRfrgtPres.Value
              OUT_VeTAIR_b_HghRfrgtPres_FA_Value: accessed-variable=VeTAIR_b_HghRfrgtPres_FA.Value
              OUT_VeTAIR_e_CompStat_Value: accessed-variable=VeTAIR_e_CompStat.Value
              OUT_VeTAIR_e_CompFltStat_Value: accessed-variable=VeTAIR_e_CompFltStat.Value
              OUT_VeTAIR_b_CompSpdIncrReq_Value: accessed-variable=VeTAIR_b_CompSpdIncrReq.Value
              OUT_VeTAIR_I_ACCElecCurr_Value: accessed-variable=VeTAIR_I_ACCElecCurr.Value
              OUT_VeTAIR_U_CompHVInp_Value: accessed-variable=VeTAIR_U_CompHVInp.Value
              OUT_VeTAIR_b_CompHVInp_FA_Value: accessed-variable=VeTAIR_b_CompHVInp_FA.Value
              OUT_VeTAIR_b_ACCompReq_Value: accessed-variable=VeTAIR_b_ACCompReq.Value
              OUT_VeTAIR_T_CompBoardTemp_Value: accessed-variable=VeTAIR_T_CompBoardTemp.Value
              OUT_VeTAIR_b_CompBoardTemp_FA_Value: accessed-variable=VeTAIR_b_CompBoardTemp_FA.Value
              OUT_VeTAIR_T_CompIGBTTemp_Value: accessed-variable=VeTAIR_T_CompIGBTTemp.Value
              OUT_VeTAIR_b_CompIGBTTemp_FA_Value: accessed-variable=VeTAIR_b_CompIGBTTemp_FA.Value
              OUT_VeTAIR_T_FtEvapTmp_Value: accessed-variable=VeTAIR_T_FtEvapTmp.Value
              OUT_VeTAIR_b_FtEvapTmp_FA_Value: accessed-variable=VeTAIR_b_FtEvapTmp_FA.Value
              OUT_VeTAIR_T_FtEvapTmp_Tgt_Value: accessed-variable=VeTAIR_T_FtEvapTmp_Tgt.Value
              OUT_VeTAIR_b_FtEvapTmp_TgtFA_Value: accessed-variable=VeTAIR_b_FtEvapTmp_TgtFA.Value
              OUT_VeTAIR_Pct_RrBlwrCmd_Value: accessed-variable=VeTAIR_Pct_RrBlwrCmd.Value
              OUT_VeTAIR_Pct_FrtBlwrCmd_Value: accessed-variable=VeTAIR_Pct_FrtBlwrCmd.Value
              OUT_VeTAIR_b_FrtBlwrCmd_FA_Value: accessed-variable=VeTAIR_b_FrtBlwrCmd_FA.Value
              OUT_VeTAIR_T_VhIntTmp_Value: accessed-variable=VeTAIR_T_VhIntTmp.Value
              OUT_VeTAIR_b_VhIntTmp_FA_Value: accessed-variable=VeTAIR_b_VhIntTmp_FA.Value
              OUT_VeTAIR_T_HtrCoreTmp_Tgt_Value: accessed-variable=VeTAIR_T_HtrCoreTmp_Tgt.Value
              OUT_VeTAIR_e_CompSpdTgt_IO_CntrlSt_Value: accessed-variable=VeTAIR_e_CompSpdTgt_IO_CntrlSt.Value
              OUT_VeTAIR_n_DVC_CompSpdTgt_Value: accessed-variable=VeTAIR_n_DVC_CompSpdTgt.Value
              OUT_VeTAIR_b_WinshldDfrst_Value: accessed-variable=VeTAIR_b_WinshldDfrst.Value
              OUT_VeTAIR_I_HVAC_Cabin_CurrentReq_Value: accessed-variable=VeTAIR_I_HVAC_Cabin_CurrentReq.Value
              OUT_VeTAIR_b_HVAC_Cabin_CurrentReqFA_Value: accessed-variable=VeTAIR_b_HVAC_Cabin_CurrentReqFA.Value
              OUT_VeTAIR_I_HVAC_ECVD_CurrentAct_Value: accessed-variable=VeTAIR_I_HVAC_ECVD_CurrentAct.Value
              OUT_VeTAIR_b_HVAC_ECVD_CurrentActFA_Value: accessed-variable=VeTAIR_b_HVAC_ECVD_CurrentActFA.Value
              OUT_VeTAIR_e_ECM_AC_ClutchSts_Value: accessed-variable=VeTAIR_e_ECM_AC_ClutchSts.Value
              OUT_VeTAIR_b_ECM_AC_ClutchStsFA_Value: accessed-variable=VeTAIR_b_ECM_AC_ClutchStsFA.Value
              OUT_VeTAIR_b_HghRfrgtPresFailSts_Value: accessed-variable=VeTAIR_b_HghRfrgtPresFailSts.Value
              OUT_VeTAIR_U_HT_CabVlvSts_Value: accessed-variable=VeTAIR_U_HT_CabVlvSts.Value
              OUT_VeTAIR_b_HT_CabVlvSts_FA_Value: accessed-variable=VeTAIR_b_HT_CabVlvSts_FA.Value
              OUT_VeTAIR_e_DVC_HTCV_CalibStrt_Value: accessed-variable=VeTAIR_e_DVC_HTCV_CalibStrt.Value
              OUT_VeTAIR_e_HT_Shtoff_VlvCmd_IO_CntrlSt_Value: accessed-variable=VeTAIR_e_HT_Shtoff_VlvCmd_IO_CntrlSt.Value
              OUT_VeTAIR_b_HT_Shtoff_VlvCmd_Value: accessed-variable=VeTAIR_b_HT_Shtoff_VlvCmd.Value
              OUT_VeTAIR_e_Ft_SO_VlvCmd_IO_Cnt_Value: accessed-variable=VeTAIR_e_Ft_SO_VlvCmd_IO_Cnt.Value
              OUT_VeTAIR_b_Ft_SO_VlvCmd_Value: accessed-variable=VeTAIR_b_Ft_SO_VlvCmd.Value
              OUT_VeTAIR_e_Chlr_SO_VlvCmd_IO_Cnt_Value: accessed-variable=VeTAIR_e_Chlr_SO_VlvCmd_IO_Cnt.Value
              OUT_VeTAIR_b_Chlr_SO_VlvCmd_Value: accessed-variable=VeTAIR_b_Chlr_SO_VlvCmd.Value
              OUT_VeTAIR_e_HT_CabVlvCmd_IO_Cnt_Value: accessed-variable=VeTAIR_e_HT_CabVlvCmd_IO_Cnt.Value
              OUT_VeTAIR_Pct_HT_CabVlvCmd_Value: accessed-variable=VeTAIR_Pct_HT_CabVlvCmd.Value
              OUT_VeTAIR_Pct_FrWyVlv_PstnAct_Value: accessed-variable=VeTAIR_Pct_FrWyVlv_PstnAct.Value
              OUT_VeTAIR_b_FrWyVlv_PstnAct_FA_Value: accessed-variable=VeTAIR_b_FrWyVlv_PstnAct_FA.Value
              OUT_VeTAIR_e_FrWyVlv_CalSts_Value: accessed-variable=VeTAIR_e_FrWyVlv_CalSts.Value
              OUT_VeTAIR_b_FrWyVlv_RsErr_Value: accessed-variable=VeTAIR_b_FrWyVlv_RsErr.Value
              OUT_VeTAIR_e_FrWyVlv_ErrSts_Value: accessed-variable=VeTAIR_e_FrWyVlv_ErrSts.Value
              OUT_VeTAIR_U_FrWyVlv_MtrVltg_Value: accessed-variable=VeTAIR_U_FrWyVlv_MtrVltg.Value
              OUT_VeTAIR_e_CPV_IO_Cnt_Value: accessed-variable=VeTAIR_e_CPV_IO_Cnt.Value
              OUT_VeTAIR_Pct_CPV_Cmd_Value: accessed-variable=VeTAIR_Pct_CPV_Cmd.Value
              OUT_VeTAIR_Pct_EXV_PosAct_Value: accessed-variable=VeTAIR_Pct_EXV_PosAct.Value
              OUT_VeTAIR_b_EXV_PosAct_FA_Value: accessed-variable=VeTAIR_b_EXV_PosAct_FA.Value
              OUT_VeTAIR_e_EXV_CalStat_Value: accessed-variable=VeTAIR_e_EXV_CalStat.Value
              OUT_VeTAIR_b_EXV_CalRq_Value: accessed-variable=VeTAIR_b_EXV_CalRq.Value
              OUT_VeTAIR_b_EXV_RspErr_Value: accessed-variable=VeTAIR_b_EXV_RspErr.Value
              OUT_VeTAIR_e_EXV_Sts_Value: accessed-variable=VeTAIR_e_EXV_Sts.Value
              OUT_VeTAIR_e_EXV_Err_Value: accessed-variable=VeTAIR_e_EXV_Err.Value
              OUT_VeTAIR_U_EXV_SupplyVolt_Value: accessed-variable=VeTAIR_U_EXV_SupplyVolt.Value
              OUT_VeTAIR_p_EXV_RefPress_Value: accessed-variable=VeTAIR_p_EXV_RefPress.Value
              OUT_VeTAIR_b_EXV_RefPress_FA_Value: accessed-variable=VeTAIR_b_EXV_RefPress_FA.Value
              OUT_VeTAIR_T_EXV_BoardTemp_Value: accessed-variable=VeTAIR_T_EXV_BoardTemp.Value
              OUT_VeTAIR_T_EXV_RefTemp_Value: accessed-variable=VeTAIR_T_EXV_RefTemp.Value
              OUT_VeTAIR_b_EXV_RefTemp_FA_Value: accessed-variable=VeTAIR_b_EXV_RefTemp_FA.Value
              OUT_VeTAIR_b_FrWyVlv_OvrVltg_Value: accessed-variable=VeTAIR_b_FrWyVlv_OvrVltg.Value
              OUT_VeTAIR_b_FrWyVlv_UndrVltg_Value: accessed-variable=VeTAIR_b_FrWyVlv_UndrVltg.Value
              OUT_VeTAIR_b_FrWyVlv_ThrmlWrng_Value: accessed-variable=VeTAIR_b_FrWyVlv_ThrmlWrng.Value
              OUT_VeTAIR_b_FrWyVlv_OpnLd_Value: accessed-variable=VeTAIR_b_FrWyVlv_OpnLd.Value
              OUT_VeTAIR_b_FrWyVlv_OvrCrnt_Value: accessed-variable=VeTAIR_b_FrWyVlv_OvrCrnt.Value
              OUT_VeTAIR_b_FrWyVlv_MechBrk_Value: accessed-variable=VeTAIR_b_FrWyVlv_MechBrk.Value
              OUT_VeTAIR_b_FrWyVlv_BlckPnt_Value: accessed-variable=VeTAIR_b_FrWyVlv_BlckPnt.Value
              OUT_VeTAIR_b_FrWyVlv_Err_SNA_Value: accessed-variable=VeTAIR_b_FrWyVlv_Err_SNA.Value
              OUT_VeTAIR_Pct_LTR_BypsVlv_ActlPstn_Value: accessed-variable=VeTAIR_Pct_LTR_BypsVlv_ActlPstn.Value
              OUT_VeTAIR_b_LTR_BypsVlv_ActlPstn_FA_Value: accessed-variable=VeTAIR_b_LTR_BypsVlv_ActlPstn_FA.Value
              OUT_VeTAIR_e_LTR_BypsVlv_CalSts_Value: accessed-variable=VeTAIR_e_LTR_BypsVlv_CalSts.Value
              OUT_VeTAIR_b_LTR_BypsVlv_CalSts_FA_Value: accessed-variable=VeTAIR_b_LTR_BypsVlv_CalSts_FA.Value
              OUT_VeTAIR_b_LTR_BypsVlv_RsErr_Value: accessed-variable=VeTAIR_b_LTR_BypsVlv_RsErr.Value
              OUT_VeTAIR_e_LTR_BypsVlv_ErrSts_Value: accessed-variable=VeTAIR_e_LTR_BypsVlv_ErrSts.Value
              OUT_VeTAIR_b_LTR_BypsVlv_ErrSts_FA_Value: accessed-variable=VeTAIR_b_LTR_BypsVlv_ErrSts_FA.Value
              OUT_VeTAIR_U_LTR_BypsVlv_MtrVltg_Value: accessed-variable=VeTAIR_U_LTR_BypsVlv_MtrVltg.Value
              OUT_VeTAIR_b_LTR_BypsVlv_MtrVltg_FA_Value: accessed-variable=VeTAIR_b_LTR_BypsVlv_MtrVltg_FA.Value
              OUT_VeTAIR_Pct_HTL_BypsVlv_ActlPstn_Value: accessed-variable=VeTAIR_Pct_HTL_BypsVlv_ActlPstn.Value
              OUT_VeTAIR_b_HTL_BypsVlv_ActlPstn_FA_Value: accessed-variable=VeTAIR_b_HTL_BypsVlv_ActlPstn_FA.Value
              OUT_VeTAIR_e_HTL_BypsVlv_CalSts_Value: accessed-variable=VeTAIR_e_HTL_BypsVlv_CalSts.Value
              OUT_VeTAIR_b_HTL_BypsVlv_CalSts_FA_Value: accessed-variable=VeTAIR_b_HTL_BypsVlv_CalSts_FA.Value
              OUT_VeTAIR_b_HTL_BypsVlv_RsErr_Value: accessed-variable=VeTAIR_b_HTL_BypsVlv_RsErr.Value
              OUT_VeTAIR_e_HTL_BypsVlv_ErrSts_Value: accessed-variable=VeTAIR_e_HTL_BypsVlv_ErrSts.Value
              OUT_VeTAIR_b_HTL_BypsVlv_ErrSts_FA_Value: accessed-variable=VeTAIR_b_HTL_BypsVlv_ErrSts_FA.Value
              OUT_VeTAIR_U_HTL_BypsVlv_MtrVltg_Value: accessed-variable=VeTAIR_U_HTL_BypsVlv_MtrVltg.Value
              OUT_VeTAIR_b_HTL_BypsVlv_MtrVltg_FA_Value: accessed-variable=VeTAIR_b_HTL_BypsVlv_MtrVltg_FA.Value
              OUT_VeTAIR_e_EXV_IO_CntrlSt_Value: accessed-variable=VeTAIR_e_EXV_IO_CntrlSt.Value
              OUT_VeTAIR_Pct_EXV_Cmd_Value: accessed-variable=VeTAIR_Pct_EXV_Cmd.Value
              OUT_VeTAIR_b_DVC_EXV_Calibration_Start_Value: accessed-variable=VeTAIR_b_DVC_EXV_Calibration_Start.Value
              OUT_VeTAIR_e_LT_Shtoff_VlvCmd_IO_CntrlSt_Value: accessed-variable=VeTAIR_e_LT_Shtoff_VlvCmd_IO_CntrlSt.Value
              OUT_VeTAIR_b_LT_Shtoff_VlvCmd_Value: accessed-variable=VeTAIR_b_LT_Shtoff_VlvCmd.Value
              OUT_VeTAIR_Pct_LTR_BypsVlv_Cmd_Value: accessed-variable=VeTAIR_Pct_LTR_BypsVlv_Cmd.Value
              OUT_VeTAIR_e_LTR_BypsVlv_IO_CntrlSt_Value: accessed-variable=VeTAIR_e_LTR_BypsVlv_IO_CntrlSt.Value
              OUT_VeTAIR_Pct_HTL_BypsVlv_Cmd_Value: accessed-variable=VeTAIR_Pct_HTL_BypsVlv_Cmd.Value
              OUT_VeTAIR_e_HTL_BypsVlv_IO_CntrlSt_Value: accessed-variable=VeTAIR_e_HTL_BypsVlv_IO_CntrlSt.Value
              OUT_VeTAIR_b_LTR_BypsVlv_OvrVltg_Value: accessed-variable=VeTAIR_b_LTR_BypsVlv_OvrVltg.Value
              OUT_VeTAIR_b_LTR_BypsVlv_UndrVltg_Value: accessed-variable=VeTAIR_b_LTR_BypsVlv_UndrVltg.Value
              OUT_VeTAIR_b_LTR_BypsVlv_ThrmlWrng_Value: accessed-variable=VeTAIR_b_LTR_BypsVlv_ThrmlWrng.Value
              OUT_VeTAIR_b_LTR_BypsVlv_OpnLd_Value: accessed-variable=VeTAIR_b_LTR_BypsVlv_OpnLd.Value
              OUT_VeTAIR_b_LTR_BypsVlv_OvrCrnt_Value: accessed-variable=VeTAIR_b_LTR_BypsVlv_OvrCrnt.Value
              OUT_VeTAIR_b_LTR_BypsVlv_MechBrk_Value: accessed-variable=VeTAIR_b_LTR_BypsVlv_MechBrk.Value
              OUT_VeTAIR_b_LTR_BypsVlv_BlckPnt_Value: accessed-variable=VeTAIR_b_LTR_BypsVlv_BlckPnt.Value
              OUT_VeTAIR_b_LTR_BypsVlv_Err_SNA_Value: accessed-variable=VeTAIR_b_LTR_BypsVlv_Err_SNA.Value
              OUT_VeTAIR_b_HTL_BypsVlv_OvrVltg_Value: accessed-variable=VeTAIR_b_HTL_BypsVlv_OvrVltg.Value
              OUT_VeTAIR_b_HTL_BypsVlv_UndrVltg_Value: accessed-variable=VeTAIR_b_HTL_BypsVlv_UndrVltg.Value
              OUT_VeTAIR_b_HTL_BypsVlv_ThrmlWrng_Value: accessed-variable=VeTAIR_b_HTL_BypsVlv_ThrmlWrng.Value
              OUT_VeTAIR_b_HTL_BypsVlv_OpnLd_Value: accessed-variable=VeTAIR_b_HTL_BypsVlv_OpnLd.Value
              OUT_VeTAIR_b_HTL_BypsVlv_OvrCrnt_Value: accessed-variable=VeTAIR_b_HTL_BypsVlv_OvrCrnt.Value
              OUT_VeTAIR_b_HTL_BypsVlv_MechBrk_Value: accessed-variable=VeTAIR_b_HTL_BypsVlv_MechBrk.Value
              OUT_VeTAIR_b_HTL_BypsVlv_BlckPnt_Value: accessed-variable=VeTAIR_b_HTL_BypsVlv_BlckPnt.Value
              OUT_VeTAIR_b_HTL_BypsVlv_Err_SNA_Value: accessed-variable=VeTAIR_b_HTL_BypsVlv_Err_SNA.Value
              OUT_VeTAIR_Pct_EEXV_PosAct_Value: accessed-variable=VeTAIR_Pct_EEXV_PosAct.Value
              OUT_VeTAIR_b_EEXV_PosAct_FA_Value: accessed-variable=VeTAIR_b_EEXV_PosAct_FA.Value
              OUT_VeTAIR_e_EEXV_CalStat_Value: accessed-variable=VeTAIR_e_EEXV_CalStat.Value
              OUT_VeTAIR_b_EEXV_CalRq_Value: accessed-variable=VeTAIR_b_EEXV_CalRq.Value
              OUT_VeTAIR_b_EEXV_RspErr_Value: accessed-variable=VeTAIR_b_EEXV_RspErr.Value
              OUT_VeTAIR_e_EEXV_Sts_Value: accessed-variable=VeTAIR_e_EEXV_Sts.Value
              OUT_VeTAIR_e_EEXV_Err_Value: accessed-variable=VeTAIR_e_EEXV_Err.Value
              OUT_VeTAIR_U_EEXV_SupplyVolt_Value: accessed-variable=VeTAIR_U_EEXV_SupplyVolt.Value
              OUT_VeTAIR_p_EEXV_RefPress_Value: accessed-variable=VeTAIR_p_EEXV_RefPress.Value
              OUT_VeTAIR_b_EEXV_RefPress_FA_Value: accessed-variable=VeTAIR_b_EEXV_RefPress_FA.Value
              OUT_VeTAIR_T_EEXV_BoardTemp_Value: accessed-variable=VeTAIR_T_EEXV_BoardTemp.Value
              OUT_VeTAIR_T_EEXV_RefTemp_Value: accessed-variable=VeTAIR_T_EEXV_RefTemp.Value
              OUT_VeTAIR_b_EEXV_RefTemp_FA_Value: accessed-variable=VeTAIR_b_EEXV_RefTemp_FA.Value
              OUT_VeTAIR_Pct_OEXV_PosAct_Value: accessed-variable=VeTAIR_Pct_OEXV_PosAct.Value
              OUT_VeTAIR_b_OEXV_PosAct_FA_Value: accessed-variable=VeTAIR_b_OEXV_PosAct_FA.Value
              OUT_VeTAIR_e_OEXV_CalStat_Value: accessed-variable=VeTAIR_e_OEXV_CalStat.Value
              OUT_VeTAIR_b_OEXV_CalRq_Value: accessed-variable=VeTAIR_b_OEXV_CalRq.Value
              OUT_VeTAIR_b_OEXV_RspErr_Value: accessed-variable=VeTAIR_b_OEXV_RspErr.Value
              OUT_VeTAIR_e_OEXV_Sts_Value: accessed-variable=VeTAIR_e_OEXV_Sts.Value
              OUT_VeTAIR_e_OEXV_Err_Value: accessed-variable=VeTAIR_e_OEXV_Err.Value
              OUT_VeTAIR_U_OEXV_SupplyVolt_Value: accessed-variable=VeTAIR_U_OEXV_SupplyVolt.Value
              OUT_VeTAIR_p_OEXV_OutPressSens_Value: accessed-variable=VeTAIR_p_OEXV_OutPressSens.Value
              OUT_VeTAIR_b_OEXV_OutPressSens_FA_Value: accessed-variable=VeTAIR_b_OEXV_OutPressSens_FA.Value
              OUT_VeTAIR_T_OEXV_BoardTemp_Value: accessed-variable=VeTAIR_T_OEXV_BoardTemp.Value
              OUT_VeTAIR_T_OEXV_OutTempSens_Value: accessed-variable=VeTAIR_T_OEXV_OutTempSens.Value
              OUT_VeTAIR_b_OEXV_OutTempSens_FA_Value: accessed-variable=VeTAIR_b_OEXV_OutTempSens_FA.Value
              OUT_VeTAIR_T_OEXV_InTempSens_Value: accessed-variable=VeTAIR_T_OEXV_InTempSens.Value
              OUT_VeTAIR_b_OEXV_InTempSens_FA_Value: accessed-variable=VeTAIR_b_OEXV_InTempSens_FA.Value
              OUT_VeTAIR_T_CEXV_OutTempSens_Value: accessed-variable=VeTAIR_T_CEXV_OutTempSens.Value
              OUT_VeTAIR_b_CEXV_OutTempSens_FA_Value: accessed-variable=VeTAIR_b_CEXV_OutTempSens_FA.Value
              OUT_VeTAIR_p_CEXV_OutPressSens_Value: accessed-variable=VeTAIR_p_CEXV_OutPressSens.Value
              OUT_VeTAIR_b_CEXV_OutPressSens_FA_Value: accessed-variable=VeTAIR_b_CEXV_OutPressSens_FA.Value
              OUT_VeTAIR_b_AGS_BoostSts_Value: accessed-variable=VeTAIR_b_AGS_BoostSts.Value
              OUT_VeTAIR_b_AGS_CalibrationActv_Value: accessed-variable=VeTAIR_b_AGS_CalibrationActv.Value
              OUT_VeTAIR_b_AGS_ErrMechBreak_Value: accessed-variable=VeTAIR_b_AGS_ErrMechBreak.Value
              OUT_VeTAIR_b_AGS_ErrMechStuck_Value: accessed-variable=VeTAIR_b_AGS_ErrMechStuck.Value
              OUT_VeTAIR_b_AGS_ErrOverTemp_Value: accessed-variable=VeTAIR_b_AGS_ErrOverTemp.Value
              OUT_VeTAIR_b_AGS_ErrOverVolt_Value: accessed-variable=VeTAIR_b_AGS_ErrOverVolt.Value
              OUT_VeTAIR_b_AGS_ErrFdbFA_Value: accessed-variable=VeTAIR_b_AGS_ErrFdbFA.Value
              OUT_VeTAIR_e_AGS_ErrFdb_Value: accessed-variable=VeTAIR_e_AGS_ErrFdb.Value
              OUT_VeTAIR_b_AGS_CurrPosFA_Value: accessed-variable=VeTAIR_b_AGS_CurrPosFA.Value
              OUT_VeTAIR_Pct_AGS_CurrPos_Value: accessed-variable=VeTAIR_Pct_AGS_CurrPos.Value
              OUT_VeTAIR_b_AGS_ResErr_Value: accessed-variable=VeTAIR_b_AGS_ResErr.Value
              OUT_VeTAIR_b_AGS_ErrUnderVolt_Value: accessed-variable=VeTAIR_b_AGS_ErrUnderVolt.Value
              OUT_VeTAIR_e_AGS_CalibrationSts_Value: accessed-variable=VeTAIR_e_AGS_CalibrationSts.Value
              OUT_VeTAIR_b_AGS2_BoostSts_Value: accessed-variable=VeTAIR_b_AGS2_BoostSts.Value
              OUT_VeTAIR_b_AGS2_CalibrationActv_Value: accessed-variable=VeTAIR_b_AGS2_CalibrationActv.Value
              OUT_VeTAIR_b_AGS2_ErrMechBreak_Value: accessed-variable=VeTAIR_b_AGS2_ErrMechBreak.Value
              OUT_VeTAIR_b_AGS2_ErrMechStuck_Value: accessed-variable=VeTAIR_b_AGS2_ErrMechStuck.Value
              OUT_VeTAIR_b_AGS2_ErrOverTemp_Value: accessed-variable=VeTAIR_b_AGS2_ErrOverTemp.Value
              OUT_VeTAIR_b_AGS2_ErrOverVolt_Value: accessed-variable=VeTAIR_b_AGS2_ErrOverVolt.Value
              OUT_VeTAIR_b_AGS2_ErrFdbFA_Value: accessed-variable=VeTAIR_b_AGS2_ErrFdbFA.Value
              OUT_VeTAIR_e_AGS2_ErrFdb_Value: accessed-variable=VeTAIR_e_AGS2_ErrFdb.Value
              OUT_VeTAIR_b_AGS2_CurrPosFA_Value: accessed-variable=VeTAIR_b_AGS2_CurrPosFA.Value
              OUT_VeTAIR_Pct_AGS2_CurrPos_Value: accessed-variable=VeTAIR_Pct_AGS2_CurrPos.Value
              OUT_VeTAIR_b_AGS2_ResErr_Value: accessed-variable=VeTAIR_b_AGS2_ResErr.Value
              OUT_VeTAIR_b_AGS2_ErrUnderVolt_Value: accessed-variable=VeTAIR_b_AGS2_ErrUnderVolt.Value
              OUT_VeTAIR_e_AGS2_CalibrationSts_Value: accessed-variable=VeTAIR_e_AGS2_CalibrationSts.Value
              OUT_VeTAIR_Pct_ECM_AirflowRequest_Value: accessed-variable=VeTAIR_Pct_ECM_AirflowRequest.Value
              OUT_VeTAIR_b_ECM_AirflowRequestFA_Value: accessed-variable=VeTAIR_b_ECM_AirflowRequestFA.Value
              OUT_VeTAIR_e_AGS2_CurrPos_Value: accessed-variable=VeTAIR_e_AGS2_CurrPos.Value
              OUT_VeTAIR_e_AGS_CurrPos_Value: accessed-variable=VeTAIR_e_AGS_CurrPos.Value
              OUT_VeTAIR_e_AGS_IO_CntrlSt_Value: accessed-variable=VeTAIR_e_AGS_IO_CntrlSt.Value
              OUT_VeTAIR_e_AGS_PstnCmnd_Value: accessed-variable=VeTAIR_e_AGS_PstnCmnd.Value
              OUT_VeTAIR_b_DVC_AGS_Calibration_Start_Value: accessed-variable=VeTAIR_b_DVC_AGS_Calibration_Start.Value
              OUT_VeTAIR_e_AGS2_IO_CntrlSt_Value: accessed-variable=VeTAIR_e_AGS2_IO_CntrlSt.Value
              OUT_VeTAIR_e_AGS2_PstnCmnd_Value: accessed-variable=VeTAIR_e_AGS2_PstnCmnd.Value
              OUT_VeTAIR_b_DVC_AGS2_Calibration_Start_Value: accessed-variable=VeTAIR_b_DVC_AGS2_Calibration_Start.Value
              OUT_VeTAIR_T_OEXV_RefTemp_Value: accessed-variable=VeTAIR_T_OEXV_RefTemp.Value
              OUT_VeTAIR_b_OEXV_RefTemp_FA_Value: accessed-variable=VeTAIR_b_OEXV_RefTemp_FA.Value
              OUT_VeTAIR_p_OEXV_RefPress_Value: accessed-variable=VeTAIR_p_OEXV_RefPress.Value
              OUT_VeTAIR_b_OEXV_RefPress_FA_Value: accessed-variable=VeTAIR_b_OEXV_RefPress_FA.Value
              OUT_VeTAIR_e_EEXV_IO_CntrlSt_Value: accessed-variable=VeTAIR_e_EEXV_IO_CntrlSt.Value
              OUT_VeTAIR_Pct_EEXV_Cmd_Value: accessed-variable=VeTAIR_Pct_EEXV_Cmd.Value
              OUT_VeTAIR_b_DVC_EEXV_Calibration_Start_Value: accessed-variable=VeTAIR_b_DVC_EEXV_Calibration_Start.Value
              OUT_VeTAIR_e_OEXV_IO_CntrlSt_Value: accessed-variable=VeTAIR_e_OEXV_IO_CntrlSt.Value
              OUT_VeTAIR_Pct_OEXV_Cmd_Value: accessed-variable=VeTAIR_Pct_OEXV_Cmd.Value
              OUT_VeTAIR_b_DVC_OEXV_Calibration_Start_Value: accessed-variable=VeTAIR_b_DVC_OEXV_Calibration_Start.Value
              OUT_VeTAIR_Pct_HTRBV_ActuatorPosTrgt_Value: accessed-variable=VeTAIR_Pct_HTRBV_ActuatorPosTrgt.Value
              OUT_VeTAIR_T_HTRBV_EcuTemp_Value: accessed-variable=VeTAIR_T_HTRBV_EcuTemp.Value
              OUT_VeTAIR_U_HTRBV_EcuVoltage_Value: accessed-variable=VeTAIR_U_HTRBV_EcuVoltage.Value
              OUT_VeTAIR_b_HTRBV_ActuatorPosAct_FA_Value: accessed-variable=VeTAIR_b_HTRBV_ActuatorPosAct_FA.Value
              OUT_VeTAIR_b_HTRBV_ResponseError_Value: accessed-variable=VeTAIR_b_HTRBV_ResponseError.Value
              OUT_VeTAIR_Pct_HTRBV_ActuatorPosAct_Value: accessed-variable=VeTAIR_Pct_HTRBV_ActuatorPosAct.Value
              OUT_VeTAIR_b_HTRBV_SelfCalReq_Value: accessed-variable=VeTAIR_b_HTRBV_SelfCalReq.Value
              OUT_VeTAIR_e_HTRBV_Err_Ecu_Value: accessed-variable=VeTAIR_e_HTRBV_Err_Ecu.Value
              OUT_VeTAIR_e_HTRBV_Err_Motor_Value: accessed-variable=VeTAIR_e_HTRBV_Err_Motor.Value
              OUT_VeTAIR_e_HTRBV_Err_Voltage_Value: accessed-variable=VeTAIR_e_HTRBV_Err_Voltage.Value
              OUT_VeTAIR_e_HTRBV_ErrLinCom_Value: accessed-variable=VeTAIR_e_HTRBV_ErrLinCom.Value
              OUT_VeTAIR_e_HTRBV_ErrPosition_Value: accessed-variable=VeTAIR_e_HTRBV_ErrPosition.Value
              OUT_VeTAIR_e_HTRBV_SystemState_Value: accessed-variable=VeTAIR_e_HTRBV_SystemState.Value
              OUT_VeTAIR_Pct_CPV2_PstnAct_Value: accessed-variable=VeTAIR_Pct_CPV2_PstnAct.Value
              OUT_VeTAIR_b_CPV2_PstnAct_FA_Value: accessed-variable=VeTAIR_b_CPV2_PstnAct_FA.Value
              OUT_VeTAIR_b_CPV2_OvrVltg_Value: accessed-variable=VeTAIR_b_CPV2_OvrVltg.Value
              OUT_VeTAIR_b_CPV2_UndrVltg_Value: accessed-variable=VeTAIR_b_CPV2_UndrVltg.Value
              OUT_VeTAIR_b_CPV2_ThrmlWrng_Value: accessed-variable=VeTAIR_b_CPV2_ThrmlWrng.Value
              OUT_VeTAIR_b_CPV2_OpnLd_Value: accessed-variable=VeTAIR_b_CPV2_OpnLd.Value
              OUT_VeTAIR_b_CPV2_OvrCrnt_Value: accessed-variable=VeTAIR_b_CPV2_OvrCrnt.Value
              OUT_VeTAIR_b_CPV2_MechBrk_Value: accessed-variable=VeTAIR_b_CPV2_MechBrk.Value
              OUT_VeTAIR_b_CPV2_BlckPnt_Value: accessed-variable=VeTAIR_b_CPV2_BlckPnt.Value
              OUT_VeTAIR_b_CPV2_Err_SNA_Value: accessed-variable=VeTAIR_b_CPV2_Err_SNA.Value
              OUT_VeTAIR_U_CPV2_MtrVltg_Value: accessed-variable=VeTAIR_U_CPV2_MtrVltg.Value
              OUT_VeTAIR_e_CPV2_ErrSts_Value: accessed-variable=VeTAIR_e_CPV2_ErrSts.Value
              OUT_VeTAIR_b_CPV2_RsErr_Value: accessed-variable=VeTAIR_b_CPV2_RsErr.Value
              OUT_VeTAIR_e_CPV2_CalSts_Value: accessed-variable=VeTAIR_e_CPV2_CalSts.Value
              OUT_VeTAIR_e_RearDefrostSts_Value: accessed-variable=VeTAIR_e_RearDefrostSts.Value
              OUT_VeTAIR_b_RearDefrostStsFA_Value: accessed-variable=VeTAIR_b_RearDefrostStsFA.Value
              OUT_VeTAIR_y_RearCabinFanSts_Value: accessed-variable=VeTAIR_y_RearCabinFanSts.Value
              OUT_VeTAIR_b_RearCabinFanStsFA_Value: accessed-variable=VeTAIR_b_RearCabinFanStsFA.Value
          written-local-variables:
            200 x access:
              WV_VeTAIR_I_ACCElecCurr_write_IRV: accessed-variable=VeTAIR_I_ACCElecCurr_write_IRV
              WV_VeTAIR_b_ACCompElec_PwrFA_write_IRV: accessed-variable=VeTAIR_b_ACCompElec_PwrFA_write_IRV
              WV_VeTAIR_P_ACCompElec_Pwr_write_IRV: accessed-variable=VeTAIR_P_ACCompElec_Pwr_write_IRV
              WV_VeTAIR_b_ACCompReq_write_IRV: accessed-variable=VeTAIR_b_ACCompReq_write_IRV
              WV_VeTAIR_b_AGS2_BoostSts_write_IRV: accessed-variable=VeTAIR_b_AGS2_BoostSts_write_IRV
              WV_VeTAIF_b_DVC_AGS2_Calibration_Start_write_IRV: accessed-variable=VeTAIF_b_DVC_AGS2_Calibration_Start_write_IRV
              WV_VeTAIR_b_AGS2_CalibrationActv_write_IRV: accessed-variable=VeTAIR_b_AGS2_CalibrationActv_write_IRV
              WV_VeTAIR_e_AGS2_CalibrationSts_write_IRV: accessed-variable=VeTAIR_e_AGS2_CalibrationSts_write_IRV
              WV_VeTAIR_b_AGS2_CurrPosFA_write_IRV: accessed-variable=VeTAIR_b_AGS2_CurrPosFA_write_IRV
              WV_VeTAIR_Pct_AGS2_CurrPos_CAN_write_IRV: accessed-variable=VeTAIR_Pct_AGS2_CurrPos_CAN_write_IRV
              WV_VeTAIR_b_AGS2_ErrFdbFA_write_IRV: accessed-variable=VeTAIR_b_AGS2_ErrFdbFA_write_IRV
              WV_VeTAIR_e_AGS2_ErrFdb_write_IRV: accessed-variable=VeTAIR_e_AGS2_ErrFdb_write_IRV
              WV_VeTAIR_b_AGS2_ErrMechBreak_write_IRV: accessed-variable=VeTAIR_b_AGS2_ErrMechBreak_write_IRV
              WV_VeTAIR_b_AGS2_ErrMechStuck_write_IRV: accessed-variable=VeTAIR_b_AGS2_ErrMechStuck_write_IRV
              WV_VeTAIR_b_AGS2_ErrOverTemp_write_IRV: accessed-variable=VeTAIR_b_AGS2_ErrOverTemp_write_IRV
              WV_VeTAIR_b_AGS2_ErrOverVolt_write_IRV: accessed-variable=VeTAIR_b_AGS2_ErrOverVolt_write_IRV
              WV_VeTAIR_b_AGS2_ErrUnderVolt_write_IRV: accessed-variable=VeTAIR_b_AGS2_ErrUnderVolt_write_IRV
              WV_VeTAIF_e_AGS2_IO_CntrlSt_write_IRV: accessed-variable=VeTAIF_e_AGS2_IO_CntrlSt_write_IRV
              WV_VeTAIF_e_AGS2_PstnCmnd_write_IRV: accessed-variable=VeTAIF_e_AGS2_PstnCmnd_write_IRV
              WV_VeTAIR_b_AGS2_ResErr_write_IRV: accessed-variable=VeTAIR_b_AGS2_ResErr_write_IRV
              WV_VeTAIR_b_AGS_BoostSts_write_IRV: accessed-variable=VeTAIR_b_AGS_BoostSts_write_IRV
              WV_VeTAIF_b_DVC_AGS1_Calibration_Start_write_IRV: accessed-variable=VeTAIF_b_DVC_AGS1_Calibration_Start_write_IRV
              WV_VeTAIR_b_AGS_CalibrationActv_write_IRV: accessed-variable=VeTAIR_b_AGS_CalibrationActv_write_IRV
              WV_VeTAIR_e_AGS_CalibrationSts_write_IRV: accessed-variable=VeTAIR_e_AGS_CalibrationSts_write_IRV
              WV_VeTAIR_b_AGS_CurrPosFA_write_IRV: accessed-variable=VeTAIR_b_AGS_CurrPosFA_write_IRV
              WV_VeTAIR_Pct_AGS_CurrPos_CAN_write_IRV: accessed-variable=VeTAIR_Pct_AGS_CurrPos_CAN_write_IRV
              WV_VeTAIR_b_AGS_ErrFdbFA_write_IRV: accessed-variable=VeTAIR_b_AGS_ErrFdbFA_write_IRV
              WV_VeTAIR_e_AGS_ErrFdb_write_IRV: accessed-variable=VeTAIR_e_AGS_ErrFdb_write_IRV
              WV_VeTAIR_b_AGS_ErrMechBreak_write_IRV: accessed-variable=VeTAIR_b_AGS_ErrMechBreak_write_IRV
              WV_VeTAIR_b_AGS_ErrMechStuck_write_IRV: accessed-variable=VeTAIR_b_AGS_ErrMechStuck_write_IRV
              WV_VeTAIR_b_AGS_ErrOverTemp_write_IRV: accessed-variable=VeTAIR_b_AGS_ErrOverTemp_write_IRV
              WV_VeTAIR_b_AGS_ErrOverVolt_write_IRV: accessed-variable=VeTAIR_b_AGS_ErrOverVolt_write_IRV
              WV_VeTAIR_b_AGS_ErrUnderVolt_write_IRV: accessed-variable=VeTAIR_b_AGS_ErrUnderVolt_write_IRV
              WV_VeTAIF_e_AGS_IO_CntrlSt_write_IRV: accessed-variable=VeTAIF_e_AGS_IO_CntrlSt_write_IRV
              WV_VeTAIF_e_AGS_PstnCmnd_write_IRV: accessed-variable=VeTAIF_e_AGS_PstnCmnd_write_IRV
              WV_VeTAIR_b_AGS_ResErr_write_IRV: accessed-variable=VeTAIR_b_AGS_ResErr_write_IRV
              WV_VeTAIR_e_CPV2_CalSts_write_IRV: accessed-variable=VeTAIR_e_CPV2_CalSts_write_IRV
              WV_VeTAIR_b_CPV2_ErrMsgsFA_write_IRV: accessed-variable=VeTAIR_b_CPV2_ErrMsgsFA_write_IRV
              WV_VeTAIR_y_CPV2_ErrMsgs_write_IRV: accessed-variable=VeTAIR_y_CPV2_ErrMsgs_write_IRV
              WV_VeTAIR_e_CPV2_ErrSts_write_IRV: accessed-variable=VeTAIR_e_CPV2_ErrSts_write_IRV
              WV_VeTAIR_U_CPV2_MtrVltg_write_IRV: accessed-variable=VeTAIR_U_CPV2_MtrVltg_write_IRV
              WV_VeTAIR_b_CPV2_ActlPstnFA_write_IRV: accessed-variable=VeTAIR_b_CPV2_ActlPstnFA_write_IRV
              WV_VeTAIR_Pct_CPV2_ActlPstn_write_IRV: accessed-variable=VeTAIR_Pct_CPV2_ActlPstn_write_IRV
              WV_VeTAIR_b_CPV2_RsErr_write_IRV: accessed-variable=VeTAIR_b_CPV2_RsErr_write_IRV
              WV_VeTAIF_Pct_CPV_VlvCmd_write_IRV: accessed-variable=VeTAIF_Pct_CPV_VlvCmd_write_IRV
              WV_VeTAIF_e_CPV_VlvCmd_IO_CntrlSt_write_IRV: accessed-variable=VeTAIF_e_CPV_VlvCmd_IO_CntrlSt_write_IRV
              WV_VeTAIF_Pct_HT_CabVlvCmd_write_IRV: accessed-variable=VeTAIF_Pct_HT_CabVlvCmd_write_IRV
              WV_VeTAIF_e_HT_CabVlvCmd_IO_CntrlSt_write_IRV: accessed-variable=VeTAIF_e_HT_CabVlvCmd_IO_CntrlSt_write_IRV
              WV_VeTAIF_e_ChlrRfgtShtoff_VlvCmd_IRV: accessed-variable=VeTAIF_e_ChlrRfgtShtoff_VlvCmd_IRV
              WV_VeTAIF_b_ChlrRfgtShtoff_VlvCmd_IRV: accessed-variable=VeTAIF_b_ChlrRfgtShtoff_VlvCmd_IRV
              WV_VeTAIR_b_CompBoardTempFA_write_IRV: accessed-variable=VeTAIR_b_CompBoardTempFA_write_IRV
              WV_VeTAIR_T_CompBoardTemp_write_IRV: accessed-variable=VeTAIR_T_CompBoardTemp_write_IRV
              WV_VeTAIR_e_CompFltStat_write_IRV: accessed-variable=VeTAIR_e_CompFltStat_write_IRV
              WV_VeTAIR_b_CompHVInputFA_write_IRV: accessed-variable=VeTAIR_b_CompHVInputFA_write_IRV
              WV_VeTAIR_U_CompHVInput_write_IRV: accessed-variable=VeTAIR_U_CompHVInput_write_IRV
              WV_VeTAIR_b_CompIGBTTempFA_write_IRV: accessed-variable=VeTAIR_b_CompIGBTTempFA_write_IRV
              WV_VeTAIR_T_CompIGBTTemp_write_IRV: accessed-variable=VeTAIR_T_CompIGBTTemp_write_IRV
              WV_VeTAIR_b_CompSpdFdbFA_write_IRV: accessed-variable=VeTAIR_b_CompSpdFdbFA_write_IRV
              WV_VeTAIR_n_CompSpdFdb_write_IRV: accessed-variable=VeTAIR_n_CompSpdFdb_write_IRV
              WV_VeTAIR_b_CompSpdIncrReq_write_IRV: accessed-variable=VeTAIR_b_CompSpdIncrReq_write_IRV
              WV_VeTAIF_n_CompSpdTgt_write_IRV: accessed-variable=VeTAIF_n_CompSpdTgt_write_IRV
              WV_VeTAIF_e_CompSpdTgt_IO_CntrlSt_write_IRV: accessed-variable=VeTAIF_e_CompSpdTgt_IO_CntrlSt_write_IRV
              WV_VeTAIR_e_CompStat_write_IRV: accessed-variable=VeTAIR_e_CompStat_write_IRV
              WV_VeTAIF_Pct_RadFanCmd_write_IRV: accessed-variable=VeTAIF_Pct_RadFanCmd_write_IRV
              WV_VeTAIF_e_RadFanCmd_IO_CntrlSt_write_IRV: accessed-variable=VeTAIF_e_RadFanCmd_IO_CntrlSt_write_IRV
              WV_VeTAIR_b_ECM_AC_ClutchStsFA_write_IRV: accessed-variable=VeTAIR_b_ECM_AC_ClutchStsFA_write_IRV
              WV_VeTAIR_e_ECM_AC_ClutchSts_write_IRV: accessed-variable=VeTAIR_e_ECM_AC_ClutchSts_write_IRV
              WV_VeTAIR_b_ECM_AirflowRequestFA_write_IRV: accessed-variable=VeTAIR_b_ECM_AirflowRequestFA_write_IRV
              WV_VeTAIR_Pct_ECM_AirflowRequest_write_IRV: accessed-variable=VeTAIR_Pct_ECM_AirflowRequest_write_IRV
              WV_VeTAIR_b_ECM_RadFanReqFA_write_IRV: accessed-variable=VeTAIR_b_ECM_RadFanReqFA_write_IRV
              WV_VeTAIR_Pct_ECM_RadFanReq_write_IRV: accessed-variable=VeTAIR_Pct_ECM_RadFanReq_write_IRV
              WV_VeTAIR_T_EEXV_BoardTemp_write_IRV: accessed-variable=VeTAIR_T_EEXV_BoardTemp_write_IRV
              WV_VeTAIR_b_EEXV_CalRq_write_IRV: accessed-variable=VeTAIR_b_EEXV_CalRq_write_IRV
              WV_VeTAIR_e_EEXV_CalStat_write_IRV: accessed-variable=VeTAIR_e_EEXV_CalStat_write_IRV
              WV_VeTAIF_b_DVC_EEXV_Calibration_Start_IRV: accessed-variable=VeTAIF_b_DVC_EEXV_Calibration_Start_IRV
              WV_VeTAIF_Pct_EEXV_VlvCmd_write_IRV: accessed-variable=VeTAIF_Pct_EEXV_VlvCmd_write_IRV
              WV_VeTAIR_e_EEXV_Err_write_IRV: accessed-variable=VeTAIR_e_EEXV_Err_write_IRV
              WV_VeTAIF_e_EEXV_VlvCmd_IO_CntrlSt_write_IRV: accessed-variable=VeTAIF_e_EEXV_VlvCmd_IO_CntrlSt_write_IRV
              WV_VeTAIR_b_EEXV_PosActFA_write_IRV: accessed-variable=VeTAIR_b_EEXV_PosActFA_write_IRV
              WV_VeTAIR_Pct_EEXV_PosAct_write_IRV: accessed-variable=VeTAIR_Pct_EEXV_PosAct_write_IRV
              WV_VeTAIR_b_EEXV_RefPressFA_write_IRV: accessed-variable=VeTAIR_b_EEXV_RefPressFA_write_IRV
              WV_VeTAIR_p_EEXV_RefPress_write_IRV: accessed-variable=VeTAIR_p_EEXV_RefPress_write_IRV
              WV_VeTAIR_b_EEXV_RefTempFA_write_IRV: accessed-variable=VeTAIR_b_EEXV_RefTempFA_write_IRV
              WV_VeTAIR_T_EEXV_RefTemp_write_IRV: accessed-variable=VeTAIR_T_EEXV_RefTemp_write_IRV
              WV_VeTAIR_b_EEXV_RspErr_write_IRV: accessed-variable=VeTAIR_b_EEXV_RspErr_write_IRV
              WV_VeTAIR_e_EEXV_Sts_write_IRV: accessed-variable=VeTAIR_e_EEXV_Sts_write_IRV
              WV_VeTAIR_U_EEXV_SupplyVolt_write_IRV: accessed-variable=VeTAIR_U_EEXV_SupplyVolt_write_IRV
              WV_VeTAIR_T_EXV_BoardTemp_write_IRV: accessed-variable=VeTAIR_T_EXV_BoardTemp_write_IRV
              WV_VeTAIR_b_EXV_CalRq_write_IRV: accessed-variable=VeTAIR_b_EXV_CalRq_write_IRV
              WV_VeTAIR_e_EXV_CalStat_write_IRV: accessed-variable=VeTAIR_e_EXV_CalStat_write_IRV
              WV_VeTAIF_b_DVC_EXV_Calibration_Start_IRV: accessed-variable=VeTAIF_b_DVC_EXV_Calibration_Start_IRV
              WV_VeTAIF_Pct_EXV_VlvCmd_write_IRV: accessed-variable=VeTAIF_Pct_EXV_VlvCmd_write_IRV
              WV_VeTAIR_e_EXV_Err_write_IRV: accessed-variable=VeTAIR_e_EXV_Err_write_IRV
              WV_VeTAIF_e_EXV_VlvCmd_IO_CntrlSt_write_IRV: accessed-variable=VeTAIF_e_EXV_VlvCmd_IO_CntrlSt_write_IRV
              WV_VeTAIR_b_EXV_PosActFA_write_IRV: accessed-variable=VeTAIR_b_EXV_PosActFA_write_IRV
              WV_VeTAIR_Pct_EXV_PosAct_write_IRV: accessed-variable=VeTAIR_Pct_EXV_PosAct_write_IRV
              WV_VeTAIR_b_EXV_RefPressFA_write_IRV: accessed-variable=VeTAIR_b_EXV_RefPressFA_write_IRV
              WV_VeTAIR_kp_EXV_RefPress_write_IRV: accessed-variable=VeTAIR_kp_EXV_RefPress_write_IRV
              WV_VeTAIR_b_EXV_RefTempFA_write_IRV: accessed-variable=VeTAIR_b_EXV_RefTempFA_write_IRV
              WV_VeTAIR_T_EXV_RefTemp_write_IRV: accessed-variable=VeTAIR_T_EXV_RefTemp_write_IRV
              WV_VeTAIR_b_EXV_RspErr_write_IRV: accessed-variable=VeTAIR_b_EXV_RspErr_write_IRV
              WV_VeTAIR_e_EXV_Sts_write_IRV: accessed-variable=VeTAIR_e_EXV_Sts_write_IRV
              WV_VeTAIR_U_EXV_SupplyVolt_write_IRV: accessed-variable=VeTAIR_U_EXV_SupplyVolt_write_IRV
              WV_VeTAIR_e_FrWyVlv_CalSts_write_IRV: accessed-variable=VeTAIR_e_FrWyVlv_CalSts_write_IRV
              WV_VeTAIR_b_FrWyVlv_ErrMsgsFA_write_IRV: accessed-variable=VeTAIR_b_FrWyVlv_ErrMsgsFA_write_IRV
              WV_VeTAIR_y_FrWyVlv_ErrMsgs_write_IRV: accessed-variable=VeTAIR_y_FrWyVlv_ErrMsgs_write_IRV
              WV_VeTAIR_e_FrWyVlv_ErrSts_write_IRV: accessed-variable=VeTAIR_e_FrWyVlv_ErrSts_write_IRV
              WV_VeTAIR_U_FrWyVlv_MtrVltg_write_IRV: accessed-variable=VeTAIR_U_FrWyVlv_MtrVltg_write_IRV
              WV_VeTAIR_b_FrWyVlv_ActlPstnFA_write_IRV: accessed-variable=VeTAIR_b_FrWyVlv_ActlPstnFA_write_IRV
              WV_VeTAIR_Pct_FrWyVlv_ActlPstn_write_IRV: accessed-variable=VeTAIR_Pct_FrWyVlv_ActlPstn_write_IRV
              WV_VeTAIR_b_FrWyVlv_RsErr_write_IRV: accessed-variable=VeTAIR_b_FrWyVlv_RsErr_write_IRV
              WV_VeTAIF_e_FtRfgtShtoff_VlvCmd_IO_CntrlSt_write_IRV: accessed-variable=VeTAIF_e_FtRfgtShtoff_VlvCmd_IO_CntrlSt_write_IRV
              WV_VeTAIF_b_FtRfgtShtoff_VlvCmd_write_IRV: accessed-variable=VeTAIF_b_FtRfgtShtoff_VlvCmd_write_IRV
              WV_VeTAIR_b_FrtBlwrCmdFA_write_IRV: accessed-variable=VeTAIR_b_FrtBlwrCmdFA_write_IRV
              WV_VeTAIR_Pct_FrtBlwrCmd_write_IRV: accessed-variable=VeTAIR_Pct_FrtBlwrCmd_write_IRV
              WV_VeTAIR_b_FtEvapTmpFA_write_IRV: accessed-variable=VeTAIR_b_FtEvapTmpFA_write_IRV
              WV_VeTAIR_T_FtEvapTmp_write_IRV: accessed-variable=VeTAIR_T_FtEvapTmp_write_IRV
              WV_VeTAIR_b_FtEvapTmp_P1CFA_write_IRV: accessed-variable=VeTAIR_b_FtEvapTmp_P1CFA_write_IRV
              WV_VeTAIR_T_FtEvapTmp_P1C_write_IRV: accessed-variable=VeTAIR_T_FtEvapTmp_P1C_write_IRV
              WV_VeTAIR_b_FtEvapTmp_TgtFA_write_IRV: accessed-variable=VeTAIR_b_FtEvapTmp_TgtFA_write_IRV
              WV_VeTAIR_T_FtEvapTmp_Tgt_write_IRV: accessed-variable=VeTAIR_T_FtEvapTmp_Tgt_write_IRV
              WV_VeTAIF_e_DVC_HTCV_Calibration_Start_write_IRV: accessed-variable=VeTAIF_e_DVC_HTCV_Calibration_Start_write_IRV
              WV_VeTAIR_b_HTL_BypsVlv_ActlPstnFA_write_IRV: accessed-variable=VeTAIR_b_HTL_BypsVlv_ActlPstnFA_write_IRV
              WV_VeTAIR_Pct_HTL_BypsVlv_ActlPstn_write_IRV: accessed-variable=VeTAIR_Pct_HTL_BypsVlv_ActlPstn_write_IRV
              WV_VeTAIR_b_HTL_BypsVlv_CalStsFA_write_IRV: accessed-variable=VeTAIR_b_HTL_BypsVlv_CalStsFA_write_IRV
              WV_VeTAIR_e_HTL_BypsVlv_CalSts_write_IRV: accessed-variable=VeTAIR_e_HTL_BypsVlv_CalSts_write_IRV
              WV_VeTAIF_Pct_HTL_BypsVlv_Cmd_write_IRV: accessed-variable=VeTAIF_Pct_HTL_BypsVlv_Cmd_write_IRV
              WV_VeTAIR_b_HTL_BypsVlv_ErrMsgsFA_write_IRV: accessed-variable=VeTAIR_b_HTL_BypsVlv_ErrMsgsFA_write_IRV
              WV_VeTAIR_y_HTL_BypsVlv_ErrMsgs_write_IRV: accessed-variable=VeTAIR_y_HTL_BypsVlv_ErrMsgs_write_IRV
              WV_VeTAIR_b_HTL_BypsVlv_ErrStsFA_write_IRV: accessed-variable=VeTAIR_b_HTL_BypsVlv_ErrStsFA_write_IRV
              WV_VeTAIR_e_HTL_BypsVlv_ErrSts_write_IRV: accessed-variable=VeTAIR_e_HTL_BypsVlv_ErrSts_write_IRV
              WV_VeTAIF_e_HTL_BypsVlv_IO_CntrlSt_write_IRV: accessed-variable=VeTAIF_e_HTL_BypsVlv_IO_CntrlSt_write_IRV
              WV_VeTAIR_b_HTL_BypsVlv_MtrVltgFA_write_IRV: accessed-variable=VeTAIR_b_HTL_BypsVlv_MtrVltgFA_write_IRV
              WV_VeTAIR_U_HTL_BypsVlv_MtrVltg_write_IRV: accessed-variable=VeTAIR_U_HTL_BypsVlv_MtrVltg_write_IRV
              WV_VeTAIR_b_HTL_BypsVlv_RsErr_write_IRV: accessed-variable=VeTAIR_b_HTL_BypsVlv_RsErr_write_IRV
              WV_FsftTAIR_Pct_HTRBV_ActuatorPosActFA_write_IRV: accessed-variable=FsftTAIR_Pct_HTRBV_ActuatorPosActFA_write_IRV
              WV_PokeTAIR_Pct_HTRBV_ActuatorPosAct_write_IRV: accessed-variable=PokeTAIR_Pct_HTRBV_ActuatorPosAct_write_IRV
              WV_VeTAIR_Pct_HTRBV_ActuatorPosTrgt_write_IRV: accessed-variable=VeTAIR_Pct_HTRBV_ActuatorPosTrgt_write_IRV
              WV_VeTAIR_T_HTRBV_EcuTemp_write_IRV: accessed-variable=VeTAIR_T_HTRBV_EcuTemp_write_IRV
              WV_VeTAIR_U_HTRBV_EcuVoltage_write_IRV: accessed-variable=VeTAIR_U_HTRBV_EcuVoltage_write_IRV
              WV_VeTAIR_e_HTRBV_ErrLinCom_write_IRV: accessed-variable=VeTAIR_e_HTRBV_ErrLinCom_write_IRV
              WV_VeTAIR_e_HTRBV_ErrPosition_write_IRV: accessed-variable=VeTAIR_e_HTRBV_ErrPosition_write_IRV
              WV_VeTAIR_e_HTRBV_Err_Ecu_write_IRV: accessed-variable=VeTAIR_e_HTRBV_Err_Ecu_write_IRV
              WV_VeTAIR_e_HTRBV_Err_Motor_write_IRV: accessed-variable=VeTAIR_e_HTRBV_Err_Motor_write_IRV
              WV_VeTAIR_e_HTRBV_Err_Voltage_write_IRV: accessed-variable=VeTAIR_e_HTRBV_Err_Voltage_write_IRV
              WV_VeTAIR_b_HTRBV_ResponseError_write_IRV: accessed-variable=VeTAIR_b_HTRBV_ResponseError_write_IRV
              WV_VeTAIR_b_HTRBV_SelfCalReq_write_IRV: accessed-variable=VeTAIR_b_HTRBV_SelfCalReq_write_IRV
              WV_VeTAIR_e_HTRBV_SystemState_write_IRV: accessed-variable=VeTAIR_e_HTRBV_SystemState_write_IRV
              WV_VeTAIR_b_HT_CabVlvStsFA_write_IRV: accessed-variable=VeTAIR_b_HT_CabVlvStsFA_write_IRV
              WV_VeTAIR_U_HT_CabVlvSts_write_IRV: accessed-variable=VeTAIR_U_HT_CabVlvSts_write_IRV
              WV_VeTAIR_b_ECVD_HVACCabinReqFA_write_IRV: accessed-variable=VeTAIR_b_ECVD_HVACCabinReqFA_write_IRV
              WV_VeTAIR_I_ECVD_HVACCabinReq_write_IRV: accessed-variable=VeTAIR_I_ECVD_HVACCabinReq_write_IRV
              WV_VeTAIR_b_ECVD_HVACCurrentActFA_write_IRV: accessed-variable=VeTAIR_b_ECVD_HVACCurrentActFA_write_IRV
              WV_VeTAIR_I_ECVD_HVACCurrentAct_write_IRV: accessed-variable=VeTAIR_I_ECVD_HVACCurrentAct_write_IRV
              WV_VeTAIR_b_HghRfrgtPresFailStsFA_write_IRV: accessed-variable=VeTAIR_b_HghRfrgtPresFailStsFA_write_IRV
              WV_VeTAIR_T_HtrCoreTmp_Tgt_write_IRV: accessed-variable=VeTAIR_T_HtrCoreTmp_Tgt_write_IRV
              WV_VeTAIR_b_LTR_BypsVlv_ActlPstnFA_write_IRV: accessed-variable=VeTAIR_b_LTR_BypsVlv_ActlPstnFA_write_IRV
              WV_VeTAIR_Pct_LTR_BypsVlv_ActlPstn_write_IRV: accessed-variable=VeTAIR_Pct_LTR_BypsVlv_ActlPstn_write_IRV
              WV_VeTAIR_b_LTR_BypsVlv_CalStsFA_write_IRV: accessed-variable=VeTAIR_b_LTR_BypsVlv_CalStsFA_write_IRV
              WV_VeTAIR_e_LTR_BypsVlv_CalSts_write_IRV: accessed-variable=VeTAIR_e_LTR_BypsVlv_CalSts_write_IRV
              WV_VeTAIF_Pct_LTR_BypsVlv_Cmd_write_IRV: accessed-variable=VeTAIF_Pct_LTR_BypsVlv_Cmd_write_IRV
              WV_VeTAIR_b_LTR_BypsVlv_ErrMsgsFA_write_IRV: accessed-variable=VeTAIR_b_LTR_BypsVlv_ErrMsgsFA_write_IRV
              WV_VeTAIR_y_LTR_BypsVlv_ErrMsgs_write_IRV: accessed-variable=VeTAIR_y_LTR_BypsVlv_ErrMsgs_write_IRV
              WV_VeTAIR_b_LTR_BypsVlv_ErrStsFA_write_IRV: accessed-variable=VeTAIR_b_LTR_BypsVlv_ErrStsFA_write_IRV
              WV_VeTAIR_e_LTR_BypsVlv_ErrSts_write_IRV: accessed-variable=VeTAIR_e_LTR_BypsVlv_ErrSts_write_IRV
              WV_VeTAIF_e_LTR_BypsVlv_IO_CntrlSt_write_IRV: accessed-variable=VeTAIF_e_LTR_BypsVlv_IO_CntrlSt_write_IRV
              WV_VeTAIR_b_LTR_BypsVlv_MtrVltgFA_write_IRV: accessed-variable=VeTAIR_b_LTR_BypsVlv_MtrVltgFA_write_IRV
              WV_VeTAIR_U_LTR_BypsVlv_MtrVltg_write_IRV: accessed-variable=VeTAIR_U_LTR_BypsVlv_MtrVltg_write_IRV
              WV_VeTAIR_b_LTR_BypsVlv_RsErr_write_IRV: accessed-variable=VeTAIR_b_LTR_BypsVlv_RsErr_write_IRV
              WV_VeTAIF_e_LT_Shtoff_VlvCmd_IO_CntrlSt_write_IRV: accessed-variable=VeTAIF_e_LT_Shtoff_VlvCmd_IO_CntrlSt_write_IRV
              WV_VeTAIF_b_LT_Shtoff_VlvCmd_write_IRV: accessed-variable=VeTAIF_b_LT_Shtoff_VlvCmd_write_IRV
              WV_VeTAIR_T_OEXV_BoardTemp_write_IRV: accessed-variable=VeTAIR_T_OEXV_BoardTemp_write_IRV
              WV_VeTAIR_b_OEXV_CalRq_write_IRV: accessed-variable=VeTAIR_b_OEXV_CalRq_write_IRV
              WV_VeTAIR_e_OEXV_CalStat_write_IRV: accessed-variable=VeTAIR_e_OEXV_CalStat_write_IRV
              WV_VeTAIF_b_DVC_OEXV_Calibration_Start_IRV: accessed-variable=VeTAIF_b_DVC_OEXV_Calibration_Start_IRV
              WV_VeTAIF_Pct_OEXV_VlvCmd_write_IRV: accessed-variable=VeTAIF_Pct_OEXV_VlvCmd_write_IRV
              WV_VeTAIR_e_OEXV_Err_write_IRV: accessed-variable=VeTAIR_e_OEXV_Err_write_IRV
              WV_VeTAIF_e_OEXV_VlvCmd_IO_CntrlSt_write_IRV: accessed-variable=VeTAIF_e_OEXV_VlvCmd_IO_CntrlSt_write_IRV
              WV_VeTAIR_b_OEXV_PosActFA_write_IRV: accessed-variable=VeTAIR_b_OEXV_PosActFA_write_IRV
              WV_VeTAIR_Pct_OEXV_PosAct_write_IRV: accessed-variable=VeTAIR_Pct_OEXV_PosAct_write_IRV
              WV_VeTAIR_b_OEXV_RefPressFA_write_IRV: accessed-variable=VeTAIR_b_OEXV_RefPressFA_write_IRV
              WV_VeTAIR_p_OEXV_RefPress_write_IRV: accessed-variable=VeTAIR_p_OEXV_RefPress_write_IRV
              WV_VeTAIR_b_OEXV_RefTempFA_write_IRV: accessed-variable=VeTAIR_b_OEXV_RefTempFA_write_IRV
              WV_VeTAIR_T_OEXV_RefTemp_write_IRV: accessed-variable=VeTAIR_T_OEXV_RefTemp_write_IRV
              WV_VeTAIR_b_OEXV_RspErr_write_IRV: accessed-variable=VeTAIR_b_OEXV_RspErr_write_IRV
              WV_VeTAIR_e_OEXV_Sts_write_IRV: accessed-variable=VeTAIR_e_OEXV_Sts_write_IRV
              WV_VeTAIR_U_OEXV_SupplyVolt_write_IRV: accessed-variable=VeTAIR_U_OEXV_SupplyVolt_write_IRV
              WV_VeTAIR_b_RearCabinFanStsFA_write_IRV: accessed-variable=VeTAIR_b_RearCabinFanStsFA_write_IRV
              WV_VeTAIR_y_RearCabinFanSts_write_IRV: accessed-variable=VeTAIR_y_RearCabinFanSts_write_IRV
              WV_VeTAIR_b_EBL_StatFA_write_IRV: accessed-variable=VeTAIR_b_EBL_StatFA_write_IRV
              WV_VeTAIR_e_RearDefrostSts_write_IRV: accessed-variable=VeTAIR_e_RearDefrostSts_write_IRV
              WV_VeTAIR_b_RespErr_EAC_write_IRV: accessed-variable=VeTAIR_b_RespErr_EAC_write_IRV
              WV_VeTAIR_Pct_RrBlwrCmd_write_IRV: accessed-variable=VeTAIR_Pct_RrBlwrCmd_write_IRV
              WV_VeTAIF_e_HT_Shtoff_VlvCmd_IO_CntrlSt_write_IRV: accessed-variable=VeTAIF_e_HT_Shtoff_VlvCmd_IO_CntrlSt_write_IRV
              WV_VeTAIF_b_HT_Shtoff_VlvCmd_write_IRV: accessed-variable=VeTAIF_b_HT_Shtoff_VlvCmd_write_IRV
              WV_VeTAIR_b_VhIntTmpFA_write_IRV: accessed-variable=VeTAIR_b_VhIntTmpFA_write_IRV
              WV_VeTAIR_T_VhIntTmp_write_IRV: accessed-variable=VeTAIR_T_VhIntTmp_write_IRV
              WV_VeTAIR_b_WinshldDfrst_write_IRV: accessed-variable=VeTAIR_b_WinshldDfrst_write_IRV
              WV_VeTAIR_e_AGS2_CurrPos_write_IRV: accessed-variable=VeTAIR_e_AGS2_CurrPos_write_IRV
              WV_VeTAIR_e_AGS_CurrPos_write_IRV: accessed-variable=VeTAIR_e_AGS_CurrPos_write_IRV
        TAIR_MedTED
          data-receive-point-by-arguments:
            10 x access:
              IN_VeTAIB_T_CEXV_OutTempSnsr_Value: accessed-variable=VeTAIB_T_CEXV_OutTempSnsr.Value
              IN_VeTAIB_T_OEXV_InTempSnsr_Value: accessed-variable=VeTAIB_T_OEXV_InTempSnsr.Value
              IN_VeTAIB_T_OEXV_OutTempSnsr_Value: accessed-variable=VeTAIB_T_OEXV_OutTempSnsr.Value
              IN_VeTAIB_b_CEXV_OutPresSnsr_FA_Value: accessed-variable=VeTAIB_b_CEXV_OutPresSnsr_FA.Value
              IN_VeTAIB_b_CEXV_OutTempSnsr_FA_Value: accessed-variable=VeTAIB_b_CEXV_OutTempSnsr_FA.Value
              IN_VeTAIB_b_OEXV_InTempSnsr_FA_Value: accessed-variable=VeTAIB_b_OEXV_InTempSnsr_FA.Value
              IN_VeTAIB_b_OEXV_OutPresSnsr_FA_Value: accessed-variable=VeTAIB_b_OEXV_OutPresSnsr_FA.Value
              IN_VeTAIB_b_OEXV_OutTempSnsr_FA_Value: accessed-variable=VeTAIB_b_OEXV_OutTempSnsr_FA.Value
              IN_VeTAIB_p_CEXV_OutPresSnsr_Value: accessed-variable=VeTAIB_p_CEXV_OutPresSnsr.Value
              IN_VeTAIB_p_OEXV_OutPresSnsr_Value: accessed-variable=VeTAIB_p_OEXV_OutPresSnsr.Value
          data-send-points:
            152 x access:
              OUT_VeTAIR_U_HT_CabVlvSts_Value: accessed-variable=VeTAIR_U_HT_CabVlvSts.Value
              OUT_VeTAIR_b_HT_CabVlvSts_FA_Value: accessed-variable=VeTAIR_b_HT_CabVlvSts_FA.Value
              OUT_VeTAIR_e_DVC_HTCV_CalibStrt_Value: accessed-variable=VeTAIR_e_DVC_HTCV_CalibStrt.Value
              OUT_VeTAIR_e_HT_Shtoff_VlvCmd_IO_CntrlSt_Value: accessed-variable=VeTAIR_e_HT_Shtoff_VlvCmd_IO_CntrlSt.Value
              OUT_VeTAIR_b_HT_Shtoff_VlvCmd_Value: accessed-variable=VeTAIR_b_HT_Shtoff_VlvCmd.Value
              OUT_VeTAIR_e_Ft_SO_VlvCmd_IO_Cnt_Value: accessed-variable=VeTAIR_e_Ft_SO_VlvCmd_IO_Cnt.Value
              OUT_VeTAIR_b_Ft_SO_VlvCmd_Value: accessed-variable=VeTAIR_b_Ft_SO_VlvCmd.Value
              OUT_VeTAIR_e_Chlr_SO_VlvCmd_IO_Cnt_Value: accessed-variable=VeTAIR_e_Chlr_SO_VlvCmd_IO_Cnt.Value
              OUT_VeTAIR_b_Chlr_SO_VlvCmd_Value: accessed-variable=VeTAIR_b_Chlr_SO_VlvCmd.Value
              OUT_VeTAIR_e_HT_CabVlvCmd_IO_Cnt_Value: accessed-variable=VeTAIR_e_HT_CabVlvCmd_IO_Cnt.Value
              OUT_VeTAIR_Pct_HT_CabVlvCmd_Value: accessed-variable=VeTAIR_Pct_HT_CabVlvCmd.Value
              OUT_VeTAIR_Pct_FrWyVlv_PstnAct_Value: accessed-variable=VeTAIR_Pct_FrWyVlv_PstnAct.Value
              OUT_VeTAIR_b_FrWyVlv_PstnAct_FA_Value: accessed-variable=VeTAIR_b_FrWyVlv_PstnAct_FA.Value
              OUT_VeTAIR_e_FrWyVlv_CalSts_Value: accessed-variable=VeTAIR_e_FrWyVlv_CalSts.Value
              OUT_VeTAIR_b_FrWyVlv_RsErr_Value: accessed-variable=VeTAIR_b_FrWyVlv_RsErr.Value
              OUT_VeTAIR_e_FrWyVlv_ErrSts_Value: accessed-variable=VeTAIR_e_FrWyVlv_ErrSts.Value
              OUT_VeTAIR_U_FrWyVlv_MtrVltg_Value: accessed-variable=VeTAIR_U_FrWyVlv_MtrVltg.Value
              OUT_VeTAIR_e_CPV_IO_Cnt_Value: accessed-variable=VeTAIR_e_CPV_IO_Cnt.Value
              OUT_VeTAIR_Pct_CPV_Cmd_Value: accessed-variable=VeTAIR_Pct_CPV_Cmd.Value
              OUT_VeTAIR_Pct_EXV_PosAct_Value: accessed-variable=VeTAIR_Pct_EXV_PosAct.Value
              OUT_VeTAIR_b_EXV_PosAct_FA_Value: accessed-variable=VeTAIR_b_EXV_PosAct_FA.Value
              OUT_VeTAIR_e_EXV_CalStat_Value: accessed-variable=VeTAIR_e_EXV_CalStat.Value
              OUT_VeTAIR_b_EXV_CalRq_Value: accessed-variable=VeTAIR_b_EXV_CalRq.Value
              OUT_VeTAIR_b_EXV_RspErr_Value: accessed-variable=VeTAIR_b_EXV_RspErr.Value
              OUT_VeTAIR_e_EXV_Sts_Value: accessed-variable=VeTAIR_e_EXV_Sts.Value
              OUT_VeTAIR_e_EXV_Err_Value: accessed-variable=VeTAIR_e_EXV_Err.Value
              OUT_VeTAIR_U_EXV_SupplyVolt_Value: accessed-variable=VeTAIR_U_EXV_SupplyVolt.Value
              OUT_VeTAIR_p_EXV_RefPress_Value: accessed-variable=VeTAIR_p_EXV_RefPress.Value
              OUT_VeTAIR_b_EXV_RefPress_FA_Value: accessed-variable=VeTAIR_b_EXV_RefPress_FA.Value
              OUT_VeTAIR_T_EXV_BoardTemp_Value: accessed-variable=VeTAIR_T_EXV_BoardTemp.Value
              OUT_VeTAIR_T_EXV_RefTemp_Value: accessed-variable=VeTAIR_T_EXV_RefTemp.Value
              OUT_VeTAIR_b_EXV_RefTemp_FA_Value: accessed-variable=VeTAIR_b_EXV_RefTemp_FA.Value
              OUT_VeTAIR_b_FrWyVlv_OvrVltg_Value: accessed-variable=VeTAIR_b_FrWyVlv_OvrVltg.Value
              OUT_VeTAIR_b_FrWyVlv_UndrVltg_Value: accessed-variable=VeTAIR_b_FrWyVlv_UndrVltg.Value
              OUT_VeTAIR_b_FrWyVlv_ThrmlWrng_Value: accessed-variable=VeTAIR_b_FrWyVlv_ThrmlWrng.Value
              OUT_VeTAIR_b_FrWyVlv_OpnLd_Value: accessed-variable=VeTAIR_b_FrWyVlv_OpnLd.Value
              OUT_VeTAIR_b_FrWyVlv_OvrCrnt_Value: accessed-variable=VeTAIR_b_FrWyVlv_OvrCrnt.Value
              OUT_VeTAIR_b_FrWyVlv_MechBrk_Value: accessed-variable=VeTAIR_b_FrWyVlv_MechBrk.Value
              OUT_VeTAIR_b_FrWyVlv_BlckPnt_Value: accessed-variable=VeTAIR_b_FrWyVlv_BlckPnt.Value
              OUT_VeTAIR_b_FrWyVlv_Err_SNA_Value: accessed-variable=VeTAIR_b_FrWyVlv_Err_SNA.Value
              OUT_VeTAIR_Pct_LTR_BypsVlv_ActlPstn_Value: accessed-variable=VeTAIR_Pct_LTR_BypsVlv_ActlPstn.Value
              OUT_VeTAIR_b_LTR_BypsVlv_ActlPstn_FA_Value: accessed-variable=VeTAIR_b_LTR_BypsVlv_ActlPstn_FA.Value
              OUT_VeTAIR_e_LTR_BypsVlv_CalSts_Value: accessed-variable=VeTAIR_e_LTR_BypsVlv_CalSts.Value
              OUT_VeTAIR_b_LTR_BypsVlv_CalSts_FA_Value: accessed-variable=VeTAIR_b_LTR_BypsVlv_CalSts_FA.Value
              OUT_VeTAIR_b_LTR_BypsVlv_RsErr_Value: accessed-variable=VeTAIR_b_LTR_BypsVlv_RsErr.Value
              OUT_VeTAIR_e_LTR_BypsVlv_ErrSts_Value: accessed-variable=VeTAIR_e_LTR_BypsVlv_ErrSts.Value
              OUT_VeTAIR_b_LTR_BypsVlv_ErrSts_FA_Value: accessed-variable=VeTAIR_b_LTR_BypsVlv_ErrSts_FA.Value
              OUT_VeTAIR_U_LTR_BypsVlv_MtrVltg_Value: accessed-variable=VeTAIR_U_LTR_BypsVlv_MtrVltg.Value
              OUT_VeTAIR_b_LTR_BypsVlv_MtrVltg_FA_Value: accessed-variable=VeTAIR_b_LTR_BypsVlv_MtrVltg_FA.Value
              OUT_VeTAIR_Pct_HTL_BypsVlv_ActlPstn_Value: accessed-variable=VeTAIR_Pct_HTL_BypsVlv_ActlPstn.Value
              OUT_VeTAIR_b_HTL_BypsVlv_ActlPstn_FA_Value: accessed-variable=VeTAIR_b_HTL_BypsVlv_ActlPstn_FA.Value
              OUT_VeTAIR_e_HTL_BypsVlv_CalSts_Value: accessed-variable=VeTAIR_e_HTL_BypsVlv_CalSts.Value
              OUT_VeTAIR_b_HTL_BypsVlv_CalSts_FA_Value: accessed-variable=VeTAIR_b_HTL_BypsVlv_CalSts_FA.Value
              OUT_VeTAIR_b_HTL_BypsVlv_RsErr_Value: accessed-variable=VeTAIR_b_HTL_BypsVlv_RsErr.Value
              OUT_VeTAIR_e_HTL_BypsVlv_ErrSts_Value: accessed-variable=VeTAIR_e_HTL_BypsVlv_ErrSts.Value
              OUT_VeTAIR_b_HTL_BypsVlv_ErrSts_FA_Value: accessed-variable=VeTAIR_b_HTL_BypsVlv_ErrSts_FA.Value
              OUT_VeTAIR_U_HTL_BypsVlv_MtrVltg_Value: accessed-variable=VeTAIR_U_HTL_BypsVlv_MtrVltg.Value
              OUT_VeTAIR_b_HTL_BypsVlv_MtrVltg_FA_Value: accessed-variable=VeTAIR_b_HTL_BypsVlv_MtrVltg_FA.Value
              OUT_VeTAIR_e_EXV_IO_CntrlSt_Value: accessed-variable=VeTAIR_e_EXV_IO_CntrlSt.Value
              OUT_VeTAIR_Pct_EXV_Cmd_Value: accessed-variable=VeTAIR_Pct_EXV_Cmd.Value
              OUT_VeTAIR_b_DVC_EXV_Calibration_Start_Value: accessed-variable=VeTAIR_b_DVC_EXV_Calibration_Start.Value
              OUT_VeTAIR_e_LT_Shtoff_VlvCmd_IO_CntrlSt_Value: accessed-variable=VeTAIR_e_LT_Shtoff_VlvCmd_IO_CntrlSt.Value
              OUT_VeTAIR_b_LT_Shtoff_VlvCmd_Value: accessed-variable=VeTAIR_b_LT_Shtoff_VlvCmd.Value
              OUT_VeTAIR_Pct_LTR_BypsVlv_Cmd_Value: accessed-variable=VeTAIR_Pct_LTR_BypsVlv_Cmd.Value
              OUT_VeTAIR_e_LTR_BypsVlv_IO_CntrlSt_Value: accessed-variable=VeTAIR_e_LTR_BypsVlv_IO_CntrlSt.Value
              OUT_VeTAIR_Pct_HTL_BypsVlv_Cmd_Value: accessed-variable=VeTAIR_Pct_HTL_BypsVlv_Cmd.Value
              OUT_VeTAIR_e_HTL_BypsVlv_IO_CntrlSt_Value: accessed-variable=VeTAIR_e_HTL_BypsVlv_IO_CntrlSt.Value
              OUT_VeTAIR_b_LTR_BypsVlv_OvrVltg_Value: accessed-variable=VeTAIR_b_LTR_BypsVlv_OvrVltg.Value
              OUT_VeTAIR_b_LTR_BypsVlv_UndrVltg_Value: accessed-variable=VeTAIR_b_LTR_BypsVlv_UndrVltg.Value
              OUT_VeTAIR_b_LTR_BypsVlv_ThrmlWrng_Value: accessed-variable=VeTAIR_b_LTR_BypsVlv_ThrmlWrng.Value
              OUT_VeTAIR_b_LTR_BypsVlv_OpnLd_Value: accessed-variable=VeTAIR_b_LTR_BypsVlv_OpnLd.Value
              OUT_VeTAIR_b_LTR_BypsVlv_OvrCrnt_Value: accessed-variable=VeTAIR_b_LTR_BypsVlv_OvrCrnt.Value
              OUT_VeTAIR_b_LTR_BypsVlv_MechBrk_Value: accessed-variable=VeTAIR_b_LTR_BypsVlv_MechBrk.Value
              OUT_VeTAIR_b_LTR_BypsVlv_BlckPnt_Value: accessed-variable=VeTAIR_b_LTR_BypsVlv_BlckPnt.Value
              OUT_VeTAIR_b_LTR_BypsVlv_Err_SNA_Value: accessed-variable=VeTAIR_b_LTR_BypsVlv_Err_SNA.Value
              OUT_VeTAIR_b_HTL_BypsVlv_OvrVltg_Value: accessed-variable=VeTAIR_b_HTL_BypsVlv_OvrVltg.Value
              OUT_VeTAIR_b_HTL_BypsVlv_UndrVltg_Value: accessed-variable=VeTAIR_b_HTL_BypsVlv_UndrVltg.Value
              OUT_VeTAIR_b_HTL_BypsVlv_ThrmlWrng_Value: accessed-variable=VeTAIR_b_HTL_BypsVlv_ThrmlWrng.Value
              OUT_VeTAIR_b_HTL_BypsVlv_OpnLd_Value: accessed-variable=VeTAIR_b_HTL_BypsVlv_OpnLd.Value
              OUT_VeTAIR_b_HTL_BypsVlv_OvrCrnt_Value: accessed-variable=VeTAIR_b_HTL_BypsVlv_OvrCrnt.Value
              OUT_VeTAIR_b_HTL_BypsVlv_MechBrk_Value: accessed-variable=VeTAIR_b_HTL_BypsVlv_MechBrk.Value
              OUT_VeTAIR_b_HTL_BypsVlv_BlckPnt_Value: accessed-variable=VeTAIR_b_HTL_BypsVlv_BlckPnt.Value
              OUT_VeTAIR_b_HTL_BypsVlv_Err_SNA_Value: accessed-variable=VeTAIR_b_HTL_BypsVlv_Err_SNA.Value
              OUT_VeTAIR_Pct_EEXV_PosAct_Value: accessed-variable=VeTAIR_Pct_EEXV_PosAct.Value
              OUT_VeTAIR_b_EEXV_PosAct_FA_Value: accessed-variable=VeTAIR_b_EEXV_PosAct_FA.Value
              OUT_VeTAIR_e_EEXV_CalStat_Value: accessed-variable=VeTAIR_e_EEXV_CalStat.Value
              OUT_VeTAIR_b_EEXV_CalRq_Value: accessed-variable=VeTAIR_b_EEXV_CalRq.Value
              OUT_VeTAIR_b_EEXV_RspErr_Value: accessed-variable=VeTAIR_b_EEXV_RspErr.Value
              OUT_VeTAIR_e_EEXV_Sts_Value: accessed-variable=VeTAIR_e_EEXV_Sts.Value
              OUT_VeTAIR_e_EEXV_Err_Value: accessed-variable=VeTAIR_e_EEXV_Err.Value
              OUT_VeTAIR_U_EEXV_SupplyVolt_Value: accessed-variable=VeTAIR_U_EEXV_SupplyVolt.Value
              OUT_VeTAIR_p_EEXV_RefPress_Value: accessed-variable=VeTAIR_p_EEXV_RefPress.Value
              OUT_VeTAIR_b_EEXV_RefPress_FA_Value: accessed-variable=VeTAIR_b_EEXV_RefPress_FA.Value
              OUT_VeTAIR_T_EEXV_BoardTemp_Value: accessed-variable=VeTAIR_T_EEXV_BoardTemp.Value
              OUT_VeTAIR_T_EEXV_RefTemp_Value: accessed-variable=VeTAIR_T_EEXV_RefTemp.Value
              OUT_VeTAIR_b_EEXV_RefTemp_FA_Value: accessed-variable=VeTAIR_b_EEXV_RefTemp_FA.Value
              OUT_VeTAIR_Pct_OEXV_PosAct_Value: accessed-variable=VeTAIR_Pct_OEXV_PosAct.Value
              OUT_VeTAIR_b_OEXV_PosAct_FA_Value: accessed-variable=VeTAIR_b_OEXV_PosAct_FA.Value
              OUT_VeTAIR_e_OEXV_CalStat_Value: accessed-variable=VeTAIR_e_OEXV_CalStat.Value
              OUT_VeTAIR_b_OEXV_CalRq_Value: accessed-variable=VeTAIR_b_OEXV_CalRq.Value
              OUT_VeTAIR_b_OEXV_RspErr_Value: accessed-variable=VeTAIR_b_OEXV_RspErr.Value
              OUT_VeTAIR_e_OEXV_Sts_Value: accessed-variable=VeTAIR_e_OEXV_Sts.Value
              OUT_VeTAIR_e_OEXV_Err_Value: accessed-variable=VeTAIR_e_OEXV_Err.Value
              OUT_VeTAIR_U_OEXV_SupplyVolt_Value: accessed-variable=VeTAIR_U_OEXV_SupplyVolt.Value
              OUT_VeTAIR_p_OEXV_OutPressSens_Value: accessed-variable=VeTAIR_p_OEXV_OutPressSens.Value
              OUT_VeTAIR_b_OEXV_OutPressSens_FA_Value: accessed-variable=VeTAIR_b_OEXV_OutPressSens_FA.Value
              OUT_VeTAIR_T_OEXV_BoardTemp_Value: accessed-variable=VeTAIR_T_OEXV_BoardTemp.Value
              OUT_VeTAIR_T_OEXV_OutTempSens_Value: accessed-variable=VeTAIR_T_OEXV_OutTempSens.Value
              OUT_VeTAIR_b_OEXV_OutTempSens_FA_Value: accessed-variable=VeTAIR_b_OEXV_OutTempSens_FA.Value
              OUT_VeTAIR_T_OEXV_InTempSens_Value: accessed-variable=VeTAIR_T_OEXV_InTempSens.Value
              OUT_VeTAIR_b_OEXV_InTempSens_FA_Value: accessed-variable=VeTAIR_b_OEXV_InTempSens_FA.Value
              OUT_VeTAIR_T_CEXV_OutTempSens_Value: accessed-variable=VeTAIR_T_CEXV_OutTempSens.Value
              OUT_VeTAIR_b_CEXV_OutTempSens_FA_Value: accessed-variable=VeTAIR_b_CEXV_OutTempSens_FA.Value
              OUT_VeTAIR_p_CEXV_OutPressSens_Value: accessed-variable=VeTAIR_p_CEXV_OutPressSens.Value
              OUT_VeTAIR_b_CEXV_OutPressSens_FA_Value: accessed-variable=VeTAIR_b_CEXV_OutPressSens_FA.Value
              OUT_VeTAIR_T_OEXV_RefTemp_Value: accessed-variable=VeTAIR_T_OEXV_RefTemp.Value
              OUT_VeTAIR_b_OEXV_RefTemp_FA_Value: accessed-variable=VeTAIR_b_OEXV_RefTemp_FA.Value
              OUT_VeTAIR_p_OEXV_RefPress_Value: accessed-variable=VeTAIR_p_OEXV_RefPress.Value
              OUT_VeTAIR_b_OEXV_RefPress_FA_Value: accessed-variable=VeTAIR_b_OEXV_RefPress_FA.Value
              OUT_VeTAIR_e_EEXV_IO_CntrlSt_Value: accessed-variable=VeTAIR_e_EEXV_IO_CntrlSt.Value
              OUT_VeTAIR_Pct_EEXV_Cmd_Value: accessed-variable=VeTAIR_Pct_EEXV_Cmd.Value
              OUT_VeTAIR_b_DVC_EEXV_Calibration_Start_Value: accessed-variable=VeTAIR_b_DVC_EEXV_Calibration_Start.Value
              OUT_VeTAIR_e_OEXV_IO_CntrlSt_Value: accessed-variable=VeTAIR_e_OEXV_IO_CntrlSt.Value
              OUT_VeTAIR_Pct_OEXV_Cmd_Value: accessed-variable=VeTAIR_Pct_OEXV_Cmd.Value
              OUT_VeTAIR_b_DVC_OEXV_Calibration_Start_Value: accessed-variable=VeTAIR_b_DVC_OEXV_Calibration_Start.Value
              OUT_VeTAIR_Pct_HTRBV_ActuatorPosTrgt_Value: accessed-variable=VeTAIR_Pct_HTRBV_ActuatorPosTrgt.Value
              OUT_VeTAIR_b_HTRBV_ActuatorPosAct_FA_Value: accessed-variable=VeTAIR_b_HTRBV_ActuatorPosAct_FA.Value
              OUT_VeTAIR_T_HTRBV_EcuTemp_Value: accessed-variable=VeTAIR_T_HTRBV_EcuTemp.Value
              OUT_VeTAIR_U_HTRBV_EcuVoltage_Value: accessed-variable=VeTAIR_U_HTRBV_EcuVoltage.Value
              OUT_VeTAIR_b_HTRBV_ResponseError_Value: accessed-variable=VeTAIR_b_HTRBV_ResponseError.Value
              OUT_VeTAIR_Pct_HTRBV_ActuatorPosAct_Value: accessed-variable=VeTAIR_Pct_HTRBV_ActuatorPosAct.Value
              OUT_VeTAIR_b_HTRBV_SelfCalReq_Value: accessed-variable=VeTAIR_b_HTRBV_SelfCalReq.Value
              OUT_VeTAIR_e_HTRBV_Err_Ecu_Value: accessed-variable=VeTAIR_e_HTRBV_Err_Ecu.Value
              OUT_VeTAIR_e_HTRBV_Err_Motor_Value: accessed-variable=VeTAIR_e_HTRBV_Err_Motor.Value
              OUT_VeTAIR_e_HTRBV_Err_Voltage_Value: accessed-variable=VeTAIR_e_HTRBV_Err_Voltage.Value
              OUT_VeTAIR_e_HTRBV_ErrLinCom_Value: accessed-variable=VeTAIR_e_HTRBV_ErrLinCom.Value
              OUT_VeTAIR_e_HTRBV_ErrPosition_Value: accessed-variable=VeTAIR_e_HTRBV_ErrPosition.Value
              OUT_VeTAIR_e_HTRBV_SystemState_Value: accessed-variable=VeTAIR_e_HTRBV_SystemState.Value
              OUT_VeTAIR_Pct_CPV2_PstnAct_Value: accessed-variable=VeTAIR_Pct_CPV2_PstnAct.Value
              OUT_VeTAIR_b_CPV2_PstnAct_FA_Value: accessed-variable=VeTAIR_b_CPV2_PstnAct_FA.Value
              OUT_VeTAIR_b_CPV2_OvrVltg_Value: accessed-variable=VeTAIR_b_CPV2_OvrVltg.Value
              OUT_VeTAIR_b_CPV2_UndrVltg_Value: accessed-variable=VeTAIR_b_CPV2_UndrVltg.Value
              OUT_VeTAIR_b_CPV2_ThrmlWrng_Value: accessed-variable=VeTAIR_b_CPV2_ThrmlWrng.Value
              OUT_VeTAIR_b_CPV2_OpnLd_Value: accessed-variable=VeTAIR_b_CPV2_OpnLd.Value
              OUT_VeTAIR_b_CPV2_OvrCrnt_Value: accessed-variable=VeTAIR_b_CPV2_OvrCrnt.Value
              OUT_VeTAIR_b_CPV2_MechBrk_Value: accessed-variable=VeTAIR_b_CPV2_MechBrk.Value
              OUT_VeTAIR_b_CPV2_BlckPnt_Value: accessed-variable=VeTAIR_b_CPV2_BlckPnt.Value
              OUT_VeTAIR_b_CPV2_Err_SNA_Value: accessed-variable=VeTAIR_b_CPV2_Err_SNA.Value
              OUT_VeTAIR_U_CPV2_MtrVltg_Value: accessed-variable=VeTAIR_U_CPV2_MtrVltg.Value
              OUT_VeTAIR_e_CPV2_ErrSts_Value: accessed-variable=VeTAIR_e_CPV2_ErrSts.Value
              OUT_VeTAIR_b_CPV2_RsErr_Value: accessed-variable=VeTAIR_b_CPV2_RsErr.Value
              OUT_VeTAIR_e_CPV2_CalSts_Value: accessed-variable=VeTAIR_e_CPV2_CalSts.Value
          read-local-variables:
            118 x access:
              RV_FsftTAIR_Pct_HTRBV_ActuatorPosActFA_write_IRV: accessed-variable=FsftTAIR_Pct_HTRBV_ActuatorPosActFA_write_IRV
              RV_PokeTAIR_Pct_HTRBV_ActuatorPosAct_write_IRV: accessed-variable=PokeTAIR_Pct_HTRBV_ActuatorPosAct_write_IRV
              RV_VeTAIF_Pct_CPV_VlvCmd_write_IRV: accessed-variable=VeTAIF_Pct_CPV_VlvCmd_write_IRV
              RV_VeTAIF_Pct_EEXV_VlvCmd_write_IRV: accessed-variable=VeTAIF_Pct_EEXV_VlvCmd_write_IRV
              RV_VeTAIF_Pct_EXV_VlvCmd_write_IRV: accessed-variable=VeTAIF_Pct_EXV_VlvCmd_write_IRV
              RV_VeTAIF_Pct_HTL_BypsVlv_Cmd_write_IRV: accessed-variable=VeTAIF_Pct_HTL_BypsVlv_Cmd_write_IRV
              RV_VeTAIF_Pct_HT_CabVlvCmd_write_IRV: accessed-variable=VeTAIF_Pct_HT_CabVlvCmd_write_IRV
              RV_VeTAIF_Pct_LTR_BypsVlv_Cmd_write_IRV: accessed-variable=VeTAIF_Pct_LTR_BypsVlv_Cmd_write_IRV
              RV_VeTAIF_Pct_OEXV_VlvCmd_write_IRV: accessed-variable=VeTAIF_Pct_OEXV_VlvCmd_write_IRV
              RV_VeTAIF_b_ChlrRfgtShtoff_VlvCmd_IRV: accessed-variable=VeTAIF_b_ChlrRfgtShtoff_VlvCmd_IRV
              RV_VeTAIF_b_DVC_EEXV_Calibration_Start_IRV: accessed-variable=VeTAIF_b_DVC_EEXV_Calibration_Start_IRV
              RV_VeTAIF_b_DVC_EXV_Calibration_Start_IRV: accessed-variable=VeTAIF_b_DVC_EXV_Calibration_Start_IRV
              RV_VeTAIF_b_DVC_OEXV_Calibration_Start_IRV: accessed-variable=VeTAIF_b_DVC_OEXV_Calibration_Start_IRV
              RV_VeTAIF_b_FtRfgtShtoff_VlvCmd_write_IRV: accessed-variable=VeTAIF_b_FtRfgtShtoff_VlvCmd_write_IRV
              RV_VeTAIF_b_HT_Shtoff_VlvCmd_write_IRV: accessed-variable=VeTAIF_b_HT_Shtoff_VlvCmd_write_IRV
              RV_VeTAIF_b_LT_Shtoff_VlvCmd_write_IRV: accessed-variable=VeTAIF_b_LT_Shtoff_VlvCmd_write_IRV
              RV_VeTAIF_e_CPV_VlvCmd_IO_CntrlSt_write_IRV: accessed-variable=VeTAIF_e_CPV_VlvCmd_IO_CntrlSt_write_IRV
              RV_VeTAIF_e_ChlrRfgtShtoff_VlvCmd_IRV: accessed-variable=VeTAIF_e_ChlrRfgtShtoff_VlvCmd_IRV
              RV_VeTAIF_e_DVC_HTCV_Calibration_Start_write_IRV: accessed-variable=VeTAIF_e_DVC_HTCV_Calibration_Start_write_IRV
              RV_VeTAIF_e_EEXV_VlvCmd_IO_CntrlSt_write_IRV: accessed-variable=VeTAIF_e_EEXV_VlvCmd_IO_CntrlSt_write_IRV
              RV_VeTAIF_e_EXV_VlvCmd_IO_CntrlSt_write_IRV: accessed-variable=VeTAIF_e_EXV_VlvCmd_IO_CntrlSt_write_IRV
              RV_VeTAIF_e_FtRfgtShtoff_VlvCmd_IO_CntrlSt_write_IRV: accessed-variable=VeTAIF_e_FtRfgtShtoff_VlvCmd_IO_CntrlSt_write_IRV
              RV_VeTAIF_e_HTL_BypsVlv_IO_CntrlSt_write_IRV: accessed-variable=VeTAIF_e_HTL_BypsVlv_IO_CntrlSt_write_IRV
              RV_VeTAIF_e_HT_CabVlvCmd_IO_CntrlSt_write_IRV: accessed-variable=VeTAIF_e_HT_CabVlvCmd_IO_CntrlSt_write_IRV
              RV_VeTAIF_e_HT_Shtoff_VlvCmd_IO_CntrlSt_write_IRV: accessed-variable=VeTAIF_e_HT_Shtoff_VlvCmd_IO_CntrlSt_write_IRV
              RV_VeTAIF_e_LTR_BypsVlv_IO_CntrlSt_write_IRV: accessed-variable=VeTAIF_e_LTR_BypsVlv_IO_CntrlSt_write_IRV
              RV_VeTAIF_e_LT_Shtoff_VlvCmd_IO_CntrlSt_write_IRV: accessed-variable=VeTAIF_e_LT_Shtoff_VlvCmd_IO_CntrlSt_write_IRV
              RV_VeTAIF_e_OEXV_VlvCmd_IO_CntrlSt_write_IRV: accessed-variable=VeTAIF_e_OEXV_VlvCmd_IO_CntrlSt_write_IRV
              RV_VeTAIR_Pct_CPV2_ActlPstn_write_IRV: accessed-variable=VeTAIR_Pct_CPV2_ActlPstn_write_IRV
              RV_VeTAIR_Pct_EEXV_PosAct_write_IRV: accessed-variable=VeTAIR_Pct_EEXV_PosAct_write_IRV
              RV_VeTAIR_Pct_EXV_PosAct_write_IRV: accessed-variable=VeTAIR_Pct_EXV_PosAct_write_IRV
              RV_VeTAIR_Pct_FrWyVlv_ActlPstn_write_IRV: accessed-variable=VeTAIR_Pct_FrWyVlv_ActlPstn_write_IRV
              RV_VeTAIR_Pct_HTL_BypsVlv_ActlPstn_write_IRV: accessed-variable=VeTAIR_Pct_HTL_BypsVlv_ActlPstn_write_IRV
              RV_VeTAIR_Pct_HTRBV_ActuatorPosTrgt_write_IRV: accessed-variable=VeTAIR_Pct_HTRBV_ActuatorPosTrgt_write_IRV
              RV_VeTAIR_Pct_LTR_BypsVlv_ActlPstn_write_IRV: accessed-variable=VeTAIR_Pct_LTR_BypsVlv_ActlPstn_write_IRV
              RV_VeTAIR_Pct_OEXV_PosAct_write_IRV: accessed-variable=VeTAIR_Pct_OEXV_PosAct_write_IRV
              RV_VeTAIR_T_EEXV_BoardTemp_write_IRV: accessed-variable=VeTAIR_T_EEXV_BoardTemp_write_IRV
              RV_VeTAIR_T_EEXV_RefTemp_write_IRV: accessed-variable=VeTAIR_T_EEXV_RefTemp_write_IRV
              RV_VeTAIR_T_EXV_BoardTemp_write_IRV: accessed-variable=VeTAIR_T_EXV_BoardTemp_write_IRV
              RV_VeTAIR_T_EXV_RefTemp_write_IRV: accessed-variable=VeTAIR_T_EXV_RefTemp_write_IRV
              RV_VeTAIR_T_HTRBV_EcuTemp_write_IRV: accessed-variable=VeTAIR_T_HTRBV_EcuTemp_write_IRV
              RV_VeTAIR_T_OEXV_BoardTemp_write_IRV: accessed-variable=VeTAIR_T_OEXV_BoardTemp_write_IRV
              RV_VeTAIR_T_OEXV_RefTemp_write_IRV: accessed-variable=VeTAIR_T_OEXV_RefTemp_write_IRV
              RV_VeTAIR_U_CPV2_MtrVltg_write_IRV: accessed-variable=VeTAIR_U_CPV2_MtrVltg_write_IRV
              RV_VeTAIR_U_EEXV_SupplyVolt_write_IRV: accessed-variable=VeTAIR_U_EEXV_SupplyVolt_write_IRV
              RV_VeTAIR_U_EXV_SupplyVolt_write_IRV: accessed-variable=VeTAIR_U_EXV_SupplyVolt_write_IRV
              RV_VeTAIR_U_FrWyVlv_MtrVltg_write_IRV: accessed-variable=VeTAIR_U_FrWyVlv_MtrVltg_write_IRV
              RV_VeTAIR_U_HTL_BypsVlv_MtrVltg_write_IRV: accessed-variable=VeTAIR_U_HTL_BypsVlv_MtrVltg_write_IRV
              RV_VeTAIR_U_HTRBV_EcuVoltage_write_IRV: accessed-variable=VeTAIR_U_HTRBV_EcuVoltage_write_IRV
              RV_VeTAIR_U_HT_CabVlvSts_write_IRV: accessed-variable=VeTAIR_U_HT_CabVlvSts_write_IRV
              RV_VeTAIR_U_LTR_BypsVlv_MtrVltg_write_IRV: accessed-variable=VeTAIR_U_LTR_BypsVlv_MtrVltg_write_IRV
              RV_VeTAIR_U_OEXV_SupplyVolt_write_IRV: accessed-variable=VeTAIR_U_OEXV_SupplyVolt_write_IRV
              RV_VeTAIR_b_CPV2_ActlPstnFA_write_IRV: accessed-variable=VeTAIR_b_CPV2_ActlPstnFA_write_IRV
              RV_VeTAIR_b_CPV2_ErrMsgsFA_write_IRV: accessed-variable=VeTAIR_b_CPV2_ErrMsgsFA_write_IRV
              RV_VeTAIR_b_CPV2_RsErr_write_IRV: accessed-variable=VeTAIR_b_CPV2_RsErr_write_IRV
              RV_VeTAIR_b_EEXV_CalRq_write_IRV: accessed-variable=VeTAIR_b_EEXV_CalRq_write_IRV
              RV_VeTAIR_b_EEXV_PosActFA_write_IRV: accessed-variable=VeTAIR_b_EEXV_PosActFA_write_IRV
              RV_VeTAIR_b_EEXV_RefPressFA_write_IRV: accessed-variable=VeTAIR_b_EEXV_RefPressFA_write_IRV
              RV_VeTAIR_b_EEXV_RefTempFA_write_IRV: accessed-variable=VeTAIR_b_EEXV_RefTempFA_write_IRV
              RV_VeTAIR_b_EEXV_RspErr_write_IRV: accessed-variable=VeTAIR_b_EEXV_RspErr_write_IRV
              RV_VeTAIR_b_EXV_CalRq_write_IRV: accessed-variable=VeTAIR_b_EXV_CalRq_write_IRV
              RV_VeTAIR_b_EXV_PosActFA_write_IRV: accessed-variable=VeTAIR_b_EXV_PosActFA_write_IRV
              RV_VeTAIR_b_EXV_RefPressFA_write_IRV: accessed-variable=VeTAIR_b_EXV_RefPressFA_write_IRV
              RV_VeTAIR_b_EXV_RefTempFA_write_IRV: accessed-variable=VeTAIR_b_EXV_RefTempFA_write_IRV
              RV_VeTAIR_b_EXV_RspErr_write_IRV: accessed-variable=VeTAIR_b_EXV_RspErr_write_IRV
              RV_VeTAIR_b_FrWyVlv_ActlPstnFA_write_IRV: accessed-variable=VeTAIR_b_FrWyVlv_ActlPstnFA_write_IRV
              RV_VeTAIR_b_FrWyVlv_ErrMsgsFA_write_IRV: accessed-variable=VeTAIR_b_FrWyVlv_ErrMsgsFA_write_IRV
              RV_VeTAIR_b_FrWyVlv_RsErr_write_IRV: accessed-variable=VeTAIR_b_FrWyVlv_RsErr_write_IRV
              RV_VeTAIR_b_HTL_BypsVlv_ActlPstnFA_write_IRV: accessed-variable=VeTAIR_b_HTL_BypsVlv_ActlPstnFA_write_IRV
              RV_VeTAIR_b_HTL_BypsVlv_CalStsFA_write_IRV: accessed-variable=VeTAIR_b_HTL_BypsVlv_CalStsFA_write_IRV
              RV_VeTAIR_b_HTL_BypsVlv_ErrMsgsFA_write_IRV: accessed-variable=VeTAIR_b_HTL_BypsVlv_ErrMsgsFA_write_IRV
              RV_VeTAIR_b_HTL_BypsVlv_ErrStsFA_write_IRV: accessed-variable=VeTAIR_b_HTL_BypsVlv_ErrStsFA_write_IRV
              RV_VeTAIR_b_HTL_BypsVlv_MtrVltgFA_write_IRV: accessed-variable=VeTAIR_b_HTL_BypsVlv_MtrVltgFA_write_IRV
              RV_VeTAIR_b_HTL_BypsVlv_RsErr_write_IRV: accessed-variable=VeTAIR_b_HTL_BypsVlv_RsErr_write_IRV
              RV_VeTAIR_b_HTRBV_ResponseError_write_IRV: accessed-variable=VeTAIR_b_HTRBV_ResponseError_write_IRV
              RV_VeTAIR_b_HTRBV_SelfCalReq_write_IRV: accessed-variable=VeTAIR_b_HTRBV_SelfCalReq_write_IRV
              RV_VeTAIR_b_HT_CabVlvStsFA_write_IRV: accessed-variable=VeTAIR_b_HT_CabVlvStsFA_write_IRV
              RV_VeTAIR_b_LTR_BypsVlv_ActlPstnFA_write_IRV: accessed-variable=VeTAIR_b_LTR_BypsVlv_ActlPstnFA_write_IRV
              RV_VeTAIR_b_LTR_BypsVlv_CalStsFA_write_IRV: accessed-variable=VeTAIR_b_LTR_BypsVlv_CalStsFA_write_IRV
              RV_VeTAIR_b_LTR_BypsVlv_ErrMsgsFA_write_IRV: accessed-variable=VeTAIR_b_LTR_BypsVlv_ErrMsgsFA_write_IRV
              RV_VeTAIR_b_LTR_BypsVlv_ErrStsFA_write_IRV: accessed-variable=VeTAIR_b_LTR_BypsVlv_ErrStsFA_write_IRV
              RV_VeTAIR_b_LTR_BypsVlv_MtrVltgFA_write_IRV: accessed-variable=VeTAIR_b_LTR_BypsVlv_MtrVltgFA_write_IRV
              RV_VeTAIR_b_LTR_BypsVlv_RsErr_write_IRV: accessed-variable=VeTAIR_b_LTR_BypsVlv_RsErr_write_IRV
              RV_VeTAIR_b_OEXV_CalRq_write_IRV: accessed-variable=VeTAIR_b_OEXV_CalRq_write_IRV
              RV_VeTAIR_b_OEXV_PosActFA_write_IRV: accessed-variable=VeTAIR_b_OEXV_PosActFA_write_IRV
              RV_VeTAIR_b_OEXV_RefPressFA_write_IRV: accessed-variable=VeTAIR_b_OEXV_RefPressFA_write_IRV
              RV_VeTAIR_b_OEXV_RefTempFA_write_IRV: accessed-variable=VeTAIR_b_OEXV_RefTempFA_write_IRV
              RV_VeTAIR_b_OEXV_RspErr_write_IRV: accessed-variable=VeTAIR_b_OEXV_RspErr_write_IRV
              RV_VeTAIR_e_CPV2_CalSts_write_IRV: accessed-variable=VeTAIR_e_CPV2_CalSts_write_IRV
              RV_VeTAIR_e_CPV2_ErrSts_write_IRV: accessed-variable=VeTAIR_e_CPV2_ErrSts_write_IRV
              RV_VeTAIR_e_EEXV_CalStat_write_IRV: accessed-variable=VeTAIR_e_EEXV_CalStat_write_IRV
              RV_VeTAIR_e_EEXV_Err_write_IRV: accessed-variable=VeTAIR_e_EEXV_Err_write_IRV
              RV_VeTAIR_e_EEXV_Sts_write_IRV: accessed-variable=VeTAIR_e_EEXV_Sts_write_IRV
              RV_VeTAIR_e_EXV_CalStat_write_IRV: accessed-variable=VeTAIR_e_EXV_CalStat_write_IRV
              RV_VeTAIR_e_EXV_Err_write_IRV: accessed-variable=VeTAIR_e_EXV_Err_write_IRV
              RV_VeTAIR_e_EXV_Sts_write_IRV: accessed-variable=VeTAIR_e_EXV_Sts_write_IRV
              RV_VeTAIR_e_FrWyVlv_CalSts_write_IRV: accessed-variable=VeTAIR_e_FrWyVlv_CalSts_write_IRV
              RV_VeTAIR_e_FrWyVlv_ErrSts_write_IRV: accessed-variable=VeTAIR_e_FrWyVlv_ErrSts_write_IRV
              RV_VeTAIR_e_HTL_BypsVlv_CalSts_write_IRV: accessed-variable=VeTAIR_e_HTL_BypsVlv_CalSts_write_IRV
              RV_VeTAIR_e_HTL_BypsVlv_ErrSts_write_IRV: accessed-variable=VeTAIR_e_HTL_BypsVlv_ErrSts_write_IRV
              RV_VeTAIR_e_HTRBV_ErrLinCom_write_IRV: accessed-variable=VeTAIR_e_HTRBV_ErrLinCom_write_IRV
              RV_VeTAIR_e_HTRBV_ErrPosition_write_IRV: accessed-variable=VeTAIR_e_HTRBV_ErrPosition_write_IRV
              RV_VeTAIR_e_HTRBV_Err_Ecu_write_IRV: accessed-variable=VeTAIR_e_HTRBV_Err_Ecu_write_IRV
              RV_VeTAIR_e_HTRBV_Err_Motor_write_IRV: accessed-variable=VeTAIR_e_HTRBV_Err_Motor_write_IRV
              RV_VeTAIR_e_HTRBV_Err_Voltage_write_IRV: accessed-variable=VeTAIR_e_HTRBV_Err_Voltage_write_IRV
              RV_VeTAIR_e_HTRBV_SystemState_write_IRV: accessed-variable=VeTAIR_e_HTRBV_SystemState_write_IRV
              RV_VeTAIR_e_LTR_BypsVlv_CalSts_write_IRV: accessed-variable=VeTAIR_e_LTR_BypsVlv_CalSts_write_IRV
              RV_VeTAIR_e_LTR_BypsVlv_ErrSts_write_IRV: accessed-variable=VeTAIR_e_LTR_BypsVlv_ErrSts_write_IRV
              RV_VeTAIR_e_OEXV_CalStat_write_IRV: accessed-variable=VeTAIR_e_OEXV_CalStat_write_IRV
              RV_VeTAIR_e_OEXV_Err_write_IRV: accessed-variable=VeTAIR_e_OEXV_Err_write_IRV
              RV_VeTAIR_e_OEXV_Sts_write_IRV: accessed-variable=VeTAIR_e_OEXV_Sts_write_IRV
              RV_VeTAIR_kp_EXV_RefPress_write_IRV: accessed-variable=VeTAIR_kp_EXV_RefPress_write_IRV
              RV_VeTAIR_p_EEXV_RefPress_write_IRV: accessed-variable=VeTAIR_p_EEXV_RefPress_write_IRV
              RV_VeTAIR_p_OEXV_RefPress_write_IRV: accessed-variable=VeTAIR_p_OEXV_RefPress_write_IRV
              RV_VeTAIR_y_CPV2_ErrMsgs_write_IRV: accessed-variable=VeTAIR_y_CPV2_ErrMsgs_write_IRV
              RV_VeTAIR_y_FrWyVlv_ErrMsgs_write_IRV: accessed-variable=VeTAIR_y_FrWyVlv_ErrMsgs_write_IRV
              RV_VeTAIR_y_HTL_BypsVlv_ErrMsgs_write_IRV: accessed-variable=VeTAIR_y_HTL_BypsVlv_ErrMsgs_write_IRV
              RV_VeTAIR_y_LTR_BypsVlv_ErrMsgs_write_IRV: accessed-variable=VeTAIR_y_LTR_BypsVlv_ErrMsgs_write_IRV
        TAIR_MedTEH
          data-receive-point-by-arguments:
            5 x access:
              IN_VePLTR_b_RadFanHndShk_dsbld_Value: accessed-variable=VePLTR_b_RadFanHndShk_dsbld.Value
              IN_VeTAIB_Pct_RadFanSts_DC_Value: accessed-variable=VeTAIB_Pct_RadFanSts_DC.Value
              IN_VeTAIB_b_HghRfrgtPresSnsr_FA_Value: accessed-variable=VeTAIB_b_HghRfrgtPresSnsr_FA.Value
              IN_VeTAIB_b_RadFan_FA_Value: accessed-variable=VeTAIB_b_RadFan_FA.Value
              IN_VeTAIB_p_HghRfrgtPresSnsr_Value: accessed-variable=VeTAIB_p_HghRfrgtPresSnsr.Value
          data-send-points:
            83 x access:
              OUT_VeTAIR_Pct_ECM_RadFanReq_Value: accessed-variable=VeTAIR_Pct_ECM_RadFanReq.Value
              OUT_VeTAIR_Pct_RadFanSts_Value: accessed-variable=VeTAIR_Pct_RadFanSts.Value
              OUT_VeTAIR_b_RadFanSts_FA_Value: accessed-variable=VeTAIR_b_RadFanSts_FA.Value
              OUT_VeTAIR_e_RadFab_IO_Cnt_Value: accessed-variable=VeTAIR_e_RadFab_IO_Cnt.Value
              OUT_VeTAIR_Pct_DVC_RadFanCmd_Value: accessed-variable=VeTAIR_Pct_DVC_RadFanCmd.Value
              OUT_VeTAIR_b_RadFanHndShk_dsbld_Value: accessed-variable=VeTAIR_b_RadFanHndShk_dsbld.Value
              OUT_VeTAIR_Pct_ECM_AirflowRequest_Value: accessed-variable=VeTAIR_Pct_ECM_AirflowRequest.Value
              OUT_VeTAIR_b_ECM_AirflowRequestFA_Value: accessed-variable=VeTAIR_b_ECM_AirflowRequestFA.Value
              OUT_VeTAIR_n_CompSpdFdb_Value: accessed-variable=VeTAIR_n_CompSpdFdb.Value
              OUT_VeTAIR_b_CompSpdFdb_FA_Value: accessed-variable=VeTAIR_b_CompSpdFdb_FA.Value
              OUT_VeTAIR_P_AC_CompElecPwr_Value: accessed-variable=VeTAIR_P_AC_CompElecPwr.Value
              OUT_VeTAIR_b_AC_CompElecPwr_FA_Value: accessed-variable=VeTAIR_b_AC_CompElecPwr_FA.Value
              OUT_VeTAIR_p_HghRfrgtPres_Value: accessed-variable=VeTAIR_p_HghRfrgtPres.Value
              OUT_VeTAIR_b_HghRfrgtPres_FA_Value: accessed-variable=VeTAIR_b_HghRfrgtPres_FA.Value
              OUT_VeTAIR_e_CompStat_Value: accessed-variable=VeTAIR_e_CompStat.Value
              OUT_VeTAIR_e_CompFltStat_Value: accessed-variable=VeTAIR_e_CompFltStat.Value
              OUT_VeTAIR_b_CompSpdIncrReq_Value: accessed-variable=VeTAIR_b_CompSpdIncrReq.Value
              OUT_VeTAIR_I_ACCElecCurr_Value: accessed-variable=VeTAIR_I_ACCElecCurr.Value
              OUT_VeTAIR_U_CompHVInp_Value: accessed-variable=VeTAIR_U_CompHVInp.Value
              OUT_VeTAIR_b_CompHVInp_FA_Value: accessed-variable=VeTAIR_b_CompHVInp_FA.Value
              OUT_VeTAIR_b_ACCompReq_Value: accessed-variable=VeTAIR_b_ACCompReq.Value
              OUT_VeTAIR_T_CompBoardTemp_Value: accessed-variable=VeTAIR_T_CompBoardTemp.Value
              OUT_VeTAIR_b_CompBoardTemp_FA_Value: accessed-variable=VeTAIR_b_CompBoardTemp_FA.Value
              OUT_VeTAIR_T_CompIGBTTemp_Value: accessed-variable=VeTAIR_T_CompIGBTTemp.Value
              OUT_VeTAIR_b_CompIGBTTemp_FA_Value: accessed-variable=VeTAIR_b_CompIGBTTemp_FA.Value
              OUT_VeTAIR_T_FtEvapTmp_Value: accessed-variable=VeTAIR_T_FtEvapTmp.Value
              OUT_VeTAIR_b_FtEvapTmp_FA_Value: accessed-variable=VeTAIR_b_FtEvapTmp_FA.Value
              OUT_VeTAIR_T_FtEvapTmp_Tgt_Value: accessed-variable=VeTAIR_T_FtEvapTmp_Tgt.Value
              OUT_VeTAIR_b_FtEvapTmp_TgtFA_Value: accessed-variable=VeTAIR_b_FtEvapTmp_TgtFA.Value
              OUT_VeTAIR_Pct_RrBlwrCmd_Value: accessed-variable=VeTAIR_Pct_RrBlwrCmd.Value
              OUT_VeTAIR_Pct_FrtBlwrCmd_Value: accessed-variable=VeTAIR_Pct_FrtBlwrCmd.Value
              OUT_VeTAIR_b_FrtBlwrCmd_FA_Value: accessed-variable=VeTAIR_b_FrtBlwrCmd_FA.Value
              OUT_VeTAIR_T_VhIntTmp_Value: accessed-variable=VeTAIR_T_VhIntTmp.Value
              OUT_VeTAIR_b_VhIntTmp_FA_Value: accessed-variable=VeTAIR_b_VhIntTmp_FA.Value
              OUT_VeTAIR_T_HtrCoreTmp_Tgt_Value: accessed-variable=VeTAIR_T_HtrCoreTmp_Tgt.Value
              OUT_VeTAIR_e_CompSpdTgt_IO_CntrlSt_Value: accessed-variable=VeTAIR_e_CompSpdTgt_IO_CntrlSt.Value
              OUT_VeTAIR_n_DVC_CompSpdTgt_Value: accessed-variable=VeTAIR_n_DVC_CompSpdTgt.Value
              OUT_VeTAIR_b_WinshldDfrst_Value: accessed-variable=VeTAIR_b_WinshldDfrst.Value
              OUT_VeTAIR_I_HVAC_Cabin_CurrentReq_Value: accessed-variable=VeTAIR_I_HVAC_Cabin_CurrentReq.Value
              OUT_VeTAIR_b_HVAC_Cabin_CurrentReqFA_Value: accessed-variable=VeTAIR_b_HVAC_Cabin_CurrentReqFA.Value
              OUT_VeTAIR_I_HVAC_ECVD_CurrentAct_Value: accessed-variable=VeTAIR_I_HVAC_ECVD_CurrentAct.Value
              OUT_VeTAIR_b_HVAC_ECVD_CurrentActFA_Value: accessed-variable=VeTAIR_b_HVAC_ECVD_CurrentActFA.Value
              OUT_VeTAIR_e_ECM_AC_ClutchSts_Value: accessed-variable=VeTAIR_e_ECM_AC_ClutchSts.Value
              OUT_VeTAIR_b_ECM_AC_ClutchStsFA_Value: accessed-variable=VeTAIR_b_ECM_AC_ClutchStsFA.Value
              OUT_VeTAIR_b_HghRfrgtPresFailSts_Value: accessed-variable=VeTAIR_b_HghRfrgtPresFailSts.Value
              OUT_VeTAIR_b_AGS_BoostSts_Value: accessed-variable=VeTAIR_b_AGS_BoostSts.Value
              OUT_VeTAIR_b_AGS_CalibrationActv_Value: accessed-variable=VeTAIR_b_AGS_CalibrationActv.Value
              OUT_VeTAIR_b_AGS_ErrMechBreak_Value: accessed-variable=VeTAIR_b_AGS_ErrMechBreak.Value
              OUT_VeTAIR_b_AGS_ErrMechStuck_Value: accessed-variable=VeTAIR_b_AGS_ErrMechStuck.Value
              OUT_VeTAIR_b_AGS_ErrOverTemp_Value: accessed-variable=VeTAIR_b_AGS_ErrOverTemp.Value
              OUT_VeTAIR_b_AGS_ErrOverVolt_Value: accessed-variable=VeTAIR_b_AGS_ErrOverVolt.Value
              OUT_VeTAIR_b_AGS_ErrFdbFA_Value: accessed-variable=VeTAIR_b_AGS_ErrFdbFA.Value
              OUT_VeTAIR_e_AGS_ErrFdb_Value: accessed-variable=VeTAIR_e_AGS_ErrFdb.Value
              OUT_VeTAIR_b_AGS_CurrPosFA_Value: accessed-variable=VeTAIR_b_AGS_CurrPosFA.Value
              OUT_VeTAIR_Pct_AGS_CurrPos_Value: accessed-variable=VeTAIR_Pct_AGS_CurrPos.Value
              OUT_VeTAIR_b_AGS_ResErr_Value: accessed-variable=VeTAIR_b_AGS_ResErr.Value
              OUT_VeTAIR_b_AGS_ErrUnderVolt_Value: accessed-variable=VeTAIR_b_AGS_ErrUnderVolt.Value
              OUT_VeTAIR_e_AGS_CalibrationSts_Value: accessed-variable=VeTAIR_e_AGS_CalibrationSts.Value
              OUT_VeTAIR_b_AGS2_BoostSts_Value: accessed-variable=VeTAIR_b_AGS2_BoostSts.Value
              OUT_VeTAIR_b_AGS2_CalibrationActv_Value: accessed-variable=VeTAIR_b_AGS2_CalibrationActv.Value
              OUT_VeTAIR_b_AGS2_ErrMechBreak_Value: accessed-variable=VeTAIR_b_AGS2_ErrMechBreak.Value
              OUT_VeTAIR_b_AGS2_ErrMechStuck_Value: accessed-variable=VeTAIR_b_AGS2_ErrMechStuck.Value
              OUT_VeTAIR_b_AGS2_ErrOverTemp_Value: accessed-variable=VeTAIR_b_AGS2_ErrOverTemp.Value
              OUT_VeTAIR_b_AGS2_ErrOverVolt_Value: accessed-variable=VeTAIR_b_AGS2_ErrOverVolt.Value
              OUT_VeTAIR_b_AGS2_ErrFdbFA_Value: accessed-variable=VeTAIR_b_AGS2_ErrFdbFA.Value
              OUT_VeTAIR_e_AGS2_ErrFdb_Value: accessed-variable=VeTAIR_e_AGS2_ErrFdb.Value
              OUT_VeTAIR_b_AGS2_CurrPosFA_Value: accessed-variable=VeTAIR_b_AGS2_CurrPosFA.Value
              OUT_VeTAIR_Pct_AGS2_CurrPos_Value: accessed-variable=VeTAIR_Pct_AGS2_CurrPos.Value
              OUT_VeTAIR_b_AGS2_ResErr_Value: accessed-variable=VeTAIR_b_AGS2_ResErr.Value
              OUT_VeTAIR_b_AGS2_ErrUnderVolt_Value: accessed-variable=VeTAIR_b_AGS2_ErrUnderVolt.Value
              OUT_VeTAIR_e_AGS2_CalibrationSts_Value: accessed-variable=VeTAIR_e_AGS2_CalibrationSts.Value
              OUT_VeTAIR_e_AGS2_CurrPos_Value: accessed-variable=VeTAIR_e_AGS2_CurrPos.Value
              OUT_VeTAIR_e_AGS_CurrPos_Value: accessed-variable=VeTAIR_e_AGS_CurrPos.Value
              OUT_VeTAIR_e_AGS_IO_CntrlSt_Value: accessed-variable=VeTAIR_e_AGS_IO_CntrlSt.Value
              OUT_VeTAIR_e_AGS_PstnCmnd_Value: accessed-variable=VeTAIR_e_AGS_PstnCmnd.Value
              OUT_VeTAIR_b_DVC_AGS_Calibration_Start_Value: accessed-variable=VeTAIR_b_DVC_AGS_Calibration_Start.Value
              OUT_VeTAIR_e_AGS2_IO_CntrlSt_Value: accessed-variable=VeTAIR_e_AGS2_IO_CntrlSt.Value
              OUT_VeTAIR_e_AGS2_PstnCmnd_Value: accessed-variable=VeTAIR_e_AGS2_PstnCmnd.Value
              OUT_VeTAIR_b_DVC_AGS2_Calibration_Start_Value: accessed-variable=VeTAIR_b_DVC_AGS2_Calibration_Start.Value
              OUT_VeTAIR_e_RearDefrostSts_Value: accessed-variable=VeTAIR_e_RearDefrostSts.Value
              OUT_VeTAIR_b_RearDefrostStsFA_Value: accessed-variable=VeTAIR_b_RearDefrostStsFA.Value
              OUT_VeTAIR_y_RearCabinFanSts_Value: accessed-variable=VeTAIR_y_RearCabinFanSts.Value
              OUT_VeTAIR_b_RearCabinFanStsFA_Value: accessed-variable=VeTAIR_b_RearCabinFanStsFA.Value
          read-local-variables:
            81 x access:
              RV_VeTAIF_Pct_RadFanCmd_write_IRV: accessed-variable=VeTAIF_Pct_RadFanCmd_write_IRV
              RV_VeTAIF_b_DVC_AGS1_Calibration_Start_write_IRV: accessed-variable=VeTAIF_b_DVC_AGS1_Calibration_Start_write_IRV
              RV_VeTAIF_b_DVC_AGS2_Calibration_Start_write_IRV: accessed-variable=VeTAIF_b_DVC_AGS2_Calibration_Start_write_IRV
              RV_VeTAIF_e_AGS2_IO_CntrlSt_write_IRV: accessed-variable=VeTAIF_e_AGS2_IO_CntrlSt_write_IRV
              RV_VeTAIF_e_AGS2_PstnCmnd_write_IRV: accessed-variable=VeTAIF_e_AGS2_PstnCmnd_write_IRV
              RV_VeTAIF_e_AGS_IO_CntrlSt_write_IRV: accessed-variable=VeTAIF_e_AGS_IO_CntrlSt_write_IRV
              RV_VeTAIF_e_AGS_PstnCmnd_write_IRV: accessed-variable=VeTAIF_e_AGS_PstnCmnd_write_IRV
              RV_VeTAIF_e_CompSpdTgt_IO_CntrlSt_write_IRV: accessed-variable=VeTAIF_e_CompSpdTgt_IO_CntrlSt_write_IRV
              RV_VeTAIF_e_RadFanCmd_IO_CntrlSt_write_IRV: accessed-variable=VeTAIF_e_RadFanCmd_IO_CntrlSt_write_IRV
              RV_VeTAIF_n_CompSpdTgt_write_IRV: accessed-variable=VeTAIF_n_CompSpdTgt_write_IRV
              RV_VeTAIR_I_ACCElecCurr_write_IRV: accessed-variable=VeTAIR_I_ACCElecCurr_write_IRV
              RV_VeTAIR_I_ECVD_HVACCabinReq_write_IRV: accessed-variable=VeTAIR_I_ECVD_HVACCabinReq_write_IRV
              RV_VeTAIR_I_ECVD_HVACCurrentAct_write_IRV: accessed-variable=VeTAIR_I_ECVD_HVACCurrentAct_write_IRV
              RV_VeTAIR_P_ACCompElec_Pwr_write_IRV: accessed-variable=VeTAIR_P_ACCompElec_Pwr_write_IRV
              RV_VeTAIR_Pct_AGS2_CurrPos_CAN_write_IRV: accessed-variable=VeTAIR_Pct_AGS2_CurrPos_CAN_write_IRV
              RV_VeTAIR_Pct_AGS_CurrPos_CAN_write_IRV: accessed-variable=VeTAIR_Pct_AGS_CurrPos_CAN_write_IRV
              RV_VeTAIR_Pct_ECM_AirflowRequest_write_IRV: accessed-variable=VeTAIR_Pct_ECM_AirflowRequest_write_IRV
              RV_VeTAIR_Pct_ECM_RadFanReq_write_IRV: accessed-variable=VeTAIR_Pct_ECM_RadFanReq_write_IRV
              RV_VeTAIR_Pct_FrtBlwrCmd_write_IRV: accessed-variable=VeTAIR_Pct_FrtBlwrCmd_write_IRV
              RV_VeTAIR_Pct_RrBlwrCmd_write_IRV: accessed-variable=VeTAIR_Pct_RrBlwrCmd_write_IRV
              RV_VeTAIR_T_CompBoardTemp_write_IRV: accessed-variable=VeTAIR_T_CompBoardTemp_write_IRV
              RV_VeTAIR_T_CompIGBTTemp_write_IRV: accessed-variable=VeTAIR_T_CompIGBTTemp_write_IRV
              RV_VeTAIR_T_FtEvapTmp_P1C_write_IRV: accessed-variable=VeTAIR_T_FtEvapTmp_P1C_write_IRV
              RV_VeTAIR_T_FtEvapTmp_Tgt_write_IRV: accessed-variable=VeTAIR_T_FtEvapTmp_Tgt_write_IRV
              RV_VeTAIR_T_FtEvapTmp_write_IRV: accessed-variable=VeTAIR_T_FtEvapTmp_write_IRV
              RV_VeTAIR_T_HtrCoreTmp_Tgt_write_IRV: accessed-variable=VeTAIR_T_HtrCoreTmp_Tgt_write_IRV
              RV_VeTAIR_T_VhIntTmp_write_IRV: accessed-variable=VeTAIR_T_VhIntTmp_write_IRV
              RV_VeTAIR_U_CompHVInput_write_IRV: accessed-variable=VeTAIR_U_CompHVInput_write_IRV
              RV_VeTAIR_b_ACCompElec_PwrFA_write_IRV: accessed-variable=VeTAIR_b_ACCompElec_PwrFA_write_IRV
              RV_VeTAIR_b_ACCompReq_write_IRV: accessed-variable=VeTAIR_b_ACCompReq_write_IRV
              RV_VeTAIR_b_AGS2_BoostSts_write_IRV: accessed-variable=VeTAIR_b_AGS2_BoostSts_write_IRV
              RV_VeTAIR_b_AGS2_CalibrationActv_write_IRV: accessed-variable=VeTAIR_b_AGS2_CalibrationActv_write_IRV
              RV_VeTAIR_b_AGS2_CurrPosFA_write_IRV: accessed-variable=VeTAIR_b_AGS2_CurrPosFA_write_IRV
              RV_VeTAIR_b_AGS2_ErrFdbFA_write_IRV: accessed-variable=VeTAIR_b_AGS2_ErrFdbFA_write_IRV
              RV_VeTAIR_b_AGS2_ErrMechBreak_write_IRV: accessed-variable=VeTAIR_b_AGS2_ErrMechBreak_write_IRV
              RV_VeTAIR_b_AGS2_ErrMechStuck_write_IRV: accessed-variable=VeTAIR_b_AGS2_ErrMechStuck_write_IRV
              RV_VeTAIR_b_AGS2_ErrOverTemp_write_IRV: accessed-variable=VeTAIR_b_AGS2_ErrOverTemp_write_IRV
              RV_VeTAIR_b_AGS2_ErrOverVolt_write_IRV: accessed-variable=VeTAIR_b_AGS2_ErrOverVolt_write_IRV
              RV_VeTAIR_b_AGS2_ErrUnderVolt_write_IRV: accessed-variable=VeTAIR_b_AGS2_ErrUnderVolt_write_IRV
              RV_VeTAIR_b_AGS2_ResErr_write_IRV: accessed-variable=VeTAIR_b_AGS2_ResErr_write_IRV
              RV_VeTAIR_b_AGS_BoostSts_write_IRV: accessed-variable=VeTAIR_b_AGS_BoostSts_write_IRV
              RV_VeTAIR_b_AGS_CalibrationActv_write_IRV: accessed-variable=VeTAIR_b_AGS_CalibrationActv_write_IRV
              RV_VeTAIR_b_AGS_CurrPosFA_write_IRV: accessed-variable=VeTAIR_b_AGS_CurrPosFA_write_IRV
              RV_VeTAIR_b_AGS_ErrFdbFA_write_IRV: accessed-variable=VeTAIR_b_AGS_ErrFdbFA_write_IRV
              RV_VeTAIR_b_AGS_ErrMechBreak_write_IRV: accessed-variable=VeTAIR_b_AGS_ErrMechBreak_write_IRV
              RV_VeTAIR_b_AGS_ErrMechStuck_write_IRV: accessed-variable=VeTAIR_b_AGS_ErrMechStuck_write_IRV
              RV_VeTAIR_b_AGS_ErrOverTemp_write_IRV: accessed-variable=VeTAIR_b_AGS_ErrOverTemp_write_IRV
              RV_VeTAIR_b_AGS_ErrOverVolt_write_IRV: accessed-variable=VeTAIR_b_AGS_ErrOverVolt_write_IRV
              RV_VeTAIR_b_AGS_ErrUnderVolt_write_IRV: accessed-variable=VeTAIR_b_AGS_ErrUnderVolt_write_IRV
              RV_VeTAIR_b_AGS_ResErr_write_IRV: accessed-variable=VeTAIR_b_AGS_ResErr_write_IRV
              RV_VeTAIR_b_CompBoardTempFA_write_IRV: accessed-variable=VeTAIR_b_CompBoardTempFA_write_IRV
              RV_VeTAIR_b_CompHVInputFA_write_IRV: accessed-variable=VeTAIR_b_CompHVInputFA_write_IRV
              RV_VeTAIR_b_CompIGBTTempFA_write_IRV: accessed-variable=VeTAIR_b_CompIGBTTempFA_write_IRV
              RV_VeTAIR_b_CompSpdFdbFA_write_IRV: accessed-variable=VeTAIR_b_CompSpdFdbFA_write_IRV
              RV_VeTAIR_b_CompSpdIncrReq_write_IRV: accessed-variable=VeTAIR_b_CompSpdIncrReq_write_IRV
              RV_VeTAIR_b_EBL_StatFA_write_IRV: accessed-variable=VeTAIR_b_EBL_StatFA_write_IRV
              RV_VeTAIR_b_ECM_AC_ClutchStsFA_write_IRV: accessed-variable=VeTAIR_b_ECM_AC_ClutchStsFA_write_IRV
              RV_VeTAIR_b_ECM_AirflowRequestFA_write_IRV: accessed-variable=VeTAIR_b_ECM_AirflowRequestFA_write_IRV
              RV_VeTAIR_b_ECM_RadFanReqFA_write_IRV: accessed-variable=VeTAIR_b_ECM_RadFanReqFA_write_IRV
              RV_VeTAIR_b_ECVD_HVACCabinReqFA_write_IRV: accessed-variable=VeTAIR_b_ECVD_HVACCabinReqFA_write_IRV
              RV_VeTAIR_b_ECVD_HVACCurrentActFA_write_IRV: accessed-variable=VeTAIR_b_ECVD_HVACCurrentActFA_write_IRV
              RV_VeTAIR_b_FrtBlwrCmdFA_write_IRV: accessed-variable=VeTAIR_b_FrtBlwrCmdFA_write_IRV
              RV_VeTAIR_b_FtEvapTmpFA_write_IRV: accessed-variable=VeTAIR_b_FtEvapTmpFA_write_IRV
              RV_VeTAIR_b_FtEvapTmp_P1CFA_write_IRV: accessed-variable=VeTAIR_b_FtEvapTmp_P1CFA_write_IRV
              RV_VeTAIR_b_FtEvapTmp_TgtFA_write_IRV: accessed-variable=VeTAIR_b_FtEvapTmp_TgtFA_write_IRV
              RV_VeTAIR_b_HghRfrgtPresFailStsFA_write_IRV: accessed-variable=VeTAIR_b_HghRfrgtPresFailStsFA_write_IRV
              RV_VeTAIR_b_RearCabinFanStsFA_write_IRV: accessed-variable=VeTAIR_b_RearCabinFanStsFA_write_IRV
              RV_VeTAIR_b_VhIntTmpFA_write_IRV: accessed-variable=VeTAIR_b_VhIntTmpFA_write_IRV
              RV_VeTAIR_b_WinshldDfrst_write_IRV: accessed-variable=VeTAIR_b_WinshldDfrst_write_IRV
              RV_VeTAIR_e_AGS2_CalibrationSts_write_IRV: accessed-variable=VeTAIR_e_AGS2_CalibrationSts_write_IRV
              RV_VeTAIR_e_AGS2_CurrPos_write_IRV: accessed-variable=VeTAIR_e_AGS2_CurrPos_write_IRV
              RV_VeTAIR_e_AGS2_ErrFdb_write_IRV: accessed-variable=VeTAIR_e_AGS2_ErrFdb_write_IRV
              RV_VeTAIR_e_AGS_CalibrationSts_write_IRV: accessed-variable=VeTAIR_e_AGS_CalibrationSts_write_IRV
              RV_VeTAIR_e_AGS_CurrPos_write_IRV: accessed-variable=VeTAIR_e_AGS_CurrPos_write_IRV
              RV_VeTAIR_e_AGS_ErrFdb_write_IRV: accessed-variable=VeTAIR_e_AGS_ErrFdb_write_IRV
              RV_VeTAIR_e_CompFltStat_write_IRV: accessed-variable=VeTAIR_e_CompFltStat_write_IRV
              RV_VeTAIR_e_CompStat_write_IRV: accessed-variable=VeTAIR_e_CompStat_write_IRV
              RV_VeTAIR_e_ECM_AC_ClutchSts_write_IRV: accessed-variable=VeTAIR_e_ECM_AC_ClutchSts_write_IRV
              RV_VeTAIR_e_RearDefrostSts_write_IRV: accessed-variable=VeTAIR_e_RearDefrostSts_write_IRV
              RV_VeTAIR_n_CompSpdFdb_write_IRV: accessed-variable=VeTAIR_n_CompSpdFdb_write_IRV
              RV_VeTAIR_y_RearCabinFanSts_write_IRV: accessed-variable=VeTAIR_y_RearCabinFanSts_write_IRV
        Routine_RC130D_EXVValCal
          data-receive-point-by-arguments:
            access IN_VeDCAB_e_Routine_RC130D_EXVValCal_Op_Value: accessed-variable=VeDCAB_e_Routine_RC130D_EXVValCal_Op.Value
          written-local-variables:
            access WV_VeTAIF_b_DVC_EXV_Calibration_Start_IRV: accessed-variable=VeTAIF_b_DVC_EXV_Calibration_Start_IRV
        Routine_RC1333_ACRefExpValActDCal
          data-receive-point-by-arguments:
            access IN_VeDCAB_e_Routine_RC1333_ACRefExpValActDCal_Op_Value: accessed-variable=VeDCAB_e_Routine_RC1333_ACRefExpValActDCal_Op.Value
          written-local-variables:
            access WV_VeTAIF_b_DVC_OEXV_Calibration_Start_IRV: accessed-variable=VeTAIF_b_DVC_OEXV_Calibration_Start_IRV
        Routine_RC1332_ACRefExpValActCCal
          data-receive-point-by-arguments:
            access IN_VeDCAB_e_Routine_RC1332_ACRefExpValActCCal_Op_Value: accessed-variable=VeDCAB_e_Routine_RC1332_ACRefExpValActCCal_Op.Value
          written-local-variables:
            access WV_VeTAIF_b_DVC_EEXV_Calibration_Start_IRV: accessed-variable=VeTAIF_b_DVC_EEXV_Calibration_Start_IRV
        IOControl_IOCD001_HigTemShuVal
          data-receive-point-by-arguments:
            access IN_VeDCAB_b_IOCD001_HigTemShuVal_Value: accessed-variable=VeDCAB_b_IOCD001_HigTemShuVal.Value
            access IN_VeDCAB_e_IOControl_IOCD001_HigTemShuVal_Op_Value: accessed-variable=VeDCAB_e_IOControl_IOCD001_HigTemShuVal_Op.Value
          written-local-variables:
            access WV_VeTAIF_b_HT_Shtoff_VlvCmd_write_IRV: accessed-variable=VeTAIF_b_HT_Shtoff_VlvCmd_write_IRV
            access WV_VeTAIF_e_HT_Shtoff_VlvCmd_IO_CntrlSt_write_IRV: accessed-variable=VeTAIF_e_HT_Shtoff_VlvCmd_IO_CntrlSt_write_IRV
        IOControl_IOCD004_RadFanDutCycle
          data-receive-point-by-arguments:
            access IN_VeDCAB_Pct_IOCD004_RadFanDutCycle_Value: accessed-variable=VeDCAB_Pct_IOCD004_RadFanDutCycle.Value
            access IN_VeDCAB_e_IOControl_IOCD004_RadFanDutCycle_Op_Value: accessed-variable=VeDCAB_e_IOControl_IOCD004_RadFanDutCycle_Op.Value
          written-local-variables:
            access WV_VeTAIF_Pct_RadFanCmd_write_IRV: accessed-variable=VeTAIF_Pct_RadFanCmd_write_IRV
            access WV_VeTAIF_e_RadFanCmd_IO_CntrlSt_write_IRV: accessed-variable=VeTAIF_e_RadFanCmd_IO_CntrlSt_write_IRV
        IOControl_IOCDOIC_PropSysCoolCntrlValvA
          data-receive-point-by-arguments:
            access IN_VeDCAB_Pct_IOCDOIC_PropSysCoolCntrlValvA_Value: accessed-variable=VeDCAB_Pct_IOCDOIC_PropSysCoolCntrlValvA.Value
            access IN_VeDCAB_e_IOControl_IOCDOIC_PropSysCoolCntrlValvA_Op_Value: accessed-variable=VeDCAB_e_IOControl_IOCDOIC_PropSysCoolCntrlValvA_Op.Value
          written-local-variables:
            access WV_VeTAIF_Pct_CPV_VlvCmd_write_IRV: accessed-variable=VeTAIF_Pct_CPV_VlvCmd_write_IRV
            access WV_VeTAIF_e_CPV_VlvCmd_IO_CntrlSt_write_IRV: accessed-variable=VeTAIF_e_CPV_VlvCmd_IO_CntrlSt_write_IRV
        IOControl_IOCD022_PropSysCoolCntrlValvB
          data-receive-point-by-arguments:
            access IN_VeDCAB_Pct_IOCD022_PropSysCoolCntrlValvB_Value: accessed-variable=VeDCAB_Pct_IOCD022_PropSysCoolCntrlValvB.Value
            access IN_VeDCAB_e_IOControl_IOCD022_PropSysCoolCntrlValvB_Op_Value: accessed-variable=VeDCAB_e_IOControl_IOCD022_PropSysCoolCntrlValvB_Op.Value
          written-local-variables:
            access WV_VeTAIF_Pct_LTR_BypsVlv_Cmd_write_IRV: accessed-variable=VeTAIF_Pct_LTR_BypsVlv_Cmd_write_IRV
            access WV_VeTAIF_e_LTR_BypsVlv_IO_CntrlSt_write_IRV: accessed-variable=VeTAIF_e_LTR_BypsVlv_IO_CntrlSt_write_IRV
        IOControl_IOCD023_PropSysCoolCntrlValvC
          data-receive-point-by-arguments:
            access IN_VeDCAB_Pct_IOCD023_PropSysCoolCntrlValvC_Value: accessed-variable=VeDCAB_Pct_IOCD023_PropSysCoolCntrlValvC.Value
            access IN_VeDCAB_e_IOControl_IOCD023_PropSysCoolCntrlValvC_Op_Value: accessed-variable=VeDCAB_e_IOControl_IOCD023_PropSysCoolCntrlValvC_Op.Value
          written-local-variables:
            access WV_VeTAIF_Pct_HTL_BypsVlv_Cmd_write_IRV: accessed-variable=VeTAIF_Pct_HTL_BypsVlv_Cmd_write_IRV
            access WV_VeTAIF_e_HTL_BypsVlv_IO_CntrlSt_write_IRV: accessed-variable=VeTAIF_e_HTL_BypsVlv_IO_CntrlSt_write_IRV
        IOControl_IOCD031_ACRefrExpValvActACntrl
          data-receive-point-by-arguments:
            access IN_VeDCAB_Pct_IOCD031_ACRefrExpValvActACntrl_Value: accessed-variable=VeDCAB_Pct_IOCD031_ACRefrExpValvActACntrl.Value
            access IN_VeDCAB_e_IOControl_IOCD031_ACRefrExpValvActACntrl_Op_Value: accessed-variable=VeDCAB_e_IOControl_IOCD031_ACRefrExpValvActACntrl_Op.Value
          written-local-variables:
            access WV_VeTAIF_Pct_EXV_VlvCmd_write_IRV: accessed-variable=VeTAIF_Pct_EXV_VlvCmd_write_IRV
            access WV_VeTAIF_e_EXV_VlvCmd_IO_CntrlSt_write_IRV: accessed-variable=VeTAIF_e_EXV_VlvCmd_IO_CntrlSt_write_IRV
        IOControl_IOCD032_ACRefrExpValvActCCntrl
          data-receive-point-by-arguments:
            access IN_VeDCAB_Pct_IOCD032_ACRefrExpValvActCCntrl_Value: accessed-variable=VeDCAB_Pct_IOCD032_ACRefrExpValvActCCntrl.Value
            access IN_VeDCAB_e_IOControl_IOCD032_ACRefrExpValvActCCntrl_Op_Value: accessed-variable=VeDCAB_e_IOControl_IOCD032_ACRefrExpValvActCCntrl_Op.Value
          written-local-variables:
            access WV_VeTAIF_Pct_EEXV_VlvCmd_write_IRV: accessed-variable=VeTAIF_Pct_EEXV_VlvCmd_write_IRV
            access WV_VeTAIF_e_EEXV_VlvCmd_IO_CntrlSt_write_IRV: accessed-variable=VeTAIF_e_EEXV_VlvCmd_IO_CntrlSt_write_IRV
        IOControl_IOCD033_ACRefrExpValvActDCntrl
          data-receive-point-by-arguments:
            access IN_VeDCAB_Pct_IOCD033_ACRefrExpValvActDCntrl_Value: accessed-variable=VeDCAB_Pct_IOCD033_ACRefrExpValvActDCntrl.Value
            access IN_VeDCAB_e_IOControl_IOCD033_ACRefrExpValvActDCntrl_Op_Value: accessed-variable=VeDCAB_e_IOControl_IOCD033_ACRefrExpValvActDCntrl_Op.Value
          written-local-variables:
            access WV_VeTAIF_Pct_OEXV_VlvCmd_write_IRV: accessed-variable=VeTAIF_Pct_OEXV_VlvCmd_write_IRV
            access WV_VeTAIF_e_OEXV_VlvCmd_IO_CntrlSt_write_IRV: accessed-variable=VeTAIF_e_OEXV_VlvCmd_IO_CntrlSt_write_IRV
        Routine_RC1314_ActGriShu2Cal
          data-receive-point-by-arguments:
            access IN_VeDCAB_e_Routine_RC1314_ActGriShu2Cal_Op_Value: accessed-variable=VeDCAB_e_Routine_RC1314_ActGriShu2Cal_Op.Value
          written-local-variables:
            access WV_VeTAIF_b_DVC_AGS2_Calibration_Start_write_IRV: accessed-variable=VeTAIF_b_DVC_AGS2_Calibration_Start_write_IRV
        Routine_RC1313_ActGriShu1Cal
          data-receive-point-by-arguments:
            access IN_VeDCAB_e_Routine_RC1313_ActGriShu1Cal_Op_Value: accessed-variable=VeDCAB_e_Routine_RC1313_ActGriShu1Cal_Op.Value
          written-local-variables:
            access WV_VeTAIF_b_DVC_AGS1_Calibration_Start_write_IRV: accessed-variable=VeTAIF_b_DVC_AGS1_Calibration_Start_write_IRV
        IOControl_IOCD013_CompSpdTgt
          data-receive-point-by-arguments:
            access IN_VeDCAB_e_IOControl_IOCD013_CompSpdTgt_Op_Value: accessed-variable=VeDCAB_e_IOControl_IOCD013_CompSpdTgt_Op.Value
            access IN_VeDCAB_n_IOCD013_CompSpdTgt_Value: accessed-variable=VeDCAB_n_IOCD013_CompSpdTgt.Value
          written-local-variables:
            access WV_VeTAIF_e_CompSpdTgt_IO_CntrlSt_write_IRV: accessed-variable=VeTAIF_e_CompSpdTgt_IO_CntrlSt_write_IRV
            access WV_VeTAIF_n_CompSpdTgt_write_IRV: accessed-variable=VeTAIF_n_CompSpdTgt_write_IRV
        IOControl_IOCD025_AGS_PstnCmnd
          data-receive-point-by-arguments:
            access IN_VeDCAB_e_IOCD025_AGS_PstnCmnd_Value: accessed-variable=VeDCAB_e_IOCD025_AGS_PstnCmnd.Value
            access IN_VeDCAB_e_IOControl_IOCD025_AGS_PstnCmnd_Op_Value: accessed-variable=VeDCAB_e_IOControl_IOCD025_AGS_PstnCmnd_Op.Value
          written-local-variables:
            access WV_VeTAIF_e_AGS_IO_CntrlSt_write_IRV: accessed-variable=VeTAIF_e_AGS_IO_CntrlSt_write_IRV
            access WV_VeTAIF_e_AGS_PstnCmnd_write_IRV: accessed-variable=VeTAIF_e_AGS_PstnCmnd_write_IRV
        IOControl_IOCD002_FtRfgtShtoff_VlvCmd
          data-receive-point-by-arguments:
            access IN_VeDCAB_b_IOCD002_FtRfgtShtoff_VlvCmd_Value: accessed-variable=VeDCAB_b_IOCD002_FtRfgtShtoff_VlvCmd.Value
            access IN_VeDCAB_e_IOControl_IOCD002_FtRfgtShtoff_VlvCmd_Op_Value: accessed-variable=VeDCAB_e_IOControl_IOCD002_FtRfgtShtoff_VlvCmd_Op.Value
          written-local-variables:
            access WV_VeTAIF_b_FtRfgtShtoff_VlvCmd_write_IRV: accessed-variable=VeTAIF_b_FtRfgtShtoff_VlvCmd_write_IRV
            access WV_VeTAIF_e_FtRfgtShtoff_VlvCmd_IO_CntrlSt_write_IRV: accessed-variable=VeTAIF_e_FtRfgtShtoff_VlvCmd_IO_CntrlSt_write_IRV
        IOControl_IOCD026_AGS2_PstnCmnd
          data-receive-point-by-arguments:
            access IN_VeDCAB_e_IOCD026_AGS2_PstnCmnd_Value: accessed-variable=VeDCAB_e_IOCD026_AGS2_PstnCmnd.Value
            access IN_VeDCAB_e_IOControl_IOCD026_AGS2_PstnCmnd_Op_Value: accessed-variable=VeDCAB_e_IOControl_IOCD026_AGS2_PstnCmnd_Op.Value
          written-local-variables:
            access WV_VeTAIF_e_AGS2_PstnCmnd_write_IRV: accessed-variable=VeTAIF_e_AGS2_PstnCmnd_write_IRV
            access WV_VeTAIF_e_AGS2_IO_CntrlSt_write_IRV: accessed-variable=VeTAIF_e_AGS2_IO_CntrlSt_write_IRV
        IOControl_IOCD01F_ACRefrExpValvActACntrl
          data-receive-point-by-arguments:
            access IN_VeDCAB_Pct_IOCD01F_ACRefrExpValvActACntrl_Value: accessed-variable=VeDCAB_Pct_IOCD01F_ACRefrExpValvActACntrl.Value
            access IN_VeDCAB_e_IOControl_IOCD01F_ACRefrExpValvActACntrl_Op_Value: accessed-variable=VeDCAB_e_IOControl_IOCD01F_ACRefrExpValvActACntrl_Op.Value
          written-local-variables:
            access WV_VeTAIF_Pct_EXV_VlvCmd_write_IRV: accessed-variable=VeTAIF_Pct_EXV_VlvCmd_write_IRV
            access WV_VeTAIF_e_EXV_VlvCmd_IO_CntrlSt_write_IRV: accessed-variable=VeTAIF_e_EXV_VlvCmd_IO_CntrlSt_write_IRV
        IOControl_IOCD007_ChlrRfgtShtoff_VlvCmd
          data-receive-point-by-arguments:
            access IN_VeDCAB_b_IOCD007_ChlrRfgtShtoff_VlvCmd_Value: accessed-variable=VeDCAB_b_IOCD007_ChlrRfgtShtoff_VlvCmd.Value
            access IN_VeDCAB_e_IOControl_IOCD007_ChlrRfgtShtoff_VlvCmd_Op_Value: accessed-variable=VeDCAB_e_IOControl_IOCD007_ChlrRfgtShtoff_VlvCmd_Op.Value
          written-local-variables:
            access WV_VeTAIF_b_ChlrRfgtShtoff_VlvCmd_IRV: accessed-variable=VeTAIF_b_ChlrRfgtShtoff_VlvCmd_IRV
            access WV_VeTAIF_e_ChlrRfgtShtoff_VlvCmd_IRV: accessed-variable=VeTAIF_e_ChlrRfgtShtoff_VlvCmd_IRV
        FsftTAIR_I_ACCElecCurr: variation-point={short-label=vpFsftTAIR_I_ACCElecCurr, sw-syscond=1}
        FsftTAIR_P_ACCompElec_Pwr: variation-point={short-label=vpFsftTAIR_P_ACCompElec_Pwr, sw-syscond=1}
          written-local-variables:
            access WV_VeTAIR_b_ACCompElec_PwrFA_write_IRV: accessed-variable=VeTAIR_b_ACCompElec_PwrFA_write_IRV, variation-point={short-label=vpWV_VeTAIR_b_ACCompElec_PwrFA_write_IRV, sw-syscond=1}
        FsftTAIR_Pct_CPV2_ActlPstn: variation-point={short-label=vpFsftTAIR_Pct_CPV2_ActlPstn, sw-syscond=1}
          written-local-variables:
            access WV_VeTAIR_b_CPV2_ActlPstnFA_write_IRV: accessed-variable=VeTAIR_b_CPV2_ActlPstnFA_write_IRV, variation-point={short-label=vpWV_VeTAIR_b_CPV2_ActlPstnFA_write_IRV, sw-syscond=1}
        FsftTAIR_Pct_DrvTmpDr_Pos: variation-point={short-label=vpFsftTAIR_Pct_DrvTmpDr_Pos, sw-syscond=1}
        FsftTAIR_Pct_ECM_AirflowRequest: variation-point={short-label=vpFsftTAIR_Pct_ECM_AirflowRequest, sw-syscond=1}
          written-local-variables:
            access WV_VeTAIR_b_ECM_AirflowRequestFA_write_IRV: accessed-variable=VeTAIR_b_ECM_AirflowRequestFA_write_IRV, variation-point={short-label=vpWV_VeTAIR_b_ECM_AirflowRequestFA_write_IRV, sw-syscond=1}
        FsftTAIR_Pct_ECM_RadFanReq: variation-point={short-label=vpFsftTAIR_Pct_ECM_RadFanReq, sw-syscond=1}
          written-local-variables:
            access WV_VeTAIR_b_ECM_RadFanReqFA_write_IRV: accessed-variable=VeTAIR_b_ECM_RadFanReqFA_write_IRV, variation-point={short-label=vpWV_VeTAIR_b_ECM_RadFanReqFA_write_IRV, sw-syscond=1}
        FsftTAIR_Pct_EEXV_PosAct: variation-point={short-label=vpFsftTAIR_Pct_EEXV_PosAct, sw-syscond=1}
          written-local-variables:
            access WV_VeTAIR_b_EEXV_PosActFA_write_IRV: accessed-variable=VeTAIR_b_EEXV_PosActFA_write_IRV, variation-point={short-label=vpWV_VeTAIR_b_EEXV_PosActFA_write_IRV, sw-syscond=1}
        FsftTAIR_Pct_EXV_PosAct: variation-point={short-label=vpFsftTAIR_Pct_EXV_PosAct, sw-syscond=1}
          written-local-variables:
            access WV_VeTAIR_b_EXV_PosActFA_write_IRV: accessed-variable=VeTAIR_b_EXV_PosActFA_write_IRV, variation-point={short-label=vpWV_VeTAIR_b_EXV_PosActFA_write_IRV, sw-syscond=1}
        FsftTAIR_Pct_FrWyVlv_ActlPstn: variation-point={short-label=vpFsftTAIR_Pct_FrWyVlv_ActlPstn, sw-syscond=1}
          written-local-variables:
            access WV_VeTAIR_b_FrWyVlv_ActlPstnFA_write_IRV: accessed-variable=VeTAIR_b_FrWyVlv_ActlPstnFA_write_IRV, variation-point={short-label=vpWV_VeTAIR_b_FrWyVlv_ActlPstnFA_write_IRV, sw-syscond=1}
        FsftTAIR_Pct_FrtBlwrCmd: variation-point={short-label=vpFsftTAIR_Pct_FrtBlwrCmd, sw-syscond=1}
          written-local-variables:
            access WV_VeTAIR_b_FrtBlwrCmdFA_write_IRV: accessed-variable=VeTAIR_b_FrtBlwrCmdFA_write_IRV, variation-point={short-label=vpWV_VeTAIR_b_FrtBlwrCmdFA_write_IRV, sw-syscond=1}
        FsftTAIR_Pct_HTL_BypsVlv_ActlPstn: variation-point={short-label=vpFsftTAIR_Pct_HTL_BypsVlv_ActlPstn, sw-syscond=1}
          written-local-variables:
            access WV_VeTAIR_b_HTL_BypsVlv_ActlPstnFA_write_IRV: accessed-variable=VeTAIR_b_HTL_BypsVlv_ActlPstnFA_write_IRV, variation-point={short-label=vpWV_VeTAIR_b_HTL_BypsVlv_ActlPstnFA_write_IRV, sw-syscond=1}
        FsftTAIR_Pct_LTR_BypsVlv_ActlPstn: variation-point={short-label=vpFsftTAIR_Pct_LTR_BypsVlv_ActlPstn, sw-syscond=1}
          written-local-variables:
            access WV_VeTAIR_b_LTR_BypsVlv_ActlPstnFA_write_IRV: accessed-variable=VeTAIR_b_LTR_BypsVlv_ActlPstnFA_write_IRV, variation-point={short-label=vpWV_VeTAIR_b_LTR_BypsVlv_ActlPstnFA_write_IRV, sw-syscond=1}
        FsftTAIR_Pct_OEXV_PosAct: variation-point={short-label=vpFsftTAIR_Pct_OEXV_PosAct, sw-syscond=1}
          written-local-variables:
            access WV_VeTAIR_b_OEXV_PosActFA_write_IRV: accessed-variable=VeTAIR_b_OEXV_PosActFA_write_IRV, variation-point={short-label=vpWV_VeTAIR_b_OEXV_PosActFA_write_IRV, sw-syscond=1}
        FsftTAIR_Pct_PasTmpDr_Pos: variation-point={short-label=vpFsftTAIR_Pct_PasTmpDr_Pos, sw-syscond=1}
        FsftTAIR_Pct_RrBlwrCmd: variation-point={short-label=vpFsftTAIR_Pct_RrBlwrCmd, sw-syscond=1}
        FsftTAIR_Pct_RrTmpDr_Cmd: variation-point={short-label=vpFsftTAIR_Pct_RrTmpDr_Cmd, sw-syscond=1}
        FsftTAIR_T_CompBoardTemp: variation-point={short-label=vpFsftTAIR_T_CompBoardTemp, sw-syscond=1}
          written-local-variables:
            access WV_VeTAIR_b_CompBoardTempFA_write_IRV: accessed-variable=VeTAIR_b_CompBoardTempFA_write_IRV, variation-point={short-label=vpWV_VeTAIR_b_CompBoardTempFA_write_IRV, sw-syscond=1}
        FsftTAIR_T_CompIGBTTemp: variation-point={short-label=vpFsftTAIR_T_CompIGBTTemp, sw-syscond=1}
          written-local-variables:
            access WV_VeTAIR_b_CompIGBTTempFA_write_IRV: accessed-variable=VeTAIR_b_CompIGBTTempFA_write_IRV, variation-point={short-label=vpWV_VeTAIR_b_CompIGBTTempFA_write_IRV, sw-syscond=1}
        FsftTAIR_T_EEXV_RefTemp: variation-point={short-label=vpFsftTAIR_T_EEXV_RefTemp, sw-syscond=1}
          written-local-variables:
            access WV_VeTAIR_b_EEXV_RefTempFA_write_IRV: accessed-variable=VeTAIR_b_EEXV_RefTempFA_write_IRV, variation-point={short-label=vpWV_VeTAIR_b_EEXV_RefTempFA_write_IRV, sw-syscond=1}
        FsftTAIR_T_EXV_BoardTemp: variation-point={short-label=vpFsftTAIR_T_EXV_BoardTemp, sw-syscond=1}
        FsftTAIR_T_EXV_RefTemp: variation-point={short-label=vpFsftTAIR_T_EXV_RefTemp, sw-syscond=1}
          written-local-variables:
            access WV_VeTAIR_b_EXV_RefTempFA_write_IRV: accessed-variable=VeTAIR_b_EXV_RefTempFA_write_IRV, variation-point={short-label=vpWV_VeTAIR_b_EXV_RefTempFA_write_IRV, sw-syscond=1}
        FsftTAIR_T_FtEvapTmp: variation-point={short-label=vpFsftTAIR_T_FtEvapTmp, sw-syscond=1}
          written-local-variables:
            access WV_VeTAIR_b_FtEvapTmpFA_write_IRV: accessed-variable=VeTAIR_b_FtEvapTmpFA_write_IRV, variation-point={short-label=vpWV_VeTAIR_b_FtEvapTmpFA_write_IRV, sw-syscond=1}
        FsftTAIR_T_FtEvapTmp_P1C: variation-point={short-label=vpFsftTAIR_T_FtEvapTmp_P1C, sw-syscond=1}
          written-local-variables:
            access WV_VeTAIR_b_FtEvapTmp_P1CFA_write_IRV: accessed-variable=VeTAIR_b_FtEvapTmp_P1CFA_write_IRV, variation-point={short-label=vpWV_VeTAIR_b_FtEvapTmp_P1CFA_write_IRV, sw-syscond=1}
        FsftTAIR_T_FtEvapTmp_Tgt: variation-point={short-label=vpFsftTAIR_T_FtEvapTmp_Tgt, sw-syscond=1}
          written-local-variables:
            access WV_VeTAIR_b_FtEvapTmp_TgtFA_write_IRV: accessed-variable=VeTAIR_b_FtEvapTmp_TgtFA_write_IRV, variation-point={short-label=vpWV_VeTAIR_b_FtEvapTmp_TgtFA_write_IRV, sw-syscond=1}
        FsftTAIR_T_HtrCoreTmp_Tgt: variation-point={short-label=vpFsftTAIR_T_HtrCoreTmp_Tgt, sw-syscond=1}
        FsftTAIR_T_OEXV_RefTemp: variation-point={short-label=vpFsftTAIR_T_OEXV_RefTemp, sw-syscond=1}
          written-local-variables:
            access WV_VeTAIR_b_OEXV_RefTempFA_write_IRV: accessed-variable=VeTAIR_b_OEXV_RefTempFA_write_IRV, variation-point={short-label=vpWV_VeTAIR_b_OEXV_RefTempFA_write_IRV, sw-syscond=1}
        FsftTAIR_T_VhIntTmp: variation-point={short-label=vpFsftTAIR_T_VhIntTmp, sw-syscond=1}
          written-local-variables:
            access WV_VeTAIR_b_VhIntTmpFA_write_IRV: accessed-variable=VeTAIR_b_VhIntTmpFA_write_IRV, variation-point={short-label=vpWV_VeTAIR_b_VhIntTmpFA_write_IRV, sw-syscond=1}
        FsftTAIR_U_CompHVInput: variation-point={short-label=vpFsftTAIR_U_CompHVInput, sw-syscond=1}
          written-local-variables:
            access WV_VeTAIR_b_CompHVInputFA_write_IRV: accessed-variable=VeTAIR_b_CompHVInputFA_write_IRV, variation-point={short-label=vpWV_VeTAIR_b_CompHVInputFA_write_IRV, sw-syscond=1}
        FsftTAIR_U_EXV_SupplyVolt: variation-point={short-label=vpFsftTAIR_U_EXV_SupplyVolt, sw-syscond=1}
        FsftTAIR_U_FrWyVlv_MtrVltg: variation-point={short-label=vpFsftTAIR_U_FrWyVlv_MtrVltg, sw-syscond=1}
        FsftTAIR_U_HTL_BypsVlv_MtrVltg: variation-point={short-label=vpFsftTAIR_U_HTL_BypsVlv_MtrVltg, sw-syscond=1}
          written-local-variables:
            access WV_VeTAIR_b_HTL_BypsVlv_MtrVltgFA_write_IRV: accessed-variable=VeTAIR_b_HTL_BypsVlv_MtrVltgFA_write_IRV, variation-point={short-label=vpWV_VeTAIR_b_HTL_BypsVlv_MtrVltgFA_write_IRV, sw-syscond=1}
        FsftTAIR_U_LTR_BypsVlv_MtrVltg: variation-point={short-label=vpFsftTAIR_U_LTR_BypsVlv_MtrVltg, sw-syscond=1}
          written-local-variables:
            access WV_VeTAIR_b_LTR_BypsVlv_MtrVltgFA_write_IRV: accessed-variable=VeTAIR_b_LTR_BypsVlv_MtrVltgFA_write_IRV, variation-point={short-label=vpWV_VeTAIR_b_LTR_BypsVlv_MtrVltgFA_write_IRV, sw-syscond=1}
        FsftTAIR_b_AGS2_CurrPos
          written-local-variables:
            access WV_VeTAIR_b_AGS2_CurrPosFA_write_IRV: accessed-variable=VeTAIR_b_AGS2_CurrPosFA_write_IRV
        FsftTAIR_b_AGS_CurrPos
          written-local-variables:
            access WV_VeTAIR_b_AGS_CurrPosFA_write_IRV: accessed-variable=VeTAIR_b_AGS_CurrPosFA_write_IRV
        FsftTAIR_b_EBL_Stat: variation-point={short-label=vpFsftTAIR_b_EBL_Stat, sw-syscond=1}
          written-local-variables:
            access WV_VeTAIR_b_EBL_StatFA_write_IRV: accessed-variable=VeTAIR_b_EBL_StatFA_write_IRV, variation-point={short-label=vpWV_VeTAIR_b_EBL_StatFA_write_IRV, sw-syscond=1}
        FsftTAIR_b_HghRfrgtPresFailSts: variation-point={short-label=vpFsftTAIR_b_HghRfrgtPresFailSts, sw-syscond=1}
          written-local-variables:
            access WV_VeTAIR_b_HghRfrgtPresFailStsFA_write_IRV: accessed-variable=VeTAIR_b_HghRfrgtPresFailStsFA_write_IRV, variation-point={short-label=vpWV_VeTAIR_b_HghRfrgtPresFailStsFA_write_IRV, sw-syscond=1}
        FsftTAIR_b_RearCabinFanSts: variation-point={short-label=vpFsftTAIR_b_RearCabinFanSts, sw-syscond=1}
          written-local-variables:
            access WV_VeTAIR_b_RearCabinFanStsFA_write_IRV: accessed-variable=VeTAIR_b_RearCabinFanStsFA_write_IRV, variation-point={short-label=vpWV_VeTAIR_b_RearCabinFanStsFA_write_IRV, sw-syscond=1}
        FsftTAIR_e_AGS2_ErrFdb: variation-point={short-label=vpFsftTAIR_e_AGS2_ErrFdb, sw-syscond=1}
          written-local-variables:
            access WV_VeTAIR_b_AGS2_ErrFdbFA_write_IRV: accessed-variable=VeTAIR_b_AGS2_ErrFdbFA_write_IRV, variation-point={short-label=vpWV_VeTAIR_b_AGS2_ErrFdbFA_write_IRV, sw-syscond=1}
        FsftTAIR_e_AGS_ErrFdb: variation-point={short-label=vpFsftTAIR_e_AGS_ErrFdb, sw-syscond=1}
          written-local-variables:
            access WV_VeTAIR_b_AGS_ErrFdbFA_write_IRV: accessed-variable=VeTAIR_b_AGS_ErrFdbFA_write_IRV, variation-point={short-label=vpWV_VeTAIR_b_AGS_ErrFdbFA_write_IRV, sw-syscond=1}
        FsftTAIR_e_CompFltStat: variation-point={short-label=vpFsftTAIR_e_CompFltStat, sw-syscond=1}
        FsftTAIR_e_CompStat: variation-point={short-label=vpFsftTAIR_e_CompStat, sw-syscond=1}
        FsftTAIR_e_EXV_CalStat: variation-point={short-label=vpFsftTAIR_e_EXV_CalStat, sw-syscond=1}
        FsftTAIR_e_EXV_Err: variation-point={short-label=vpFsftTAIR_e_EXV_Err, sw-syscond=1}
        FsftTAIR_e_EXV_Sts: variation-point={short-label=vpFsftTAIR_e_EXV_Sts, sw-syscond=1}
        FsftTAIR_e_FrWyVlv_CalSts: variation-point={short-label=vpFsftTAIR_e_FrWyVlv_CalSts, sw-syscond=1}
        FsftTAIR_e_FrWyVlv_ErrSts: variation-point={short-label=vpFsftTAIR_e_FrWyVlv_ErrSts, sw-syscond=1}
        FsftTAIR_e_HTL_BypsVlv_CalSts: variation-point={short-label=vpFsftTAIR_e_HTL_BypsVlv_CalSts, sw-syscond=1}
          written-local-variables:
            access WV_VeTAIR_b_HTL_BypsVlv_CalStsFA_write_IRV: accessed-variable=VeTAIR_b_HTL_BypsVlv_CalStsFA_write_IRV, variation-point={short-label=vpWV_VeTAIR_b_HTL_BypsVlv_CalStsFA_write_IRV, sw-syscond=1}
        FsftTAIR_e_HTL_BypsVlv_ErrSts: variation-point={short-label=vpFsftTAIR_e_HTL_BypsVlv_ErrSts, sw-syscond=1}
          written-local-variables:
            access WV_VeTAIR_b_HTL_BypsVlv_ErrStsFA_write_IRV: accessed-variable=VeTAIR_b_HTL_BypsVlv_ErrStsFA_write_IRV, variation-point={short-label=vpWV_VeTAIR_b_HTL_BypsVlv_ErrStsFA_write_IRV, sw-syscond=1}
        FsftTAIR_e_LTR_BypsVlv_CalSts: variation-point={short-label=vpFsftTAIR_e_LTR_BypsVlv_CalSts, sw-syscond=1}
          written-local-variables:
            access WV_VeTAIR_b_LTR_BypsVlv_CalStsFA_write_IRV: accessed-variable=VeTAIR_b_LTR_BypsVlv_CalStsFA_write_IRV, variation-point={short-label=vpWV_VeTAIR_b_LTR_BypsVlv_CalStsFA_write_IRV, sw-syscond=1}
        FsftTAIR_e_LTR_BypsVlv_ErrSts: variation-point={short-label=vpFsftTAIR_e_LTR_BypsVlv_ErrSts, sw-syscond=1}
          written-local-variables:
            access WV_VeTAIR_b_LTR_BypsVlv_ErrStsFA_write_IRV: accessed-variable=VeTAIR_b_LTR_BypsVlv_ErrStsFA_write_IRV, variation-point={short-label=vpWV_VeTAIR_b_LTR_BypsVlv_ErrStsFA_write_IRV, sw-syscond=1}
        FsftTAIR_kp_EXV_RefPress: variation-point={short-label=vpFsftTAIR_kp_EXV_RefPress, sw-syscond=1}
          written-local-variables:
            access WV_VeTAIR_b_EXV_RefPressFA_write_IRV: accessed-variable=VeTAIR_b_EXV_RefPressFA_write_IRV, variation-point={short-label=vpWV_VeTAIR_b_EXV_RefPressFA_write_IRV, sw-syscond=1}
        FsftTAIR_n_CompSpdFdb: variation-point={short-label=vpFsftTAIR_n_CompSpdFdb, sw-syscond=1}
          written-local-variables:
            access WV_VeTAIR_b_CompSpdFdbFA_write_IRV: accessed-variable=VeTAIR_b_CompSpdFdbFA_write_IRV, variation-point={short-label=vpWV_VeTAIR_b_CompSpdFdbFA_write_IRV, sw-syscond=1}
        FsftTAIR_p_EEXV_RefPress: variation-point={short-label=vpFsftTAIR_p_EEXV_RefPress, sw-syscond=1}
          written-local-variables:
            access WV_VeTAIR_b_EEXV_RefPressFA_write_IRV: accessed-variable=VeTAIR_b_EEXV_RefPressFA_write_IRV, variation-point={short-label=vpWV_VeTAIR_b_EEXV_RefPressFA_write_IRV, sw-syscond=1}
        FsftTAIR_p_OEXV_RefPress: variation-point={short-label=vpFsftTAIR_p_OEXV_RefPress, sw-syscond=1}
          written-local-variables:
            access WV_VeTAIR_b_OEXV_RefPressFA_write_IRV: accessed-variable=VeTAIR_b_OEXV_RefPressFA_write_IRV, variation-point={short-label=vpWV_VeTAIR_b_OEXV_RefPressFA_write_IRV, sw-syscond=1}
        FsftTAIR_y_CPV2_ErrMsgs: variation-point={short-label=vpFsftTAIR_y_CPV2_ErrMsgs, sw-syscond=1}
          written-local-variables:
            access WV_VeTAIR_b_CPV2_ErrMsgsFA_write_IRV: accessed-variable=VeTAIR_b_CPV2_ErrMsgsFA_write_IRV, variation-point={short-label=vpWV_VeTAIR_b_CPV2_ErrMsgsFA_write_IRV, sw-syscond=1}
        FsftTAIR_y_FrWyVlv_ErrMsgs: variation-point={short-label=vpFsftTAIR_y_FrWyVlv_ErrMsgs, sw-syscond=1}
          written-local-variables:
            access WV_VeTAIR_b_FrWyVlv_ErrMsgsFA_write_IRV: accessed-variable=VeTAIR_b_FrWyVlv_ErrMsgsFA_write_IRV, variation-point={short-label=vpWV_VeTAIR_b_FrWyVlv_ErrMsgsFA_write_IRV, sw-syscond=1}
        FsftTAIR_y_HTL_BypsVlv_ErrMsgs: variation-point={short-label=vpFsftTAIR_y_HTL_BypsVlv_ErrMsgs, sw-syscond=1}
          written-local-variables:
            access WV_VeTAIR_b_HTL_BypsVlv_ErrMsgsFA_write_IRV: accessed-variable=VeTAIR_b_HTL_BypsVlv_ErrMsgsFA_write_IRV, variation-point={short-label=vpWV_VeTAIR_b_HTL_BypsVlv_ErrMsgsFA_write_IRV, sw-syscond=1}
        FsftTAIR_y_LTR_BypsVlv_ErrMsgs: variation-point={short-label=vpFsftTAIR_y_LTR_BypsVlv_ErrMsgs, sw-syscond=1}
          written-local-variables:
            access WV_VeTAIR_b_LTR_BypsVlv_ErrMsgsFA_write_IRV: accessed-variable=VeTAIR_b_LTR_BypsVlv_ErrMsgsFA_write_IRV, variation-point={short-label=vpWV_VeTAIR_b_LTR_BypsVlv_ErrMsgsFA_write_IRV, sw-syscond=1}
        PokeTAIF_DVC_HTempCbnVlv
          written-local-variables:
            access WV_VeTAIF_Pct_HT_CabVlvCmd_write_IRV: accessed-variable=VeTAIF_Pct_HT_CabVlvCmd_write_IRV
            access WV_VeTAIF_e_HT_CabVlvCmd_IO_CntrlSt_write_IRV: accessed-variable=VeTAIF_e_HT_CabVlvCmd_IO_CntrlSt_write_IRV
        PokeTAIF_DVC_LT_Shtoff_VlvCmd
          written-local-variables:
            access WV_VeTAIF_b_LT_Shtoff_VlvCmd_write_IRV: accessed-variable=VeTAIF_b_LT_Shtoff_VlvCmd_write_IRV
            access WV_VeTAIF_e_LT_Shtoff_VlvCmd_IO_CntrlSt_write_IRV: accessed-variable=VeTAIF_e_LT_Shtoff_VlvCmd_IO_CntrlSt_write_IRV
        PokeTAIF_e_DVC_HTCV_Calibration_Start
          written-local-variables:
            access WV_VeTAIF_e_DVC_HTCV_Calibration_Start_write_IRV: accessed-variable=VeTAIF_e_DVC_HTCV_Calibration_Start_write_IRV
        PokeTAIR_I_ACCElecCurr: variation-point={short-label=vpPokeTAIR_I_ACCElecCurr, sw-syscond=1}
          written-local-variables:
            access WV_VeTAIR_I_ACCElecCurr_write_IRV: accessed-variable=VeTAIR_I_ACCElecCurr_write_IRV, variation-point={short-label=vpWV_VeTAIR_I_ACCElecCurr_write_IRV, sw-syscond=1}
        PokeTAIR_P_ACCompElec_Pwr: variation-point={short-label=vpPokeTAIR_P_ACCompElec_Pwr, sw-syscond=1}
          written-local-variables:
            access WV_VeTAIR_P_ACCompElec_Pwr_write_IRV: accessed-variable=VeTAIR_P_ACCompElec_Pwr_write_IRV, variation-point={short-label=vpWV_VeTAIR_P_ACCompElec_Pwr_write_IRV, sw-syscond=1}
            access WV_VeTAIR_b_ACCompElec_PwrFA_write_IRV: accessed-variable=VeTAIR_b_ACCompElec_PwrFA_write_IRV, variation-point={short-label=vpWV_VeTAIR_b_ACCompElec_PwrFA_write_IRV, sw-syscond=1}
        PokeTAIR_Pct_CPV2_ActlPstn: variation-point={short-label=vpPokeTAIR_Pct_CPV2_ActlPstn, sw-syscond=1}
          written-local-variables:
            access WV_VeTAIR_Pct_CPV2_ActlPstn_write_IRV: accessed-variable=VeTAIR_Pct_CPV2_ActlPstn_write_IRV, variation-point={short-label=vpWV_VeTAIR_Pct_CPV2_ActlPstn_write_IRV, sw-syscond=1}
            access WV_VeTAIR_b_CPV2_ActlPstnFA_write_IRV: accessed-variable=VeTAIR_b_CPV2_ActlPstnFA_write_IRV, variation-point={short-label=vpWV_VeTAIR_b_CPV2_ActlPstnFA_write_IRV, sw-syscond=1}
        PokeTAIR_Pct_DrvTmpDr_Pos: variation-point={short-label=vpPokeTAIR_Pct_DrvTmpDr_Pos, sw-syscond=1}
        PokeTAIR_Pct_ECM_AirflowRequest: variation-point={short-label=vpPokeTAIR_Pct_ECM_AirflowRequest, sw-syscond=1}
          written-local-variables:
            access WV_VeTAIR_Pct_ECM_AirflowRequest_write_IRV: accessed-variable=VeTAIR_Pct_ECM_AirflowRequest_write_IRV, variation-point={short-label=vpWV_VeTAIR_Pct_ECM_AirflowRequest_write_IRV, sw-syscond=1}
            access WV_VeTAIR_b_ECM_AirflowRequestFA_write_IRV: accessed-variable=VeTAIR_b_ECM_AirflowRequestFA_write_IRV, variation-point={short-label=vpWV_VeTAIR_b_ECM_AirflowRequestFA_write_IRV, sw-syscond=1}
        PokeTAIR_Pct_ECM_RadFanReq: variation-point={short-label=vpPokeTAIR_Pct_ECM_RadFanReq, sw-syscond=1}
          written-local-variables:
            access WV_VeTAIR_Pct_ECM_RadFanReq_write_IRV: accessed-variable=VeTAIR_Pct_ECM_RadFanReq_write_IRV, variation-point={short-label=vpWV_VeTAIR_Pct_ECM_RadFanReq_write_IRV, sw-syscond=1}
            access WV_VeTAIR_b_ECM_RadFanReqFA_write_IRV: accessed-variable=VeTAIR_b_ECM_RadFanReqFA_write_IRV, variation-point={short-label=vpWV_VeTAIR_b_ECM_RadFanReqFA_write_IRV, sw-syscond=1}
        PokeTAIR_Pct_EEXV_PosAct: variation-point={short-label=vpPokeTAIR_Pct_EEXV_PosAct, sw-syscond=1}
          written-local-variables:
            access WV_VeTAIR_Pct_EEXV_PosAct_write_IRV: accessed-variable=VeTAIR_Pct_EEXV_PosAct_write_IRV, variation-point={short-label=vpWV_VeTAIR_Pct_EEXV_PosAct_write_IRV, sw-syscond=1}
            access WV_VeTAIR_b_EEXV_PosActFA_write_IRV: accessed-variable=VeTAIR_b_EEXV_PosActFA_write_IRV, variation-point={short-label=vpWV_VeTAIR_b_EEXV_PosActFA_write_IRV, sw-syscond=1}
        PokeTAIR_Pct_EXV_PosAct: variation-point={short-label=vpPokeTAIR_Pct_EXV_PosAct, sw-syscond=1}
          written-local-variables:
            access WV_VeTAIR_Pct_EXV_PosAct_write_IRV: accessed-variable=VeTAIR_Pct_EXV_PosAct_write_IRV, variation-point={short-label=vpWV_VeTAIR_Pct_EXV_PosAct_write_IRV, sw-syscond=1}
            access WV_VeTAIR_b_EXV_PosActFA_write_IRV: accessed-variable=VeTAIR_b_EXV_PosActFA_write_IRV, variation-point={short-label=vpWV_VeTAIR_b_EXV_PosActFA_write_IRV, sw-syscond=1}
        PokeTAIR_Pct_FrWyVlv_ActlPstn: variation-point={short-label=vpPokeTAIR_Pct_FrWyVlv_ActlPstn, sw-syscond=1}
          written-local-variables:
            access WV_VeTAIR_Pct_FrWyVlv_ActlPstn_write_IRV: accessed-variable=VeTAIR_Pct_FrWyVlv_ActlPstn_write_IRV, variation-point={short-label=vpWV_VeTAIR_Pct_FrWyVlv_ActlPstn_write_IRV, sw-syscond=1}
            access WV_VeTAIR_b_FrWyVlv_ActlPstnFA_write_IRV: accessed-variable=VeTAIR_b_FrWyVlv_ActlPstnFA_write_IRV, variation-point={short-label=vpWV_VeTAIR_b_FrWyVlv_ActlPstnFA_write_IRV, sw-syscond=1}
        PokeTAIR_Pct_FrtBlwrCmd: variation-point={short-label=vpPokeTAIR_Pct_FrtBlwrCmd, sw-syscond=1}
          written-local-variables:
            access WV_VeTAIR_Pct_FrtBlwrCmd_write_IRV: accessed-variable=VeTAIR_Pct_FrtBlwrCmd_write_IRV, variation-point={short-label=vpWV_VeTAIR_Pct_FrtBlwrCmd_write_IRV, sw-syscond=1}
            access WV_VeTAIR_b_FrtBlwrCmdFA_write_IRV: accessed-variable=VeTAIR_b_FrtBlwrCmdFA_write_IRV, variation-point={short-label=vpWV_VeTAIR_b_FrtBlwrCmdFA_write_IRV, sw-syscond=1}
        PokeTAIR_Pct_HTL_BypsVlv_ActlPstn: variation-point={short-label=vpPokeTAIR_Pct_HTL_BypsVlv_ActlPstn, sw-syscond=1}
          written-local-variables:
            access WV_VeTAIR_Pct_HTL_BypsVlv_ActlPstn_write_IRV: accessed-variable=VeTAIR_Pct_HTL_BypsVlv_ActlPstn_write_IRV, variation-point={short-label=vpWV_VeTAIR_Pct_HTL_BypsVlv_ActlPstn_write_IRV, sw-syscond=1}
            access WV_VeTAIR_b_HTL_BypsVlv_ActlPstnFA_write_IRV: accessed-variable=VeTAIR_b_HTL_BypsVlv_ActlPstnFA_write_IRV, variation-point={short-label=vpWV_VeTAIR_b_HTL_BypsVlv_ActlPstnFA_write_IRV, sw-syscond=1}
        PokeTAIR_Pct_LTR_BypsVlv_ActlPstn: variation-point={short-label=vpPokeTAIR_Pct_LTR_BypsVlv_ActlPstn, sw-syscond=1}
          written-local-variables:
            access WV_VeTAIR_Pct_LTR_BypsVlv_ActlPstn_write_IRV: accessed-variable=VeTAIR_Pct_LTR_BypsVlv_ActlPstn_write_IRV, variation-point={short-label=vpWV_VeTAIR_Pct_LTR_BypsVlv_ActlPstn_write_IRV, sw-syscond=1}
            access WV_VeTAIR_b_LTR_BypsVlv_ActlPstnFA_write_IRV: accessed-variable=VeTAIR_b_LTR_BypsVlv_ActlPstnFA_write_IRV, variation-point={short-label=vpWV_VeTAIR_b_LTR_BypsVlv_ActlPstnFA_write_IRV, sw-syscond=1}
        PokeTAIR_Pct_OEXV_PosAct: variation-point={short-label=vpPokeTAIR_Pct_OEXV_PosAct, sw-syscond=1}
          written-local-variables:
            access WV_VeTAIR_Pct_OEXV_PosAct_write_IRV: accessed-variable=VeTAIR_Pct_OEXV_PosAct_write_IRV, variation-point={short-label=vpWV_VeTAIR_Pct_OEXV_PosAct_write_IRV, sw-syscond=1}
            access WV_VeTAIR_b_OEXV_PosActFA_write_IRV: accessed-variable=VeTAIR_b_OEXV_PosActFA_write_IRV, variation-point={short-label=vpWV_VeTAIR_b_OEXV_PosActFA_write_IRV, sw-syscond=1}
        PokeTAIR_Pct_PasTmpDr_Pos: variation-point={short-label=vpPokeTAIR_Pct_PasTmpDr_Pos, sw-syscond=1}
        PokeTAIR_Pct_RrBlwrCmd: variation-point={short-label=vpPokeTAIR_Pct_RrBlwrCmd, sw-syscond=1}
          written-local-variables:
            access WV_VeTAIR_Pct_RrBlwrCmd_write_IRV: accessed-variable=VeTAIR_Pct_RrBlwrCmd_write_IRV, variation-point={short-label=vpWV_VeTAIR_Pct_RrBlwrCmd_write_IRV, sw-syscond=1}
        PokeTAIR_Pct_RrTmpDr_Cmd: variation-point={short-label=vpPokeTAIR_Pct_RrTmpDr_Cmd, sw-syscond=1}
        PokeTAIR_T_CompBoardTemp: variation-point={short-label=vpPokeTAIR_T_CompBoardTemp, sw-syscond=1}
          written-local-variables:
            access WV_VeTAIR_T_CompBoardTemp_write_IRV: accessed-variable=VeTAIR_T_CompBoardTemp_write_IRV, variation-point={short-label=vpWV_VeTAIR_T_CompBoardTemp_write_IRV, sw-syscond=1}
            access WV_VeTAIR_b_CompBoardTempFA_write_IRV: accessed-variable=VeTAIR_b_CompBoardTempFA_write_IRV, variation-point={short-label=vpWV_VeTAIR_b_CompBoardTempFA_write_IRV, sw-syscond=1}
        PokeTAIR_T_CompIGBTTemp: variation-point={short-label=vpPokeTAIR_T_CompIGBTTemp, sw-syscond=1}
          written-local-variables:
            access WV_VeTAIR_T_CompIGBTTemp_write_IRV: accessed-variable=VeTAIR_T_CompIGBTTemp_write_IRV, variation-point={short-label=vpWV_VeTAIR_T_CompIGBTTemp_write_IRV, sw-syscond=1}
            access WV_VeTAIR_b_CompIGBTTempFA_write_IRV: accessed-variable=VeTAIR_b_CompIGBTTempFA_write_IRV, variation-point={short-label=vpWV_VeTAIR_b_CompIGBTTempFA_write_IRV, sw-syscond=1}
        PokeTAIR_T_EEXV_BoardTemp: variation-point={short-label=vpPokeTAIR_T_EEXV_BoardTemp, sw-syscond=1}
          written-local-variables:
            access WV_VeTAIR_T_EEXV_BoardTemp_write_IRV: accessed-variable=VeTAIR_T_EEXV_BoardTemp_write_IRV, variation-point={short-label=vpWV_VeTAIR_T_EEXV_BoardTemp_write_IRV, sw-syscond=1}
        PokeTAIR_T_EEXV_RefTemp: variation-point={short-label=vpPokeTAIR_T_EEXV_RefTemp, sw-syscond=1}
          written-local-variables:
            access WV_VeTAIR_T_EEXV_RefTemp_write_IRV: accessed-variable=VeTAIR_T_EEXV_RefTemp_write_IRV, variation-point={short-label=vpWV_VeTAIR_T_EEXV_RefTemp_write_IRV, sw-syscond=1}
            access WV_VeTAIR_b_EEXV_RefTempFA_write_IRV: accessed-variable=VeTAIR_b_EEXV_RefTempFA_write_IRV, variation-point={short-label=vpWV_VeTAIR_b_EEXV_RefTempFA_write_IRV, sw-syscond=1}
        PokeTAIR_T_EXV_BoardTemp: variation-point={short-label=vpPokeTAIR_T_EXV_BoardTemp, sw-syscond=1}
          written-local-variables:
            access WV_VeTAIR_T_EXV_BoardTemp_write_IRV: accessed-variable=VeTAIR_T_EXV_BoardTemp_write_IRV, variation-point={short-label=vpWV_VeTAIR_T_EXV_BoardTemp_write_IRV, sw-syscond=1}
        PokeTAIR_T_EXV_RefTemp: variation-point={short-label=vpPokeTAIR_T_EXV_RefTemp, sw-syscond=1}
          written-local-variables:
            access WV_VeTAIR_T_EXV_RefTemp_write_IRV: accessed-variable=VeTAIR_T_EXV_RefTemp_write_IRV, variation-point={short-label=vpWV_VeTAIR_T_EXV_RefTemp_write_IRV, sw-syscond=1}
            access WV_VeTAIR_b_EXV_RefTempFA_write_IRV: accessed-variable=VeTAIR_b_EXV_RefTempFA_write_IRV, variation-point={short-label=vpWV_VeTAIR_b_EXV_RefTempFA_write_IRV, sw-syscond=1}
        PokeTAIR_T_FtEvapTmp: variation-point={short-label=vpPokeTAIR_T_FtEvapTmp, sw-syscond=1}
          written-local-variables:
            access WV_VeTAIR_T_FtEvapTmp_write_IRV: accessed-variable=VeTAIR_T_FtEvapTmp_write_IRV, variation-point={short-label=vpWV_VeTAIR_T_FtEvapTmp_write_IRV, sw-syscond=1}
            access WV_VeTAIR_b_FtEvapTmpFA_write_IRV: accessed-variable=VeTAIR_b_FtEvapTmpFA_write_IRV, variation-point={short-label=vpWV_VeTAIR_b_FtEvapTmpFA_write_IRV, sw-syscond=1}
        PokeTAIR_T_FtEvapTmp_P1C: variation-point={short-label=vpPokeTAIR_T_FtEvapTmp_P1C, sw-syscond=1}
          written-local-variables:
            access WV_VeTAIR_T_FtEvapTmp_P1C_write_IRV: accessed-variable=VeTAIR_T_FtEvapTmp_P1C_write_IRV, variation-point={short-label=vpWV_VeTAIR_T_FtEvapTmp_P1C_write_IRV, sw-syscond=1}
            access WV_VeTAIR_b_FtEvapTmp_P1CFA_write_IRV: accessed-variable=VeTAIR_b_FtEvapTmp_P1CFA_write_IRV, variation-point={short-label=vpWV_VeTAIR_b_FtEvapTmp_P1CFA_write_IRV, sw-syscond=1}
        PokeTAIR_T_FtEvapTmp_Tgt: variation-point={short-label=vpPokeTAIR_T_FtEvapTmp_Tgt, sw-syscond=1}
          written-local-variables:
            access WV_VeTAIR_T_FtEvapTmp_Tgt_write_IRV: accessed-variable=VeTAIR_T_FtEvapTmp_Tgt_write_IRV, variation-point={short-label=vpWV_VeTAIR_T_FtEvapTmp_Tgt_write_IRV, sw-syscond=1}
            access WV_VeTAIR_b_FtEvapTmp_TgtFA_write_IRV: accessed-variable=VeTAIR_b_FtEvapTmp_TgtFA_write_IRV, variation-point={short-label=vpWV_VeTAIR_b_FtEvapTmp_TgtFA_write_IRV, sw-syscond=1}
        PokeTAIR_T_HtrCoreTmp_Tgt: variation-point={short-label=vpPokeTAIR_T_HtrCoreTmp_Tgt, sw-syscond=1}
          written-local-variables:
            access WV_VeTAIR_T_HtrCoreTmp_Tgt_write_IRV: accessed-variable=VeTAIR_T_HtrCoreTmp_Tgt_write_IRV, variation-point={short-label=vpWV_VeTAIR_T_HtrCoreTmp_Tgt_write_IRV, sw-syscond=1}
        PokeTAIR_T_OEXV_BoardTemp: variation-point={short-label=vpPokeTAIR_T_OEXV_BoardTemp, sw-syscond=1}
          written-local-variables:
            access WV_VeTAIR_T_OEXV_BoardTemp_write_IRV: accessed-variable=VeTAIR_T_OEXV_BoardTemp_write_IRV, variation-point={short-label=vpWV_VeTAIR_T_OEXV_BoardTemp_write_IRV, sw-syscond=1}
        PokeTAIR_T_OEXV_RefTemp: variation-point={short-label=vpPokeTAIR_T_OEXV_RefTemp, sw-syscond=1}
          written-local-variables:
            access WV_VeTAIR_T_OEXV_RefTemp_write_IRV: accessed-variable=VeTAIR_T_OEXV_RefTemp_write_IRV, variation-point={short-label=vpWV_VeTAIR_T_OEXV_RefTemp_write_IRV, sw-syscond=1}
            access WV_VeTAIR_b_OEXV_RefTempFA_write_IRV: accessed-variable=VeTAIR_b_OEXV_RefTempFA_write_IRV, variation-point={short-label=vpWV_VeTAIR_b_OEXV_RefTempFA_write_IRV, sw-syscond=1}
        PokeTAIR_T_VhIntTmp: variation-point={short-label=vpPokeTAIR_T_VhIntTmp, sw-syscond=1}
          written-local-variables:
            access WV_VeTAIR_T_VhIntTmp_write_IRV: accessed-variable=VeTAIR_T_VhIntTmp_write_IRV, variation-point={short-label=vpWV_VeTAIR_T_VhIntTmp_write_IRV, sw-syscond=1}
            access WV_VeTAIR_b_VhIntTmpFA_write_IRV: accessed-variable=VeTAIR_b_VhIntTmpFA_write_IRV, variation-point={short-label=vpWV_VeTAIR_b_VhIntTmpFA_write_IRV, sw-syscond=1}
        PokeTAIR_U_CPV2_MtrVltg: variation-point={short-label=vpPokeTAIR_U_CPV2_MtrVltg, sw-syscond=1}
          written-local-variables:
            access WV_VeTAIR_U_CPV2_MtrVltg_write_IRV: accessed-variable=VeTAIR_U_CPV2_MtrVltg_write_IRV, variation-point={short-label=vpWV_VeTAIR_U_CPV2_MtrVltg_write_IRV, sw-syscond=1}
        PokeTAIR_U_CompHVInput: variation-point={short-label=vpPokeTAIR_U_CompHVInput, sw-syscond=1}
          written-local-variables:
            access WV_VeTAIR_U_CompHVInput_write_IRV: accessed-variable=VeTAIR_U_CompHVInput_write_IRV, variation-point={short-label=vpWV_VeTAIR_U_CompHVInput_write_IRV, sw-syscond=1}
            access WV_VeTAIR_b_CompHVInputFA_write_IRV: accessed-variable=VeTAIR_b_CompHVInputFA_write_IRV, variation-point={short-label=vpWV_VeTAIR_b_CompHVInputFA_write_IRV, sw-syscond=1}
        PokeTAIR_U_EEXV_SupplyVolt: variation-point={short-label=vpPokeTAIR_U_EEXV_SupplyVolt, sw-syscond=1}
          written-local-variables:
            access WV_VeTAIR_U_EEXV_SupplyVolt_write_IRV: accessed-variable=VeTAIR_U_EEXV_SupplyVolt_write_IRV, variation-point={short-label=vpWV_VeTAIR_U_EEXV_SupplyVolt_write_IRV, sw-syscond=1}
        PokeTAIR_U_EXV_SupplyVolt: variation-point={short-label=vpPokeTAIR_U_EXV_SupplyVolt, sw-syscond=1}
          written-local-variables:
            access WV_VeTAIR_U_EXV_SupplyVolt_write_IRV: accessed-variable=VeTAIR_U_EXV_SupplyVolt_write_IRV, variation-point={short-label=vpWV_VeTAIR_U_EXV_SupplyVolt_write_IRV, sw-syscond=1}
        PokeTAIR_U_FrWyVlv_MtrVltg: variation-point={short-label=vpPokeTAIR_U_FrWyVlv_MtrVltg, sw-syscond=1}
          written-local-variables:
            access WV_VeTAIR_U_FrWyVlv_MtrVltg_write_IRV: accessed-variable=VeTAIR_U_FrWyVlv_MtrVltg_write_IRV, variation-point={short-label=vpWV_VeTAIR_U_FrWyVlv_MtrVltg_write_IRV, sw-syscond=1}
        PokeTAIR_U_HTL_BypsVlv_MtrVltg: variation-point={short-label=vpPokeTAIR_U_HTL_BypsVlv_MtrVltg, sw-syscond=1}
          written-local-variables:
            access WV_VeTAIR_U_HTL_BypsVlv_MtrVltg_write_IRV: accessed-variable=VeTAIR_U_HTL_BypsVlv_MtrVltg_write_IRV, variation-point={short-label=vpWV_VeTAIR_U_HTL_BypsVlv_MtrVltg_write_IRV, sw-syscond=1}
            access WV_VeTAIR_b_HTL_BypsVlv_MtrVltgFA_write_IRV: accessed-variable=VeTAIR_b_HTL_BypsVlv_MtrVltgFA_write_IRV, variation-point={short-label=vpWV_VeTAIR_b_HTL_BypsVlv_MtrVltgFA_write_IRV, sw-syscond=1}
        PokeTAIR_U_HT_CabVlvSts
          written-local-variables:
            access WV_VeTAIR_U_HT_CabVlvSts_write_IRV: accessed-variable=VeTAIR_U_HT_CabVlvSts_write_IRV
            access WV_VeTAIR_b_HT_CabVlvStsFA_write_IRV: accessed-variable=VeTAIR_b_HT_CabVlvStsFA_write_IRV
        PokeTAIR_U_LTR_BypsVlv_MtrVltg: variation-point={short-label=vpPokeTAIR_U_LTR_BypsVlv_MtrVltg, sw-syscond=1}
          written-local-variables:
            access WV_VeTAIR_U_LTR_BypsVlv_MtrVltg_write_IRV: accessed-variable=VeTAIR_U_LTR_BypsVlv_MtrVltg_write_IRV, variation-point={short-label=vpWV_VeTAIR_U_LTR_BypsVlv_MtrVltg_write_IRV, sw-syscond=1}
            access WV_VeTAIR_b_LTR_BypsVlv_MtrVltgFA_write_IRV: accessed-variable=VeTAIR_b_LTR_BypsVlv_MtrVltgFA_write_IRV, variation-point={short-label=vpWV_VeTAIR_b_LTR_BypsVlv_MtrVltgFA_write_IRV, sw-syscond=1}
        PokeTAIR_U_OEXV_SupplyVolt: variation-point={short-label=vpPokeTAIR_U_OEXV_SupplyVolt, sw-syscond=1}
          written-local-variables:
            access WV_VeTAIR_U_OEXV_SupplyVolt_write_IRV: accessed-variable=VeTAIR_U_OEXV_SupplyVolt_write_IRV, variation-point={short-label=vpWV_VeTAIR_U_OEXV_SupplyVolt_write_IRV, sw-syscond=1}
        PokeTAIR_b_ACCompReq: variation-point={short-label=vpPokeTAIR_b_ACCompReq, sw-syscond=1}
          written-local-variables:
            access WV_VeTAIR_b_ACCompReq_write_IRV: accessed-variable=VeTAIR_b_ACCompReq_write_IRV, variation-point={short-label=vpWV_VeTAIR_b_ACCompReq_write_IRV, sw-syscond=1}
        PokeTAIR_b_AGS2_BoostSts: variation-point={short-label=vpPokeTAIR_b_AGS2_BoostSts, sw-syscond=1}
          written-local-variables:
            access WV_VeTAIR_b_AGS2_BoostSts_write_IRV: accessed-variable=VeTAIR_b_AGS2_BoostSts_write_IRV, variation-point={short-label=vpWV_VeTAIR_b_AGS2_BoostSts_write_IRV, sw-syscond=1}
        PokeTAIR_b_AGS2_CalibrationActv: variation-point={short-label=vpPokeTAIR_b_AGS2_CalibrationActv, sw-syscond=1}
          written-local-variables:
            access WV_VeTAIR_b_AGS2_CalibrationActv_write_IRV: accessed-variable=VeTAIR_b_AGS2_CalibrationActv_write_IRV, variation-point={short-label=vpWV_VeTAIR_b_AGS2_CalibrationActv_write_IRV, sw-syscond=1}
        PokeTAIR_b_AGS2_ErrMechBreak: variation-point={short-label=vpPokeTAIR_b_AGS2_ErrMechBreak, sw-syscond=1}
          written-local-variables:
            access WV_VeTAIR_b_AGS2_ErrMechBreak_write_IRV: accessed-variable=VeTAIR_b_AGS2_ErrMechBreak_write_IRV, variation-point={short-label=vpWV_VeTAIR_b_AGS2_ErrMechBreak_write_IRV, sw-syscond=1}
        PokeTAIR_b_AGS2_ErrMechStuck: variation-point={short-label=vpPokeTAIR_b_AGS2_ErrMechStuck, sw-syscond=1}
          written-local-variables:
            access WV_VeTAIR_b_AGS2_ErrMechStuck_write_IRV: accessed-variable=VeTAIR_b_AGS2_ErrMechStuck_write_IRV, variation-point={short-label=vpWV_VeTAIR_b_AGS2_ErrMechStuck_write_IRV, sw-syscond=1}
        PokeTAIR_b_AGS2_ErrOverTemp: variation-point={short-label=vpPokeTAIR_b_AGS2_ErrOverTemp, sw-syscond=1}
          written-local-variables:
            access WV_VeTAIR_b_AGS2_ErrOverTemp_write_IRV: accessed-variable=VeTAIR_b_AGS2_ErrOverTemp_write_IRV, variation-point={short-label=vpWV_VeTAIR_b_AGS2_ErrOverTemp_write_IRV, sw-syscond=1}
        PokeTAIR_b_AGS2_ErrOverVolt: variation-point={short-label=vpPokeTAIR_b_AGS2_ErrOverVolt, sw-syscond=1}
          written-local-variables:
            access WV_VeTAIR_b_AGS2_ErrOverVolt_write_IRV: accessed-variable=VeTAIR_b_AGS2_ErrOverVolt_write_IRV, variation-point={short-label=vpWV_VeTAIR_b_AGS2_ErrOverVolt_write_IRV, sw-syscond=1}
        PokeTAIR_b_AGS2_ErrUnderVolt: variation-point={short-label=vpPokeTAIR_b_AGS2_ErrUnderVolt, sw-syscond=1}
          written-local-variables:
            access WV_VeTAIR_b_AGS2_ErrUnderVolt_write_IRV: accessed-variable=VeTAIR_b_AGS2_ErrUnderVolt_write_IRV, variation-point={short-label=vpWV_VeTAIR_b_AGS2_ErrUnderVolt_write_IRV, sw-syscond=1}
        PokeTAIR_b_AGS2_ResErr: variation-point={short-label=vpPokeTAIR_b_AGS2_ResErr, sw-syscond=1}
          written-local-variables:
            access WV_VeTAIR_b_AGS2_ResErr_write_IRV: accessed-variable=VeTAIR_b_AGS2_ResErr_write_IRV, variation-point={short-label=vpWV_VeTAIR_b_AGS2_ResErr_write_IRV, sw-syscond=1}
        PokeTAIR_b_AGS_BoostSts: variation-point={short-label=vpPokeTAIR_b_AGS_BoostSts, sw-syscond=1}
          written-local-variables:
            access WV_VeTAIR_b_AGS_BoostSts_write_IRV: accessed-variable=VeTAIR_b_AGS_BoostSts_write_IRV, variation-point={short-label=vpWV_VeTAIR_b_AGS_BoostSts_write_IRV, sw-syscond=1}
        PokeTAIR_b_AGS_CalibrationActv: variation-point={short-label=vpPokeTAIR_b_AGS_CalibrationActv, sw-syscond=1}
          written-local-variables:
            access WV_VeTAIR_b_AGS_CalibrationActv_write_IRV: accessed-variable=VeTAIR_b_AGS_CalibrationActv_write_IRV, variation-point={short-label=vpWV_VeTAIR_b_AGS_CalibrationActv_write_IRV, sw-syscond=1}
        PokeTAIR_b_AGS_ErrMechBreak: variation-point={short-label=vpPokeTAIR_b_AGS_ErrMechBreak, sw-syscond=1}
          written-local-variables:
            access WV_VeTAIR_b_AGS_ErrMechBreak_write_IRV: accessed-variable=VeTAIR_b_AGS_ErrMechBreak_write_IRV, variation-point={short-label=vpWV_VeTAIR_b_AGS_ErrMechBreak_write_IRV, sw-syscond=1}
        PokeTAIR_b_AGS_ErrMechStuck: variation-point={short-label=vpPokeTAIR_b_AGS_ErrMechStuck, sw-syscond=1}
          written-local-variables:
            access WV_VeTAIR_b_AGS_ErrMechStuck_write_IRV: accessed-variable=VeTAIR_b_AGS_ErrMechStuck_write_IRV, variation-point={short-label=vpWV_VeTAIR_b_AGS_ErrMechStuck_write_IRV, sw-syscond=1}
        PokeTAIR_b_AGS_ErrOverTemp: variation-point={short-label=vpPokeTAIR_b_AGS_ErrOverTemp, sw-syscond=1}
          written-local-variables:
            access WV_VeTAIR_b_AGS_ErrOverTemp_write_IRV: accessed-variable=VeTAIR_b_AGS_ErrOverTemp_write_IRV, variation-point={short-label=vpWV_VeTAIR_b_AGS_ErrOverTemp_write_IRV, sw-syscond=1}
        PokeTAIR_b_AGS_ErrOverVolt: variation-point={short-label=vpPokeTAIR_b_AGS_ErrOverVolt, sw-syscond=1}
          written-local-variables:
            access WV_VeTAIR_b_AGS_ErrOverVolt_write_IRV: accessed-variable=VeTAIR_b_AGS_ErrOverVolt_write_IRV, variation-point={short-label=vpWV_VeTAIR_b_AGS_ErrOverVolt_write_IRV, sw-syscond=1}
        PokeTAIR_b_AGS_ErrUnderVolt: variation-point={short-label=vpPokeTAIR_b_AGS_ErrUnderVolt, sw-syscond=1}
          written-local-variables:
            access WV_VeTAIR_b_AGS_ErrUnderVolt_write_IRV: accessed-variable=VeTAIR_b_AGS_ErrUnderVolt_write_IRV, variation-point={short-label=vpWV_VeTAIR_b_AGS_ErrUnderVolt_write_IRV, sw-syscond=1}
        PokeTAIR_b_AGS_ResErr: variation-point={short-label=vpPokeTAIR_b_AGS_ResErr, sw-syscond=1}
          written-local-variables:
            access WV_VeTAIR_b_AGS_ResErr_write_IRV: accessed-variable=VeTAIR_b_AGS_ResErr_write_IRV, variation-point={short-label=vpWV_VeTAIR_b_AGS_ResErr_write_IRV, sw-syscond=1}
        PokeTAIR_b_CPV2_RsErr: variation-point={short-label=vpPokeTAIR_b_CPV2_RsErr, sw-syscond=1}
          written-local-variables:
            access WV_VeTAIR_b_CPV2_RsErr_write_IRV: accessed-variable=VeTAIR_b_CPV2_RsErr_write_IRV, variation-point={short-label=vpWV_VeTAIR_b_CPV2_RsErr_write_IRV, sw-syscond=1}
        PokeTAIR_b_CompSpdIncrReq: variation-point={short-label=vpPokeTAIR_b_CompSpdIncrReq, sw-syscond=1}
          written-local-variables:
            access WV_VeTAIR_b_CompSpdIncrReq_write_IRV: accessed-variable=VeTAIR_b_CompSpdIncrReq_write_IRV, variation-point={short-label=vpWV_VeTAIR_b_CompSpdIncrReq_write_IRV, sw-syscond=1}
        PokeTAIR_b_EEXV_CalRq: variation-point={short-label=vpPokeTAIR_b_EEXV_CalRq, sw-syscond=1}
          written-local-variables:
            access WV_VeTAIR_b_EEXV_CalRq_write_IRV: accessed-variable=VeTAIR_b_EEXV_CalRq_write_IRV, variation-point={short-label=vpWV_VeTAIR_b_EEXV_CalRq_write_IRV, sw-syscond=1}
        PokeTAIR_b_EEXV_RspErr: variation-point={short-label=vpPokeTAIR_b_EEXV_RspErr, sw-syscond=1}
          written-local-variables:
            access WV_VeTAIR_b_EEXV_RspErr_write_IRV: accessed-variable=VeTAIR_b_EEXV_RspErr_write_IRV, variation-point={short-label=vpWV_VeTAIR_b_EEXV_RspErr_write_IRV, sw-syscond=1}
        PokeTAIR_b_EXV_CalRq: variation-point={short-label=vpPokeTAIR_b_EXV_CalRq, sw-syscond=1}
          written-local-variables:
            access WV_VeTAIR_b_EXV_CalRq_write_IRV: accessed-variable=VeTAIR_b_EXV_CalRq_write_IRV, variation-point={short-label=vpWV_VeTAIR_b_EXV_CalRq_write_IRV, sw-syscond=1}
        PokeTAIR_b_EXV_RspErr: variation-point={short-label=vpPokeTAIR_b_EXV_RspErr, sw-syscond=1}
          written-local-variables:
            access WV_VeTAIR_b_EXV_RspErr_write_IRV: accessed-variable=VeTAIR_b_EXV_RspErr_write_IRV, variation-point={short-label=vpWV_VeTAIR_b_EXV_RspErr_write_IRV, sw-syscond=1}
        PokeTAIR_b_FrWyVlv_RsErr: variation-point={short-label=vpPokeTAIR_b_FrWyVlv_RsErr, sw-syscond=1}
          written-local-variables:
            access WV_VeTAIR_b_FrWyVlv_RsErr_write_IRV: accessed-variable=VeTAIR_b_FrWyVlv_RsErr_write_IRV, variation-point={short-label=vpWV_VeTAIR_b_FrWyVlv_RsErr_write_IRV, sw-syscond=1}
        PokeTAIR_b_HTL_BypsVlv_RsErr: variation-point={short-label=vpPokeTAIR_b_HTL_BypsVlv_RsErr, sw-syscond=1}
          written-local-variables:
            access WV_VeTAIR_b_HTL_BypsVlv_RsErr_write_IRV: accessed-variable=VeTAIR_b_HTL_BypsVlv_RsErr_write_IRV, variation-point={short-label=vpWV_VeTAIR_b_HTL_BypsVlv_RsErr_write_IRV, sw-syscond=1}
        PokeTAIR_b_HghRfrgtPresFailSts: variation-point={short-label=vpPokeTAIR_b_HghRfrgtPresFailSts, sw-syscond=1}
          written-local-variables:
            access WV_VeTAIR_b_HghRfrgtPresFailStsFA_write_IRV: accessed-variable=VeTAIR_b_HghRfrgtPresFailStsFA_write_IRV, variation-point={short-label=vpWV_VeTAIR_b_HghRfrgtPresFailStsFA_write_IRV, sw-syscond=1}
        PokeTAIR_b_LTR_BypsVlv_RsErr: variation-point={short-label=vpPokeTAIR_b_LTR_BypsVlv_RsErr, sw-syscond=1}
          written-local-variables:
            access WV_VeTAIR_b_LTR_BypsVlv_RsErr_write_IRV: accessed-variable=VeTAIR_b_LTR_BypsVlv_RsErr_write_IRV, variation-point={short-label=vpWV_VeTAIR_b_LTR_BypsVlv_RsErr_write_IRV, sw-syscond=1}
        PokeTAIR_b_OEXV_CalRq: variation-point={short-label=vpPokeTAIR_b_OEXV_CalRq, sw-syscond=1}
          written-local-variables:
            access WV_VeTAIR_b_OEXV_CalRq_write_IRV: accessed-variable=VeTAIR_b_OEXV_CalRq_write_IRV, variation-point={short-label=vpWV_VeTAIR_b_OEXV_CalRq_write_IRV, sw-syscond=1}
        PokeTAIR_b_OEXV_RspErr: variation-point={short-label=vpPokeTAIR_b_OEXV_RspErr, sw-syscond=1}
          written-local-variables:
            access WV_VeTAIR_b_OEXV_RspErr_write_IRV: accessed-variable=VeTAIR_b_OEXV_RspErr_write_IRV, variation-point={short-label=vpWV_VeTAIR_b_OEXV_RspErr_write_IRV, sw-syscond=1}
        PokeTAIR_b_RespErr_EAC: variation-point={short-label=vpPokeTAIR_b_RespErr_EAC, sw-syscond=1}
          written-local-variables:
            access WV_VeTAIR_b_RespErr_EAC_write_IRV: accessed-variable=VeTAIR_b_RespErr_EAC_write_IRV, variation-point={short-label=vpWV_VeTAIR_b_RespErr_EAC_write_IRV, sw-syscond=1}
        PokeTAIR_b_WinshldDfrst: variation-point={short-label=vpPokeTAIR_b_WinshldDfrst, sw-syscond=1}
          written-local-variables:
            access WV_VeTAIR_b_WinshldDfrst_write_IRV: accessed-variable=VeTAIR_b_WinshldDfrst_write_IRV, variation-point={short-label=vpWV_VeTAIR_b_WinshldDfrst_write_IRV, sw-syscond=1}
        PokeTAIR_e_AGS2_CalibrationSts: variation-point={short-label=vpPokeTAIR_e_AGS2_CalibrationSts, sw-syscond=1}
          written-local-variables:
            access WV_VeTAIR_e_AGS2_CalibrationSts_write_IRV: accessed-variable=VeTAIR_e_AGS2_CalibrationSts_write_IRV, variation-point={short-label=vpWV_VeTAIR_e_AGS2_CalibrationSts_write_IRV, sw-syscond=1}
        PokeTAIR_e_AGS2_CurrPos_LIN: variation-point={short-label=vpPokeTAIR_e_AGS2_CurrPos_LIN, sw-syscond=1}
          written-local-variables:
            access WV_VeTAIR_Pct_AGS2_CurrPos_CAN_write_IRV: accessed-variable=VeTAIR_Pct_AGS2_CurrPos_CAN_write_IRV, variation-point={short-label=vpWV_VeTAIR_Pct_AGS2_CurrPos_CAN_write_IRV, sw-syscond=1}
            access WV_VeTAIR_b_AGS2_CurrPosFA_write_IRV: accessed-variable=VeTAIR_b_AGS2_CurrPosFA_write_IRV, variation-point={short-label=vpWV_VeTAIR_b_AGS2_CurrPosFA_write_IRV, sw-syscond=1}
            access WV_VeTAIR_e_AGS2_CurrPos_write_IRV: accessed-variable=VeTAIR_e_AGS2_CurrPos_write_IRV, variation-point={short-label=vpWV_VeTAIR_e_AGS2_CurrPos_write_IRV, sw-syscond=1}
        PokeTAIR_e_AGS2_ErrFdb: variation-point={short-label=vpPokeTAIR_e_AGS2_ErrFdb, sw-syscond=1}
          written-local-variables:
            access WV_VeTAIR_b_AGS2_ErrFdbFA_write_IRV: accessed-variable=VeTAIR_b_AGS2_ErrFdbFA_write_IRV, variation-point={short-label=vpWV_VeTAIR_b_AGS2_ErrFdbFA_write_IRV, sw-syscond=1}
            access WV_VeTAIR_e_AGS2_ErrFdb_write_IRV: accessed-variable=VeTAIR_e_AGS2_ErrFdb_write_IRV, variation-point={short-label=vpWV_VeTAIR_e_AGS2_ErrFdb_write_IRV, sw-syscond=1}
        PokeTAIR_e_AGS_CalibrationSts: variation-point={short-label=vpPokeTAIR_e_AGS_CalibrationSts, sw-syscond=1}
          written-local-variables:
            access WV_VeTAIR_e_AGS_CalibrationSts_write_IRV: accessed-variable=VeTAIR_e_AGS_CalibrationSts_write_IRV, variation-point={short-label=vpWV_VeTAIR_e_AGS_CalibrationSts_write_IRV, sw-syscond=1}
        PokeTAIR_e_AGS_CurrPos_LIN: variation-point={short-label=vpPokeTAIR_e_AGS_CurrPos_LIN, sw-syscond=1}
          written-local-variables:
            access WV_VeTAIR_Pct_AGS_CurrPos_CAN_write_IRV: accessed-variable=VeTAIR_Pct_AGS_CurrPos_CAN_write_IRV, variation-point={short-label=vpWV_VeTAIR_Pct_AGS_CurrPos_CAN_write_IRV, sw-syscond=1}
            access WV_VeTAIR_b_AGS_CurrPosFA_write_IRV: accessed-variable=VeTAIR_b_AGS_CurrPosFA_write_IRV, variation-point={short-label=vpWV_VeTAIR_b_AGS_CurrPosFA_write_IRV, sw-syscond=1}
            access WV_VeTAIR_e_AGS_CurrPos_write_IRV: accessed-variable=VeTAIR_e_AGS_CurrPos_write_IRV, variation-point={short-label=vpWV_VeTAIR_e_AGS_CurrPos_write_IRV, sw-syscond=1}
        PokeTAIR_e_AGS_ErrFdb: variation-point={short-label=vpPokeTAIR_e_AGS_ErrFdb, sw-syscond=1}
          written-local-variables:
            access WV_VeTAIR_b_AGS_ErrFdbFA_write_IRV: accessed-variable=VeTAIR_b_AGS_ErrFdbFA_write_IRV, variation-point={short-label=vpWV_VeTAIR_b_AGS_ErrFdbFA_write_IRV, sw-syscond=1}
            access WV_VeTAIR_e_AGS_ErrFdb_write_IRV: accessed-variable=VeTAIR_e_AGS_ErrFdb_write_IRV, variation-point={short-label=vpWV_VeTAIR_e_AGS_ErrFdb_write_IRV, sw-syscond=1}
        PokeTAIR_e_CPV2_CalSts: variation-point={short-label=vpPokeTAIR_e_CPV2_CalSts, sw-syscond=1}
          written-local-variables:
            access WV_VeTAIR_e_CPV2_CalSts_write_IRV: accessed-variable=VeTAIR_e_CPV2_CalSts_write_IRV, variation-point={short-label=vpWV_VeTAIR_e_CPV2_CalSts_write_IRV, sw-syscond=1}
        PokeTAIR_e_CPV2_ErrSts: variation-point={short-label=vpPokeTAIR_e_CPV2_ErrSts, sw-syscond=1}
          written-local-variables:
            access WV_VeTAIR_e_CPV2_ErrSts_write_IRV: accessed-variable=VeTAIR_e_CPV2_ErrSts_write_IRV, variation-point={short-label=vpWV_VeTAIR_e_CPV2_ErrSts_write_IRV, sw-syscond=1}
        PokeTAIR_e_CompFltStat: variation-point={short-label=vpPokeTAIR_e_CompFltStat, sw-syscond=1}
          written-local-variables:
            access WV_VeTAIR_e_CompFltStat_write_IRV: accessed-variable=VeTAIR_e_CompFltStat_write_IRV, variation-point={short-label=vpWV_VeTAIR_e_CompFltStat_write_IRV, sw-syscond=1}
        PokeTAIR_e_CompStat: variation-point={short-label=vpPokeTAIR_e_CompStat, sw-syscond=1}
          written-local-variables:
            access WV_VeTAIR_e_CompStat_write_IRV: accessed-variable=VeTAIR_e_CompStat_write_IRV, variation-point={short-label=vpWV_VeTAIR_e_CompStat_write_IRV, sw-syscond=1}
        PokeTAIR_e_EEXV_CalStat: variation-point={short-label=vpPokeTAIR_e_EEXV_CalStat, sw-syscond=1}
          written-local-variables:
            access WV_VeTAIR_e_EEXV_CalStat_write_IRV: accessed-variable=VeTAIR_e_EEXV_CalStat_write_IRV, variation-point={short-label=vpWV_VeTAIR_e_EEXV_CalStat_write_IRV, sw-syscond=1}
        PokeTAIR_e_EEXV_Err: variation-point={short-label=vpPokeTAIR_e_EEXV_Err, sw-syscond=1}
          written-local-variables:
            access WV_VeTAIR_e_EEXV_Err_write_IRV: accessed-variable=VeTAIR_e_EEXV_Err_write_IRV, variation-point={short-label=vpWV_VeTAIR_e_EEXV_Err_write_IRV, sw-syscond=1}
        PokeTAIR_e_EEXV_Sts: variation-point={short-label=vpPokeTAIR_e_EEXV_Sts, sw-syscond=1}
          written-local-variables:
            access WV_VeTAIR_e_EEXV_Sts_write_IRV: accessed-variable=VeTAIR_e_EEXV_Sts_write_IRV, variation-point={short-label=vpWV_VeTAIR_e_EEXV_Sts_write_IRV, sw-syscond=1}
        PokeTAIR_e_EXV_CalStat: variation-point={short-label=vpPokeTAIR_e_EXV_CalStat, sw-syscond=1}
          written-local-variables:
            access WV_VeTAIR_e_EXV_CalStat_write_IRV: accessed-variable=VeTAIR_e_EXV_CalStat_write_IRV, variation-point={short-label=vpWV_VeTAIR_e_EXV_CalStat_write_IRV, sw-syscond=1}
        PokeTAIR_e_EXV_Err: variation-point={short-label=vpPokeTAIR_e_EXV_Err, sw-syscond=1}
          written-local-variables:
            access WV_VeTAIR_e_EXV_Err_write_IRV: accessed-variable=VeTAIR_e_EXV_Err_write_IRV, variation-point={short-label=vpWV_VeTAIR_e_EXV_Err_write_IRV, sw-syscond=1}
        PokeTAIR_e_EXV_Sts: variation-point={short-label=vpPokeTAIR_e_EXV_Sts, sw-syscond=1}
          written-local-variables:
            access WV_VeTAIR_e_EXV_Sts_write_IRV: accessed-variable=VeTAIR_e_EXV_Sts_write_IRV, variation-point={short-label=vpWV_VeTAIR_e_EXV_Sts_write_IRV, sw-syscond=1}
        PokeTAIR_e_FrWyVlv_CalSts: variation-point={short-label=vpPokeTAIR_e_FrWyVlv_CalSts, sw-syscond=1}
          written-local-variables:
            access WV_VeTAIR_e_FrWyVlv_CalSts_write_IRV: accessed-variable=VeTAIR_e_FrWyVlv_CalSts_write_IRV, variation-point={short-label=vpWV_VeTAIR_e_FrWyVlv_CalSts_write_IRV, sw-syscond=1}
        PokeTAIR_e_FrWyVlv_ErrSts: variation-point={short-label=vpPokeTAIR_e_FrWyVlv_ErrSts, sw-syscond=1}
          written-local-variables:
            access WV_VeTAIR_e_FrWyVlv_ErrSts_write_IRV: accessed-variable=VeTAIR_e_FrWyVlv_ErrSts_write_IRV, variation-point={short-label=vpWV_VeTAIR_e_FrWyVlv_ErrSts_write_IRV, sw-syscond=1}
        PokeTAIR_e_HTL_BypsVlv_CalSts: variation-point={short-label=vpPokeTAIR_e_HTL_BypsVlv_CalSts, sw-syscond=1}
          written-local-variables:
            access WV_VeTAIR_b_HTL_BypsVlv_CalStsFA_write_IRV: accessed-variable=VeTAIR_b_HTL_BypsVlv_CalStsFA_write_IRV, variation-point={short-label=vpWV_VeTAIR_b_HTL_BypsVlv_CalStsFA_write_IRV, sw-syscond=1}
            access WV_VeTAIR_e_HTL_BypsVlv_CalSts_write_IRV: accessed-variable=VeTAIR_e_HTL_BypsVlv_CalSts_write_IRV, variation-point={short-label=vpWV_VeTAIR_e_HTL_BypsVlv_CalSts_write_IRV, sw-syscond=1}
        PokeTAIR_e_HTL_BypsVlv_ErrSts: variation-point={short-label=vpPokeTAIR_e_HTL_BypsVlv_ErrSts, sw-syscond=1}
          written-local-variables:
            access WV_VeTAIR_b_HTL_BypsVlv_ErrStsFA_write_IRV: accessed-variable=VeTAIR_b_HTL_BypsVlv_ErrStsFA_write_IRV, variation-point={short-label=vpWV_VeTAIR_b_HTL_BypsVlv_ErrStsFA_write_IRV, sw-syscond=1}
            access WV_VeTAIR_e_HTL_BypsVlv_ErrSts_write_IRV: accessed-variable=VeTAIR_e_HTL_BypsVlv_ErrSts_write_IRV, variation-point={short-label=vpWV_VeTAIR_e_HTL_BypsVlv_ErrSts_write_IRV, sw-syscond=1}
        PokeTAIR_e_LTR_BypsVlv_CalSts: variation-point={short-label=vpPokeTAIR_e_LTR_BypsVlv_CalSts, sw-syscond=1}
          written-local-variables:
            access WV_VeTAIR_b_LTR_BypsVlv_CalStsFA_write_IRV: accessed-variable=VeTAIR_b_LTR_BypsVlv_CalStsFA_write_IRV, variation-point={short-label=vpWV_VeTAIR_b_LTR_BypsVlv_CalStsFA_write_IRV, sw-syscond=1}
            access WV_VeTAIR_e_LTR_BypsVlv_CalSts_write_IRV: accessed-variable=VeTAIR_e_LTR_BypsVlv_CalSts_write_IRV, variation-point={short-label=vpWV_VeTAIR_e_LTR_BypsVlv_CalSts_write_IRV, sw-syscond=1}
        PokeTAIR_e_LTR_BypsVlv_ErrSts: variation-point={short-label=vpPokeTAIR_e_LTR_BypsVlv_ErrSts, sw-syscond=1}
          written-local-variables:
            access WV_VeTAIR_b_LTR_BypsVlv_ErrStsFA_write_IRV: accessed-variable=VeTAIR_b_LTR_BypsVlv_ErrStsFA_write_IRV, variation-point={short-label=vpWV_VeTAIR_b_LTR_BypsVlv_ErrStsFA_write_IRV, sw-syscond=1}
            access WV_VeTAIR_e_LTR_BypsVlv_ErrSts_write_IRV: accessed-variable=VeTAIR_e_LTR_BypsVlv_ErrSts_write_IRV, variation-point={short-label=vpWV_VeTAIR_e_LTR_BypsVlv_ErrSts_write_IRV, sw-syscond=1}
        PokeTAIR_e_OEXV_CalStat: variation-point={short-label=vpPokeTAIR_e_OEXV_CalStat, sw-syscond=1}
          written-local-variables:
            access WV_VeTAIR_e_OEXV_CalStat_write_IRV: accessed-variable=VeTAIR_e_OEXV_CalStat_write_IRV, variation-point={short-label=vpWV_VeTAIR_e_OEXV_CalStat_write_IRV, sw-syscond=1}
        PokeTAIR_e_OEXV_Err: variation-point={short-label=vpPokeTAIR_e_OEXV_Err, sw-syscond=1}
          written-local-variables:
            access WV_VeTAIR_e_OEXV_Err_write_IRV: accessed-variable=VeTAIR_e_OEXV_Err_write_IRV, variation-point={short-label=vpWV_VeTAIR_e_OEXV_Err_write_IRV, sw-syscond=1}
        PokeTAIR_e_OEXV_Sts: variation-point={short-label=vpPokeTAIR_e_OEXV_Sts, sw-syscond=1}
          written-local-variables:
            access WV_VeTAIR_e_OEXV_Sts_write_IRV: accessed-variable=VeTAIR_e_OEXV_Sts_write_IRV, variation-point={short-label=vpWV_VeTAIR_e_OEXV_Sts_write_IRV, sw-syscond=1}
        PokeTAIR_e_RearDefrostSts: variation-point={short-label=vpPokeTAIR_e_RearDefrostSts, sw-syscond=1}
          written-local-variables:
            access WV_VeTAIR_b_EBL_StatFA_write_IRV: accessed-variable=VeTAIR_b_EBL_StatFA_write_IRV, variation-point={short-label=vpWV_VeTAIR_b_EBL_StatFA_write_IRV, sw-syscond=1}
            access WV_VeTAIR_e_RearDefrostSts_write_IRV: accessed-variable=VeTAIR_e_RearDefrostSts_write_IRV, variation-point={short-label=vpWV_VeTAIR_e_RearDefrostSts_write_IRV, sw-syscond=1}
        PokeTAIR_kp_EXV_RefPress: variation-point={short-label=vpPokeTAIR_kp_EXV_RefPress, sw-syscond=1}
          written-local-variables:
            access WV_VeTAIR_b_EXV_RefPressFA_write_IRV: accessed-variable=VeTAIR_b_EXV_RefPressFA_write_IRV, variation-point={short-label=vpWV_VeTAIR_b_EXV_RefPressFA_write_IRV, sw-syscond=1}
            access WV_VeTAIR_kp_EXV_RefPress_write_IRV: accessed-variable=VeTAIR_kp_EXV_RefPress_write_IRV, variation-point={short-label=vpWV_VeTAIR_kp_EXV_RefPress_write_IRV, sw-syscond=1}
        PokeTAIR_n_CompSpdFdb: variation-point={short-label=vpPokeTAIR_n_CompSpdFdb, sw-syscond=1}
          written-local-variables:
            access WV_VeTAIR_b_CompSpdFdbFA_write_IRV: accessed-variable=VeTAIR_b_CompSpdFdbFA_write_IRV, variation-point={short-label=vpWV_VeTAIR_b_CompSpdFdbFA_write_IRV, sw-syscond=1}
            access WV_VeTAIR_n_CompSpdFdb_write_IRV: accessed-variable=VeTAIR_n_CompSpdFdb_write_IRV, variation-point={short-label=vpWV_VeTAIR_n_CompSpdFdb_write_IRV, sw-syscond=1}
        PokeTAIR_p_EEXV_RefPress: variation-point={short-label=vpPokeTAIR_p_EEXV_RefPress, sw-syscond=1}
          written-local-variables:
            access WV_VeTAIR_b_EEXV_RefPressFA_write_IRV: accessed-variable=VeTAIR_b_EEXV_RefPressFA_write_IRV, variation-point={short-label=vpWV_VeTAIR_b_EEXV_RefPressFA_write_IRV, sw-syscond=1}
            access WV_VeTAIR_p_EEXV_RefPress_write_IRV: accessed-variable=VeTAIR_p_EEXV_RefPress_write_IRV, variation-point={short-label=vpWV_VeTAIR_p_EEXV_RefPress_write_IRV, sw-syscond=1}
        PokeTAIR_p_OEXV_RefPress: variation-point={short-label=vpPokeTAIR_p_OEXV_RefPress, sw-syscond=1}
          written-local-variables:
            access WV_VeTAIR_b_OEXV_RefPressFA_write_IRV: accessed-variable=VeTAIR_b_OEXV_RefPressFA_write_IRV, variation-point={short-label=vpWV_VeTAIR_b_OEXV_RefPressFA_write_IRV, sw-syscond=1}
            access WV_VeTAIR_p_OEXV_RefPress_write_IRV: accessed-variable=VeTAIR_p_OEXV_RefPress_write_IRV, variation-point={short-label=vpWV_VeTAIR_p_OEXV_RefPress_write_IRV, sw-syscond=1}
        PokeTAIR_y_CPV2_ErrMsgs: variation-point={short-label=vpPokeTAIR_y_CPV2_ErrMsgs, sw-syscond=1}
          written-local-variables:
            access WV_VeTAIR_b_CPV2_ErrMsgsFA_write_IRV: accessed-variable=VeTAIR_b_CPV2_ErrMsgsFA_write_IRV, variation-point={short-label=vpWV_VeTAIR_b_CPV2_ErrMsgsFA_write_IRV, sw-syscond=1}
            access WV_VeTAIR_y_CPV2_ErrMsgs_write_IRV: accessed-variable=VeTAIR_y_CPV2_ErrMsgs_write_IRV, variation-point={short-label=vpWV_VeTAIR_y_CPV2_ErrMsgs_write_IRV, sw-syscond=1}
        PokeTAIR_y_FrWyVlv_ErrMsgs: variation-point={short-label=vpPokeTAIR_y_FrWyVlv_ErrMsgs, sw-syscond=1}
          written-local-variables:
            access WV_VeTAIR_b_FrWyVlv_ErrMsgsFA_write_IRV: accessed-variable=VeTAIR_b_FrWyVlv_ErrMsgsFA_write_IRV, variation-point={short-label=vpWV_VeTAIR_b_FrWyVlv_ErrMsgsFA_write_IRV, sw-syscond=1}
            access WV_VeTAIR_y_FrWyVlv_ErrMsgs_write_IRV: accessed-variable=VeTAIR_y_FrWyVlv_ErrMsgs_write_IRV, variation-point={short-label=vpWV_VeTAIR_y_FrWyVlv_ErrMsgs_write_IRV, sw-syscond=1}
        PokeTAIR_y_HTL_BypsVlv_ErrMsgs: variation-point={short-label=vpPokeTAIR_y_HTL_BypsVlv_ErrMsgs, sw-syscond=1}
          written-local-variables:
            access WV_VeTAIR_b_HTL_BypsVlv_ErrMsgsFA_write_IRV: accessed-variable=VeTAIR_b_HTL_BypsVlv_ErrMsgsFA_write_IRV, variation-point={short-label=vpWV_VeTAIR_b_HTL_BypsVlv_ErrMsgsFA_write_IRV, sw-syscond=1}
            access WV_VeTAIR_y_HTL_BypsVlv_ErrMsgs_write_IRV: accessed-variable=VeTAIR_y_HTL_BypsVlv_ErrMsgs_write_IRV, variation-point={short-label=vpWV_VeTAIR_y_HTL_BypsVlv_ErrMsgs_write_IRV, sw-syscond=1}
        PokeTAIR_y_LTR_BypsVlv_ErrMsgs: variation-point={short-label=vpPokeTAIR_y_LTR_BypsVlv_ErrMsgs, sw-syscond=1}
          written-local-variables:
            access WV_VeTAIR_b_LTR_BypsVlv_ErrMsgsFA_write_IRV: accessed-variable=VeTAIR_b_LTR_BypsVlv_ErrMsgsFA_write_IRV, variation-point={short-label=vpWV_VeTAIR_b_LTR_BypsVlv_ErrMsgsFA_write_IRV, sw-syscond=1}
            access WV_VeTAIR_y_LTR_BypsVlv_ErrMsgs_write_IRV: accessed-variable=VeTAIR_y_LTR_BypsVlv_ErrMsgs_write_IRV, variation-point={short-label=vpWV_VeTAIR_y_LTR_BypsVlv_ErrMsgs_write_IRV, sw-syscond=1}
        PokeTAIR_y_RearCabinFanSts: variation-point={short-label=vpPokeTAIR_y_RearCabinFanSts, sw-syscond=1}
          written-local-variables:
            access WV_VeTAIR_b_RearCabinFanStsFA_write_IRV: accessed-variable=VeTAIR_b_RearCabinFanStsFA_write_IRV, variation-point={short-label=vpWV_VeTAIR_b_RearCabinFanStsFA_write_IRV, sw-syscond=1}
            access WV_VeTAIR_y_RearCabinFanSts_write_IRV: accessed-variable=VeTAIR_y_RearCabinFanSts_write_IRV, variation-point={short-label=vpWV_VeTAIR_y_RearCabinFanSts_write_IRV, sw-syscond=1}
      15 x variation point proxy, all with category=CONDITION:
        Variant_TAIR_1: condition-access=1
        Variant_TAIR_{10..15}: condition-access=1
        Variant_TAIR_2: condition-access=1
        Variant_TAIR_3: condition-access=1
        Variant_TAIR_4: condition-access=0
        Variant_TAIR_5: condition-access=1
        Variant_TAIR_6: condition-access=0
        Variant_TAIR_7: condition-access=1
        Variant_TAIR_8: condition-access=0
        Variant_TAIR_9: condition-access=1
