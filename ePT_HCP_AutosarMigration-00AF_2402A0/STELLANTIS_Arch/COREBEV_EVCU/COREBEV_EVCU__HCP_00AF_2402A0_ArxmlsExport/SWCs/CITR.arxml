[part 2 of 2: package /STELLANTIS/EPT/ASWCs]
AUTOSAR XML (schema 4-2-2)
package /STELLANTIS/EPT/ASWCs  (continued)
  application sw component type CITR  (continued)
    behavior IB_CITR: data-type-mapping=msADTtoIDTMapping, handle-termination-and-restart=NO-SUPPORT  (continued)
      init event Event_CITR_ac_Init: start-on-event=CITR_ac_Init
      init event Event_PwrOn: start-on-event=CITR_PwrOn
      init event Event_PwrOff: start-on-event=CITR_PwrOff
      data received event Event_IOControl_Charge_Port_Lock: start-on-event=IOControl_Charge_Port_Lock, data=VeDCAB_e_IOControl_Charge_Port_Lock_Op.Value
      data received event Event_DIDWrite_RWDB604_DCChrg_TestSts: start-on-event=DIDWrite_RWDB604_DCChrg_TestSts, data=VeDCAB_e_RWDB604_DCChrg_TestSts_DidWrite.Value
      explicit-inter-runnable-variables:
        21 x data, all with category=VALUE, sw-calibration-access=READ-ONLY:
          ChrgPort_Sense_Init_write_IRV: type=Boolean, init-value=0
          ChrgPortDoorSts_Init_write_IRV: type=TeCITR_e_ChrgPortDoor_Sts, init-value=CeCITR_e_ChrgPortDoor_Closed
          DoorLockLastElSts_Init_write_IRV: type=TeOBCR_e_DoorLockSts, init-value=CeOBCR_e_LKD
          DoorLockLastElSts_FA_Init_write_IRV: type=Boolean, init-value=0
          DoorLockLastElSts_SgnlRcvd_Init_write_IRV: type=Boolean, init-value=0
          DoorLockLastElSts_2_Init_write_IRV: type=TeOBCR_e_DoorLockSts, init-value=CeOBCR_e_LKD
          DoorLockLastElSts_2_FA_Init_write_IRV: type=Boolean, init-value=0
          DoorLockLastElSts_2_SgnlRcvd_Init_write_IRV: type=Boolean, init-value=0
          PwrLimReq_Init_write_IRV: type=TeOBCR_e_PwrLimReq, init-value=CeOBCR_e_PwrLimReq_SNA
          PwrLimReq_FA_Init_write_IRV: type=Boolean, init-value=0
          PwrLimReq_SgnlRcvd_Init_write_IRV: type=Boolean, init-value=0
          PwrLimReq_2_Init_write_IRV: type=TeOBCR_e_PwrLimReq, init-value=CeOBCR_e_PwrLimReq_SNA
          PwrLimReq_FA_2_Init_write_IRV: type=Boolean, init-value=0
          PwrLimReq_SgnlRcvd_2_Init_write_IRV: type=Boolean, init-value=0
          ChrgPort_BCM_Cmd_Init_write_IRV: type=Boolean, init-value=0
          ChrgPort_BCM_Cmd_SgnlRcvd_Init_write_IRV: type=Boolean, init-value=0
          LockSense_write_IRV: type=Boolean, init-value=0
          ChrgPortLock_StsB_Init_write_IRV: type=Float, init-value=0
          ChrgPortLock_StsB_FA_Init_write_IRV: type=Boolean, init-value=0
          ChrgPortLock_StsC_Init_write_IRV: type=Boolean, init-value=0
          ChrgPortLock_StsC_FA_Init_write_IRV: type=Boolean, init-value=0
      444 x runnable:
        CITR_ac_Init
          data-send-points:
            93 x access:
              OUT_VeCITR_e_DoorLockLastElSts_Value: accessed-variable=VeCITR_e_DoorLockLastElSts.Value
              OUT_VeCITR_e_CPIM_RedLED_FailSts_Value: accessed-variable=VeCITR_e_CPIM_RedLED_FailSts.Value
              OUT_VeCITR_e_CPIM_GreenLED_FailSts_Value: accessed-variable=VeCITR_e_CPIM_GreenLED_FailSts.Value
              OUT_VeCITR_e_CPIM_BlueLED_FailSts_Value: accessed-variable=VeCITR_e_CPIM_BlueLED_FailSts.Value
              OUT_VeCITR_e_CPIM_Ind{1..5}_Fdbk_Value: accessed-variable=VeCITR_e_CPIM_Ind{1..5}_Fdbk.Value
              OUT_VeCITR_e_CPIM_Ind{1..5}_FailSts_Value: accessed-variable=VeCITR_e_CPIM_Ind{1..5}_FailSts.Value
              OUT_VeCITR_e_CPIM_Ind_Color_Fdbk_Value: accessed-variable=VeCITR_e_CPIM_Ind_Color_Fdbk.Value
              OUT_VeCITR_e_BCIM_Ind{1..5}_Fdbk_Value: accessed-variable=VeCITR_e_BCIM_Ind{1..5}_Fdbk.Value
              OUT_VeCITR_e_BCIM_Ind{1..5}_FailSts_Value: accessed-variable=VeCITR_e_BCIM_Ind{1..5}_FailSts.Value
              OUT_VeCITR_e_PwrLimReq_Value: accessed-variable=VeCITR_e_PwrLimReq.Value
              OUT_VeCITR_e_CPIM_Icon1_Sts_Value: accessed-variable=VeCITR_e_CPIM_Icon1_Sts.Value
              OUT_VeCITR_e_CPIM_Icon2_Sts_Value: accessed-variable=VeCITR_e_CPIM_Icon2_Sts.Value
              OUT_VeCITR_e_HU_Sch1_Type_Value: accessed-variable=VeCITR_e_HU_Sch1_Type.Value
              OUT_VeCITR_e_TBM_Sch1_Type_Value: accessed-variable=VeCITR_e_TBM_Sch1_Type.Value
              OUT_VeCITR_e_HU_Sch2_Type_Value: accessed-variable=VeCITR_e_HU_Sch2_Type.Value
              OUT_VeCITR_e_TBM_Sch2_Type_Value: accessed-variable=VeCITR_e_TBM_Sch2_Type.Value
              OUT_VeCITR_e_HU_Sch3_Type_Value: accessed-variable=VeCITR_e_HU_Sch3_Type.Value
              OUT_VeCITR_e_TBM_Sch3_Type_Value: accessed-variable=VeCITR_e_TBM_Sch3_Type.Value
              OUT_VeCITR_e_CPIM_ChrgPortLock_FailSts_Value: accessed-variable=VeCITR_e_CPIM_ChrgPortLock_FailSts.Value
              OUT_VeCITR_e_RRM_VP_Level_Value: accessed-variable=VeCITR_e_RRM_VP_Level.Value
              OUT_VeCITR_e_DateTmFormat_Value: accessed-variable=VeCITR_e_DateTmFormat.Value
              OUT_VeCITR_e_DVC_ChrgPort_IO_Value: accessed-variable=VeCITR_e_DVC_ChrgPort_IO.Value
              OUT_VeCITR_e_DCChrg_TestSts_Value: accessed-variable=VeCITR_e_DCChrg_TestSts.Value
              OUT_VeCITR_e_ChrgPortLock_StsB_Value: accessed-variable=VeCITR_e_ChrgPortLock_StsB.Value
              OUT_VeCITR_e_DVC_BCIM_IO_Value: accessed-variable=VeCITR_e_DVC_BCIM_IO.Value
              OUT_VeCITR_e_DVC_BCIM_Ind{1..5}_Value: accessed-variable=VeCITR_e_DVC_BCIM_Ind{1..5}.Value
              OUT_VeCITR_e_DVC_CPIM_IO_Value: accessed-variable=VeCITR_e_DVC_CPIM_IO.Value
              OUT_VeCITR_e_DVC_CPIM_Ind{1..5}_Value: accessed-variable=VeCITR_e_DVC_CPIM_Ind{1..5}.Value
              OUT_VeCITR_e_DVC_CPIMBlinkRate_Value: accessed-variable=VeCITR_e_DVC_CPIMBlinkRate.Value
              OUT_VeCITR_e_DVC_CPIM_Color_Value: accessed-variable=VeCITR_e_DVC_CPIM_Color.Value
              OUT_VeCITR_e_DVC_CPIM_IconI1_Value: accessed-variable=VeCITR_e_DVC_CPIM_IconI1.Value
              OUT_VeCITR_e_DVC_CPIM_IconI2_Value: accessed-variable=VeCITR_e_DVC_CPIM_IconI2.Value
              OUT_VeCITR_e_DVC_BCIM_BlinkRate_Value: accessed-variable=VeCITR_e_DVC_BCIM_BlinkRate.Value
              OUT_VeCITR_e_HU_Sch3_Allow_Value: accessed-variable=VeCITR_e_HU_Sch3_Allow.Value
              OUT_VeCITR_e_TBM_Sch3_Allow_Value: accessed-variable=VeCITR_e_TBM_Sch3_Allow.Value
              OUT_VeCITR_e_HU_Sch4_Allow_Value: accessed-variable=VeCITR_e_HU_Sch4_Allow.Value
              OUT_VeCITR_e_TBM_Sch4_Allow_Value: accessed-variable=VeCITR_e_TBM_Sch4_Allow.Value
              OUT_VeCITR_e_FOTA_Install_Type_Value: accessed-variable=VeCITR_e_FOTA_Install_Type.Value
              OUT_VeCITR_e_FOTA_Install_Status_Value: accessed-variable=VeCITR_e_FOTA_Install_Status.Value
              OUT_VeCITR_e_ChrgrFlapSts_Value: accessed-variable=VeCITR_e_ChrgrFlapSts.Value
              OUT_VeCITR_e_BCIM_Ind_Color_Fdbk_Value: accessed-variable=VeCITR_e_BCIM_Ind_Color_Fdbk.Value
              OUT_VeCITR_e_DVC_BCIM_Color_Value: accessed-variable=VeCITR_e_DVC_BCIM_Color.Value
              OUT_VeCITR_e_HU_ChrgSchedType1_Value: accessed-variable=VeCITR_e_HU_ChrgSchedType1.Value
              OUT_VeCITR_e_HU_ChrgSchedType2_Value: accessed-variable=VeCITR_e_HU_ChrgSchedType2.Value
              OUT_VeCITR_e_RmtChrgPortLkCmd_Value: accessed-variable=VeCITR_e_RmtChrgPortLkCmd.Value
              OUT_VeCITR_e_CoopCh_ChrgCmd_Value: accessed-variable=VeCITR_e_CoopCh_ChrgCmd.Value
              OUT_VeCITR_e_TBM_ChrgSchedType1_Value: accessed-variable=VeCITR_e_TBM_ChrgSchedType1.Value
              OUT_VeCITR_e_TBM_ChrgSchedType2_Value: accessed-variable=VeCITR_e_TBM_ChrgSchedType2.Value
              OUT_VeCITR_e_PPFaultRsn_Value: accessed-variable=VeCITR_e_PPFaultRsn.Value
              OUT_VeCITR_e_PPFault_Value: accessed-variable=VeCITR_e_PPFault.Value
              OUT_VeCITR_e_PPLEDFault_Value: accessed-variable=VeCITR_e_PPLEDFault.Value
              OUT_VeCITR_e_PP2FaultRsn_Value: accessed-variable=VeCITR_e_PP2FaultRsn.Value
              OUT_VeCITR_e_PP2Fault_Value: accessed-variable=VeCITR_e_PP2Fault.Value
              OUT_VeCITR_e_PP2LEDFault_Value: accessed-variable=VeCITR_e_PP2LEDFault.Value
              OUT_VeCITR_e_PP_LED_A_Feedback_Value: accessed-variable=VeCITR_e_PP_LED_A_Feedback.Value
              OUT_VeCITR_e_PP_LED_B_Feedback_Value: accessed-variable=VeCITR_e_PP_LED_B_Feedback.Value
              OUT_VeCITR_e_PP_LED_C_Feedback_Value: accessed-variable=VeCITR_e_PP_LED_C_Feedback.Value
              OUT_VeCITR_e_PP_LED_A_FailStatus_Value: accessed-variable=VeCITR_e_PP_LED_A_FailStatus.Value
              OUT_VeCITR_e_PP_LED_B_FailStatus_Value: accessed-variable=VeCITR_e_PP_LED_B_FailStatus.Value
              OUT_VeCITR_e_PP_LED_C_FailStatus_Value: accessed-variable=VeCITR_e_PP_LED_C_FailStatus.Value
              OUT_VeCITR_e_PP_LED_A_Color_Feedback_Value: accessed-variable=VeCITR_e_PP_LED_A_Color_Feedback.Value
              OUT_VeCITR_e_PP_LED_B_Color_Feedback_Value: accessed-variable=VeCITR_e_PP_LED_B_Color_Feedback.Value
              OUT_VeCITR_e_PP_LED_C_Color_Feedback_Value: accessed-variable=VeCITR_e_PP_LED_C_Color_Feedback.Value
              OUT_VeCITR_e_PP2_LED_A_Feedback_Value: accessed-variable=VeCITR_e_PP2_LED_A_Feedback.Value
              OUT_VeCITR_e_PP2_LED_B_Feedback_Value: accessed-variable=VeCITR_e_PP2_LED_B_Feedback.Value
              OUT_VeCITR_e_PP2_LED_A_FailStatus_Value: accessed-variable=VeCITR_e_PP2_LED_A_FailStatus.Value
              OUT_VeCITR_e_PP2_LED_B_FailStatus_Value: accessed-variable=VeCITR_e_PP2_LED_B_FailStatus.Value
              OUT_VeCITR_e_PP2_LED_A_Color_Feedback_Value: accessed-variable=VeCITR_e_PP2_LED_A_Color_Feedback.Value
              OUT_VeCITR_e_PP2_LED_B_Color_Feedback_Value: accessed-variable=VeCITR_e_PP2_LED_B_Color_Feedback.Value
        CITR_PwrOn
          data-receive-point-by-arguments:
            access IN_NeCITR_b_Lock_Status_Rx_NeCITR_b_Lock_Status: accessed-variable=NeCITR_b_Lock_Status_Rx.NeCITR_b_Lock_Status
            access IN_NeCITR_b_PortLockBCM_Cmd_Rx_NeCITR_b_PortLockBCM_Cmd: accessed-variable=NeCITR_b_PortLockBCM_Cmd_Rx.NeCITR_b_PortLockBCM_Cmd
          data-send-points:
            455 x access:
              OUT_VeCITR_b_ChrgPortButton_FailSts_Value: accessed-variable=VeCITR_b_ChrgPortButton_FailSts.Value
              OUT_VeCITR_U_ChrgPortLock_StsB_Value: accessed-variable=VeCITR_U_ChrgPortLock_StsB.Value
              OUT_VeCITR_b_ChrgPortLock_StsB_FA_Value: accessed-variable=VeCITR_b_ChrgPortLock_StsB_FA.Value
              OUT_VeCITR_b_ChrgPortLock_StsC_Value: accessed-variable=VeCITR_b_ChrgPortLock_StsC.Value
              OUT_VeCITR_b_ChrgPortLock_StsC_FA_Value: accessed-variable=VeCITR_b_ChrgPortLock_StsC_FA.Value
              OUT_VeCITR_b_ChrgPort_BCM_Cmd_Rcvd_Value: accessed-variable=VeCITR_b_ChrgPort_BCM_Cmd_Rcvd.Value
              OUT_VeCITR_d_ChrgPortHbridgeFlt_Value: accessed-variable=VeCITR_d_ChrgPortHbridgeFlt.Value
              OUT_VeCITR_b_ChrgPortLock_FailStsFA_Value: accessed-variable=VeCITR_b_ChrgPortLock_FailStsFA.Value
              OUT_VeCITR_Cnt_DCEOL_SgnlRcvd_Value: accessed-variable=VeCITR_Cnt_DCEOL_SgnlRcvd.Value
              OUT_VeCITR_e_DVC_ChrgPort_IO_Value: accessed-variable=VeCITR_e_DVC_ChrgPort_IO.Value
              OUT_VeCITR_b_DVC_ChrgPortRq_Value: accessed-variable=VeCITR_b_DVC_ChrgPortRq.Value
              OUT_VeCITR_e_DCChrg_TestSts_Value: accessed-variable=VeCITR_e_DCChrg_TestSts.Value
              OUT_VeCITR_b_ChrgPortButton_Sts_Value: accessed-variable=VeCITR_b_ChrgPortButton_Sts.Value
              OUT_VeCITR_b_SOC_Max_Lev_Value: accessed-variable=VeCITR_b_SOC_Max_Lev.Value
              OUT_VeCITR_b_SOC_Max_Lev_FA_Value: accessed-variable=VeCITR_b_SOC_Max_Lev_FA.Value
              OUT_VeCITR_b_DC_PwrLev_Value: accessed-variable=VeCITR_b_DC_PwrLev.Value
              OUT_VeCITR_b_DC_PwrLev_FA_Value: accessed-variable=VeCITR_b_DC_PwrLev_FA.Value
              OUT_VeCITR_b_DC_PwrLev_SgnlRcvd_Value: accessed-variable=VeCITR_b_DC_PwrLev_SgnlRcvd.Value
              OUT_VeCITR_e_ChrgrFlapSts_Value: accessed-variable=VeCITR_e_ChrgrFlapSts.Value
              OUT_VeCITR_b_ChrgrFlapSts_FA_Value: accessed-variable=VeCITR_b_ChrgrFlapSts_FA.Value
              OUT_VeCITR_e_CPIM_ChrgPortLock_FailSts_Value: accessed-variable=VeCITR_e_CPIM_ChrgPortLock_FailSts.Value
              OUT_VeCITR_b_ChrgPort_BCM_Cmd_Out_Value: accessed-variable=VeCITR_b_ChrgPort_BCM_Cmd_Out.Value
              OUT_VeCITR_e_RRM_VP_Level_Value: accessed-variable=VeCITR_e_RRM_VP_Level.Value
              OUT_VeCITR_b_Drv_Dr_Unlocking_Value: accessed-variable=VeCITR_b_Drv_Dr_Unlocking.Value
              OUT_VeCITR_b_CPIM_RedLED_Sts_Value: accessed-variable=VeCITR_b_CPIM_RedLED_Sts.Value
              OUT_VeCITR_b_CPIM_GreenLED_Sts_Value: accessed-variable=VeCITR_b_CPIM_GreenLED_Sts.Value
              OUT_VeCITR_b_CPIM_LINDataErr_Value: accessed-variable=VeCITR_b_CPIM_LINDataErr.Value
              OUT_VeCITR_e_CPIM_Ind1_FailSts_Value: accessed-variable=VeCITR_e_CPIM_Ind1_FailSts.Value
              OUT_VeCITR_e_CPIM_Ind2_FailSts_Value: accessed-variable=VeCITR_e_CPIM_Ind2_FailSts.Value
              OUT_VeCITR_e_CPIM_Ind5_Fdbk_Value: accessed-variable=VeCITR_e_CPIM_Ind5_Fdbk.Value
              OUT_VeCITR_e_CPIM_Ind{3..5}_FailSts_Value: accessed-variable=VeCITR_e_CPIM_Ind{3..5}_FailSts.Value
              OUT_VeCITR_e_CPIM_Ind_Color_Fdbk_Value: accessed-variable=VeCITR_e_CPIM_Ind_Color_Fdbk.Value
              OUT_VeCITR_e_CPIM_Ind1_Fdbk_Value: accessed-variable=VeCITR_e_CPIM_Ind1_Fdbk.Value
              OUT_VeCITR_e_CPIM_Ind2_Fdbk_Value: accessed-variable=VeCITR_e_CPIM_Ind2_Fdbk.Value
              OUT_VeCITR_b_CPIM_BlueLED_Sts_Value: accessed-variable=VeCITR_b_CPIM_BlueLED_Sts.Value
              OUT_VeCITR_e_CPIM_Ind3_Fdbk_Value: accessed-variable=VeCITR_e_CPIM_Ind3_Fdbk.Value
              OUT_VeCITR_e_CPIM_Ind4_Fdbk_Value: accessed-variable=VeCITR_e_CPIM_Ind4_Fdbk.Value
              OUT_VeCITR_e_CPIM_Icon1_Sts_Value: accessed-variable=VeCITR_e_CPIM_Icon1_Sts.Value
              OUT_VeCITR_e_CPIM_Icon2_Sts_Value: accessed-variable=VeCITR_e_CPIM_Icon2_Sts.Value
              OUT_VeCITR_b_CPIM_Icon1_FailSts_Value: accessed-variable=VeCITR_b_CPIM_Icon1_FailSts.Value
              OUT_VeCITR_b_CPIM_Icon2_FailSts_Value: accessed-variable=VeCITR_b_CPIM_Icon2_FailSts.Value
              OUT_VeCITR_e_BCIM_Ind{1..4}_Fdbk_Value: accessed-variable=VeCITR_e_BCIM_Ind{1..4}_Fdbk.Value
              OUT_VeCITR_e_CPIM_RedLED_FailSts_Value: accessed-variable=VeCITR_e_CPIM_RedLED_FailSts.Value
              OUT_VeCITR_e_BCIM_Ind5_Fdbk_Value: accessed-variable=VeCITR_e_BCIM_Ind5_Fdbk.Value
              OUT_VeCITR_e_BCIM_Ind{1..5}_FailSts_Value: accessed-variable=VeCITR_e_BCIM_Ind{1..5}_FailSts.Value
              OUT_VeCITR_b_BCIM_UnderVolt_Value: accessed-variable=VeCITR_b_BCIM_UnderVolt.Value
              OUT_VeCITR_b_BCIM_OverTemp_Value: accessed-variable=VeCITR_b_BCIM_OverTemp.Value
              OUT_VeCITR_b_BCIM_LINParityErr_Value: accessed-variable=VeCITR_b_BCIM_LINParityErr.Value
              OUT_VeCITR_b_BCIM_LINChkSumErr_Value: accessed-variable=VeCITR_b_BCIM_LINChkSumErr.Value
              OUT_VeCITR_e_CPIM_GreenLED_FailSts_Value: accessed-variable=VeCITR_e_CPIM_GreenLED_FailSts.Value
              OUT_VeCITR_b_BCIM_LINDataErr_Value: accessed-variable=VeCITR_b_BCIM_LINDataErr.Value
              OUT_VeCITR_b_CPIM_Ind{1..5}_FdbkFA_Value: accessed-variable=VeCITR_b_CPIM_Ind{1..5}_FdbkFA.Value
              OUT_VeCITR_b_CPIM_Ind_Color_FdbkFA_Value: accessed-variable=VeCITR_b_CPIM_Ind_Color_FdbkFA.Value
              OUT_VeCITR_b_CPIM_Icon1_StsFA_Value: accessed-variable=VeCITR_b_CPIM_Icon1_StsFA.Value
              OUT_VeCITR_b_CPIM_Icon2_StsFA_Value: accessed-variable=VeCITR_b_CPIM_Icon2_StsFA.Value
              OUT_VeCITR_b_BCIM_Ind1_FdbkFA_Value: accessed-variable=VeCITR_b_BCIM_Ind1_FdbkFA.Value
              OUT_VeCITR_e_CPIM_BlueLED_FailSts_Value: accessed-variable=VeCITR_e_CPIM_BlueLED_FailSts.Value
              OUT_VeCITR_b_BCIM_Ind{2..5}_FdbkFA_Value: accessed-variable=VeCITR_b_BCIM_Ind{2..5}_FdbkFA.Value
              OUT_VeCITR_b_CPIM_UnderVolt_Value: accessed-variable=VeCITR_b_CPIM_UnderVolt.Value
              OUT_VeCITR_b_CPIM_OverTemp_Value: accessed-variable=VeCITR_b_CPIM_OverTemp.Value
              OUT_VeCITR_e_BCIM_Ind_Color_Fdbk_Value: accessed-variable=VeCITR_e_BCIM_Ind_Color_Fdbk.Value
              OUT_VeCITR_b_BCIM_Ind_Color_FdbkFA_Value: accessed-variable=VeCITR_b_BCIM_Ind_Color_FdbkFA.Value
              OUT_VeCITR_b_CPIM_LINParityErr_Value: accessed-variable=VeCITR_b_CPIM_LINParityErr.Value
              OUT_VeCITR_b_CPIM_LINChkSumErr_Value: accessed-variable=VeCITR_b_CPIM_LINChkSumErr.Value
              OUT_VeCITR_e_DVC_BCIM_IO_Value: accessed-variable=VeCITR_e_DVC_BCIM_IO.Value
              OUT_VeCITR_e_DVC_BCIM_Ind{1..5}_Value: accessed-variable=VeCITR_e_DVC_BCIM_Ind{1..5}.Value
              OUT_VeCITR_e_DVC_BCIM_BlinkRate_Value: accessed-variable=VeCITR_e_DVC_BCIM_BlinkRate.Value
              OUT_VeCITR_e_DVC_CPIM_IO_Value: accessed-variable=VeCITR_e_DVC_CPIM_IO.Value
              OUT_VeCITR_e_DVC_CPIM_Ind{1..5}_Value: accessed-variable=VeCITR_e_DVC_CPIM_Ind{1..5}.Value
              OUT_VeCITR_e_DVC_CPIMBlinkRate_Value: accessed-variable=VeCITR_e_DVC_CPIMBlinkRate.Value
              OUT_VeCITR_e_DVC_CPIM_Color_Value: accessed-variable=VeCITR_e_DVC_CPIM_Color.Value
              OUT_VeCITR_e_DVC_CPIM_IconI1_Value: accessed-variable=VeCITR_e_DVC_CPIM_IconI1.Value
              OUT_VeCITR_e_DVC_CPIM_IconI2_Value: accessed-variable=VeCITR_e_DVC_CPIM_IconI2.Value
              OUT_VeCITR_e_DVC_BCIM_Color_Value: accessed-variable=VeCITR_e_DVC_BCIM_Color.Value
              OUT_VeCITR_b_HU_Sch1_Priority_Value: accessed-variable=VeCITR_b_HU_Sch1_Priority.Value
              OUT_VeCITR_b_HU_Sch1_ChargeUntilFull_Value: accessed-variable=VeCITR_b_HU_Sch1_ChargeUntilFull.Value
              OUT_VeCITR_b_HU_Sch1_Day_FA_Value: accessed-variable=VeCITR_b_HU_Sch1_Day_FA.Value
              OUT_VeCITR_e_HU_Sch1_Type_Value: accessed-variable=VeCITR_e_HU_Sch1_Type.Value
              OUT_VeCITR_b_HU_Sch1_Day_SgnlRcvd_Value: accessed-variable=VeCITR_b_HU_Sch1_Day_SgnlRcvd.Value
              OUT_VeCITR_b_HU_Sch1_Do_Not_Repeat_Value: accessed-variable=VeCITR_b_HU_Sch1_Do_Not_Repeat.Value
              OUT_VeCITR_b_HU_Sch1_Start_Time_HrFA_Value: accessed-variable=VeCITR_b_HU_Sch1_Start_Time_HrFA.Value
              OUT_VeCITR_b_HU_Sch1_Start_Time_MinFA_Value: accessed-variable=VeCITR_b_HU_Sch1_Start_Time_MinFA.Value
              OUT_VeCITR_b_HU_Sch1_End_Time_HrFA_Value: accessed-variable=VeCITR_b_HU_Sch1_End_Time_HrFA.Value
              OUT_VeCITR_b_HU_Sch1_End_Time_MinFA_Value: accessed-variable=VeCITR_b_HU_Sch1_End_Time_MinFA.Value
              OUT_VeCITR_b_HU_Sch1_Enbl_Value: accessed-variable=VeCITR_b_HU_Sch1_Enbl.Value
              OUT_VeCITR_b_HU_Sch1_TypeFA_Value: accessed-variable=VeCITR_b_HU_Sch1_TypeFA.Value
              OUT_VeCITR_T_HU_Sch1_Temperature_Value: accessed-variable=VeCITR_T_HU_Sch1_Temperature.Value
              OUT_VeCITR_b_HU_Sch1_TemperatureFA_Value: accessed-variable=VeCITR_b_HU_Sch1_TemperatureFA.Value
              OUT_VeCITR_b_HU_Sch1_Submit_Value: accessed-variable=VeCITR_b_HU_Sch1_Submit.Value
              OUT_VeCITR_K_HU_Sch1_Start_Time_Hr_Value: accessed-variable=VeCITR_K_HU_Sch1_Start_Time_Hr.Value
              OUT_VeCITR_K_HU_Sch1_Start_Time_Min_Value: accessed-variable=VeCITR_K_HU_Sch1_Start_Time_Min.Value
              OUT_VeCITR_K_HU_Sch1_End_Time_Hr_Value: accessed-variable=VeCITR_K_HU_Sch1_End_Time_Hr.Value
              OUT_VeCITR_K_HU_Sch1_End_Time_Min_Value: accessed-variable=VeCITR_K_HU_Sch1_End_Time_Min.Value
              OUT_VeCITR_K_HU_Sch1_Day_Value: accessed-variable=VeCITR_K_HU_Sch1_Day.Value
              OUT_VeCITR_b_HU_Sch2_Priority_Value: accessed-variable=VeCITR_b_HU_Sch2_Priority.Value
              OUT_VeCITR_b_HU_Sch2_ChargeUntilFull_Value: accessed-variable=VeCITR_b_HU_Sch2_ChargeUntilFull.Value
              OUT_VeCITR_b_HU_Sch2_Day_FA_Value: accessed-variable=VeCITR_b_HU_Sch2_Day_FA.Value
              OUT_VeCITR_e_HU_Sch2_Type_Value: accessed-variable=VeCITR_e_HU_Sch2_Type.Value
              OUT_VeCITR_b_HU_Sch2_Day_SgnlRcvd_Value: accessed-variable=VeCITR_b_HU_Sch2_Day_SgnlRcvd.Value
              OUT_VeCITR_b_HU_Sch2_Do_Not_Repeat_Value: accessed-variable=VeCITR_b_HU_Sch2_Do_Not_Repeat.Value
              OUT_VeCITR_b_HU_Sch2_Start_Time_HrFA_Value: accessed-variable=VeCITR_b_HU_Sch2_Start_Time_HrFA.Value
              OUT_VeCITR_b_HU_Sch2_Start_Time_MinFA_Value: accessed-variable=VeCITR_b_HU_Sch2_Start_Time_MinFA.Value
              OUT_VeCITR_b_HU_Sch2_End_Time_HrFA_Value: accessed-variable=VeCITR_b_HU_Sch2_End_Time_HrFA.Value
              OUT_VeCITR_b_HU_Sch2_End_Time_MinFA_Value: accessed-variable=VeCITR_b_HU_Sch2_End_Time_MinFA.Value
              OUT_VeCITR_b_HU_Sch2_Enbl_Value: accessed-variable=VeCITR_b_HU_Sch2_Enbl.Value
              OUT_VeCITR_b_HU_Sch2_TypeFA_Value: accessed-variable=VeCITR_b_HU_Sch2_TypeFA.Value
              OUT_VeCITR_T_HU_Sch2_Temperature_Value: accessed-variable=VeCITR_T_HU_Sch2_Temperature.Value
              OUT_VeCITR_b_HU_Sch2_TemperatureFA_Value: accessed-variable=VeCITR_b_HU_Sch2_TemperatureFA.Value
              OUT_VeCITR_b_HU_Sch2_Submit_Value: accessed-variable=VeCITR_b_HU_Sch2_Submit.Value
              OUT_VeCITR_K_HU_Sch2_Start_Time_Hr_Value: accessed-variable=VeCITR_K_HU_Sch2_Start_Time_Hr.Value
              OUT_VeCITR_K_HU_Sch2_Start_Time_Min_Value: accessed-variable=VeCITR_K_HU_Sch2_Start_Time_Min.Value
              OUT_VeCITR_K_HU_Sch2_End_Time_Hr_Value: accessed-variable=VeCITR_K_HU_Sch2_End_Time_Hr.Value
              OUT_VeCITR_K_HU_Sch2_End_Time_Min_Value: accessed-variable=VeCITR_K_HU_Sch2_End_Time_Min.Value
              OUT_VeCITR_K_HU_Sch2_Day_Value: accessed-variable=VeCITR_K_HU_Sch2_Day.Value
              OUT_VeCITR_b_HU_Sch3_Priority_Value: accessed-variable=VeCITR_b_HU_Sch3_Priority.Value
              OUT_VeCITR_b_HU_Sch3_ChargeUntilFull_Value: accessed-variable=VeCITR_b_HU_Sch3_ChargeUntilFull.Value
              OUT_VeCITR_b_HU_Sch3_Day_FA_Value: accessed-variable=VeCITR_b_HU_Sch3_Day_FA.Value
              OUT_VeCITR_e_HU_Sch3_Type_Value: accessed-variable=VeCITR_e_HU_Sch3_Type.Value
              OUT_VeCITR_b_HU_Sch3_Day_SgnlRcvd_Value: accessed-variable=VeCITR_b_HU_Sch3_Day_SgnlRcvd.Value
              OUT_VeCITR_b_HU_Sch3_Do_Not_Repeat_Value: accessed-variable=VeCITR_b_HU_Sch3_Do_Not_Repeat.Value
              OUT_VeCITR_b_HU_Sch3_Start_Time_HrFA_Value: accessed-variable=VeCITR_b_HU_Sch3_Start_Time_HrFA.Value
              OUT_VeCITR_b_HU_Sch3_Start_Time_MinFA_Value: accessed-variable=VeCITR_b_HU_Sch3_Start_Time_MinFA.Value
              OUT_VeCITR_b_HU_Sch3_End_Time_HrFA_Value: accessed-variable=VeCITR_b_HU_Sch3_End_Time_HrFA.Value
              OUT_VeCITR_b_HU_Sch3_End_Time_MinFA_Value: accessed-variable=VeCITR_b_HU_Sch3_End_Time_MinFA.Value
              OUT_VeCITR_b_HU_Sch3_Enbl_Value: accessed-variable=VeCITR_b_HU_Sch3_Enbl.Value
              OUT_VeCITR_b_HU_Sch3_TypeFA_Value: accessed-variable=VeCITR_b_HU_Sch3_TypeFA.Value
              OUT_VeCITR_T_HU_Sch3_Temperature_Value: accessed-variable=VeCITR_T_HU_Sch3_Temperature.Value
              OUT_VeCITR_b_HU_Sch3_TemperatureFA_Value: accessed-variable=VeCITR_b_HU_Sch3_TemperatureFA.Value
              OUT_VeCITR_b_HU_Sch3_Submit_Value: accessed-variable=VeCITR_b_HU_Sch3_Submit.Value
              OUT_VeCITR_e_HU_Sch3_Allow_Value: accessed-variable=VeCITR_e_HU_Sch3_Allow.Value
              OUT_VeCITR_b_HU_Sch3_AllowFA_Value: accessed-variable=VeCITR_b_HU_Sch3_AllowFA.Value
              OUT_VeCITR_K_HU_Sch3_Start_Time_Hr_Value: accessed-variable=VeCITR_K_HU_Sch3_Start_Time_Hr.Value
              OUT_VeCITR_K_HU_Sch3_Start_Time_Min_Value: accessed-variable=VeCITR_K_HU_Sch3_Start_Time_Min.Value
              OUT_VeCITR_K_HU_Sch3_End_Time_Hr_Value: accessed-variable=VeCITR_K_HU_Sch3_End_Time_Hr.Value
              OUT_VeCITR_K_HU_Sch3_End_Time_Min_Value: accessed-variable=VeCITR_K_HU_Sch3_End_Time_Min.Value
              OUT_VeCITR_K_HU_Sch3_Day_Value: accessed-variable=VeCITR_K_HU_Sch3_Day.Value
              OUT_VeCITR_b_HU_Sch4_Day_FA_Value: accessed-variable=VeCITR_b_HU_Sch4_Day_FA.Value
              OUT_VeCITR_b_HU_Sch4_Day_SgnlRcvd_Value: accessed-variable=VeCITR_b_HU_Sch4_Day_SgnlRcvd.Value
              OUT_VeCITR_b_HU_Sch4_Start_Time_HrFA_Value: accessed-variable=VeCITR_b_HU_Sch4_Start_Time_HrFA.Value
              OUT_VeCITR_b_HU_Sch4_Start_Time_MinFA_Value: accessed-variable=VeCITR_b_HU_Sch4_Start_Time_MinFA.Value
              OUT_VeCITR_b_HU_Sch4_Enbl_Value: accessed-variable=VeCITR_b_HU_Sch4_Enbl.Value
              OUT_VeCITR_T_HU_Sch4_Temperature_Value: accessed-variable=VeCITR_T_HU_Sch4_Temperature.Value
              OUT_VeCITR_b_HU_Sch4_TemperatureFA_Value: accessed-variable=VeCITR_b_HU_Sch4_TemperatureFA.Value
              OUT_VeCITR_b_HU_Sch4_Submit_Value: accessed-variable=VeCITR_b_HU_Sch4_Submit.Value
              OUT_VeCITR_e_HU_Sch4_Allow_Value: accessed-variable=VeCITR_e_HU_Sch4_Allow.Value
              OUT_VeCITR_b_HU_Sch4_AllowFA_Value: accessed-variable=VeCITR_b_HU_Sch4_AllowFA.Value
              OUT_VeCITR_K_HU_Sch4_Start_Time_Hr_Value: accessed-variable=VeCITR_K_HU_Sch4_Start_Time_Hr.Value
              OUT_VeCITR_K_HU_Sch4_Start_Time_Min_Value: accessed-variable=VeCITR_K_HU_Sch4_Start_Time_Min.Value
              OUT_VeCITR_K_HU_Sch4_Day_Value: accessed-variable=VeCITR_K_HU_Sch4_Day.Value
              OUT_VeCITR_b_TBM_Sch1_Priority_Value: accessed-variable=VeCITR_b_TBM_Sch1_Priority.Value
              OUT_VeCITR_b_TBM_Sch1_ChargeUntilFull_Value: accessed-variable=VeCITR_b_TBM_Sch1_ChargeUntilFull.Value
              OUT_VeCITR_b_TBM_Sch1_Day_FA_Value: accessed-variable=VeCITR_b_TBM_Sch1_Day_FA.Value
              OUT_VeCITR_e_TBM_Sch1_Type_Value: accessed-variable=VeCITR_e_TBM_Sch1_Type.Value
              OUT_VeCITR_b_TBM_Sch1_Day_SgnlRcvd_Value: accessed-variable=VeCITR_b_TBM_Sch1_Day_SgnlRcvd.Value
              OUT_VeCITR_b_TBM_Sch1_Do_Not_Repeat_Value: accessed-variable=VeCITR_b_TBM_Sch1_Do_Not_Repeat.Value
              OUT_VeCITR_b_TBM_Sch1_Enbl_Value: accessed-variable=VeCITR_b_TBM_Sch1_Enbl.Value
              OUT_VeCITR_b_TBM_Sch1_Submit_Value: accessed-variable=VeCITR_b_TBM_Sch1_Submit.Value
              OUT_VeCITR_K_TBM_Sch1_Start_Time_Hr_Value: accessed-variable=VeCITR_K_TBM_Sch1_Start_Time_Hr.Value
              OUT_VeCITR_K_TBM_Sch1_Start_Time_Min_Value: accessed-variable=VeCITR_K_TBM_Sch1_Start_Time_Min.Value
              OUT_VeCITR_K_TBM_Sch1_End_Time_Hr_Value: accessed-variable=VeCITR_K_TBM_Sch1_End_Time_Hr.Value
              OUT_VeCITR_K_TBM_Sch1_End_Time_Min_Value: accessed-variable=VeCITR_K_TBM_Sch1_End_Time_Min.Value
              OUT_VeCITR_K_TBM_Sch1_Day_Value: accessed-variable=VeCITR_K_TBM_Sch1_Day.Value
              OUT_VeCITR_b_TBM_Sch1_Start_Time_HrFA_Value: accessed-variable=VeCITR_b_TBM_Sch1_Start_Time_HrFA.Value
              OUT_VeCITR_b_TBM_Sch1_Start_Time_MinFA_Value: accessed-variable=VeCITR_b_TBM_Sch1_Start_Time_MinFA.Value
              OUT_VeCITR_b_TBM_Sch1_End_Time_HrFA_Value: accessed-variable=VeCITR_b_TBM_Sch1_End_Time_HrFA.Value
              OUT_VeCITR_b_TBM_Sch1_End_Time_MinFA_Value: accessed-variable=VeCITR_b_TBM_Sch1_End_Time_MinFA.Value
              OUT_VeCITR_b_TBM_Sch1_TypeFA_Value: accessed-variable=VeCITR_b_TBM_Sch1_TypeFA.Value
              OUT_VeCITR_T_TBM_Sch1_Temperature_Value: accessed-variable=VeCITR_T_TBM_Sch1_Temperature.Value
              OUT_VeCITR_b_TBM_Sch1_TemperatureFA_Value: accessed-variable=VeCITR_b_TBM_Sch1_TemperatureFA.Value
              OUT_VeCITR_b_TBM_Sch2_Priority_Value: accessed-variable=VeCITR_b_TBM_Sch2_Priority.Value
              OUT_VeCITR_b_TBM_Sch2_ChargeUntilFull_Value: accessed-variable=VeCITR_b_TBM_Sch2_ChargeUntilFull.Value
              OUT_VeCITR_b_TBM_Sch2_Day_FA_Value: accessed-variable=VeCITR_b_TBM_Sch2_Day_FA.Value
              OUT_VeCITR_e_TBM_Sch2_Type_Value: accessed-variable=VeCITR_e_TBM_Sch2_Type.Value
              OUT_VeCITR_b_TBM_Sch2_Day_SgnlRcvd_Value: accessed-variable=VeCITR_b_TBM_Sch2_Day_SgnlRcvd.Value
              OUT_VeCITR_b_TBM_Sch2_Do_Not_Repeat_Value: accessed-variable=VeCITR_b_TBM_Sch2_Do_Not_Repeat.Value
              OUT_VeCITR_b_TBM_Sch2_Enbl_Value: accessed-variable=VeCITR_b_TBM_Sch2_Enbl.Value
              OUT_VeCITR_b_TBM_Sch2_Submit_Value: accessed-variable=VeCITR_b_TBM_Sch2_Submit.Value
              OUT_VeCITR_K_TBM_Sch2_Start_Time_Hr_Value: accessed-variable=VeCITR_K_TBM_Sch2_Start_Time_Hr.Value
              OUT_VeCITR_K_TBM_Sch2_Start_Time_Min_Value: accessed-variable=VeCITR_K_TBM_Sch2_Start_Time_Min.Value
              OUT_VeCITR_K_TBM_Sch2_End_Time_Hr_Value: accessed-variable=VeCITR_K_TBM_Sch2_End_Time_Hr.Value
              OUT_VeCITR_K_TBM_Sch2_End_Time_Min_Value: accessed-variable=VeCITR_K_TBM_Sch2_End_Time_Min.Value
              OUT_VeCITR_K_TBM_Sch2_Day_Value: accessed-variable=VeCITR_K_TBM_Sch2_Day.Value
              OUT_VeCITR_b_TBM_Sch2_Start_Time_HrFA_Value: accessed-variable=VeCITR_b_TBM_Sch2_Start_Time_HrFA.Value
              OUT_VeCITR_b_TBM_Sch2_Start_Time_MinFA_Value: accessed-variable=VeCITR_b_TBM_Sch2_Start_Time_MinFA.Value
              OUT_VeCITR_b_TBM_Sch2_End_Time_HrFA_Value: accessed-variable=VeCITR_b_TBM_Sch2_End_Time_HrFA.Value
              OUT_VeCITR_b_TBM_Sch2_End_Time_MinFA_Value: accessed-variable=VeCITR_b_TBM_Sch2_End_Time_MinFA.Value
              OUT_VeCITR_b_TBM_Sch2_TypeFA_Value: accessed-variable=VeCITR_b_TBM_Sch2_TypeFA.Value
              OUT_VeCITR_T_TBM_Sch2_Temperature_Value: accessed-variable=VeCITR_T_TBM_Sch2_Temperature.Value
              OUT_VeCITR_b_TBM_Sch2_TemperatureFA_Value: accessed-variable=VeCITR_b_TBM_Sch2_TemperatureFA.Value
              OUT_VeCITR_b_TBM_Sch3_Priority_Value: accessed-variable=VeCITR_b_TBM_Sch3_Priority.Value
              OUT_VeCITR_b_TBM_Sch3_ChargeUntilFull_Value: accessed-variable=VeCITR_b_TBM_Sch3_ChargeUntilFull.Value
              OUT_VeCITR_b_TBM_Sch3_Day_FA_Value: accessed-variable=VeCITR_b_TBM_Sch3_Day_FA.Value
              OUT_VeCITR_e_TBM_Sch3_Type_Value: accessed-variable=VeCITR_e_TBM_Sch3_Type.Value
              OUT_VeCITR_b_TBM_Sch3_Day_SgnlRcvd_Value: accessed-variable=VeCITR_b_TBM_Sch3_Day_SgnlRcvd.Value
              OUT_VeCITR_b_TBM_Sch3_Do_Not_Repeat_Value: accessed-variable=VeCITR_b_TBM_Sch3_Do_Not_Repeat.Value
              OUT_VeCITR_b_TBM_Sch3_Enbl_Value: accessed-variable=VeCITR_b_TBM_Sch3_Enbl.Value
              OUT_VeCITR_b_TBM_Sch3_Submit_Value: accessed-variable=VeCITR_b_TBM_Sch3_Submit.Value
              OUT_VeCITR_K_TBM_Sch3_Start_Time_Hr_Value: accessed-variable=VeCITR_K_TBM_Sch3_Start_Time_Hr.Value
              OUT_VeCITR_K_TBM_Sch3_Start_Time_Min_Value: accessed-variable=VeCITR_K_TBM_Sch3_Start_Time_Min.Value
              OUT_VeCITR_K_TBM_Sch3_End_Time_Hr_Value: accessed-variable=VeCITR_K_TBM_Sch3_End_Time_Hr.Value
              OUT_VeCITR_K_TBM_Sch3_End_Time_Min_Value: accessed-variable=VeCITR_K_TBM_Sch3_End_Time_Min.Value
              OUT_VeCITR_K_TBM_Sch3_Day_Value: accessed-variable=VeCITR_K_TBM_Sch3_Day.Value
              OUT_VeCITR_b_TBM_Sch3_Start_Time_HrFA_Value: accessed-variable=VeCITR_b_TBM_Sch3_Start_Time_HrFA.Value
              OUT_VeCITR_b_TBM_Sch3_Start_Time_MinFA_Value: accessed-variable=VeCITR_b_TBM_Sch3_Start_Time_MinFA.Value
              OUT_VeCITR_b_TBM_Sch3_End_Time_HrFA_Value: accessed-variable=VeCITR_b_TBM_Sch3_End_Time_HrFA.Value
              OUT_VeCITR_b_TBM_Sch3_End_Time_MinFA_Value: accessed-variable=VeCITR_b_TBM_Sch3_End_Time_MinFA.Value
              OUT_VeCITR_b_TBM_Sch3_TypeFA_Value: accessed-variable=VeCITR_b_TBM_Sch3_TypeFA.Value
              OUT_VeCITR_T_TBM_Sch3_Temperature_Value: accessed-variable=VeCITR_T_TBM_Sch3_Temperature.Value
              OUT_VeCITR_b_TBM_Sch3_TemperatureFA_Value: accessed-variable=VeCITR_b_TBM_Sch3_TemperatureFA.Value
              OUT_VeCITR_e_TBM_Sch3_Allow_Value: accessed-variable=VeCITR_e_TBM_Sch3_Allow.Value
              OUT_VeCITR_b_TBM_Sch3_AllowFA_Value: accessed-variable=VeCITR_b_TBM_Sch3_AllowFA.Value
              OUT_VeCITR_b_TBM_Sch4_Day_FA_Value: accessed-variable=VeCITR_b_TBM_Sch4_Day_FA.Value
              OUT_VeCITR_b_TBM_Sch4_Day_SgnlRcvd_Value: accessed-variable=VeCITR_b_TBM_Sch4_Day_SgnlRcvd.Value
              OUT_VeCITR_b_TBM_Sch4_Enbl_Value: accessed-variable=VeCITR_b_TBM_Sch4_Enbl.Value
              OUT_VeCITR_b_TBM_Sch4_Submit_Value: accessed-variable=VeCITR_b_TBM_Sch4_Submit.Value
              OUT_VeCITR_K_TBM_Sch4_Start_Time_Hr_Value: accessed-variable=VeCITR_K_TBM_Sch4_Start_Time_Hr.Value
              OUT_VeCITR_K_TBM_Sch4_Start_Time_Min_Value: accessed-variable=VeCITR_K_TBM_Sch4_Start_Time_Min.Value
              OUT_VeCITR_K_TBM_Sch4_Day_Value: accessed-variable=VeCITR_K_TBM_Sch4_Day.Value
              OUT_VeCITR_b_TBM_Sch4_Start_Time_HrFA_Value: accessed-variable=VeCITR_b_TBM_Sch4_Start_Time_HrFA.Value
              OUT_VeCITR_b_TBM_Sch4_Start_Time_MinFA_Value: accessed-variable=VeCITR_b_TBM_Sch4_Start_Time_MinFA.Value
              OUT_VeCITR_T_TBM_Sch4_Temperature_Value: accessed-variable=VeCITR_T_TBM_Sch4_Temperature.Value
              OUT_VeCITR_b_TBM_Sch4_TemperatureFA_Value: accessed-variable=VeCITR_b_TBM_Sch4_TemperatureFA.Value
              OUT_VeCITR_e_TBM_Sch4_Allow_Value: accessed-variable=VeCITR_e_TBM_Sch4_Allow.Value
              OUT_VeCITR_b_TBM_Sch4_AllowFA_Value: accessed-variable=VeCITR_b_TBM_Sch4_AllowFA.Value
              OUT_VeCITR_K_Date_Day1_Value: accessed-variable=VeCITR_K_Date_Day1.Value
              OUT_VeCITR_b_Date_Day1_FA_Value: accessed-variable=VeCITR_b_Date_Day1_FA.Value
              OUT_VeCITR_K_Time_Hour1_Value: accessed-variable=VeCITR_K_Time_Hour1.Value
              OUT_VeCITR_K_Time_Minute2_Value: accessed-variable=VeCITR_K_Time_Minute2.Value
              OUT_VeCITR_K_Time_Hour2_Value: accessed-variable=VeCITR_K_Time_Hour2.Value
              OUT_VeCITR_K_Time_Minute1_Value: accessed-variable=VeCITR_K_Time_Minute1.Value
              OUT_VeCITR_b_ChargeNow_Value: accessed-variable=VeCITR_b_ChargeNow.Value
              OUT_VeCITR_b_TBM_ChargeNow_Value: accessed-variable=VeCITR_b_TBM_ChargeNow.Value
              OUT_VeCITR_K_DateTmDay_Value: accessed-variable=VeCITR_K_DateTmDay.Value
              OUT_VeCITR_b_DateTmDay_FA_Value: accessed-variable=VeCITR_b_DateTmDay_FA.Value
              OUT_VeCITR_P_ChargingDestinationPwr_Value: accessed-variable=VeCITR_P_ChargingDestinationPwr.Value
              OUT_VeCITR_b_ChargingDestinationPwr_FA_Value: accessed-variable=VeCITR_b_ChargingDestinationPwr_FA.Value
              OUT_VeCITR_b_Date_Day1_SgnlRcvd_Value: accessed-variable=VeCITR_b_Date_Day1_SgnlRcvd.Value
              OUT_VeCITR_b_DateTmDay_SgnlRcvd_Value: accessed-variable=VeCITR_b_DateTmDay_SgnlRcvd.Value
              OUT_VeCITR_K_DateTmMon_Value: accessed-variable=VeCITR_K_DateTmMon.Value
              OUT_VeCITR_K_DateTmYear_Value: accessed-variable=VeCITR_K_DateTmYear.Value
              OUT_VeCITR_K_DateTmHour_Value: accessed-variable=VeCITR_K_DateTmHour.Value
              OUT_VeCITR_K_DateTmMin_Value: accessed-variable=VeCITR_K_DateTmMin.Value
              OUT_VeCITR_K_DateTmSec_Value: accessed-variable=VeCITR_K_DateTmSec.Value
              OUT_VeCITR_e_DateTmFormat_Value: accessed-variable=VeCITR_e_DateTmFormat.Value
              OUT_VeCITR_b_DateTmFormat_FA_Value: accessed-variable=VeCITR_b_DateTmFormat_FA.Value
              OUT_VeCITR_l_DistanceToCharge_Value: accessed-variable=VeCITR_l_DistanceToCharge.Value
              OUT_VeCITR_b_DistanceToCharge_FA_Value: accessed-variable=VeCITR_b_DistanceToCharge_FA.Value
              OUT_VeCITR_K_Date_Day2_Value: accessed-variable=VeCITR_K_Date_Day2.Value
              OUT_VeCITR_t_TimeToCharge_Value: accessed-variable=VeCITR_t_TimeToCharge.Value
              OUT_VeCITR_b_TimeToCharge_FA_Value: accessed-variable=VeCITR_b_TimeToCharge_FA.Value
              OUT_VeCITR_e_FOTA_Install_Type_Value: accessed-variable=VeCITR_e_FOTA_Install_Type.Value
              OUT_VeCITR_b_FOTA_Install_Type_FA_Value: accessed-variable=VeCITR_b_FOTA_Install_Type_FA.Value
              OUT_VeCITR_e_FOTA_Install_Status_Value: accessed-variable=VeCITR_e_FOTA_Install_Status.Value
              OUT_VeCITR_K_Date_Month1_Value: accessed-variable=VeCITR_K_Date_Month1.Value
              OUT_VeCITR_K_Date_Month2_Value: accessed-variable=VeCITR_K_Date_Month2.Value
              OUT_VeCITR_K_Date_Year{1..4}_Value: accessed-variable=VeCITR_K_Date_Year{1..4}.Value
              OUT_VeCITR_e_DoorLockLastElSts_Value: accessed-variable=VeCITR_e_DoorLockLastElSts.Value
              OUT_VeCITR_b_DoorLockLastElSts_Rcvd_Value: accessed-variable=VeCITR_b_DoorLockLastElSts_Rcvd.Value
              OUT_VeCITR_b_Lock_Sense_Value: accessed-variable=VeCITR_b_Lock_Sense.Value
              OUT_VeCITR_e_PwrLimReq_Value: accessed-variable=VeCITR_e_PwrLimReq.Value
              OUT_VeCITR_b_PwrLimReq_FA_Value: accessed-variable=VeCITR_b_PwrLimReq_FA.Value
              OUT_VeCITR_b_PwrLimReq_SgnlRcvd_Value: accessed-variable=VeCITR_b_PwrLimReq_SgnlRcvd.Value
              OUT_VeCITR_b_ChrgPortDoorSts_Value: accessed-variable=VeCITR_b_ChrgPortDoorSts.Value
              OUT_VeCITR_b_PortLockBCM_Cmd_Value: accessed-variable=VeCITR_b_PortLockBCM_Cmd.Value
              OUT_VeCITR_e_ChrgPortLock_StsB_Value: accessed-variable=VeCITR_e_ChrgPortLock_StsB.Value
              OUT_VeCITR_b_HBridge_ChrgPortLck_Cal_Value: accessed-variable=VeCITR_b_HBridge_ChrgPortLck_Cal.Value
              OUT_VeCITR_b_ChrgPortLockSts_Value: accessed-variable=VeCITR_b_ChrgPortLockSts.Value
              OUT_VeCITR_b_ChrgPortLockSts_FA_Value: accessed-variable=VeCITR_b_ChrgPortLockSts_FA.Value
              OUT_VeCITR_b_ChrgPortSts_Value: accessed-variable=VeCITR_b_ChrgPortSts.Value
              OUT_VeCITR_e_HU_ChrgSchedType1_Value: accessed-variable=VeCITR_e_HU_ChrgSchedType1.Value
              OUT_VeCITR_b_HU_ChrgSchedType1FA_Value: accessed-variable=VeCITR_b_HU_ChrgSchedType1FA.Value
              OUT_VeCITR_e_HU_ChrgSchedType2_Value: accessed-variable=VeCITR_e_HU_ChrgSchedType2.Value
              OUT_VeCITR_b_HU_ChrgSchedType2FA_Value: accessed-variable=VeCITR_b_HU_ChrgSchedType2FA.Value
              OUT_VeCITR_Pct_HU_ExtChrgTarget1_Value: accessed-variable=VeCITR_Pct_HU_ExtChrgTarget1.Value
              OUT_VeCITR_b_HU_ExtChrgTarget1FA_Value: accessed-variable=VeCITR_b_HU_ExtChrgTarget1FA.Value
              OUT_VeCITR_Pct_HU_ExtChrgTarget2_Value: accessed-variable=VeCITR_Pct_HU_ExtChrgTarget2.Value
              OUT_VeCITR_b_HU_ExtChrgTarget2FA_Value: accessed-variable=VeCITR_b_HU_ExtChrgTarget2FA.Value
              OUT_VeCITR_Pct_HU_ImmChrgTarget1_Value: accessed-variable=VeCITR_Pct_HU_ImmChrgTarget1.Value
              OUT_VeCITR_b_HU_ImmChrgTarget1FA_Value: accessed-variable=VeCITR_b_HU_ImmChrgTarget1FA.Value
              OUT_VeCITR_Pct_HU_ImmChrgTarget2_Value: accessed-variable=VeCITR_Pct_HU_ImmChrgTarget2.Value
              OUT_VeCITR_b_HU_ImmChrgTarget2FA_Value: accessed-variable=VeCITR_b_HU_ImmChrgTarget2FA.Value
              OUT_VeCITR_b_CoopCh_VehLocation_Value: accessed-variable=VeCITR_b_CoopCh_VehLocation.Value
              OUT_VeCITR_b_CoopCh_VehLocationFA_Value: accessed-variable=VeCITR_b_CoopCh_VehLocationFA.Value
              OUT_VeCITR_e_RmtChrgPortLkCmd_Value: accessed-variable=VeCITR_e_RmtChrgPortLkCmd.Value
              OUT_VeCITR_b_RmtChrgPortLkCmdFA_Value: accessed-variable=VeCITR_b_RmtChrgPortLkCmdFA.Value
              OUT_VeCITR_b_RmtChrgPortLkCmd_SgnlRcvd_Value: accessed-variable=VeCITR_b_RmtChrgPortLkCmd_SgnlRcvd.Value
              OUT_VeCITR_e_CoopCh_ChrgCmd_Value: accessed-variable=VeCITR_e_CoopCh_ChrgCmd.Value
              OUT_VeCITR_b_CoopCh_ChrgCmdFA_Value: accessed-variable=VeCITR_b_CoopCh_ChrgCmdFA.Value
              OUT_VeCITR_b_TBMStopChrg_Value: accessed-variable=VeCITR_b_TBMStopChrg.Value
              OUT_VeCITR_b_TBMStopChrgFA_Value: accessed-variable=VeCITR_b_TBMStopChrgFA.Value
              OUT_VeCITR_e_TBM_ChrgSchedType1_Value: accessed-variable=VeCITR_e_TBM_ChrgSchedType1.Value
              OUT_VeCITR_b_TBM_ChrgSchedType1FA_Value: accessed-variable=VeCITR_b_TBM_ChrgSchedType1FA.Value
              OUT_VeCITR_e_TBM_ChrgSchedType2_Value: accessed-variable=VeCITR_e_TBM_ChrgSchedType2.Value
              OUT_VeCITR_b_TBM_ChrgSchedType2FA_Value: accessed-variable=VeCITR_b_TBM_ChrgSchedType2FA.Value
              OUT_VeCITR_Pct_TBM_ExtChrgTarget1_Value: accessed-variable=VeCITR_Pct_TBM_ExtChrgTarget1.Value
              OUT_VeCITR_b_TBM_ExtChrgTarget1FA_Value: accessed-variable=VeCITR_b_TBM_ExtChrgTarget1FA.Value
              OUT_VeCITR_Pct_TBM_ExtChrgTarget2_Value: accessed-variable=VeCITR_Pct_TBM_ExtChrgTarget2.Value
              OUT_VeCITR_b_TBM_ExtChrgTarget2FA_Value: accessed-variable=VeCITR_b_TBM_ExtChrgTarget2FA.Value
              OUT_VeCITR_Pct_TBM_ImmChrgTarget1_Value: accessed-variable=VeCITR_Pct_TBM_ImmChrgTarget1.Value
              OUT_VeCITR_b_TBM_ImmChrgTarget1FA_Value: accessed-variable=VeCITR_b_TBM_ImmChrgTarget1FA.Value
              OUT_VeCITR_Pct_TBM_ImmChrgTarget2_Value: accessed-variable=VeCITR_Pct_TBM_ImmChrgTarget2.Value
              OUT_VeCITR_b_TBM_ImmChrgTarget2FA_Value: accessed-variable=VeCITR_b_TBM_ImmChrgTarget2FA.Value
              OUT_VeCITR_b_V2HModeReq_Value: accessed-variable=VeCITR_b_V2HModeReq.Value
              OUT_VeCITR_b_V2HModeReqFA_Value: accessed-variable=VeCITR_b_V2HModeReqFA.Value
              OUT_VeCITR_b_V2HReq_Value: accessed-variable=VeCITR_b_V2HReq.Value
              OUT_VeCITR_b_V2HReqFA_Value: accessed-variable=VeCITR_b_V2HReqFA.Value
              OUT_VeCITR_Pct_V2HRsrvBatt_Value: accessed-variable=VeCITR_Pct_V2HRsrvBatt.Value
              OUT_VeCITR_b_V2HRsrvBattFA_Value: accessed-variable=VeCITR_b_V2HRsrvBattFA.Value
              OUT_VeCITR_b_V2HSubmit_Value: accessed-variable=VeCITR_b_V2HSubmit.Value
              OUT_VeCITR_b_V2HSubmitFA_Value: accessed-variable=VeCITR_b_V2HSubmitFA.Value
              OUT_VeCITR_b_V2L_AllReq_Value: accessed-variable=VeCITR_b_V2L_AllReq.Value
              OUT_VeCITR_b_V2L_AllReqFA_Value: accessed-variable=VeCITR_b_V2L_AllReqFA.Value
              OUT_VeCITR_b_V2L_FrunkReq_Value: accessed-variable=VeCITR_b_V2L_FrunkReq.Value
              OUT_VeCITR_b_V2L_FrunkReqFA_Value: accessed-variable=VeCITR_b_V2L_FrunkReqFA.Value
              OUT_VeCITR_b_V2LModeReq_Value: accessed-variable=VeCITR_b_V2LModeReq.Value
              OUT_VeCITR_b_V2LModeReqFA_Value: accessed-variable=VeCITR_b_V2LModeReqFA.Value
              OUT_VeCITR_Pct_V2LRsrvBatt_Value: accessed-variable=VeCITR_Pct_V2LRsrvBatt.Value
              OUT_VeCITR_b_V2LRsrvBattFA_Value: accessed-variable=VeCITR_b_V2LRsrvBattFA.Value
              OUT_VeCITR_b_V2LSubmit_Value: accessed-variable=VeCITR_b_V2LSubmit.Value
              OUT_VeCITR_b_V2LSubmitFA_Value: accessed-variable=VeCITR_b_V2LSubmitFA.Value
              OUT_VeCITR_b_V2LTrunkReq_Value: accessed-variable=VeCITR_b_V2LTrunkReq.Value
              OUT_VeCITR_b_V2LTrunkReqFA_Value: accessed-variable=VeCITR_b_V2LTrunkReqFA.Value
              OUT_VeCITR_b_V2VModeReq_Value: accessed-variable=VeCITR_b_V2VModeReq.Value
              OUT_VeCITR_b_V2VModeReqFA_Value: accessed-variable=VeCITR_b_V2VModeReqFA.Value
              OUT_VeCITR_b_V2VReq_Value: accessed-variable=VeCITR_b_V2VReq.Value
              OUT_VeCITR_b_V2VReqFA_Value: accessed-variable=VeCITR_b_V2VReqFA.Value
              OUT_VeCITR_Pct_V2VRsrvBatt_Value: accessed-variable=VeCITR_Pct_V2VRsrvBatt.Value
              OUT_VeCITR_b_V2VRsrvBattFA_Value: accessed-variable=VeCITR_b_V2VRsrvBattFA.Value
              OUT_VeCITR_b_V2VSubmit_Value: accessed-variable=VeCITR_b_V2VSubmit.Value
              OUT_VeCITR_b_V2VSubmitFA_Value: accessed-variable=VeCITR_b_V2VSubmitFA.Value
              OUT_VeCITR_I_PPCurrentDrawSens1_Value: accessed-variable=VeCITR_I_PPCurrentDrawSens1.Value
              OUT_VeCITR_b_PPCurrentDrawSens1FA_Value: accessed-variable=VeCITR_b_PPCurrentDrawSens1FA.Value
              OUT_VeCITR_b_PPButtonSts_Value: accessed-variable=VeCITR_b_PPButtonSts.Value
              OUT_VeCITR_b_PPButtonStsFA_Value: accessed-variable=VeCITR_b_PPButtonStsFA.Value
              OUT_VeCITR_b_PPLidSwitchSts120A_Value: accessed-variable=VeCITR_b_PPLidSwitchSts120A.Value
              OUT_VeCITR_b_PPLidSwitchSts120AFA_Value: accessed-variable=VeCITR_b_PPLidSwitchSts120AFA.Value
              OUT_VeCITR_b_PPLidSwitchSts120B_Value: accessed-variable=VeCITR_b_PPLidSwitchSts120B.Value
              OUT_VeCITR_b_PPLidSwitchSts120BFA_Value: accessed-variable=VeCITR_b_PPLidSwitchSts120BFA.Value
              OUT_VeCITR_b_PPLidSwitchSts240_Value: accessed-variable=VeCITR_b_PPLidSwitchSts240.Value
              OUT_VeCITR_b_PPLidSwitchSts240FA_Value: accessed-variable=VeCITR_b_PPLidSwitchSts240FA.Value
              OUT_VeCITR_b_PPACPresentSens1_Value: accessed-variable=VeCITR_b_PPACPresentSens1.Value
              OUT_VeCITR_b_PPACPresentSens1FA_Value: accessed-variable=VeCITR_b_PPACPresentSens1FA.Value
              OUT_VeCITR_b_PPACPresentSens2_Value: accessed-variable=VeCITR_b_PPACPresentSens2.Value
              OUT_VeCITR_b_PPACPresentSens2FA_Value: accessed-variable=VeCITR_b_PPACPresentSens2FA.Value
              OUT_VeCITR_I_PPCurrentDrawSens2_Value: accessed-variable=VeCITR_I_PPCurrentDrawSens2.Value
              OUT_VeCITR_b_PPCurrentDrawSens2FA_Value: accessed-variable=VeCITR_b_PPCurrentDrawSens2FA.Value
              OUT_VeCITR_e_PPFaultRsn_Value: accessed-variable=VeCITR_e_PPFaultRsn.Value
              OUT_VeCITR_b_PPFaultRsnFA_Value: accessed-variable=VeCITR_b_PPFaultRsnFA.Value
              OUT_VeCITR_e_PPFault_Value: accessed-variable=VeCITR_e_PPFault.Value
              OUT_VeCITR_b_PPFaultFA_Value: accessed-variable=VeCITR_b_PPFaultFA.Value
              OUT_VeCITR_e_PPLEDFault_Value: accessed-variable=VeCITR_e_PPLEDFault.Value
              OUT_VeCITR_b_PPLEDFaultFA_Value: accessed-variable=VeCITR_b_PPLEDFaultFA.Value
              OUT_VeCITR_b_RsErrSPP_Value: accessed-variable=VeCITR_b_RsErrSPP.Value
              OUT_VeCITR_b_RsErrSPPFA_Value: accessed-variable=VeCITR_b_RsErrSPPFA.Value
              OUT_VeCITR_P_PPRatedPower_Value: accessed-variable=VeCITR_P_PPRatedPower.Value
              OUT_VeCITR_b_PPRatedPowerFA_Value: accessed-variable=VeCITR_b_PPRatedPowerFA.Value
              OUT_VeCITR_I_PP2CurrentDrawSens1_Value: accessed-variable=VeCITR_I_PP2CurrentDrawSens1.Value
              OUT_VeCITR_b_PP2CurrentDrawSens1FA_Value: accessed-variable=VeCITR_b_PP2CurrentDrawSens1FA.Value
              OUT_VeCITR_b_PP2ButtonSts_Value: accessed-variable=VeCITR_b_PP2ButtonSts.Value
              OUT_VeCITR_b_PP2ButtonStsFA_Value: accessed-variable=VeCITR_b_PP2ButtonStsFA.Value
              OUT_VeCITR_b_PP2LidSwitchSts120A_Value: accessed-variable=VeCITR_b_PP2LidSwitchSts120A.Value
              OUT_VeCITR_b_PP2LidSwitchSts120AFA_Value: accessed-variable=VeCITR_b_PP2LidSwitchSts120AFA.Value
              OUT_VeCITR_b_PP2LidSwitchSts120B_Value: accessed-variable=VeCITR_b_PP2LidSwitchSts120B.Value
              OUT_VeCITR_b_PP2LidSwitchSts120BFA_Value: accessed-variable=VeCITR_b_PP2LidSwitchSts120BFA.Value
              OUT_VeCITR_b_PP2LidSwitchSts240_Value: accessed-variable=VeCITR_b_PP2LidSwitchSts240.Value
              OUT_VeCITR_b_PP2LidSwitchSts240FA_Value: accessed-variable=VeCITR_b_PP2LidSwitchSts240FA.Value
              OUT_VeCITR_b_PP2ACPresentSens1_Value: accessed-variable=VeCITR_b_PP2ACPresentSens1.Value
              OUT_VeCITR_b_PP2ACPresentSens1FA_Value: accessed-variable=VeCITR_b_PP2ACPresentSens1FA.Value
              OUT_VeCITR_b_PP2ACPresentSens2_Value: accessed-variable=VeCITR_b_PP2ACPresentSens2.Value
              OUT_VeCITR_b_PP2ACPresentSens2FA_Value: accessed-variable=VeCITR_b_PP2ACPresentSens2FA.Value
              OUT_VeCITR_I_PP2CurrentDrawSens2_Value: accessed-variable=VeCITR_I_PP2CurrentDrawSens2.Value
              OUT_VeCITR_b_PP2CurrentDrawSens2FA_Value: accessed-variable=VeCITR_b_PP2CurrentDrawSens2FA.Value
              OUT_VeCITR_e_PP2FaultRsn_Value: accessed-variable=VeCITR_e_PP2FaultRsn.Value
              OUT_VeCITR_b_PP2FaultRsnFA_Value: accessed-variable=VeCITR_b_PP2FaultRsnFA.Value
              OUT_VeCITR_e_PP2Fault_Value: accessed-variable=VeCITR_e_PP2Fault.Value
              OUT_VeCITR_b_PP2FaultFA_Value: accessed-variable=VeCITR_b_PP2FaultFA.Value
              OUT_VeCITR_e_PP2LEDFault_Value: accessed-variable=VeCITR_e_PP2LEDFault.Value
              OUT_VeCITR_b_PP2LEDFaultFA_Value: accessed-variable=VeCITR_b_PP2LEDFaultFA.Value
              OUT_VeCITR_b_RsErrSPP2_Value: accessed-variable=VeCITR_b_RsErrSPP2.Value
              OUT_VeCITR_b_RsErrSPP2FA_Value: accessed-variable=VeCITR_b_RsErrSPP2FA.Value
              OUT_VeCITR_P_PP2RatedPower_Value: accessed-variable=VeCITR_P_PP2RatedPower.Value
              OUT_VeCITR_b_PP2RatedPowerFA_Value: accessed-variable=VeCITR_b_PP2RatedPowerFA.Value
              OUT_VeCITR_e_PP_LED_A_Feedback_Value: accessed-variable=VeCITR_e_PP_LED_A_Feedback.Value
              OUT_VeCITR_b_PP_LED_A_Feedback_FA_Value: accessed-variable=VeCITR_b_PP_LED_A_Feedback_FA.Value
              OUT_VeCITR_e_PP_LED_B_Feedback_Value: accessed-variable=VeCITR_e_PP_LED_B_Feedback.Value
              OUT_VeCITR_b_PP_LED_B_Feedback_FA_Value: accessed-variable=VeCITR_b_PP_LED_B_Feedback_FA.Value
              OUT_VeCITR_e_PP_LED_C_Feedback_Value: accessed-variable=VeCITR_e_PP_LED_C_Feedback.Value
              OUT_VeCITR_b_PP_LED_C_Feedback_FA_Value: accessed-variable=VeCITR_b_PP_LED_C_Feedback_FA.Value
              OUT_VeCITR_e_PP_LED_A_FailStatus_Value: accessed-variable=VeCITR_e_PP_LED_A_FailStatus.Value
              OUT_VeCITR_b_PP_LED_A_FailStatus_FA_Value: accessed-variable=VeCITR_b_PP_LED_A_FailStatus_FA.Value
              OUT_VeCITR_e_PP_LED_B_FailStatus_Value: accessed-variable=VeCITR_e_PP_LED_B_FailStatus.Value
              OUT_VeCITR_b_PP_LED_B_FailStatus_FA_Value: accessed-variable=VeCITR_b_PP_LED_B_FailStatus_FA.Value
              OUT_VeCITR_e_PP_LED_C_FailStatus_Value: accessed-variable=VeCITR_e_PP_LED_C_FailStatus.Value
              OUT_VeCITR_b_PP_LED_C_FailStatus_FA_Value: accessed-variable=VeCITR_b_PP_LED_C_FailStatus_FA.Value
              OUT_VeCITR_e_PP_LED_A_Color_Feedback_Value: accessed-variable=VeCITR_e_PP_LED_A_Color_Feedback.Value
              OUT_VeCITR_b_PP_LED_A_Color_Feedback_FA_Value: accessed-variable=VeCITR_b_PP_LED_A_Color_Feedback_FA.Value
              OUT_VeCITR_e_PP_LED_B_Color_Feedback_Value: accessed-variable=VeCITR_e_PP_LED_B_Color_Feedback.Value
              OUT_VeCITR_b_PP_LED_B_Color_Feedback_FA_Value: accessed-variable=VeCITR_b_PP_LED_B_Color_Feedback_FA.Value
              OUT_VeCITR_e_PP_LED_C_Color_Feedback_Value: accessed-variable=VeCITR_e_PP_LED_C_Color_Feedback.Value
              OUT_VeCITR_b_PP_LED_C_Color_Feedback_FA_Value: accessed-variable=VeCITR_b_PP_LED_C_Color_Feedback_FA.Value
              OUT_VeCITR_b_PP_LIN_Checksum_Error_Value: accessed-variable=VeCITR_b_PP_LIN_Checksum_Error.Value
              OUT_VeCITR_b_PP_LIN_Checksum_Error_FA_Value: accessed-variable=VeCITR_b_PP_LIN_Checksum_Error_FA.Value
              OUT_VeCITR_b_PP_LIN_Data_Error_Value: accessed-variable=VeCITR_b_PP_LIN_Data_Error.Value
              OUT_VeCITR_b_PP_LIN_Data_Error_FA_Value: accessed-variable=VeCITR_b_PP_LIN_Data_Error_FA.Value
              OUT_VeCITR_b_PP_LIN_Parity_Error_Value: accessed-variable=VeCITR_b_PP_LIN_Parity_Error.Value
              OUT_VeCITR_b_PP_LIN_Parity_Error_FA_Value: accessed-variable=VeCITR_b_PP_LIN_Parity_Error_FA.Value
              OUT_VeCITR_b_PP_Gnd_Fault_Detected_Value: accessed-variable=VeCITR_b_PP_Gnd_Fault_Detected.Value
              OUT_VeCITR_b_PP_Gnd_Fault_Detected_FA_Value: accessed-variable=VeCITR_b_PP_Gnd_Fault_Detected_FA.Value
              OUT_VeCITR_e_PP2_LED_A_Feedback_Value: accessed-variable=VeCITR_e_PP2_LED_A_Feedback.Value
              OUT_VeCITR_b_PP2_LED_A_Feedback_FA_Value: accessed-variable=VeCITR_b_PP2_LED_A_Feedback_FA.Value
              OUT_VeCITR_e_PP2_LED_B_Feedback_Value: accessed-variable=VeCITR_e_PP2_LED_B_Feedback.Value
              OUT_VeCITR_b_PP2_LED_B_Feedback_FA_Value: accessed-variable=VeCITR_b_PP2_LED_B_Feedback_FA.Value
              OUT_VeCITR_e_PP2_LED_A_FailStatus_Value: accessed-variable=VeCITR_e_PP2_LED_A_FailStatus.Value
              OUT_VeCITR_b_PP2_LED_A_FailStatus_FA_Value: accessed-variable=VeCITR_b_PP2_LED_A_FailStatus_FA.Value
              OUT_VeCITR_e_PP2_LED_B_FailStatus_Value: accessed-variable=VeCITR_e_PP2_LED_B_FailStatus.Value
              OUT_VeCITR_b_PP2_LED_B_FailStatus_FA_Value: accessed-variable=VeCITR_b_PP2_LED_B_FailStatus_FA.Value
              OUT_VeCITR_e_PP2_LED_A_Color_Feedback_Value: accessed-variable=VeCITR_e_PP2_LED_A_Color_Feedback.Value
              OUT_VeCITR_b_PP2_LED_A_Color_Feedback_FA_Value: accessed-variable=VeCITR_b_PP2_LED_A_Color_Feedback_FA.Value
              OUT_VeCITR_e_PP2_LED_B_Color_Feedback_Value: accessed-variable=VeCITR_e_PP2_LED_B_Color_Feedback.Value
              OUT_VeCITR_b_PP2_LED_B_Color_Feedback_FA_Value: accessed-variable=VeCITR_b_PP2_LED_B_Color_Feedback_FA.Value
              OUT_VeCITR_b_PP2_LIN_Checksum_Error_Value: accessed-variable=VeCITR_b_PP2_LIN_Checksum_Error.Value
              OUT_VeCITR_b_PP2_LIN_Checksum_Error_FA_Value: accessed-variable=VeCITR_b_PP2_LIN_Checksum_Error_FA.Value
              OUT_VeCITR_b_PP2_LIN_Data_Error_Value: accessed-variable=VeCITR_b_PP2_LIN_Data_Error.Value
              OUT_VeCITR_b_PP2_LIN_Data_Error_FA_Value: accessed-variable=VeCITR_b_PP2_LIN_Data_Error_FA.Value
              OUT_VeCITR_b_PP2_LIN_Parity_Error_Value: accessed-variable=VeCITR_b_PP2_LIN_Parity_Error.Value
              OUT_VeCITR_b_PP2_LIN_Parity_Error_FA_Value: accessed-variable=VeCITR_b_PP2_LIN_Parity_Error_FA.Value
              OUT_VeCITR_b_PP2_Gnd_Fault_Detected_Value: accessed-variable=VeCITR_b_PP2_Gnd_Fault_Detected.Value
              OUT_VeCITR_b_PP2_Gnd_Fault_Detected_FA_Value: accessed-variable=VeCITR_b_PP2_Gnd_Fault_Detected_FA.Value
          written-local-variables:
            21 x access:
              WV_ChrgPortDoorSts_Init_write_IRV: accessed-variable=ChrgPortDoorSts_Init_write_IRV
              WV_ChrgPortLock_StsB_FA_Init_write_IRV: accessed-variable=ChrgPortLock_StsB_FA_Init_write_IRV
              WV_ChrgPortLock_StsB_Init_write_IRV: accessed-variable=ChrgPortLock_StsB_Init_write_IRV
              WV_ChrgPortLock_StsC_FA_Init_write_IRV: accessed-variable=ChrgPortLock_StsC_FA_Init_write_IRV
              WV_ChrgPortLock_StsC_Init_write_IRV: accessed-variable=ChrgPortLock_StsC_Init_write_IRV
              WV_ChrgPort_BCM_Cmd_Init_write_IRV: accessed-variable=ChrgPort_BCM_Cmd_Init_write_IRV
              WV_ChrgPort_BCM_Cmd_SgnlRcvd_Init_write_IRV: accessed-variable=ChrgPort_BCM_Cmd_SgnlRcvd_Init_write_IRV
              WV_ChrgPort_Sense_Init_write_IRV: accessed-variable=ChrgPort_Sense_Init_write_IRV
              WV_DoorLockLastElSts_2_FA_Init_write_IRV: accessed-variable=DoorLockLastElSts_2_FA_Init_write_IRV
              WV_DoorLockLastElSts_2_Init_write_IRV: accessed-variable=DoorLockLastElSts_2_Init_write_IRV
              WV_DoorLockLastElSts_2_SgnlRcvd_Init_write_IRV: accessed-variable=DoorLockLastElSts_2_SgnlRcvd_Init_write_IRV
              WV_DoorLockLastElSts_FA_Init_write_IRV: accessed-variable=DoorLockLastElSts_FA_Init_write_IRV
              WV_DoorLockLastElSts_Init_write_IRV: accessed-variable=DoorLockLastElSts_Init_write_IRV
              WV_DoorLockLastElSts_SgnlRcvd_Init_write_IRV: accessed-variable=DoorLockLastElSts_SgnlRcvd_Init_write_IRV
              WV_LockSense_write_IRV: accessed-variable=LockSense_write_IRV
              WV_PwrLimReq_2_Init_write_IRV: accessed-variable=PwrLimReq_2_Init_write_IRV
              WV_PwrLimReq_FA_2_Init_write_IRV: accessed-variable=PwrLimReq_FA_2_Init_write_IRV
              WV_PwrLimReq_FA_Init_write_IRV: accessed-variable=PwrLimReq_FA_Init_write_IRV
              WV_PwrLimReq_Init_write_IRV: accessed-variable=PwrLimReq_Init_write_IRV
              WV_PwrLimReq_SgnlRcvd_2_Init_write_IRV: accessed-variable=PwrLimReq_SgnlRcvd_2_Init_write_IRV
              WV_PwrLimReq_SgnlRcvd_Init_write_IRV: accessed-variable=PwrLimReq_SgnlRcvd_Init_write_IRV
        CITR_FastTEF
          data-send-points:
            access OUT_VeCITR_b_Lock_Sense_Value: accessed-variable=VeCITR_b_Lock_Sense.Value
            access OUT_VeCITR_b_ChrgPortDoorSts_Value: accessed-variable=VeCITR_b_ChrgPortDoorSts.Value
          read-local-variables:
            access RV_ChrgPortDoorSts_Init_write_IRV: accessed-variable=ChrgPortDoorSts_Init_write_IRV
            access RV_ChrgPort_Sense_Init_write_IRV: accessed-variable=ChrgPort_Sense_Init_write_IRV
          written-local-variables:
            access WV_LockSense_write_IRV: accessed-variable=LockSense_write_IRV
        CITR_MedTED
          data-receive-point-by-arguments:
            access IN_VeOBCR_e_ChrgPort_Req_Value: accessed-variable=VeOBCR_e_ChrgPort_Req.Value
            access IN_VePRXR_e_RRM_VP_Level_Value: accessed-variable=VePRXR_e_RRM_VP_Level.Value
          data-send-points:
            12 x access:
              OUT_VeCITR_e_DoorLockLastElSts_Value: accessed-variable=VeCITR_e_DoorLockLastElSts.Value
              OUT_VeCITR_b_DoorLockLastElSts_Rcvd_Value: accessed-variable=VeCITR_b_DoorLockLastElSts_Rcvd.Value
              OUT_VeCITR_e_PwrLimReq_Value: accessed-variable=VeCITR_e_PwrLimReq.Value
              OUT_VeCITR_b_PwrLimReq_FA_Value: accessed-variable=VeCITR_b_PwrLimReq_FA.Value
              OUT_VeCITR_b_PwrLimReq_SgnlRcvd_Value: accessed-variable=VeCITR_b_PwrLimReq_SgnlRcvd.Value
              OUT_VeCITR_b_PortLockBCM_Cmd_Value: accessed-variable=VeCITR_b_PortLockBCM_Cmd.Value
              OUT_VeCITR_e_ChrgPortLock_StsB_Value: accessed-variable=VeCITR_e_ChrgPortLock_StsB.Value
              OUT_VeCITR_b_HBridge_ChrgPortLck_Cal_Value: accessed-variable=VeCITR_b_HBridge_ChrgPortLck_Cal.Value
              OUT_VeCITR_b_ChrgPortLockSts_Value: accessed-variable=VeCITR_b_ChrgPortLockSts.Value
              OUT_VeCITR_b_ChrgPortLockSts_FA_Value: accessed-variable=VeCITR_b_ChrgPortLockSts_FA.Value
              OUT_VeCITR_b_ChrgPortSts_Value: accessed-variable=VeCITR_b_ChrgPortSts.Value
              OUT_VeCITR_e_RRM_VP_Level_Value: accessed-variable=VeCITR_e_RRM_VP_Level.Value
          read-local-variables:
            17 x access:
              RV_ChrgPortLock_StsB_FA_Init_write_IRV: accessed-variable=ChrgPortLock_StsB_FA_Init_write_IRV
              RV_ChrgPortLock_StsB_Init_write_IRV: accessed-variable=ChrgPortLock_StsB_Init_write_IRV
              RV_ChrgPortLock_StsC_FA_Init_write_IRV: accessed-variable=ChrgPortLock_StsC_FA_Init_write_IRV
              RV_ChrgPortLock_StsC_Init_write_IRV: accessed-variable=ChrgPortLock_StsC_Init_write_IRV
              RV_ChrgPort_BCM_Cmd_Init_write_IRV: accessed-variable=ChrgPort_BCM_Cmd_Init_write_IRV
              RV_ChrgPort_BCM_Cmd_SgnlRcvd_Init_write_IRV: accessed-variable=ChrgPort_BCM_Cmd_SgnlRcvd_Init_write_IRV
              RV_DoorLockLastElSts_2_Init_write_IRV: accessed-variable=DoorLockLastElSts_2_Init_write_IRV
              RV_DoorLockLastElSts_2_SgnlRcvd_Init_write_IRV: accessed-variable=DoorLockLastElSts_2_SgnlRcvd_Init_write_IRV
              RV_DoorLockLastElSts_Init_write_IRV: accessed-variable=DoorLockLastElSts_Init_write_IRV
              RV_DoorLockLastElSts_SgnlRcvd_Init_write_IRV: accessed-variable=DoorLockLastElSts_SgnlRcvd_Init_write_IRV
              RV_LockSense_write_IRV: accessed-variable=LockSense_write_IRV
              RV_PwrLimReq_2_Init_write_IRV: accessed-variable=PwrLimReq_2_Init_write_IRV
              RV_PwrLimReq_FA_2_Init_write_IRV: accessed-variable=PwrLimReq_FA_2_Init_write_IRV
              RV_PwrLimReq_FA_Init_write_IRV: accessed-variable=PwrLimReq_FA_Init_write_IRV
              RV_PwrLimReq_Init_write_IRV: accessed-variable=PwrLimReq_Init_write_IRV
              RV_PwrLimReq_SgnlRcvd_2_Init_write_IRV: accessed-variable=PwrLimReq_SgnlRcvd_2_Init_write_IRV
              RV_PwrLimReq_SgnlRcvd_Init_write_IRV: accessed-variable=PwrLimReq_SgnlRcvd_Init_write_IRV
        CITR_PwrOff
          data-send-points:
            access OUT_NeCITR_b_Lock_Status_NeCITR_b_Lock_Status: accessed-variable=NeCITR_b_Lock_Status.NeCITR_b_Lock_Status
            access OUT_NeCITR_b_PortLockBCM_Cmd_NeCITR_b_PortLockBCM_Cmd: accessed-variable=NeCITR_b_PortLockBCM_Cmd.NeCITR_b_PortLockBCM_Cmd
        IOControl_Charge_Port_Lock
          data-receive-point-by-arguments:
            access IN_VeDCAB_b_IOCtrlD014ChargePortRq_Value: accessed-variable=VeDCAB_b_IOCtrlD014ChargePortRq.Value
            access IN_VeDCAB_e_IOControl_Charge_Port_Lock_Op_Value: accessed-variable=VeDCAB_e_IOControl_Charge_Port_Lock_Op.Value
          data-send-points:
            access OUT_VeCITR_e_DVC_ChrgPort_IO_Value: accessed-variable=VeCITR_e_DVC_ChrgPort_IO.Value
            access OUT_VeCITR_b_DVC_ChrgPortRq_Value: accessed-variable=VeCITR_b_DVC_ChrgPortRq.Value
        DIDWrite_RWDB604_DCChrg_TestSts
          data-receive-point-by-arguments:
            access IN_VeDCAB_e_RWDB604_DCChrg_TestSts_DidWrite_Value: accessed-variable=VeDCAB_e_RWDB604_DCChrg_TestSts_DidWrite.Value
          data-send-points:
            access OUT_VeCITR_e_DCChrg_TestSts_Value: accessed-variable=VeCITR_e_DCChrg_TestSts.Value
            access OUT_VeCITR_Cnt_DCEOL_SgnlRcvd_Value: accessed-variable=VeCITR_Cnt_DCEOL_SgnlRcvd.Value
        FsftCITR_I_PP2CurrentDrawSens1
          data-send-points:
            access OUT_VeCITR_b_PP2CurrentDrawSens1FA_Value: accessed-variable=VeCITR_b_PP2CurrentDrawSens1FA.Value
        FsftCITR_I_PP2CurrentDrawSens2
          data-send-points:
            access OUT_VeCITR_b_PP2CurrentDrawSens2FA_Value: accessed-variable=VeCITR_b_PP2CurrentDrawSens2FA.Value
        FsftCITR_I_PPCurrentDrawSens1
          data-send-points:
            access OUT_VeCITR_b_PPCurrentDrawSens1FA_Value: accessed-variable=VeCITR_b_PPCurrentDrawSens1FA.Value
        FsftCITR_I_PPCurrentDrawSens2
          data-send-points:
            access OUT_VeCITR_b_PPCurrentDrawSens2FA_Value: accessed-variable=VeCITR_b_PPCurrentDrawSens2FA.Value
        FsftCITR_P_ChargingDestinationPwr
          data-send-points:
            access OUT_VeCITR_b_ChargingDestinationPwr_FA_Value: accessed-variable=VeCITR_b_ChargingDestinationPwr_FA.Value
        FsftCITR_P_PP2RatedPower
          data-send-points:
            access OUT_VeCITR_b_PP2RatedPowerFA_Value: accessed-variable=VeCITR_b_PP2RatedPowerFA.Value
        FsftCITR_P_PPRatedPower
          data-send-points:
            access OUT_VeCITR_b_PPRatedPowerFA_Value: accessed-variable=VeCITR_b_PPRatedPowerFA.Value
        FsftCITR_Pct_HU_ExtChrgTarget1
          data-send-points:
            access OUT_VeCITR_b_HU_ExtChrgTarget1FA_Value: accessed-variable=VeCITR_b_HU_ExtChrgTarget1FA.Value
        FsftCITR_Pct_HU_ExtChrgTarget2
          data-send-points:
            access OUT_VeCITR_b_HU_ExtChrgTarget2FA_Value: accessed-variable=VeCITR_b_HU_ExtChrgTarget2FA.Value
        FsftCITR_Pct_HU_ImmChrgTarget1
          data-send-points:
            access OUT_VeCITR_b_HU_ImmChrgTarget1FA_Value: accessed-variable=VeCITR_b_HU_ImmChrgTarget1FA.Value
        FsftCITR_Pct_HU_ImmChrgTarget2
          data-send-points:
            access OUT_VeCITR_b_HU_ImmChrgTarget2FA_Value: accessed-variable=VeCITR_b_HU_ImmChrgTarget2FA.Value
        FsftCITR_Pct_TBM_ExtChrgTarget1
          data-send-points:
            access OUT_VeCITR_b_TBM_ExtChrgTarget1FA_Value: accessed-variable=VeCITR_b_TBM_ExtChrgTarget1FA.Value
        FsftCITR_Pct_TBM_ExtChrgTarget2
          data-send-points:
            access OUT_VeCITR_b_TBM_ExtChrgTarget2FA_Value: accessed-variable=VeCITR_b_TBM_ExtChrgTarget2FA.Value
        FsftCITR_Pct_TBM_ImmChrgTarget1
          data-send-points:
            access OUT_VeCITR_b_TBM_ImmChrgTarget1FA_Value: accessed-variable=VeCITR_b_TBM_ImmChrgTarget1FA.Value
        FsftCITR_Pct_TBM_ImmChrgTarget2
          data-send-points:
            access OUT_VeCITR_b_TBM_ImmChrgTarget2FA_Value: accessed-variable=VeCITR_b_TBM_ImmChrgTarget2FA.Value
        FsftCITR_Pct_V2HRsrvBatt
          data-send-points:
            access OUT_VeCITR_b_V2HRsrvBattFA_Value: accessed-variable=VeCITR_b_V2HRsrvBattFA.Value
        FsftCITR_Pct_V2LRsrvBatt
          data-send-points:
            access OUT_VeCITR_b_V2LRsrvBattFA_Value: accessed-variable=VeCITR_b_V2LRsrvBattFA.Value
        FsftCITR_Pct_V2VRsrvBatt
          data-send-points:
            access OUT_VeCITR_b_V2VRsrvBattFA_Value: accessed-variable=VeCITR_b_V2VRsrvBattFA.Value
        FsftCITR_b_ChrgPortDoor_Sts
        FsftCITR_b_ChrgPortLock_StsC
          data-send-points:
            access OUT_VeCITR_b_ChrgPortLock_StsC_FA_Value: accessed-variable=VeCITR_b_ChrgPortLock_StsC_FA.Value
          written-local-variables:
            access WV_ChrgPortLock_StsC_FA_Init_write_IRV: accessed-variable=ChrgPortLock_StsC_FA_Init_write_IRV
        FsftCITR_b_ChrgPort_BCM_Cmd
          data-send-points:
            access OUT_VeCITR_b_ChrgPort_BCM_Cmd_Rcvd_Value: accessed-variable=VeCITR_b_ChrgPort_BCM_Cmd_Rcvd.Value
          written-local-variables:
            access WV_ChrgPort_BCM_Cmd_SgnlRcvd_Init_write_IRV: accessed-variable=ChrgPort_BCM_Cmd_SgnlRcvd_Init_write_IRV
        FsftCITR_b_CoopCh_VehLocation
          data-send-points:
            access OUT_VeCITR_b_CoopCh_VehLocationFA_Value: accessed-variable=VeCITR_b_CoopCh_VehLocationFA.Value
        FsftCITR_b_DC_PwrLev
          data-send-points:
            access OUT_VeCITR_b_DC_PwrLev_FA_Value: accessed-variable=VeCITR_b_DC_PwrLev_FA.Value
            access OUT_VeCITR_b_DC_PwrLev_SgnlRcvd_Value: accessed-variable=VeCITR_b_DC_PwrLev_SgnlRcvd.Value
        FsftCITR_b_DateTmDay
          data-send-points:
            access OUT_VeCITR_b_DateTmDay_FA_Value: accessed-variable=VeCITR_b_DateTmDay_FA.Value
            access OUT_VeCITR_b_DateTmDay_SgnlRcvd_Value: accessed-variable=VeCITR_b_DateTmDay_SgnlRcvd.Value
        FsftCITR_b_DateTmFormat
          data-send-points:
            access OUT_VeCITR_b_DateTmFormat_FA_Value: accessed-variable=VeCITR_b_DateTmFormat_FA.Value
        FsftCITR_b_Date_Day1
          data-send-points:
            access OUT_VeCITR_b_Date_Day1_FA_Value: accessed-variable=VeCITR_b_Date_Day1_FA.Value
            access OUT_VeCITR_b_Date_Day1_SgnlRcvd_Value: accessed-variable=VeCITR_b_Date_Day1_SgnlRcvd.Value
        FsftCITR_b_HU_Sch1_CabTemp
          data-send-points:
            access OUT_VeCITR_b_HU_Sch1_TemperatureFA_Value: accessed-variable=VeCITR_b_HU_Sch1_TemperatureFA.Value
        FsftCITR_b_HU_Sch1_Day
          data-send-points:
            access OUT_VeCITR_b_HU_Sch1_Day_FA_Value: accessed-variable=VeCITR_b_HU_Sch1_Day_FA.Value
            access OUT_VeCITR_b_HU_Sch1_Day_SgnlRcvd_Value: accessed-variable=VeCITR_b_HU_Sch1_Day_SgnlRcvd.Value
        FsftCITR_b_HU_Sch1_End_Time_Hr
          data-send-points:
            access OUT_VeCITR_b_HU_Sch1_End_Time_HrFA_Value: accessed-variable=VeCITR_b_HU_Sch1_End_Time_HrFA.Value
        FsftCITR_b_HU_Sch1_End_Time_Min
          data-send-points:
            access OUT_VeCITR_b_HU_Sch1_End_Time_MinFA_Value: accessed-variable=VeCITR_b_HU_Sch1_End_Time_MinFA.Value
        FsftCITR_b_HU_Sch1_Start_Time_Hr
          data-send-points:
            access OUT_VeCITR_b_HU_Sch1_Start_Time_HrFA_Value: accessed-variable=VeCITR_b_HU_Sch1_Start_Time_HrFA.Value
        FsftCITR_b_HU_Sch1_Start_Time_Min
          data-send-points:
            access OUT_VeCITR_b_HU_Sch1_Start_Time_MinFA_Value: accessed-variable=VeCITR_b_HU_Sch1_Start_Time_MinFA.Value
        FsftCITR_b_HU_Sch1_Type
          data-send-points:
            access OUT_VeCITR_b_HU_Sch1_TypeFA_Value: accessed-variable=VeCITR_b_HU_Sch1_TypeFA.Value
        FsftCITR_b_HU_Sch2_CabTemp
          data-send-points:
            access OUT_VeCITR_b_HU_Sch2_TemperatureFA_Value: accessed-variable=VeCITR_b_HU_Sch2_TemperatureFA.Value
        FsftCITR_b_HU_Sch2_Day
          data-send-points:
            access OUT_VeCITR_b_HU_Sch2_Day_FA_Value: accessed-variable=VeCITR_b_HU_Sch2_Day_FA.Value
            access OUT_VeCITR_b_HU_Sch2_Day_SgnlRcvd_Value: accessed-variable=VeCITR_b_HU_Sch2_Day_SgnlRcvd.Value
        FsftCITR_b_HU_Sch2_End_Time_Hr
          data-send-points:
            access OUT_VeCITR_b_HU_Sch2_End_Time_HrFA_Value: accessed-variable=VeCITR_b_HU_Sch2_End_Time_HrFA.Value
        FsftCITR_b_HU_Sch2_End_Time_Min
          data-send-points:
            access OUT_VeCITR_b_HU_Sch2_End_Time_MinFA_Value: accessed-variable=VeCITR_b_HU_Sch2_End_Time_MinFA.Value
        FsftCITR_b_HU_Sch2_Start_Time_Hr
          data-send-points:
            access OUT_VeCITR_b_HU_Sch2_Start_Time_HrFA_Value: accessed-variable=VeCITR_b_HU_Sch2_Start_Time_HrFA.Value
        FsftCITR_b_HU_Sch2_Start_Time_Min
          data-send-points:
            access OUT_VeCITR_b_HU_Sch2_Start_Time_MinFA_Value: accessed-variable=VeCITR_b_HU_Sch2_Start_Time_MinFA.Value
        FsftCITR_b_HU_Sch2_Type
          data-send-points:
            access OUT_VeCITR_b_HU_Sch2_TypeFA_Value: accessed-variable=VeCITR_b_HU_Sch2_TypeFA.Value
        FsftCITR_b_HU_Sch3_Allow
          data-send-points:
            access OUT_VeCITR_b_HU_Sch3_AllowFA_Value: accessed-variable=VeCITR_b_HU_Sch3_AllowFA.Value
        FsftCITR_b_HU_Sch3_CabTemp
          data-send-points:
            access OUT_VeCITR_b_HU_Sch3_TemperatureFA_Value: accessed-variable=VeCITR_b_HU_Sch3_TemperatureFA.Value
        FsftCITR_b_HU_Sch3_Day
          data-send-points:
            access OUT_VeCITR_b_HU_Sch3_Day_FA_Value: accessed-variable=VeCITR_b_HU_Sch3_Day_FA.Value
            access OUT_VeCITR_b_HU_Sch3_Day_SgnlRcvd_Value: accessed-variable=VeCITR_b_HU_Sch3_Day_SgnlRcvd.Value
        FsftCITR_b_HU_Sch3_End_Time_Hr
          data-send-points:
            access OUT_VeCITR_b_HU_Sch3_End_Time_HrFA_Value: accessed-variable=VeCITR_b_HU_Sch3_End_Time_HrFA.Value
        FsftCITR_b_HU_Sch3_End_Time_Min
          data-send-points:
            access OUT_VeCITR_b_HU_Sch3_End_Time_MinFA_Value: accessed-variable=VeCITR_b_HU_Sch3_End_Time_MinFA.Value
        FsftCITR_b_HU_Sch3_Start_Time_Hr
          data-send-points:
            access OUT_VeCITR_b_HU_Sch3_Start_Time_HrFA_Value: accessed-variable=VeCITR_b_HU_Sch3_Start_Time_HrFA.Value
        FsftCITR_b_HU_Sch3_Start_Time_Min
          data-send-points:
            access OUT_VeCITR_b_HU_Sch3_Start_Time_MinFA_Value: accessed-variable=VeCITR_b_HU_Sch3_Start_Time_MinFA.Value
        FsftCITR_b_HU_Sch3_Type
          data-send-points:
            access OUT_VeCITR_b_HU_Sch3_TypeFA_Value: accessed-variable=VeCITR_b_HU_Sch3_TypeFA.Value
        FsftCITR_b_HU_Sch4_Allow
          data-send-points:
            access OUT_VeCITR_b_HU_Sch4_AllowFA_Value: accessed-variable=VeCITR_b_HU_Sch4_AllowFA.Value
        FsftCITR_b_HU_Sch4_CabTemp
          data-send-points:
            access OUT_VeCITR_b_HU_Sch4_TemperatureFA_Value: accessed-variable=VeCITR_b_HU_Sch4_TemperatureFA.Value
        FsftCITR_b_HU_Sch4_Day
          data-send-points:
            access OUT_VeCITR_b_HU_Sch4_Day_FA_Value: accessed-variable=VeCITR_b_HU_Sch4_Day_FA.Value
            access OUT_VeCITR_b_HU_Sch4_Day_SgnlRcvd_Value: accessed-variable=VeCITR_b_HU_Sch4_Day_SgnlRcvd.Value
        FsftCITR_b_HU_Sch4_Start_Time_Hr
          data-send-points:
            access OUT_VeCITR_b_HU_Sch4_Start_Time_HrFA_Value: accessed-variable=VeCITR_b_HU_Sch4_Start_Time_HrFA.Value
        FsftCITR_b_HU_Sch4_Start_Time_Min
          data-send-points:
            access OUT_VeCITR_b_HU_Sch4_Start_Time_MinFA_Value: accessed-variable=VeCITR_b_HU_Sch4_Start_Time_MinFA.Value
        FsftCITR_b_PP2ACPresentSens1
          data-send-points:
            access OUT_VeCITR_b_PP2ACPresentSens1FA_Value: accessed-variable=VeCITR_b_PP2ACPresentSens1FA.Value
        FsftCITR_b_PP2ACPresentSens2
          data-send-points:
            access OUT_VeCITR_b_PP2ACPresentSens2FA_Value: accessed-variable=VeCITR_b_PP2ACPresentSens2FA.Value
        FsftCITR_b_PP2ButtonSts
          data-send-points:
            access OUT_VeCITR_b_PP2ButtonStsFA_Value: accessed-variable=VeCITR_b_PP2ButtonStsFA.Value
        FsftCITR_b_PP2LidSwitchSts240
          data-send-points:
            access OUT_VeCITR_b_PP2LidSwitchSts240FA_Value: accessed-variable=VeCITR_b_PP2LidSwitchSts240FA.Value
        FsftCITR_b_PP2LidSwitchSts120A
          data-send-points:
            access OUT_VeCITR_b_PP2LidSwitchSts120AFA_Value: accessed-variable=VeCITR_b_PP2LidSwitchSts120AFA.Value
        FsftCITR_b_PP2LidSwitchSts120B
          data-send-points:
            access OUT_VeCITR_b_PP2LidSwitchSts120BFA_Value: accessed-variable=VeCITR_b_PP2LidSwitchSts120BFA.Value
        FsftCITR_b_PP2_Gnd_Fault_Det
          data-send-points:
            access OUT_VeCITR_b_PP2_Gnd_Fault_Detected_FA_Value: accessed-variable=VeCITR_b_PP2_Gnd_Fault_Detected_FA.Value
        FsftCITR_b_PP2_LIN_Cksm_Err
          data-send-points:
            access OUT_VeCITR_b_PP2_LIN_Checksum_Error_FA_Value: accessed-variable=VeCITR_b_PP2_LIN_Checksum_Error_FA.Value
        FsftCITR_b_PP2_LIN_Data_Err
          data-send-points:
            access OUT_VeCITR_b_PP2_LIN_Data_Error_FA_Value: accessed-variable=VeCITR_b_PP2_LIN_Data_Error_FA.Value
        FsftCITR_b_PP2_LIN_Parity_Err
          data-send-points:
            access OUT_VeCITR_b_PP2_LIN_Parity_Error_FA_Value: accessed-variable=VeCITR_b_PP2_LIN_Parity_Error_FA.Value
        FsftCITR_b_PPACPresentSens1
          data-send-points:
            access OUT_VeCITR_b_PPACPresentSens1FA_Value: accessed-variable=VeCITR_b_PPACPresentSens1FA.Value
        FsftCITR_b_PPACPresentSens2
          data-send-points:
            access OUT_VeCITR_b_PPACPresentSens2FA_Value: accessed-variable=VeCITR_b_PPACPresentSens2FA.Value
        FsftCITR_b_PPButtonSts
          data-send-points:
            access OUT_VeCITR_b_PPButtonStsFA_Value: accessed-variable=VeCITR_b_PPButtonStsFA.Value
        FsftCITR_b_PPLidSwitchSts120A
          data-send-points:
            access OUT_VeCITR_b_PPLidSwitchSts120AFA_Value: accessed-variable=VeCITR_b_PPLidSwitchSts120AFA.Value
        FsftCITR_b_PPLidSwitchSts120B
          data-send-points:
            access OUT_VeCITR_b_PPLidSwitchSts120BFA_Value: accessed-variable=VeCITR_b_PPLidSwitchSts120BFA.Value
        FsftCITR_b_PPLidSwitchSts240
          data-send-points:
            access OUT_VeCITR_b_PPLidSwitchSts240FA_Value: accessed-variable=VeCITR_b_PPLidSwitchSts240FA.Value
        FsftCITR_b_PP_Gnd_Fault_Det
          data-send-points:
            access OUT_VeCITR_b_PP_Gnd_Fault_Detected_FA_Value: accessed-variable=VeCITR_b_PP_Gnd_Fault_Detected_FA.Value
        FsftCITR_b_PP_LIN_Cksm_Err
          data-send-points:
            access OUT_VeCITR_b_PP_LIN_Checksum_Error_FA_Value: accessed-variable=VeCITR_b_PP_LIN_Checksum_Error_FA.Value
        FsftCITR_b_PP_LIN_Data_Err
          data-send-points:
            access OUT_VeCITR_b_PP_LIN_Data_Error_FA_Value: accessed-variable=VeCITR_b_PP_LIN_Data_Error_FA.Value
        FsftCITR_b_PP_LIN_Parity_Err
          data-send-points:
            access OUT_VeCITR_b_PP_LIN_Parity_Error_FA_Value: accessed-variable=VeCITR_b_PP_LIN_Parity_Error_FA.Value
        FsftCITR_b_RsErrSPP
          data-send-points:
            access OUT_VeCITR_b_RsErrSPPFA_Value: accessed-variable=VeCITR_b_RsErrSPPFA.Value
        FsftCITR_b_RsErrSPP2
          data-send-points:
            access OUT_VeCITR_b_RsErrSPP2FA_Value: accessed-variable=VeCITR_b_RsErrSPP2FA.Value
        FsftCITR_b_SOC_Max_Lev
          data-send-points:
            access OUT_VeCITR_b_SOC_Max_Lev_FA_Value: accessed-variable=VeCITR_b_SOC_Max_Lev_FA.Value
        FsftCITR_b_TBMStopChrg
          data-send-points:
            access OUT_VeCITR_b_TBMStopChrgFA_Value: accessed-variable=VeCITR_b_TBMStopChrgFA.Value
        FsftCITR_b_TBM_Sch1_CabTemp
          data-send-points:
            access OUT_VeCITR_b_TBM_Sch1_TemperatureFA_Value: accessed-variable=VeCITR_b_TBM_Sch1_TemperatureFA.Value
        FsftCITR_b_TBM_Sch1_Day
          data-send-points:
            access OUT_VeCITR_b_TBM_Sch1_Day_FA_Value: accessed-variable=VeCITR_b_TBM_Sch1_Day_FA.Value
            access OUT_VeCITR_b_TBM_Sch1_Day_SgnlRcvd_Value: accessed-variable=VeCITR_b_TBM_Sch1_Day_SgnlRcvd.Value
        FsftCITR_b_TBM_Sch1_End_Time_Hr
          data-send-points:
            access OUT_VeCITR_b_TBM_Sch1_End_Time_HrFA_Value: accessed-variable=VeCITR_b_TBM_Sch1_End_Time_HrFA.Value
        FsftCITR_b_TBM_Sch1_End_Time_Min
          data-send-points:
            access OUT_VeCITR_b_TBM_Sch1_End_Time_MinFA_Value: accessed-variable=VeCITR_b_TBM_Sch1_End_Time_MinFA.Value
        FsftCITR_b_TBM_Sch1_Start_Time_Hr
          data-send-points:
            access OUT_VeCITR_b_TBM_Sch1_Start_Time_HrFA_Value: accessed-variable=VeCITR_b_TBM_Sch1_Start_Time_HrFA.Value
        FsftCITR_b_TBM_Sch1_Start_Time_Min
          data-send-points:
            access OUT_VeCITR_b_TBM_Sch1_Start_Time_MinFA_Value: accessed-variable=VeCITR_b_TBM_Sch1_Start_Time_MinFA.Value
        FsftCITR_b_TBM_Sch1_Type
          data-send-points:
            access OUT_VeCITR_b_TBM_Sch1_TypeFA_Value: accessed-variable=VeCITR_b_TBM_Sch1_TypeFA.Value
        FsftCITR_b_TBM_Sch2_CabTemp
          data-send-points:
            access OUT_VeCITR_b_TBM_Sch2_TemperatureFA_Value: accessed-variable=VeCITR_b_TBM_Sch2_TemperatureFA.Value
        FsftCITR_b_TBM_Sch2_Day
          data-send-points:
            access OUT_VeCITR_b_TBM_Sch2_Day_FA_Value: accessed-variable=VeCITR_b_TBM_Sch2_Day_FA.Value
            access OUT_VeCITR_b_TBM_Sch2_Day_SgnlRcvd_Value: accessed-variable=VeCITR_b_TBM_Sch2_Day_SgnlRcvd.Value
        FsftCITR_b_TBM_Sch2_End_Time_Hr
          data-send-points:
            access OUT_VeCITR_b_TBM_Sch2_End_Time_HrFA_Value: accessed-variable=VeCITR_b_TBM_Sch2_End_Time_HrFA.Value
        FsftCITR_b_TBM_Sch2_End_Time_Min
          data-send-points:
            access OUT_VeCITR_b_TBM_Sch2_End_Time_MinFA_Value: accessed-variable=VeCITR_b_TBM_Sch2_End_Time_MinFA.Value
        FsftCITR_b_TBM_Sch2_Start_Time_Hr
          data-send-points:
            access OUT_VeCITR_b_TBM_Sch2_Start_Time_HrFA_Value: accessed-variable=VeCITR_b_TBM_Sch2_Start_Time_HrFA.Value
        FsftCITR_b_TBM_Sch2_Start_Time_Min
          data-send-points:
            access OUT_VeCITR_b_TBM_Sch2_Start_Time_MinFA_Value: accessed-variable=VeCITR_b_TBM_Sch2_Start_Time_MinFA.Value
        FsftCITR_b_TBM_Sch2_Type
          data-send-points:
            access OUT_VeCITR_b_TBM_Sch2_TypeFA_Value: accessed-variable=VeCITR_b_TBM_Sch2_TypeFA.Value
        FsftCITR_b_TBM_Sch3_Allow
          data-send-points:
            access OUT_VeCITR_b_TBM_Sch3_AllowFA_Value: accessed-variable=VeCITR_b_TBM_Sch3_AllowFA.Value
        FsftCITR_b_TBM_Sch3_CabTemp
          data-send-points:
            access OUT_VeCITR_b_TBM_Sch3_TemperatureFA_Value: accessed-variable=VeCITR_b_TBM_Sch3_TemperatureFA.Value
        FsftCITR_b_TBM_Sch3_Day
          data-send-points:
            access OUT_VeCITR_b_TBM_Sch3_Day_FA_Value: accessed-variable=VeCITR_b_TBM_Sch3_Day_FA.Value
            access OUT_VeCITR_b_TBM_Sch3_Day_SgnlRcvd_Value: accessed-variable=VeCITR_b_TBM_Sch3_Day_SgnlRcvd.Value
        FsftCITR_b_TBM_Sch3_End_Time_Hr
          data-send-points:
            access OUT_VeCITR_b_TBM_Sch3_End_Time_HrFA_Value: accessed-variable=VeCITR_b_TBM_Sch3_End_Time_HrFA.Value
        FsftCITR_b_TBM_Sch3_End_Time_Min
          data-send-points:
            access OUT_VeCITR_b_TBM_Sch3_End_Time_MinFA_Value: accessed-variable=VeCITR_b_TBM_Sch3_End_Time_MinFA.Value
        FsftCITR_b_TBM_Sch3_Start_Time_Hr
          data-send-points:
            access OUT_VeCITR_b_TBM_Sch3_Start_Time_HrFA_Value: accessed-variable=VeCITR_b_TBM_Sch3_Start_Time_HrFA.Value
        FsftCITR_b_TBM_Sch3_Start_Time_Min
          data-send-points:
            access OUT_VeCITR_b_TBM_Sch3_Start_Time_MinFA_Value: accessed-variable=VeCITR_b_TBM_Sch3_Start_Time_MinFA.Value
        FsftCITR_b_TBM_Sch3_Type
          data-send-points:
            access OUT_VeCITR_b_TBM_Sch3_TypeFA_Value: accessed-variable=VeCITR_b_TBM_Sch3_TypeFA.Value
        FsftCITR_b_TBM_Sch4_Allow
          data-send-points:
            access OUT_VeCITR_b_TBM_Sch4_AllowFA_Value: accessed-variable=VeCITR_b_TBM_Sch4_AllowFA.Value
        FsftCITR_b_TBM_Sch4_CabTemp
          data-send-points:
            access OUT_VeCITR_b_TBM_Sch4_TemperatureFA_Value: accessed-variable=VeCITR_b_TBM_Sch4_TemperatureFA.Value
        FsftCITR_b_TBM_Sch4_Day
          data-send-points:
            access OUT_VeCITR_b_TBM_Sch4_Day_FA_Value: accessed-variable=VeCITR_b_TBM_Sch4_Day_FA.Value
            access OUT_VeCITR_b_TBM_Sch4_Day_SgnlRcvd_Value: accessed-variable=VeCITR_b_TBM_Sch4_Day_SgnlRcvd.Value
        FsftCITR_b_TBM_Sch4_Start_Time_Hr
          data-send-points:
            access OUT_VeCITR_b_TBM_Sch4_Start_Time_HrFA_Value: accessed-variable=VeCITR_b_TBM_Sch4_Start_Time_HrFA.Value
        FsftCITR_b_TBM_Sch4_Start_Time_Min
          data-send-points:
            access OUT_VeCITR_b_TBM_Sch4_Start_Time_MinFA_Value: accessed-variable=VeCITR_b_TBM_Sch4_Start_Time_MinFA.Value
        FsftCITR_b_V2HModeReq
          data-send-points:
            access OUT_VeCITR_b_V2HModeReqFA_Value: accessed-variable=VeCITR_b_V2HModeReqFA.Value
        FsftCITR_b_V2HReq
          data-send-points:
            access OUT_VeCITR_b_V2HReqFA_Value: accessed-variable=VeCITR_b_V2HReqFA.Value
        FsftCITR_b_V2HSubmit
          data-send-points:
            access OUT_VeCITR_b_V2HSubmitFA_Value: accessed-variable=VeCITR_b_V2HSubmitFA.Value
        FsftCITR_b_V2LModeReq
          data-send-points:
            access OUT_VeCITR_b_V2LModeReqFA_Value: accessed-variable=VeCITR_b_V2LModeReqFA.Value
        FsftCITR_b_V2LSubmit
          data-send-points:
            access OUT_VeCITR_b_V2LSubmitFA_Value: accessed-variable=VeCITR_b_V2LSubmitFA.Value
        FsftCITR_b_V2LTrunkReq
          data-send-points:
            access OUT_VeCITR_b_V2LTrunkReqFA_Value: accessed-variable=VeCITR_b_V2LTrunkReqFA.Value
        FsftCITR_b_V2L_AllReq
          data-send-points:
            access OUT_VeCITR_b_V2L_AllReqFA_Value: accessed-variable=VeCITR_b_V2L_AllReqFA.Value
        FsftCITR_b_V2L_FrunkReq
          data-send-points:
            access OUT_VeCITR_b_V2L_FrunkReqFA_Value: accessed-variable=VeCITR_b_V2L_FrunkReqFA.Value
        FsftCITR_b_V2VModeReq
          data-send-points:
            access OUT_VeCITR_b_V2VModeReqFA_Value: accessed-variable=VeCITR_b_V2VModeReqFA.Value
        FsftCITR_b_V2VReq
          data-send-points:
            access OUT_VeCITR_b_V2VReqFA_Value: accessed-variable=VeCITR_b_V2VReqFA.Value
        FsftCITR_b_V2VSubmit
          data-send-points:
            access OUT_VeCITR_b_V2VSubmitFA_Value: accessed-variable=VeCITR_b_V2VSubmitFA.Value
        FsftCITR_e_BCIM_Ind1_Fdbk
          data-send-points:
            access OUT_VeCITR_b_BCIM_Ind1_FdbkFA_Value: accessed-variable=VeCITR_b_BCIM_Ind1_FdbkFA.Value
        FsftCITR_e_BCIM_Ind2_Fdbk
          data-send-points:
            access OUT_VeCITR_b_BCIM_Ind2_FdbkFA_Value: accessed-variable=VeCITR_b_BCIM_Ind2_FdbkFA.Value
        FsftCITR_e_BCIM_Ind3_Fdbk
          data-send-points:
            access OUT_VeCITR_b_BCIM_Ind3_FdbkFA_Value: accessed-variable=VeCITR_b_BCIM_Ind3_FdbkFA.Value
        FsftCITR_e_BCIM_Ind4_Fdbk
          data-send-points:
            access OUT_VeCITR_b_BCIM_Ind4_FdbkFA_Value: accessed-variable=VeCITR_b_BCIM_Ind4_FdbkFA.Value
        FsftCITR_e_BCIM_Ind5_Fdbk
          data-send-points:
            access OUT_VeCITR_b_BCIM_Ind5_FdbkFA_Value: accessed-variable=VeCITR_b_BCIM_Ind5_FdbkFA.Value
        FsftCITR_e_BCIM_Ind_Color_Fdbk
          data-send-points:
            access OUT_VeCITR_b_BCIM_Ind_Color_FdbkFA_Value: accessed-variable=VeCITR_b_BCIM_Ind_Color_FdbkFA.Value
        FsftCITR_e_CPIM_Icon1_Sts
          data-send-points:
            access OUT_VeCITR_b_CPIM_Icon1_StsFA_Value: accessed-variable=VeCITR_b_CPIM_Icon1_StsFA.Value
        FsftCITR_e_CPIM_Icon2_Sts
          data-send-points:
            access OUT_VeCITR_b_CPIM_Icon2_StsFA_Value: accessed-variable=VeCITR_b_CPIM_Icon2_StsFA.Value
        FsftCITR_e_CPIM_Ind1_Fdbk
          data-send-points:
            access OUT_VeCITR_b_CPIM_Ind1_FdbkFA_Value: accessed-variable=VeCITR_b_CPIM_Ind1_FdbkFA.Value
        FsftCITR_e_CPIM_Ind2_Fdbk
          data-send-points:
            access OUT_VeCITR_b_CPIM_Ind2_FdbkFA_Value: accessed-variable=VeCITR_b_CPIM_Ind2_FdbkFA.Value
        FsftCITR_e_CPIM_Ind3_Fdbk
          data-send-points:
            access OUT_VeCITR_b_CPIM_Ind3_FdbkFA_Value: accessed-variable=VeCITR_b_CPIM_Ind3_FdbkFA.Value
        FsftCITR_e_CPIM_Ind4_Fdbk
          data-send-points:
            access OUT_VeCITR_b_CPIM_Ind4_FdbkFA_Value: accessed-variable=VeCITR_b_CPIM_Ind4_FdbkFA.Value
        FsftCITR_e_CPIM_Ind5_Fdbk
          data-send-points:
            access OUT_VeCITR_b_CPIM_Ind5_FdbkFA_Value: accessed-variable=VeCITR_b_CPIM_Ind5_FdbkFA.Value
        FsftCITR_e_CPIM_Ind_Color_Fdbk
          data-send-points:
            access OUT_VeCITR_b_CPIM_Ind_Color_FdbkFA_Value: accessed-variable=VeCITR_b_CPIM_Ind_Color_FdbkFA.Value
        FsftCITR_e_ChrgPortLock_FailSts
          data-send-points:
            access OUT_VeCITR_b_ChrgPortLock_FailStsFA_Value: accessed-variable=VeCITR_b_ChrgPortLock_FailStsFA.Value
        FsftCITR_e_ChrgrFlapSts
          data-send-points:
            access OUT_VeCITR_b_ChrgrFlapSts_FA_Value: accessed-variable=VeCITR_b_ChrgrFlapSts_FA.Value
        FsftCITR_e_CoopCh_ChrgCmd
          data-send-points:
            access OUT_VeCITR_b_CoopCh_ChrgCmdFA_Value: accessed-variable=VeCITR_b_CoopCh_ChrgCmdFA.Value
        FsftCITR_e_DoorLockLastElSts
          written-local-variables:
            access WV_DoorLockLastElSts_FA_Init_write_IRV: accessed-variable=DoorLockLastElSts_FA_Init_write_IRV
            access WV_DoorLockLastElSts_SgnlRcvd_Init_write_IRV: accessed-variable=DoorLockLastElSts_SgnlRcvd_Init_write_IRV
        FsftCITR_e_DoorLockLastElSts_2
          written-local-variables:
            access WV_DoorLockLastElSts_2_FA_Init_write_IRV: accessed-variable=DoorLockLastElSts_2_FA_Init_write_IRV
            access WV_DoorLockLastElSts_2_SgnlRcvd_Init_write_IRV: accessed-variable=DoorLockLastElSts_2_SgnlRcvd_Init_write_IRV
        FsftCITR_e_FOTA_Install_Type
          data-send-points:
            access OUT_VeCITR_b_FOTA_Install_Type_FA_Value: accessed-variable=VeCITR_b_FOTA_Install_Type_FA.Value
        FsftCITR_e_HU_ChrgSchedType1
          data-send-points:
            access OUT_VeCITR_b_HU_ChrgSchedType1FA_Value: accessed-variable=VeCITR_b_HU_ChrgSchedType1FA.Value
        FsftCITR_e_HU_ChrgSchedType2
          data-send-points:
            access OUT_VeCITR_b_HU_ChrgSchedType2FA_Value: accessed-variable=VeCITR_b_HU_ChrgSchedType2FA.Value
        FsftCITR_e_PP2Fault
          data-send-points:
            access OUT_VeCITR_b_PP2FaultFA_Value: accessed-variable=VeCITR_b_PP2FaultFA.Value
        FsftCITR_e_PP2FaultRsn
          data-send-points:
            access OUT_VeCITR_b_PP2FaultRsnFA_Value: accessed-variable=VeCITR_b_PP2FaultRsnFA.Value
        FsftCITR_e_PP2LEDFault
          data-send-points:
            access OUT_VeCITR_b_PP2LEDFaultFA_Value: accessed-variable=VeCITR_b_PP2LEDFaultFA.Value
        FsftCITR_e_PP2_LED_A_ColorFeedback
          data-send-points:
            access OUT_VeCITR_b_PP2_LED_A_Color_Feedback_FA_Value: accessed-variable=VeCITR_b_PP2_LED_A_Color_Feedback_FA.Value
        FsftCITR_e_PP2_LED_A_FailSts
          data-send-points:
            access OUT_VeCITR_b_PP2_LED_A_FailStatus_FA_Value: accessed-variable=VeCITR_b_PP2_LED_A_FailStatus_FA.Value
        FsftCITR_e_PP2_LED_A_Feedback
          data-send-points:
            access OUT_VeCITR_b_PP2_LED_A_Feedback_FA_Value: accessed-variable=VeCITR_b_PP2_LED_A_Feedback_FA.Value
        FsftCITR_e_PP2_LED_B_FailSts
          data-send-points:
            access OUT_VeCITR_b_PP2_LED_B_FailStatus_FA_Value: accessed-variable=VeCITR_b_PP2_LED_B_FailStatus_FA.Value
        FsftCITR_e_PP2_LED_B_Feedback
          data-send-points:
            access OUT_VeCITR_b_PP2_LED_B_Feedback_FA_Value: accessed-variable=VeCITR_b_PP2_LED_B_Feedback_FA.Value
        FsftCITR_e_PPFault
          data-send-points:
            access OUT_VeCITR_b_PPFaultFA_Value: accessed-variable=VeCITR_b_PPFaultFA.Value
        FsftCITR_e_PPFaultRsn
          data-send-points:
            access OUT_VeCITR_b_PPFaultRsnFA_Value: accessed-variable=VeCITR_b_PPFaultRsnFA.Value
        FsftCITR_e_PPLEDFault
          data-send-points:
            access OUT_VeCITR_b_PPLEDFaultFA_Value: accessed-variable=VeCITR_b_PPLEDFaultFA.Value
        FsftCITR_e_PP_LED_A_ColorFeedback
          data-send-points:
            access OUT_VeCITR_b_PP_LED_A_Color_Feedback_FA_Value: accessed-variable=VeCITR_b_PP_LED_A_Color_Feedback_FA.Value
        FsftCITR_e_PP_LED_A_FailSts
          data-send-points:
            access OUT_VeCITR_b_PP_LED_A_FailStatus_FA_Value: accessed-variable=VeCITR_b_PP_LED_A_FailStatus_FA.Value
        FsftCITR_e_PP_LED_A_Feedback
          data-send-points:
            access OUT_VeCITR_b_PP_LED_A_Feedback_FA_Value: accessed-variable=VeCITR_b_PP_LED_A_Feedback_FA.Value
        FsftCITR_e_PP_LED_B_ColorFeedback
          data-send-points:
            access OUT_VeCITR_b_PP_LED_B_Color_Feedback_FA_Value: accessed-variable=VeCITR_b_PP_LED_B_Color_Feedback_FA.Value
        FsftCITR_e_PP2_LED_B_ColorFeedback
          data-send-points:
            access OUT_VeCITR_b_PP2_LED_B_Color_Feedback_FA_Value: accessed-variable=VeCITR_b_PP2_LED_B_Color_Feedback_FA.Value
        FsftCITR_e_PP_LED_B_FailSts
          data-send-points:
            access OUT_VeCITR_b_PP_LED_B_FailStatus_FA_Value: accessed-variable=VeCITR_b_PP_LED_B_FailStatus_FA.Value
        FsftCITR_e_PP_LED_B_Feedback
          data-send-points:
            access OUT_VeCITR_b_PP_LED_B_Feedback_FA_Value: accessed-variable=VeCITR_b_PP_LED_B_Feedback_FA.Value
        FsftCITR_e_PP_LED_C_ColorFeedback
          data-send-points:
            access OUT_VeCITR_b_PP_LED_C_Color_Feedback_FA_Value: accessed-variable=VeCITR_b_PP_LED_C_Color_Feedback_FA.Value
        FsftCITR_e_PP_LED_C_FailSts
          data-send-points:
            access OUT_VeCITR_b_PP_LED_C_FailStatus_FA_Value: accessed-variable=VeCITR_b_PP_LED_C_FailStatus_FA.Value
        FsftCITR_e_PP_LED_C_Feedback
          data-send-points:
            access OUT_VeCITR_b_PP_LED_C_Feedback_FA_Value: accessed-variable=VeCITR_b_PP_LED_C_Feedback_FA.Value
        FsftCITR_e_PowerLimitReq
          written-local-variables:
            access WV_PwrLimReq_FA_Init_write_IRV: accessed-variable=PwrLimReq_FA_Init_write_IRV
            access WV_PwrLimReq_SgnlRcvd_Init_write_IRV: accessed-variable=PwrLimReq_SgnlRcvd_Init_write_IRV
        FsftCITR_e_PowerLimitReq_2
          written-local-variables:
            access WV_PwrLimReq_SgnlRcvd_2_Init_write_IRV: accessed-variable=PwrLimReq_SgnlRcvd_2_Init_write_IRV
            access WV_PwrLimReq_FA_2_Init_write_IRV: accessed-variable=PwrLimReq_FA_2_Init_write_IRV
        FsftCITR_e_RmtChrgPortLkCmd
          data-send-points:
            access OUT_VeCITR_b_RmtChrgPortLkCmdFA_Value: accessed-variable=VeCITR_b_RmtChrgPortLkCmdFA.Value
            access OUT_VeCITR_b_RmtChrgPortLkCmd_SgnlRcvd_Value: accessed-variable=VeCITR_b_RmtChrgPortLkCmd_SgnlRcvd.Value
        FsftCITR_e_TBM_ChrgSchedType1
          data-send-points:
            access OUT_VeCITR_b_TBM_ChrgSchedType1FA_Value: accessed-variable=VeCITR_b_TBM_ChrgSchedType1FA.Value
        FsftCITR_e_TBM_ChrgSchedType2
          data-send-points:
            access OUT_VeCITR_b_TBM_ChrgSchedType2FA_Value: accessed-variable=VeCITR_b_TBM_ChrgSchedType2FA.Value
        FsftCITR_l_DistanceToCharge
          data-send-points:
            access OUT_VeCITR_b_DistanceToCharge_FA_Value: accessed-variable=VeCITR_b_DistanceToCharge_FA.Value
        FsftCITR_t_TimeToCharge
          data-send-points:
            access OUT_VeCITR_b_TimeToCharge_FA_Value: accessed-variable=VeCITR_b_TimeToCharge_FA.Value
        PokeCITR_I_PP2CurrentDrawSens1
          data-send-points:
            access OUT_VeCITR_I_PP2CurrentDrawSens1_Value: accessed-variable=VeCITR_I_PP2CurrentDrawSens1.Value
            access OUT_VeCITR_b_PP2CurrentDrawSens1FA_Value: accessed-variable=VeCITR_b_PP2CurrentDrawSens1FA.Value
        PokeCITR_I_PP2CurrentDrawSens2
          data-send-points:
            access OUT_VeCITR_I_PP2CurrentDrawSens2_Value: accessed-variable=VeCITR_I_PP2CurrentDrawSens2.Value
            access OUT_VeCITR_b_PP2CurrentDrawSens2FA_Value: accessed-variable=VeCITR_b_PP2CurrentDrawSens2FA.Value
        PokeCITR_I_PPCurrentDrawSens1
          data-send-points:
            access OUT_VeCITR_I_PPCurrentDrawSens1_Value: accessed-variable=VeCITR_I_PPCurrentDrawSens1.Value
            access OUT_VeCITR_b_PPCurrentDrawSens1FA_Value: accessed-variable=VeCITR_b_PPCurrentDrawSens1FA.Value
        PokeCITR_I_PPCurrentDrawSens2
          data-send-points:
            access OUT_VeCITR_I_PPCurrentDrawSens2_Value: accessed-variable=VeCITR_I_PPCurrentDrawSens2.Value
            access OUT_VeCITR_b_PPCurrentDrawSens2FA_Value: accessed-variable=VeCITR_b_PPCurrentDrawSens2FA.Value
        PokeCITR_K_ChrgPortHbridgeFlt
          data-send-points:
            access OUT_VeCITR_d_ChrgPortHbridgeFlt_Value: accessed-variable=VeCITR_d_ChrgPortHbridgeFlt.Value
        PokeCITR_K_DateTmDay
          data-send-points:
            access OUT_VeCITR_K_DateTmDay_Value: accessed-variable=VeCITR_K_DateTmDay.Value
            access OUT_VeCITR_b_DateTmDay_FA_Value: accessed-variable=VeCITR_b_DateTmDay_FA.Value
            access OUT_VeCITR_b_DateTmDay_SgnlRcvd_Value: accessed-variable=VeCITR_b_DateTmDay_SgnlRcvd.Value
        PokeCITR_K_DateTmHour
          data-send-points:
            access OUT_VeCITR_K_DateTmHour_Value: accessed-variable=VeCITR_K_DateTmHour.Value
        PokeCITR_K_DateTmMin
          data-send-points:
            access OUT_VeCITR_K_DateTmMin_Value: accessed-variable=VeCITR_K_DateTmMin.Value
        PokeCITR_K_DateTmMon
          data-send-points:
            access OUT_VeCITR_K_DateTmMon_Value: accessed-variable=VeCITR_K_DateTmMon.Value
        PokeCITR_K_DateTmSec
          data-send-points:
            access OUT_VeCITR_K_DateTmSec_Value: accessed-variable=VeCITR_K_DateTmSec.Value
        PokeCITR_K_DateTmYear
          data-send-points:
            access OUT_VeCITR_K_DateTmYear_Value: accessed-variable=VeCITR_K_DateTmYear.Value
        PokeCITR_K_Date_Day1
          data-send-points:
            access OUT_VeCITR_K_Date_Day1_Value: accessed-variable=VeCITR_K_Date_Day1.Value
            access OUT_VeCITR_b_Date_Day1_FA_Value: accessed-variable=VeCITR_b_Date_Day1_FA.Value
            access OUT_VeCITR_b_Date_Day1_SgnlRcvd_Value: accessed-variable=VeCITR_b_Date_Day1_SgnlRcvd.Value
        PokeCITR_K_Date_Day2
          data-send-points:
            access OUT_VeCITR_K_Date_Day2_Value: accessed-variable=VeCITR_K_Date_Day2.Value
        PokeCITR_K_Date_Month1
          data-send-points:
            access OUT_VeCITR_K_Date_Month1_Value: accessed-variable=VeCITR_K_Date_Month1.Value
        PokeCITR_K_Date_Month2
          data-send-points:
            access OUT_VeCITR_K_Date_Month2_Value: accessed-variable=VeCITR_K_Date_Month2.Value
        PokeCITR_K_Date_Year1
          data-send-points:
            access OUT_VeCITR_K_Date_Year1_Value: accessed-variable=VeCITR_K_Date_Year1.Value
        PokeCITR_K_Date_Year2
          data-send-points:
            access OUT_VeCITR_K_Date_Year2_Value: accessed-variable=VeCITR_K_Date_Year2.Value
        PokeCITR_K_Date_Year3
          data-send-points:
            access OUT_VeCITR_K_Date_Year3_Value: accessed-variable=VeCITR_K_Date_Year3.Value
        PokeCITR_K_Date_Year4
          data-send-points:
            access OUT_VeCITR_K_Date_Year4_Value: accessed-variable=VeCITR_K_Date_Year4.Value
        PokeCITR_K_HU_Sch1_Day
          data-send-points:
            access OUT_VeCITR_K_HU_Sch1_Day_Value: accessed-variable=VeCITR_K_HU_Sch1_Day.Value
            access OUT_VeCITR_b_HU_Sch1_Day_FA_Value: accessed-variable=VeCITR_b_HU_Sch1_Day_FA.Value
            access OUT_VeCITR_b_HU_Sch1_Day_SgnlRcvd_Value: accessed-variable=VeCITR_b_HU_Sch1_Day_SgnlRcvd.Value
        PokeCITR_K_HU_Sch1_End_Time_Hr
          data-send-points:
            access OUT_VeCITR_K_HU_Sch1_End_Time_Hr_Value: accessed-variable=VeCITR_K_HU_Sch1_End_Time_Hr.Value
            access OUT_VeCITR_b_HU_Sch1_End_Time_HrFA_Value: accessed-variable=VeCITR_b_HU_Sch1_End_Time_HrFA.Value
        PokeCITR_K_HU_Sch1_End_Time_Min
          data-send-points:
            access OUT_VeCITR_K_HU_Sch1_End_Time_Min_Value: accessed-variable=VeCITR_K_HU_Sch1_End_Time_Min.Value
            access OUT_VeCITR_b_HU_Sch1_End_Time_MinFA_Value: accessed-variable=VeCITR_b_HU_Sch1_End_Time_MinFA.Value
        PokeCITR_K_HU_Sch1_Start_Time_Hr
          data-send-points:
            access OUT_VeCITR_K_HU_Sch1_Start_Time_Hr_Value: accessed-variable=VeCITR_K_HU_Sch1_Start_Time_Hr.Value
            access OUT_VeCITR_b_HU_Sch1_Start_Time_HrFA_Value: accessed-variable=VeCITR_b_HU_Sch1_Start_Time_HrFA.Value
        PokeCITR_K_HU_Sch1_Start_Time_Min
          data-send-points:
            access OUT_VeCITR_K_HU_Sch1_Start_Time_Min_Value: accessed-variable=VeCITR_K_HU_Sch1_Start_Time_Min.Value
            access OUT_VeCITR_b_HU_Sch1_Start_Time_MinFA_Value: accessed-variable=VeCITR_b_HU_Sch1_Start_Time_MinFA.Value
        PokeCITR_K_HU_Sch2_Day
          data-send-points:
            access OUT_VeCITR_K_HU_Sch2_Day_Value: accessed-variable=VeCITR_K_HU_Sch2_Day.Value
            access OUT_VeCITR_b_HU_Sch2_Day_FA_Value: accessed-variable=VeCITR_b_HU_Sch2_Day_FA.Value
            access OUT_VeCITR_b_HU_Sch2_Day_SgnlRcvd_Value: accessed-variable=VeCITR_b_HU_Sch2_Day_SgnlRcvd.Value
        PokeCITR_K_HU_Sch2_End_Time_Hr
          data-send-points:
            access OUT_VeCITR_K_HU_Sch2_End_Time_Hr_Value: accessed-variable=VeCITR_K_HU_Sch2_End_Time_Hr.Value
            access OUT_VeCITR_b_HU_Sch2_End_Time_HrFA_Value: accessed-variable=VeCITR_b_HU_Sch2_End_Time_HrFA.Value
        PokeCITR_K_HU_Sch2_End_Time_Min
          data-send-points:
            access OUT_VeCITR_K_HU_Sch2_End_Time_Min_Value: accessed-variable=VeCITR_K_HU_Sch2_End_Time_Min.Value
            access OUT_VeCITR_b_HU_Sch2_End_Time_MinFA_Value: accessed-variable=VeCITR_b_HU_Sch2_End_Time_MinFA.Value
        PokeCITR_K_HU_Sch2_Start_Time_Hr
          data-send-points:
            access OUT_VeCITR_K_HU_Sch2_Start_Time_Hr_Value: accessed-variable=VeCITR_K_HU_Sch2_Start_Time_Hr.Value
            access OUT_VeCITR_b_HU_Sch2_Start_Time_HrFA_Value: accessed-variable=VeCITR_b_HU_Sch2_Start_Time_HrFA.Value
        PokeCITR_K_HU_Sch2_Start_Time_Min
          data-send-points:
            access OUT_VeCITR_K_HU_Sch2_Start_Time_Min_Value: accessed-variable=VeCITR_K_HU_Sch2_Start_Time_Min.Value
            access OUT_VeCITR_b_HU_Sch2_Start_Time_MinFA_Value: accessed-variable=VeCITR_b_HU_Sch2_Start_Time_MinFA.Value
        PokeCITR_K_HU_Sch3_Day
          data-send-points:
            access OUT_VeCITR_K_HU_Sch3_Day_Value: accessed-variable=VeCITR_K_HU_Sch3_Day.Value
            access OUT_VeCITR_b_HU_Sch3_Day_FA_Value: accessed-variable=VeCITR_b_HU_Sch3_Day_FA.Value
            access OUT_VeCITR_b_HU_Sch3_Day_SgnlRcvd_Value: accessed-variable=VeCITR_b_HU_Sch3_Day_SgnlRcvd.Value
        PokeCITR_K_HU_Sch3_End_Time_Hr
          data-send-points:
            access OUT_VeCITR_K_HU_Sch3_End_Time_Hr_Value: accessed-variable=VeCITR_K_HU_Sch3_End_Time_Hr.Value
            access OUT_VeCITR_b_HU_Sch3_End_Time_HrFA_Value: accessed-variable=VeCITR_b_HU_Sch3_End_Time_HrFA.Value
        PokeCITR_K_HU_Sch3_End_Time_Min
          data-send-points:
            access OUT_VeCITR_K_HU_Sch3_End_Time_Min_Value: accessed-variable=VeCITR_K_HU_Sch3_End_Time_Min.Value
            access OUT_VeCITR_b_HU_Sch3_End_Time_MinFA_Value: accessed-variable=VeCITR_b_HU_Sch3_End_Time_MinFA.Value
        PokeCITR_K_HU_Sch3_Start_Time_Hr
          data-send-points:
            access OUT_VeCITR_K_HU_Sch3_Start_Time_Hr_Value: accessed-variable=VeCITR_K_HU_Sch3_Start_Time_Hr.Value
            access OUT_VeCITR_b_HU_Sch3_Start_Time_HrFA_Value: accessed-variable=VeCITR_b_HU_Sch3_Start_Time_HrFA.Value
        PokeCITR_K_HU_Sch3_Start_Time_Min
          data-send-points:
            access OUT_VeCITR_K_HU_Sch3_Start_Time_Min_Value: accessed-variable=VeCITR_K_HU_Sch3_Start_Time_Min.Value
            access OUT_VeCITR_b_HU_Sch3_Start_Time_MinFA_Value: accessed-variable=VeCITR_b_HU_Sch3_Start_Time_MinFA.Value
        PokeCITR_K_HU_Sch4_Day
          data-send-points:
            access OUT_VeCITR_K_HU_Sch4_Day_Value: accessed-variable=VeCITR_K_HU_Sch4_Day.Value
            access OUT_VeCITR_b_HU_Sch4_Day_FA_Value: accessed-variable=VeCITR_b_HU_Sch4_Day_FA.Value
            access OUT_VeCITR_b_HU_Sch4_Day_SgnlRcvd_Value: accessed-variable=VeCITR_b_HU_Sch4_Day_SgnlRcvd.Value
        PokeCITR_K_HU_Sch4_Start_Time_Hr
          data-send-points:
            access OUT_VeCITR_K_HU_Sch4_Start_Time_Hr_Value: accessed-variable=VeCITR_K_HU_Sch4_Start_Time_Hr.Value
            access OUT_VeCITR_b_HU_Sch4_Start_Time_HrFA_Value: accessed-variable=VeCITR_b_HU_Sch4_Start_Time_HrFA.Value
        PokeCITR_K_HU_Sch4_Start_Time_Min
          data-send-points:
            access OUT_VeCITR_K_HU_Sch4_Start_Time_Min_Value: accessed-variable=VeCITR_K_HU_Sch4_Start_Time_Min.Value
            access OUT_VeCITR_b_HU_Sch4_Start_Time_MinFA_Value: accessed-variable=VeCITR_b_HU_Sch4_Start_Time_MinFA.Value
        PokeCITR_K_TBM_Sch1_Day
          data-send-points:
            access OUT_VeCITR_K_TBM_Sch1_Day_Value: accessed-variable=VeCITR_K_TBM_Sch1_Day.Value
            access OUT_VeCITR_b_TBM_Sch1_Day_FA_Value: accessed-variable=VeCITR_b_TBM_Sch1_Day_FA.Value
            access OUT_VeCITR_b_TBM_Sch1_Day_SgnlRcvd_Value: accessed-variable=VeCITR_b_TBM_Sch1_Day_SgnlRcvd.Value
        PokeCITR_K_TBM_Sch1_End_Time_Hr
          data-send-points:
            access OUT_VeCITR_K_TBM_Sch1_End_Time_Hr_Value: accessed-variable=VeCITR_K_TBM_Sch1_End_Time_Hr.Value
            access OUT_VeCITR_b_TBM_Sch1_End_Time_HrFA_Value: accessed-variable=VeCITR_b_TBM_Sch1_End_Time_HrFA.Value
        PokeCITR_K_TBM_Sch1_End_Time_Min
          data-send-points:
            access OUT_VeCITR_K_TBM_Sch1_End_Time_Min_Value: accessed-variable=VeCITR_K_TBM_Sch1_End_Time_Min.Value
            access OUT_VeCITR_b_TBM_Sch1_End_Time_MinFA_Value: accessed-variable=VeCITR_b_TBM_Sch1_End_Time_MinFA.Value
        PokeCITR_K_TBM_Sch1_Start_Time_Hr
          data-send-points:
            access OUT_VeCITR_K_TBM_Sch1_Start_Time_Hr_Value: accessed-variable=VeCITR_K_TBM_Sch1_Start_Time_Hr.Value
            access OUT_VeCITR_b_TBM_Sch1_Start_Time_HrFA_Value: accessed-variable=VeCITR_b_TBM_Sch1_Start_Time_HrFA.Value
        PokeCITR_K_TBM_Sch1_Start_Time_Min
          data-send-points:
            access OUT_VeCITR_K_TBM_Sch1_Start_Time_Min_Value: accessed-variable=VeCITR_K_TBM_Sch1_Start_Time_Min.Value
            access OUT_VeCITR_b_TBM_Sch1_Start_Time_MinFA_Value: accessed-variable=VeCITR_b_TBM_Sch1_Start_Time_MinFA.Value
        PokeCITR_K_TBM_Sch2_Day
          data-send-points:
            access OUT_VeCITR_K_TBM_Sch2_Day_Value: accessed-variable=VeCITR_K_TBM_Sch2_Day.Value
            access OUT_VeCITR_b_TBM_Sch2_Day_FA_Value: accessed-variable=VeCITR_b_TBM_Sch2_Day_FA.Value
            access OUT_VeCITR_b_TBM_Sch2_Day_SgnlRcvd_Value: accessed-variable=VeCITR_b_TBM_Sch2_Day_SgnlRcvd.Value
        PokeCITR_K_TBM_Sch2_End_Time_Hr
          data-send-points:
            access OUT_VeCITR_K_TBM_Sch2_End_Time_Hr_Value: accessed-variable=VeCITR_K_TBM_Sch2_End_Time_Hr.Value
            access OUT_VeCITR_b_TBM_Sch2_End_Time_HrFA_Value: accessed-variable=VeCITR_b_TBM_Sch2_End_Time_HrFA.Value
        PokeCITR_K_TBM_Sch2_End_Time_Min
          data-send-points:
            access OUT_VeCITR_K_TBM_Sch2_End_Time_Min_Value: accessed-variable=VeCITR_K_TBM_Sch2_End_Time_Min.Value
            access OUT_VeCITR_b_TBM_Sch2_End_Time_MinFA_Value: accessed-variable=VeCITR_b_TBM_Sch2_End_Time_MinFA.Value
        PokeCITR_K_TBM_Sch2_Start_Time_Hr
          data-send-points:
            access OUT_VeCITR_K_TBM_Sch2_Start_Time_Hr_Value: accessed-variable=VeCITR_K_TBM_Sch2_Start_Time_Hr.Value
            access OUT_VeCITR_b_TBM_Sch2_Start_Time_HrFA_Value: accessed-variable=VeCITR_b_TBM_Sch2_Start_Time_HrFA.Value
        PokeCITR_K_TBM_Sch2_Start_Time_Min
          data-send-points:
            access OUT_VeCITR_K_TBM_Sch2_Start_Time_Min_Value: accessed-variable=VeCITR_K_TBM_Sch2_Start_Time_Min.Value
            access OUT_VeCITR_b_TBM_Sch2_Start_Time_MinFA_Value: accessed-variable=VeCITR_b_TBM_Sch2_Start_Time_MinFA.Value
        PokeCITR_K_TBM_Sch3_Day
          data-send-points:
            access OUT_VeCITR_K_TBM_Sch3_Day_Value: accessed-variable=VeCITR_K_TBM_Sch3_Day.Value
            access OUT_VeCITR_b_TBM_Sch3_Day_FA_Value: accessed-variable=VeCITR_b_TBM_Sch3_Day_FA.Value
            access OUT_VeCITR_b_TBM_Sch3_Day_SgnlRcvd_Value: accessed-variable=VeCITR_b_TBM_Sch3_Day_SgnlRcvd.Value
        PokeCITR_K_TBM_Sch3_End_Time_Hr
          data-send-points:
            access OUT_VeCITR_K_TBM_Sch3_End_Time_Hr_Value: accessed-variable=VeCITR_K_TBM_Sch3_End_Time_Hr.Value
            access OUT_VeCITR_b_TBM_Sch3_End_Time_HrFA_Value: accessed-variable=VeCITR_b_TBM_Sch3_End_Time_HrFA.Value
        PokeCITR_K_TBM_Sch3_End_Time_Min
          data-send-points:
            access OUT_VeCITR_K_TBM_Sch3_End_Time_Min_Value: accessed-variable=VeCITR_K_TBM_Sch3_End_Time_Min.Value
            access OUT_VeCITR_b_TBM_Sch3_End_Time_MinFA_Value: accessed-variable=VeCITR_b_TBM_Sch3_End_Time_MinFA.Value
        PokeCITR_K_TBM_Sch3_Start_Time_Hr
          data-send-points:
            access OUT_VeCITR_K_TBM_Sch3_Start_Time_Hr_Value: accessed-variable=VeCITR_K_TBM_Sch3_Start_Time_Hr.Value
            access OUT_VeCITR_b_TBM_Sch3_Start_Time_HrFA_Value: accessed-variable=VeCITR_b_TBM_Sch3_Start_Time_HrFA.Value
        PokeCITR_K_TBM_Sch3_Start_Time_Min
          data-send-points:
            access OUT_VeCITR_K_TBM_Sch3_Start_Time_Min_Value: accessed-variable=VeCITR_K_TBM_Sch3_Start_Time_Min.Value
            access OUT_VeCITR_b_TBM_Sch3_Start_Time_MinFA_Value: accessed-variable=VeCITR_b_TBM_Sch3_Start_Time_MinFA.Value
        PokeCITR_K_TBM_Sch4_Day
          data-send-points:
            access OUT_VeCITR_K_TBM_Sch4_Day_Value: accessed-variable=VeCITR_K_TBM_Sch4_Day.Value
            access OUT_VeCITR_b_TBM_Sch4_Day_FA_Value: accessed-variable=VeCITR_b_TBM_Sch4_Day_FA.Value
            access OUT_VeCITR_b_TBM_Sch4_Day_SgnlRcvd_Value: accessed-variable=VeCITR_b_TBM_Sch4_Day_SgnlRcvd.Value
        PokeCITR_K_TBM_Sch4_Start_Time_Hr
          data-send-points:
            access OUT_VeCITR_K_TBM_Sch4_Start_Time_Hr_Value: accessed-variable=VeCITR_K_TBM_Sch4_Start_Time_Hr.Value
            access OUT_VeCITR_b_TBM_Sch4_Start_Time_HrFA_Value: accessed-variable=VeCITR_b_TBM_Sch4_Start_Time_HrFA.Value
        PokeCITR_K_TBM_Sch4_Start_Time_Min
          data-send-points:
            access OUT_VeCITR_K_TBM_Sch4_Start_Time_Min_Value: accessed-variable=VeCITR_K_TBM_Sch4_Start_Time_Min.Value
            access OUT_VeCITR_b_TBM_Sch4_Start_Time_MinFA_Value: accessed-variable=VeCITR_b_TBM_Sch4_Start_Time_MinFA.Value
        PokeCITR_K_Time_Hour1
          data-send-points:
            access OUT_VeCITR_K_Time_Hour1_Value: accessed-variable=VeCITR_K_Time_Hour1.Value
        PokeCITR_K_Time_Hour2
          data-send-points:
            access OUT_VeCITR_K_Time_Hour2_Value: accessed-variable=VeCITR_K_Time_Hour2.Value
        PokeCITR_K_Time_Minute1
          data-send-points:
            access OUT_VeCITR_K_Time_Minute1_Value: accessed-variable=VeCITR_K_Time_Minute1.Value
        PokeCITR_K_Time_Minute2
          data-send-points:
            access OUT_VeCITR_K_Time_Minute2_Value: accessed-variable=VeCITR_K_Time_Minute2.Value
        PokeCITR_P_ChargingDestinationPwr
          data-send-points:
            access OUT_VeCITR_P_ChargingDestinationPwr_Value: accessed-variable=VeCITR_P_ChargingDestinationPwr.Value
            access OUT_VeCITR_b_ChargingDestinationPwr_FA_Value: accessed-variable=VeCITR_b_ChargingDestinationPwr_FA.Value
        PokeCITR_P_PP2RatedPower
          data-send-points:
            access OUT_VeCITR_P_PP2RatedPower_Value: accessed-variable=VeCITR_P_PP2RatedPower.Value
            access OUT_VeCITR_b_PP2RatedPowerFA_Value: accessed-variable=VeCITR_b_PP2RatedPowerFA.Value
        PokeCITR_P_PPRatedPower
          data-send-points:
            access OUT_VeCITR_P_PPRatedPower_Value: accessed-variable=VeCITR_P_PPRatedPower.Value
            access OUT_VeCITR_b_PPRatedPowerFA_Value: accessed-variable=VeCITR_b_PPRatedPowerFA.Value
        PokeCITR_Pct_HU_ExtChrgTarget1
          data-send-points:
            access OUT_VeCITR_Pct_HU_ExtChrgTarget1_Value: accessed-variable=VeCITR_Pct_HU_ExtChrgTarget1.Value
            access OUT_VeCITR_b_HU_ExtChrgTarget1FA_Value: accessed-variable=VeCITR_b_HU_ExtChrgTarget1FA.Value
        PokeCITR_Pct_HU_ExtChrgTarget2
          data-send-points:
            access OUT_VeCITR_Pct_HU_ExtChrgTarget2_Value: accessed-variable=VeCITR_Pct_HU_ExtChrgTarget2.Value
            access OUT_VeCITR_b_HU_ExtChrgTarget2FA_Value: accessed-variable=VeCITR_b_HU_ExtChrgTarget2FA.Value
        PokeCITR_Pct_HU_ImmChrgTarget1
          data-send-points:
            access OUT_VeCITR_Pct_HU_ImmChrgTarget1_Value: accessed-variable=VeCITR_Pct_HU_ImmChrgTarget1.Value
            access OUT_VeCITR_b_HU_ImmChrgTarget1FA_Value: accessed-variable=VeCITR_b_HU_ImmChrgTarget1FA.Value
        PokeCITR_Pct_HU_ImmChrgTarget2
          data-send-points:
            access OUT_VeCITR_Pct_HU_ImmChrgTarget2_Value: accessed-variable=VeCITR_Pct_HU_ImmChrgTarget2.Value
            access OUT_VeCITR_b_HU_ImmChrgTarget2FA_Value: accessed-variable=VeCITR_b_HU_ImmChrgTarget2FA.Value
        PokeCITR_Pct_TBM_ExtChrgTarget1
          data-send-points:
            access OUT_VeCITR_Pct_TBM_ExtChrgTarget1_Value: accessed-variable=VeCITR_Pct_TBM_ExtChrgTarget1.Value
            access OUT_VeCITR_b_TBM_ExtChrgTarget1FA_Value: accessed-variable=VeCITR_b_TBM_ExtChrgTarget1FA.Value
        PokeCITR_Pct_TBM_ExtChrgTarget2
          data-send-points:
            access OUT_VeCITR_Pct_TBM_ExtChrgTarget2_Value: accessed-variable=VeCITR_Pct_TBM_ExtChrgTarget2.Value
            access OUT_VeCITR_b_TBM_ExtChrgTarget2FA_Value: accessed-variable=VeCITR_b_TBM_ExtChrgTarget2FA.Value
        PokeCITR_Pct_TBM_ImmChrgTarget1
          data-send-points:
            access OUT_VeCITR_Pct_TBM_ImmChrgTarget1_Value: accessed-variable=VeCITR_Pct_TBM_ImmChrgTarget1.Value
            access OUT_VeCITR_b_TBM_ImmChrgTarget1FA_Value: accessed-variable=VeCITR_b_TBM_ImmChrgTarget1FA.Value
        PokeCITR_Pct_TBM_ImmChrgTarget2
          data-send-points:
            access OUT_VeCITR_Pct_TBM_ImmChrgTarget2_Value: accessed-variable=VeCITR_Pct_TBM_ImmChrgTarget2.Value
            access OUT_VeCITR_b_TBM_ImmChrgTarget2FA_Value: accessed-variable=VeCITR_b_TBM_ImmChrgTarget2FA.Value
        PokeCITR_Pct_V2HRsrvBatt
          data-send-points:
            access OUT_VeCITR_Pct_V2HRsrvBatt_Value: accessed-variable=VeCITR_Pct_V2HRsrvBatt.Value
            access OUT_VeCITR_b_V2HRsrvBattFA_Value: accessed-variable=VeCITR_b_V2HRsrvBattFA.Value
        PokeCITR_Pct_V2LRsrvBatt
          data-send-points:
            access OUT_VeCITR_Pct_V2LRsrvBatt_Value: accessed-variable=VeCITR_Pct_V2LRsrvBatt.Value
            access OUT_VeCITR_b_V2LRsrvBattFA_Value: accessed-variable=VeCITR_b_V2LRsrvBattFA.Value
        PokeCITR_Pct_V2VRsrvBatt
          data-send-points:
            access OUT_VeCITR_Pct_V2VRsrvBatt_Value: accessed-variable=VeCITR_Pct_V2VRsrvBatt.Value
            access OUT_VeCITR_b_V2VRsrvBattFA_Value: accessed-variable=VeCITR_b_V2VRsrvBattFA.Value
        PokeCITR_T_HU_Sch1_CabTemp
          data-send-points:
            access OUT_VeCITR_T_HU_Sch1_Temperature_Value: accessed-variable=VeCITR_T_HU_Sch1_Temperature.Value
            access OUT_VeCITR_b_HU_Sch1_TemperatureFA_Value: accessed-variable=VeCITR_b_HU_Sch1_TemperatureFA.Value
        PokeCITR_T_HU_Sch2_CabTemp
          data-send-points:
            access OUT_VeCITR_T_HU_Sch2_Temperature_Value: accessed-variable=VeCITR_T_HU_Sch2_Temperature.Value
            access OUT_VeCITR_b_HU_Sch2_TemperatureFA_Value: accessed-variable=VeCITR_b_HU_Sch2_TemperatureFA.Value
        PokeCITR_T_HU_Sch3_CabTemp
          data-send-points:
            access OUT_VeCITR_T_HU_Sch3_Temperature_Value: accessed-variable=VeCITR_T_HU_Sch3_Temperature.Value
            access OUT_VeCITR_b_HU_Sch3_TemperatureFA_Value: accessed-variable=VeCITR_b_HU_Sch3_TemperatureFA.Value
        PokeCITR_T_HU_Sch4_CabTemp
          data-send-points:
            access OUT_VeCITR_T_HU_Sch4_Temperature_Value: accessed-variable=VeCITR_T_HU_Sch4_Temperature.Value
            access OUT_VeCITR_b_HU_Sch4_TemperatureFA_Value: accessed-variable=VeCITR_b_HU_Sch4_TemperatureFA.Value
        PokeCITR_T_TBM_Sch1_CabTemp
          data-send-points:
            access OUT_VeCITR_T_TBM_Sch1_Temperature_Value: accessed-variable=VeCITR_T_TBM_Sch1_Temperature.Value
            access OUT_VeCITR_b_TBM_Sch1_TemperatureFA_Value: accessed-variable=VeCITR_b_TBM_Sch1_TemperatureFA.Value
        PokeCITR_T_TBM_Sch2_CabTemp
          data-send-points:
            access OUT_VeCITR_T_TBM_Sch2_Temperature_Value: accessed-variable=VeCITR_T_TBM_Sch2_Temperature.Value
            access OUT_VeCITR_b_TBM_Sch2_TemperatureFA_Value: accessed-variable=VeCITR_b_TBM_Sch2_TemperatureFA.Value
        PokeCITR_T_TBM_Sch3_CabTemp
          data-send-points:
            access OUT_VeCITR_T_TBM_Sch3_Temperature_Value: accessed-variable=VeCITR_T_TBM_Sch3_Temperature.Value
            access OUT_VeCITR_b_TBM_Sch3_TemperatureFA_Value: accessed-variable=VeCITR_b_TBM_Sch3_TemperatureFA.Value
        PokeCITR_T_TBM_Sch4_CabTemp
          data-send-points:
            access OUT_VeCITR_T_TBM_Sch4_Temperature_Value: accessed-variable=VeCITR_T_TBM_Sch4_Temperature.Value
            access OUT_VeCITR_b_TBM_Sch4_TemperatureFA_Value: accessed-variable=VeCITR_b_TBM_Sch4_TemperatureFA.Value
        PokeCITR_U_ChrgPortLock_StsB
          data-send-points:
            access OUT_VeCITR_U_ChrgPortLock_StsB_Value: accessed-variable=VeCITR_U_ChrgPortLock_StsB.Value
            access OUT_VeCITR_b_ChrgPortLock_StsB_FA_Value: accessed-variable=VeCITR_b_ChrgPortLock_StsB_FA.Value
          written-local-variables:
            access WV_ChrgPortLock_StsB_Init_write_IRV: accessed-variable=ChrgPortLock_StsB_Init_write_IRV
            access WV_ChrgPortLock_StsB_FA_Init_write_IRV: accessed-variable=ChrgPortLock_StsB_FA_Init_write_IRV
        PokeCITR_b_BCIM_LIN_Chksum_Error
          data-send-points:
            access OUT_VeCITR_b_BCIM_LINChkSumErr_Value: accessed-variable=VeCITR_b_BCIM_LINChkSumErr.Value
        PokeCITR_b_BCIM_LIN_Data_Error
          data-send-points:
            access OUT_VeCITR_b_BCIM_LINDataErr_Value: accessed-variable=VeCITR_b_BCIM_LINDataErr.Value
        PokeCITR_b_BCIM_LIN_Parity_Error
          data-send-points:
            access OUT_VeCITR_b_BCIM_LINParityErr_Value: accessed-variable=VeCITR_b_BCIM_LINParityErr.Value
        PokeCITR_b_BCIM_Over_Temp
          data-send-points:
            access OUT_VeCITR_b_BCIM_OverTemp_Value: accessed-variable=VeCITR_b_BCIM_OverTemp.Value
        PokeCITR_b_BCIM_Undervolt
          data-send-points:
            access OUT_VeCITR_b_BCIM_UnderVolt_Value: accessed-variable=VeCITR_b_BCIM_UnderVolt.Value
        PokeCITR_b_CPIM_BlueLED_Sts
          data-send-points:
            access OUT_VeCITR_b_CPIM_BlueLED_Sts_Value: accessed-variable=VeCITR_b_CPIM_BlueLED_Sts.Value
        PokeCITR_b_CPIM_GreenLED_Sts
          data-send-points:
            access OUT_VeCITR_b_CPIM_GreenLED_Sts_Value: accessed-variable=VeCITR_b_CPIM_GreenLED_Sts.Value
        PokeCITR_b_CPIM_LINChkSumErr
          data-send-points:
            access OUT_VeCITR_b_CPIM_LINChkSumErr_Value: accessed-variable=VeCITR_b_CPIM_LINChkSumErr.Value
        PokeCITR_b_CPIM_LINDataErr
          data-send-points:
            access OUT_VeCITR_b_CPIM_LINDataErr_Value: accessed-variable=VeCITR_b_CPIM_LINDataErr.Value
        PokeCITR_b_CPIM_LINParityErr
          data-send-points:
            access OUT_VeCITR_b_CPIM_LINParityErr_Value: accessed-variable=VeCITR_b_CPIM_LINParityErr.Value
        PokeCITR_b_CPIM_OverTemp
          data-send-points:
            access OUT_VeCITR_b_CPIM_OverTemp_Value: accessed-variable=VeCITR_b_CPIM_OverTemp.Value
        PokeCITR_b_CPIM_RedLED_Sts
          data-send-points:
            access OUT_VeCITR_b_CPIM_RedLED_Sts_Value: accessed-variable=VeCITR_b_CPIM_RedLED_Sts.Value
        PokeCITR_b_CPIM_UnderVolt
          data-send-points:
            access OUT_VeCITR_b_CPIM_UnderVolt_Value: accessed-variable=VeCITR_b_CPIM_UnderVolt.Value
        PokeCITR_b_ChargeNow
          data-send-points:
            access OUT_VeCITR_b_ChargeNow_Value: accessed-variable=VeCITR_b_ChargeNow.Value
        PokeCITR_b_ChrgPortButton_FailSts
          data-send-points:
            access OUT_VeCITR_b_ChrgPortButton_FailSts_Value: accessed-variable=VeCITR_b_ChrgPortButton_FailSts.Value
        PokeCITR_b_ChrgPortButton_Sts
          data-send-points:
            access OUT_VeCITR_b_ChrgPortButton_Sts_Value: accessed-variable=VeCITR_b_ChrgPortButton_Sts.Value
        PokeCITR_b_ChrgPortLock_StsC
          data-send-points:
            access OUT_VeCITR_b_ChrgPortLock_StsC_Value: accessed-variable=VeCITR_b_ChrgPortLock_StsC.Value
            access OUT_VeCITR_b_ChrgPortLock_StsC_FA_Value: accessed-variable=VeCITR_b_ChrgPortLock_StsC_FA.Value
          written-local-variables:
            access WV_ChrgPortLock_StsC_FA_Init_write_IRV: accessed-variable=ChrgPortLock_StsC_FA_Init_write_IRV
            access WV_ChrgPortLock_StsC_Init_write_IRV: accessed-variable=ChrgPortLock_StsC_Init_write_IRV
        PokeCITR_b_ChrgPort_BCM_Cmd
          data-send-points:
            access OUT_VeCITR_b_ChrgPort_BCM_Cmd_Out_Value: accessed-variable=VeCITR_b_ChrgPort_BCM_Cmd_Out.Value
            access OUT_VeCITR_b_ChrgPort_BCM_Cmd_Rcvd_Value: accessed-variable=VeCITR_b_ChrgPort_BCM_Cmd_Rcvd.Value
          written-local-variables:
            access WV_ChrgPort_BCM_Cmd_SgnlRcvd_Init_write_IRV: accessed-variable=ChrgPort_BCM_Cmd_SgnlRcvd_Init_write_IRV
            access WV_ChrgPort_BCM_Cmd_Init_write_IRV: accessed-variable=ChrgPort_BCM_Cmd_Init_write_IRV
        PokeCITR_b_ChrgPort_Fdbk
          written-local-variables:
            access WV_ChrgPort_Sense_Init_write_IRV: accessed-variable=ChrgPort_Sense_Init_write_IRV
        PokeCITR_b_CoopCh_VehLocation
          data-send-points:
            access OUT_VeCITR_b_CoopCh_VehLocation_Value: accessed-variable=VeCITR_b_CoopCh_VehLocation.Value
            access OUT_VeCITR_b_CoopCh_VehLocationFA_Value: accessed-variable=VeCITR_b_CoopCh_VehLocationFA.Value
        PokeCITR_b_DC_PwrLev
          data-send-points:
            access OUT_VeCITR_b_DC_PwrLev_Value: accessed-variable=VeCITR_b_DC_PwrLev.Value
            access OUT_VeCITR_b_DC_PwrLev_FA_Value: accessed-variable=VeCITR_b_DC_PwrLev_FA.Value
            access OUT_VeCITR_b_DC_PwrLev_SgnlRcvd_Value: accessed-variable=VeCITR_b_DC_PwrLev_SgnlRcvd.Value
        PokeCITR_b_Drv_Dr_Unlocking
          data-send-points:
            access OUT_VeCITR_b_Drv_Dr_Unlocking_Value: accessed-variable=VeCITR_b_Drv_Dr_Unlocking.Value
        PokeCITR_b_HU_Sch1_ChargeUntilFull
          data-send-points:
            access OUT_VeCITR_b_HU_Sch1_ChargeUntilFull_Value: accessed-variable=VeCITR_b_HU_Sch1_ChargeUntilFull.Value
        PokeCITR_b_HU_Sch1_Do_Not_Repeat
          data-send-points:
            access OUT_VeCITR_b_HU_Sch1_Do_Not_Repeat_Value: accessed-variable=VeCITR_b_HU_Sch1_Do_Not_Repeat.Value
        PokeCITR_b_HU_Sch1_Enbl
          data-send-points:
            access OUT_VeCITR_b_HU_Sch1_Enbl_Value: accessed-variable=VeCITR_b_HU_Sch1_Enbl.Value
        PokeCITR_b_HU_Sch1_Priority
          data-send-points:
            access OUT_VeCITR_b_HU_Sch1_Priority_Value: accessed-variable=VeCITR_b_HU_Sch1_Priority.Value
        PokeCITR_b_HU_Sch1_Submit
          data-send-points:
            access OUT_VeCITR_b_HU_Sch1_Submit_Value: accessed-variable=VeCITR_b_HU_Sch1_Submit.Value
        PokeCITR_b_HU_Sch2_ChargeUntilFull
          data-send-points:
            access OUT_VeCITR_b_HU_Sch2_ChargeUntilFull_Value: accessed-variable=VeCITR_b_HU_Sch2_ChargeUntilFull.Value
        PokeCITR_b_HU_Sch2_Do_Not_Repeat
          data-send-points:
            access OUT_VeCITR_b_HU_Sch2_Do_Not_Repeat_Value: accessed-variable=VeCITR_b_HU_Sch2_Do_Not_Repeat.Value
        PokeCITR_b_HU_Sch2_Enbl
          data-send-points:
            access OUT_VeCITR_b_HU_Sch2_Enbl_Value: accessed-variable=VeCITR_b_HU_Sch2_Enbl.Value
        PokeCITR_b_HU_Sch2_Priority
          data-send-points:
            access OUT_VeCITR_b_HU_Sch2_Priority_Value: accessed-variable=VeCITR_b_HU_Sch2_Priority.Value
        PokeCITR_b_HU_Sch2_Submit
          data-send-points:
            access OUT_VeCITR_b_HU_Sch2_Submit_Value: accessed-variable=VeCITR_b_HU_Sch2_Submit.Value
        PokeCITR_b_HU_Sch3_ChargeUntilFull
          data-send-points:
            access OUT_VeCITR_b_HU_Sch3_ChargeUntilFull_Value: accessed-variable=VeCITR_b_HU_Sch3_ChargeUntilFull.Value
        PokeCITR_b_HU_Sch3_Do_Not_Repeat
          data-send-points:
            access OUT_VeCITR_b_HU_Sch3_Do_Not_Repeat_Value: accessed-variable=VeCITR_b_HU_Sch3_Do_Not_Repeat.Value
        PokeCITR_b_HU_Sch3_Enbl
          data-send-points:
            access OUT_VeCITR_b_HU_Sch3_Enbl_Value: accessed-variable=VeCITR_b_HU_Sch3_Enbl.Value
        PokeCITR_b_HU_Sch3_Priority
          data-send-points:
            access OUT_VeCITR_b_HU_Sch3_Priority_Value: accessed-variable=VeCITR_b_HU_Sch3_Priority.Value
        PokeCITR_b_HU_Sch3_Submit
          data-send-points:
            access OUT_VeCITR_b_HU_Sch3_Submit_Value: accessed-variable=VeCITR_b_HU_Sch3_Submit.Value
        PokeCITR_b_HU_Sch4_Enbl
          data-send-points:
            access OUT_VeCITR_b_HU_Sch4_Enbl_Value: accessed-variable=VeCITR_b_HU_Sch4_Enbl.Value
        PokeCITR_b_HU_Sch4_Submit
          data-send-points:
            access OUT_VeCITR_b_HU_Sch4_Submit_Value: accessed-variable=VeCITR_b_HU_Sch4_Submit.Value
        PokeCITR_b_Icon1_FailSts
          data-send-points:
            access OUT_VeCITR_b_CPIM_Icon1_FailSts_Value: accessed-variable=VeCITR_b_CPIM_Icon1_FailSts.Value
        PokeCITR_b_Icon2_FailSts
          data-send-points:
            access OUT_VeCITR_b_CPIM_Icon2_FailSts_Value: accessed-variable=VeCITR_b_CPIM_Icon2_FailSts.Value
        PokeCITR_b_PP2ACPresentSens1
          data-send-points:
            access OUT_VeCITR_b_PP2ACPresentSens1_Value: accessed-variable=VeCITR_b_PP2ACPresentSens1.Value
            access OUT_VeCITR_b_PP2ACPresentSens1FA_Value: accessed-variable=VeCITR_b_PP2ACPresentSens1FA.Value
        PokeCITR_b_PP2ACPresentSens2
          data-send-points:
            access OUT_VeCITR_b_PP2ACPresentSens2_Value: accessed-variable=VeCITR_b_PP2ACPresentSens2.Value
            access OUT_VeCITR_b_PP2ACPresentSens2FA_Value: accessed-variable=VeCITR_b_PP2ACPresentSens2FA.Value
        PokeCITR_b_PP2ButtonSts
          data-send-points:
            access OUT_VeCITR_b_PP2ButtonSts_Value: accessed-variable=VeCITR_b_PP2ButtonSts.Value
            access OUT_VeCITR_b_PP2ButtonStsFA_Value: accessed-variable=VeCITR_b_PP2ButtonStsFA.Value
        PokeCITR_b_PP2LidSwitchSts240
          data-send-points:
            access OUT_VeCITR_b_PP2LidSwitchSts240_Value: accessed-variable=VeCITR_b_PP2LidSwitchSts240.Value
            access OUT_VeCITR_b_PP2LidSwitchSts240FA_Value: accessed-variable=VeCITR_b_PP2LidSwitchSts240FA.Value
        PokeCITR_b_PP2LidSwitchSts120A
          data-send-points:
            access OUT_VeCITR_b_PP2LidSwitchSts120A_Value: accessed-variable=VeCITR_b_PP2LidSwitchSts120A.Value
            access OUT_VeCITR_b_PP2LidSwitchSts120AFA_Value: accessed-variable=VeCITR_b_PP2LidSwitchSts120AFA.Value
        PokeCITR_b_PP2LidSwitchSts120B
          data-send-points:
            access OUT_VeCITR_b_PP2LidSwitchSts120B_Value: accessed-variable=VeCITR_b_PP2LidSwitchSts120B.Value
            access OUT_VeCITR_b_PP2LidSwitchSts120BFA_Value: accessed-variable=VeCITR_b_PP2LidSwitchSts120BFA.Value
        PokeCITR_b_PP2_Gnd_Fault_Det
          data-send-points:
            access OUT_VeCITR_b_PP2_Gnd_Fault_Detected_Value: accessed-variable=VeCITR_b_PP2_Gnd_Fault_Detected.Value
            access OUT_VeCITR_b_PP2_Gnd_Fault_Detected_FA_Value: accessed-variable=VeCITR_b_PP2_Gnd_Fault_Detected_FA.Value
        PokeCITR_b_PP2_LIN_Cksm_Err
          data-send-points:
            access OUT_VeCITR_b_PP2_LIN_Checksum_Error_Value: accessed-variable=VeCITR_b_PP2_LIN_Checksum_Error.Value
            access OUT_VeCITR_b_PP2_LIN_Checksum_Error_FA_Value: accessed-variable=VeCITR_b_PP2_LIN_Checksum_Error_FA.Value
        PokeCITR_b_PP2_LIN_Data_Err
          data-send-points:
            access OUT_VeCITR_b_PP2_LIN_Data_Error_Value: accessed-variable=VeCITR_b_PP2_LIN_Data_Error.Value
            access OUT_VeCITR_b_PP2_LIN_Data_Error_FA_Value: accessed-variable=VeCITR_b_PP2_LIN_Data_Error_FA.Value
        PokeCITR_b_PP2_LIN_Parity_Err
          data-send-points:
            access OUT_VeCITR_b_PP2_LIN_Parity_Error_Value: accessed-variable=VeCITR_b_PP2_LIN_Parity_Error.Value
            access OUT_VeCITR_b_PP2_LIN_Parity_Error_FA_Value: accessed-variable=VeCITR_b_PP2_LIN_Parity_Error_FA.Value
        PokeCITR_b_PPACPresentSens1
          data-send-points:
            access OUT_VeCITR_b_PPACPresentSens1_Value: accessed-variable=VeCITR_b_PPACPresentSens1.Value
            access OUT_VeCITR_b_PPACPresentSens1FA_Value: accessed-variable=VeCITR_b_PPACPresentSens1FA.Value
        PokeCITR_b_PPACPresentSens2
          data-send-points:
            access OUT_VeCITR_b_PPACPresentSens2_Value: accessed-variable=VeCITR_b_PPACPresentSens2.Value
            access OUT_VeCITR_b_PPACPresentSens2FA_Value: accessed-variable=VeCITR_b_PPACPresentSens2FA.Value
        PokeCITR_b_PPButtonSts
          data-send-points:
            access OUT_VeCITR_b_PPButtonSts_Value: accessed-variable=VeCITR_b_PPButtonSts.Value
            access OUT_VeCITR_b_PPButtonStsFA_Value: accessed-variable=VeCITR_b_PPButtonStsFA.Value
        PokeCITR_b_PPLidSwitchSts120A
          data-send-points:
            access OUT_VeCITR_b_PPLidSwitchSts120A_Value: accessed-variable=VeCITR_b_PPLidSwitchSts120A.Value
            access OUT_VeCITR_b_PPLidSwitchSts120AFA_Value: accessed-variable=VeCITR_b_PPLidSwitchSts120AFA.Value
        PokeCITR_b_PPLidSwitchSts120B
          data-send-points:
            access OUT_VeCITR_b_PPLidSwitchSts120B_Value: accessed-variable=VeCITR_b_PPLidSwitchSts120B.Value
            access OUT_VeCITR_b_PPLidSwitchSts120BFA_Value: accessed-variable=VeCITR_b_PPLidSwitchSts120BFA.Value
        PokeCITR_b_PPLidSwitchSts240
          data-send-points:
            access OUT_VeCITR_b_PPLidSwitchSts240_Value: accessed-variable=VeCITR_b_PPLidSwitchSts240.Value
            access OUT_VeCITR_b_PPLidSwitchSts240FA_Value: accessed-variable=VeCITR_b_PPLidSwitchSts240FA.Value
        PokeCITR_b_PP_Gnd_Fault_Det
          data-send-points:
            access OUT_VeCITR_b_PP_Gnd_Fault_Detected_Value: accessed-variable=VeCITR_b_PP_Gnd_Fault_Detected.Value
            access OUT_VeCITR_b_PP_Gnd_Fault_Detected_FA_Value: accessed-variable=VeCITR_b_PP_Gnd_Fault_Detected_FA.Value
        PokeCITR_b_PP_LIN_Cksm_Err
          data-send-points:
            access OUT_VeCITR_b_PP_LIN_Checksum_Error_Value: accessed-variable=VeCITR_b_PP_LIN_Checksum_Error.Value
            access OUT_VeCITR_b_PP_LIN_Checksum_Error_FA_Value: accessed-variable=VeCITR_b_PP_LIN_Checksum_Error_FA.Value
        PokeCITR_b_PP_LIN_Data_Err
          data-send-points:
            access OUT_VeCITR_b_PP_LIN_Data_Error_Value: accessed-variable=VeCITR_b_PP_LIN_Data_Error.Value
            access OUT_VeCITR_b_PP_LIN_Data_Error_FA_Value: accessed-variable=VeCITR_b_PP_LIN_Data_Error_FA.Value
        PokeCITR_b_PP_LIN_Parity_Err
          data-send-points:
            access OUT_VeCITR_b_PP_LIN_Parity_Error_Value: accessed-variable=VeCITR_b_PP_LIN_Parity_Error.Value
            access OUT_VeCITR_b_PP_LIN_Parity_Error_FA_Value: accessed-variable=VeCITR_b_PP_LIN_Parity_Error_FA.Value
        PokeCITR_b_RsErrSPP
          data-send-points:
            access OUT_VeCITR_b_RsErrSPP_Value: accessed-variable=VeCITR_b_RsErrSPP.Value
            access OUT_VeCITR_b_RsErrSPPFA_Value: accessed-variable=VeCITR_b_RsErrSPPFA.Value
        PokeCITR_b_RsErrSPP2
          data-send-points:
            access OUT_VeCITR_b_RsErrSPP2_Value: accessed-variable=VeCITR_b_RsErrSPP2.Value
            access OUT_VeCITR_b_RsErrSPP2FA_Value: accessed-variable=VeCITR_b_RsErrSPP2FA.Value
        PokeCITR_b_SOC_Max_Lev
          data-send-points:
            access OUT_VeCITR_b_SOC_Max_Lev_Value: accessed-variable=VeCITR_b_SOC_Max_Lev.Value
            access OUT_VeCITR_b_SOC_Max_Lev_FA_Value: accessed-variable=VeCITR_b_SOC_Max_Lev_FA.Value
        PokeCITR_b_TBMStopChrg
          data-send-points:
            access OUT_VeCITR_b_TBMStopChrg_Value: accessed-variable=VeCITR_b_TBMStopChrg.Value
            access OUT_VeCITR_b_TBMStopChrgFA_Value: accessed-variable=VeCITR_b_TBMStopChrgFA.Value
        PokeCITR_b_TBM_Charge_Now
          data-send-points:
            access OUT_VeCITR_b_TBM_ChargeNow_Value: accessed-variable=VeCITR_b_TBM_ChargeNow.Value
        PokeCITR_b_TBM_Sch1_ChargeUntilFull
          data-send-points:
            access OUT_VeCITR_b_TBM_Sch1_ChargeUntilFull_Value: accessed-variable=VeCITR_b_TBM_Sch1_ChargeUntilFull.Value
        PokeCITR_b_TBM_Sch1_Do_Not_Repeat
          data-send-points:
            access OUT_VeCITR_b_TBM_Sch1_Do_Not_Repeat_Value: accessed-variable=VeCITR_b_TBM_Sch1_Do_Not_Repeat.Value
        PokeCITR_b_TBM_Sch1_Enbl
          data-send-points:
            access OUT_VeCITR_b_TBM_Sch1_Enbl_Value: accessed-variable=VeCITR_b_TBM_Sch1_Enbl.Value
        PokeCITR_b_TBM_Sch1_Priority
          data-send-points:
            access OUT_VeCITR_b_TBM_Sch1_Priority_Value: accessed-variable=VeCITR_b_TBM_Sch1_Priority.Value
        PokeCITR_b_TBM_Sch1_Submit
          data-send-points:
            access OUT_VeCITR_b_TBM_Sch1_Submit_Value: accessed-variable=VeCITR_b_TBM_Sch1_Submit.Value
        PokeCITR_b_TBM_Sch2_ChargeUntilFull
          data-send-points:
            access OUT_VeCITR_b_TBM_Sch2_ChargeUntilFull_Value: accessed-variable=VeCITR_b_TBM_Sch2_ChargeUntilFull.Value
        PokeCITR_b_TBM_Sch2_Do_Not_Repeat
          data-send-points:
            access OUT_VeCITR_b_TBM_Sch2_Do_Not_Repeat_Value: accessed-variable=VeCITR_b_TBM_Sch2_Do_Not_Repeat.Value
        PokeCITR_b_TBM_Sch2_Enbl
          data-send-points:
            access OUT_VeCITR_b_TBM_Sch2_Enbl_Value: accessed-variable=VeCITR_b_TBM_Sch2_Enbl.Value
        PokeCITR_b_TBM_Sch2_Priority
          data-send-points:
            access OUT_VeCITR_b_TBM_Sch2_Priority_Value: accessed-variable=VeCITR_b_TBM_Sch2_Priority.Value
        PokeCITR_b_TBM_Sch2_Submit
          data-send-points:
            access OUT_VeCITR_b_TBM_Sch2_Submit_Value: accessed-variable=VeCITR_b_TBM_Sch2_Submit.Value
        PokeCITR_b_TBM_Sch3_ChargeUntilFull
          data-send-points:
            access OUT_VeCITR_b_TBM_Sch3_ChargeUntilFull_Value: accessed-variable=VeCITR_b_TBM_Sch3_ChargeUntilFull.Value
        PokeCITR_b_TBM_Sch3_Do_Not_Repeat
          data-send-points:
            access OUT_VeCITR_b_TBM_Sch3_Do_Not_Repeat_Value: accessed-variable=VeCITR_b_TBM_Sch3_Do_Not_Repeat.Value
        PokeCITR_b_TBM_Sch3_Enbl
          data-send-points:
            access OUT_VeCITR_b_TBM_Sch3_Enbl_Value: accessed-variable=VeCITR_b_TBM_Sch3_Enbl.Value
        PokeCITR_b_TBM_Sch3_Priority
          data-send-points:
            access OUT_VeCITR_b_TBM_Sch3_Priority_Value: accessed-variable=VeCITR_b_TBM_Sch3_Priority.Value
        PokeCITR_b_TBM_Sch3_Submit
          data-send-points:
            access OUT_VeCITR_b_TBM_Sch3_Submit_Value: accessed-variable=VeCITR_b_TBM_Sch3_Submit.Value
        PokeCITR_b_TBM_Sch4_Enbl
          data-send-points:
            access OUT_VeCITR_b_TBM_Sch4_Enbl_Value: accessed-variable=VeCITR_b_TBM_Sch4_Enbl.Value
        PokeCITR_b_TBM_Sch4_Submit
          data-send-points:
            access OUT_VeCITR_b_TBM_Sch4_Submit_Value: accessed-variable=VeCITR_b_TBM_Sch4_Submit.Value
        PokeCITR_b_V2HModeReq
          data-send-points:
            access OUT_VeCITR_b_V2HModeReq_Value: accessed-variable=VeCITR_b_V2HModeReq.Value
            access OUT_VeCITR_b_V2HModeReqFA_Value: accessed-variable=VeCITR_b_V2HModeReqFA.Value
        PokeCITR_b_V2HReq
          data-send-points:
            access OUT_VeCITR_b_V2HReq_Value: accessed-variable=VeCITR_b_V2HReq.Value
            access OUT_VeCITR_b_V2HReqFA_Value: accessed-variable=VeCITR_b_V2HReqFA.Value
        PokeCITR_b_V2HSubmit
          data-send-points:
            access OUT_VeCITR_b_V2HSubmit_Value: accessed-variable=VeCITR_b_V2HSubmit.Value
            access OUT_VeCITR_b_V2HSubmitFA_Value: accessed-variable=VeCITR_b_V2HSubmitFA.Value
        PokeCITR_b_V2LModeReq
          data-send-points:
            access OUT_VeCITR_b_V2LModeReq_Value: accessed-variable=VeCITR_b_V2LModeReq.Value
            access OUT_VeCITR_b_V2LModeReqFA_Value: accessed-variable=VeCITR_b_V2LModeReqFA.Value
        PokeCITR_b_V2LSubmit
          data-send-points:
            access OUT_VeCITR_b_V2LSubmit_Value: accessed-variable=VeCITR_b_V2LSubmit.Value
            access OUT_VeCITR_b_V2LSubmitFA_Value: accessed-variable=VeCITR_b_V2LSubmitFA.Value
        PokeCITR_b_V2LTrunkReq
          data-send-points:
            access OUT_VeCITR_b_V2LTrunkReq_Value: accessed-variable=VeCITR_b_V2LTrunkReq.Value
            access OUT_VeCITR_b_V2LTrunkReqFA_Value: accessed-variable=VeCITR_b_V2LTrunkReqFA.Value
        PokeCITR_b_V2L_AllReq
          data-send-points:
            access OUT_VeCITR_b_V2L_AllReq_Value: accessed-variable=VeCITR_b_V2L_AllReq.Value
            access OUT_VeCITR_b_V2L_AllReqFA_Value: accessed-variable=VeCITR_b_V2L_AllReqFA.Value
        PokeCITR_b_V2L_FrunkReq
          data-send-points:
            access OUT_VeCITR_b_V2L_FrunkReq_Value: accessed-variable=VeCITR_b_V2L_FrunkReq.Value
            access OUT_VeCITR_b_V2L_FrunkReqFA_Value: accessed-variable=VeCITR_b_V2L_FrunkReqFA.Value
        PokeCITR_b_V2VModeReq
          data-send-points:
            access OUT_VeCITR_b_V2VModeReq_Value: accessed-variable=VeCITR_b_V2VModeReq.Value
            access OUT_VeCITR_b_V2VModeReqFA_Value: accessed-variable=VeCITR_b_V2VModeReqFA.Value
        PokeCITR_b_V2VReq
          data-send-points:
            access OUT_VeCITR_b_V2VReq_Value: accessed-variable=VeCITR_b_V2VReq.Value
            access OUT_VeCITR_b_V2VReqFA_Value: accessed-variable=VeCITR_b_V2VReqFA.Value
        PokeCITR_b_V2VSubmit
          data-send-points:
            access OUT_VeCITR_b_V2VSubmit_Value: accessed-variable=VeCITR_b_V2VSubmit.Value
            access OUT_VeCITR_b_V2VSubmitFA_Value: accessed-variable=VeCITR_b_V2VSubmitFA.Value
        PokeCITR_e_BCIM_Ind1_FailSts
          data-send-points:
            access OUT_VeCITR_e_BCIM_Ind1_FailSts_Value: accessed-variable=VeCITR_e_BCIM_Ind1_FailSts.Value
        PokeCITR_e_BCIM_Ind1_Fdbk
          data-send-points:
            access OUT_VeCITR_e_BCIM_Ind1_Fdbk_Value: accessed-variable=VeCITR_e_BCIM_Ind1_Fdbk.Value
            access OUT_VeCITR_b_BCIM_Ind1_FdbkFA_Value: accessed-variable=VeCITR_b_BCIM_Ind1_FdbkFA.Value
        PokeCITR_e_BCIM_Ind2_FailSts
          data-send-points:
            access OUT_VeCITR_e_BCIM_Ind2_FailSts_Value: accessed-variable=VeCITR_e_BCIM_Ind2_FailSts.Value
        PokeCITR_e_BCIM_Ind2_Fdbk
          data-send-points:
            access OUT_VeCITR_e_BCIM_Ind2_Fdbk_Value: accessed-variable=VeCITR_e_BCIM_Ind2_Fdbk.Value
            access OUT_VeCITR_b_BCIM_Ind2_FdbkFA_Value: accessed-variable=VeCITR_b_BCIM_Ind2_FdbkFA.Value
        PokeCITR_e_BCIM_Ind3_FailSts
          data-send-points:
            access OUT_VeCITR_e_BCIM_Ind3_FailSts_Value: accessed-variable=VeCITR_e_BCIM_Ind3_FailSts.Value
        PokeCITR_e_BCIM_Ind3_Fdbk
          data-send-points:
            access OUT_VeCITR_e_BCIM_Ind3_Fdbk_Value: accessed-variable=VeCITR_e_BCIM_Ind3_Fdbk.Value
            access OUT_VeCITR_b_BCIM_Ind3_FdbkFA_Value: accessed-variable=VeCITR_b_BCIM_Ind3_FdbkFA.Value
        PokeCITR_e_BCIM_Ind4_FailSts
          data-send-points:
            access OUT_VeCITR_e_BCIM_Ind4_FailSts_Value: accessed-variable=VeCITR_e_BCIM_Ind4_FailSts.Value
        PokeCITR_e_BCIM_Ind4_Fdbk
          data-send-points:
            access OUT_VeCITR_e_BCIM_Ind4_Fdbk_Value: accessed-variable=VeCITR_e_BCIM_Ind4_Fdbk.Value
            access OUT_VeCITR_b_BCIM_Ind4_FdbkFA_Value: accessed-variable=VeCITR_b_BCIM_Ind4_FdbkFA.Value
        PokeCITR_e_BCIM_Ind5_FailSts
          data-send-points:
            access OUT_VeCITR_e_BCIM_Ind5_FailSts_Value: accessed-variable=VeCITR_e_BCIM_Ind5_FailSts.Value
        PokeCITR_e_BCIM_Ind5_Fdbk
          data-send-points:
            access OUT_VeCITR_e_BCIM_Ind5_Fdbk_Value: accessed-variable=VeCITR_e_BCIM_Ind5_Fdbk.Value
            access OUT_VeCITR_b_BCIM_Ind5_FdbkFA_Value: accessed-variable=VeCITR_b_BCIM_Ind5_FdbkFA.Value
        PokeCITR_e_BCIM_Ind_Color_Fdbk
          data-send-points:
            access OUT_VeCITR_e_BCIM_Ind_Color_Fdbk_Value: accessed-variable=VeCITR_e_BCIM_Ind_Color_Fdbk.Value
            access OUT_VeCITR_b_BCIM_Ind_Color_FdbkFA_Value: accessed-variable=VeCITR_b_BCIM_Ind_Color_FdbkFA.Value
        PokeCITR_e_CPIM_BlueLED_FailSts
          data-send-points:
            access OUT_VeCITR_e_CPIM_BlueLED_FailSts_Value: accessed-variable=VeCITR_e_CPIM_BlueLED_FailSts.Value
        PokeCITR_e_CPIM_GreenLED_FailSts
          data-send-points:
            access OUT_VeCITR_e_CPIM_GreenLED_FailSts_Value: accessed-variable=VeCITR_e_CPIM_GreenLED_FailSts.Value
        PokeCITR_e_CPIM_Icon1_Sts
          data-send-points:
            access OUT_VeCITR_e_CPIM_Icon1_Sts_Value: accessed-variable=VeCITR_e_CPIM_Icon1_Sts.Value
            access OUT_VeCITR_b_CPIM_Icon1_StsFA_Value: accessed-variable=VeCITR_b_CPIM_Icon1_StsFA.Value
        PokeCITR_e_CPIM_Icon2_Sts
          data-send-points:
            access OUT_VeCITR_e_CPIM_Icon2_Sts_Value: accessed-variable=VeCITR_e_CPIM_Icon2_Sts.Value
            access OUT_VeCITR_b_CPIM_Icon2_StsFA_Value: accessed-variable=VeCITR_b_CPIM_Icon2_StsFA.Value
        PokeCITR_e_CPIM_Ind1_FailSts
          data-send-points:
            access OUT_VeCITR_e_CPIM_Ind1_FailSts_Value: accessed-variable=VeCITR_e_CPIM_Ind1_FailSts.Value
        PokeCITR_e_CPIM_Ind1_Fdbk
          data-send-points:
            access OUT_VeCITR_e_CPIM_Ind1_Fdbk_Value: accessed-variable=VeCITR_e_CPIM_Ind1_Fdbk.Value
            access OUT_VeCITR_b_CPIM_Ind1_FdbkFA_Value: accessed-variable=VeCITR_b_CPIM_Ind1_FdbkFA.Value
        PokeCITR_e_CPIM_Ind2_FailSts
          data-send-points:
            access OUT_VeCITR_e_CPIM_Ind2_FailSts_Value: accessed-variable=VeCITR_e_CPIM_Ind2_FailSts.Value
        PokeCITR_e_CPIM_Ind2_Fdbk
          data-send-points:
            access OUT_VeCITR_e_CPIM_Ind2_Fdbk_Value: accessed-variable=VeCITR_e_CPIM_Ind2_Fdbk.Value
            access OUT_VeCITR_b_CPIM_Ind2_FdbkFA_Value: accessed-variable=VeCITR_b_CPIM_Ind2_FdbkFA.Value
        PokeCITR_e_CPIM_Ind3_FailSts
          data-send-points:
            access OUT_VeCITR_e_CPIM_Ind3_FailSts_Value: accessed-variable=VeCITR_e_CPIM_Ind3_FailSts.Value
        PokeCITR_e_CPIM_Ind3_Fdbk
          data-send-points:
            access OUT_VeCITR_e_CPIM_Ind3_Fdbk_Value: accessed-variable=VeCITR_e_CPIM_Ind3_Fdbk.Value
            access OUT_VeCITR_b_CPIM_Ind3_FdbkFA_Value: accessed-variable=VeCITR_b_CPIM_Ind3_FdbkFA.Value
        PokeCITR_e_CPIM_Ind4_FailSts
          data-send-points:
            access OUT_VeCITR_e_CPIM_Ind4_FailSts_Value: accessed-variable=VeCITR_e_CPIM_Ind4_FailSts.Value
        PokeCITR_e_CPIM_Ind4_Fdbk
          data-send-points:
            access OUT_VeCITR_e_CPIM_Ind4_Fdbk_Value: accessed-variable=VeCITR_e_CPIM_Ind4_Fdbk.Value
            access OUT_VeCITR_b_CPIM_Ind4_FdbkFA_Value: accessed-variable=VeCITR_b_CPIM_Ind4_FdbkFA.Value
        PokeCITR_e_CPIM_Ind5_FailSts
          data-send-points:
            access OUT_VeCITR_e_CPIM_Ind5_FailSts_Value: accessed-variable=VeCITR_e_CPIM_Ind5_FailSts.Value
        PokeCITR_e_CPIM_Ind5_Fdbk
          data-send-points:
            access OUT_VeCITR_e_CPIM_Ind5_Fdbk_Value: accessed-variable=VeCITR_e_CPIM_Ind5_Fdbk.Value
            access OUT_VeCITR_b_CPIM_Ind5_FdbkFA_Value: accessed-variable=VeCITR_b_CPIM_Ind5_FdbkFA.Value
        PokeCITR_e_CPIM_Ind_Color_Fdbk
          data-send-points:
            access OUT_VeCITR_e_CPIM_Ind_Color_Fdbk_Value: accessed-variable=VeCITR_e_CPIM_Ind_Color_Fdbk.Value
            access OUT_VeCITR_b_CPIM_Ind_Color_FdbkFA_Value: accessed-variable=VeCITR_b_CPIM_Ind_Color_FdbkFA.Value
        PokeCITR_e_CPIM_RedLED_FailSts
          data-send-points:
            access OUT_VeCITR_e_CPIM_RedLED_FailSts_Value: accessed-variable=VeCITR_e_CPIM_RedLED_FailSts.Value
        PokeCITR_e_ChrgPortDoor_Sts
          written-local-variables:
            access WV_ChrgPortDoorSts_Init_write_IRV: accessed-variable=ChrgPortDoorSts_Init_write_IRV
        PokeCITR_e_ChrgPortLock_FailSts
          data-send-points:
            access OUT_VeCITR_e_CPIM_ChrgPortLock_FailSts_Value: accessed-variable=VeCITR_e_CPIM_ChrgPortLock_FailSts.Value
            access OUT_VeCITR_b_ChrgPortLock_FailStsFA_Value: accessed-variable=VeCITR_b_ChrgPortLock_FailStsFA.Value
        PokeCITR_e_ChrgrFlapSts
          data-send-points:
            access OUT_VeCITR_e_ChrgrFlapSts_Value: accessed-variable=VeCITR_e_ChrgrFlapSts.Value
            access OUT_VeCITR_b_ChrgrFlapSts_FA_Value: accessed-variable=VeCITR_b_ChrgrFlapSts_FA.Value
        PokeCITR_e_CoopCh_ChrgCmd
          data-send-points:
            access OUT_VeCITR_e_CoopCh_ChrgCmd_Value: accessed-variable=VeCITR_e_CoopCh_ChrgCmd.Value
            access OUT_VeCITR_b_CoopCh_ChrgCmdFA_Value: accessed-variable=VeCITR_b_CoopCh_ChrgCmdFA.Value
        PokeCITR_e_DVC_IO_BCIM
          data-send-points:
            7 x access:
              OUT_VeCITR_e_DVC_BCIM_IO_Value: accessed-variable=VeCITR_e_DVC_BCIM_IO.Value
              OUT_VeCITR_e_DVC_BCIM_Ind{1..5}_Value: accessed-variable=VeCITR_e_DVC_BCIM_Ind{1..5}.Value
              OUT_VeCITR_e_DVC_BCIM_BlinkRate_Value: accessed-variable=VeCITR_e_DVC_BCIM_BlinkRate.Value
        PokeCITR_e_DVC_IO_BCIM_JL
          data-send-points:
            8 x access:
              OUT_VeCITR_e_DVC_BCIM_IO_Value: accessed-variable=VeCITR_e_DVC_BCIM_IO.Value
              OUT_VeCITR_e_DVC_BCIM_Ind{1..5}_Value: accessed-variable=VeCITR_e_DVC_BCIM_Ind{1..5}.Value
              OUT_VeCITR_e_DVC_BCIM_BlinkRate_Value: accessed-variable=VeCITR_e_DVC_BCIM_BlinkRate.Value
              OUT_VeCITR_e_DVC_BCIM_Color_Value: accessed-variable=VeCITR_e_DVC_BCIM_Color.Value
        PokeCITR_e_DVC_IO_CPIM
          data-send-points:
            10 x access:
              OUT_VeCITR_e_DVC_CPIM_IO_Value: accessed-variable=VeCITR_e_DVC_CPIM_IO.Value
              OUT_VeCITR_e_DVC_CPIM_Ind{1..5}_Value: accessed-variable=VeCITR_e_DVC_CPIM_Ind{1..5}.Value
              OUT_VeCITR_e_DVC_CPIMBlinkRate_Value: accessed-variable=VeCITR_e_DVC_CPIMBlinkRate.Value
              OUT_VeCITR_e_DVC_CPIM_Color_Value: accessed-variable=VeCITR_e_DVC_CPIM_Color.Value
              OUT_VeCITR_e_DVC_CPIM_IconI1_Value: accessed-variable=VeCITR_e_DVC_CPIM_IconI1.Value
              OUT_VeCITR_e_DVC_CPIM_IconI2_Value: accessed-variable=VeCITR_e_DVC_CPIM_IconI2.Value
        PokeCITR_e_DateTmFormat
          data-send-points:
            access OUT_VeCITR_e_DateTmFormat_Value: accessed-variable=VeCITR_e_DateTmFormat.Value
            access OUT_VeCITR_b_DateTmFormat_FA_Value: accessed-variable=VeCITR_b_DateTmFormat_FA.Value
        PokeCITR_e_DoorLockLastElSts
          written-local-variables:
            access WV_DoorLockLastElSts_FA_Init_write_IRV: accessed-variable=DoorLockLastElSts_FA_Init_write_IRV
            access WV_DoorLockLastElSts_SgnlRcvd_Init_write_IRV: accessed-variable=DoorLockLastElSts_SgnlRcvd_Init_write_IRV
            access WV_DoorLockLastElSts_Init_write_IRV: accessed-variable=DoorLockLastElSts_Init_write_IRV
        PokeCITR_e_DoorLockLastElSts_2
          written-local-variables:
            access WV_DoorLockLastElSts_2_FA_Init_write_IRV: accessed-variable=DoorLockLastElSts_2_FA_Init_write_IRV
            access WV_DoorLockLastElSts_2_SgnlRcvd_Init_write_IRV: accessed-variable=DoorLockLastElSts_2_SgnlRcvd_Init_write_IRV
            access WV_DoorLockLastElSts_2_Init_write_IRV: accessed-variable=DoorLockLastElSts_2_Init_write_IRV
        PokeCITR_e_FOTA_Install_Type
          data-send-points:
            access OUT_VeCITR_e_FOTA_Install_Type_Value: accessed-variable=VeCITR_e_FOTA_Install_Type.Value
            access OUT_VeCITR_b_FOTA_Install_Type_FA_Value: accessed-variable=VeCITR_b_FOTA_Install_Type_FA.Value
        PokeCITR_e_FOTA_Installation_Status
          data-send-points:
            access OUT_VeCITR_e_FOTA_Install_Status_Value: accessed-variable=VeCITR_e_FOTA_Install_Status.Value
        PokeCITR_e_HU_ChrgSchedType1
          data-send-points:
            access OUT_VeCITR_e_HU_ChrgSchedType1_Value: accessed-variable=VeCITR_e_HU_ChrgSchedType1.Value
            access OUT_VeCITR_b_HU_ChrgSchedType1FA_Value: accessed-variable=VeCITR_b_HU_ChrgSchedType1FA.Value
        PokeCITR_e_HU_ChrgSchedType2
          data-send-points:
            access OUT_VeCITR_e_HU_ChrgSchedType2_Value: accessed-variable=VeCITR_e_HU_ChrgSchedType2.Value
            access OUT_VeCITR_b_HU_ChrgSchedType2FA_Value: accessed-variable=VeCITR_b_HU_ChrgSchedType2FA.Value
        PokeCITR_e_HU_Sch1_Type
          data-send-points:
            access OUT_VeCITR_e_HU_Sch1_Type_Value: accessed-variable=VeCITR_e_HU_Sch1_Type.Value
            access OUT_VeCITR_b_HU_Sch1_TypeFA_Value: accessed-variable=VeCITR_b_HU_Sch1_TypeFA.Value
        PokeCITR_e_HU_Sch2_Type
          data-send-points:
            access OUT_VeCITR_e_HU_Sch2_Type_Value: accessed-variable=VeCITR_e_HU_Sch2_Type.Value
            access OUT_VeCITR_b_HU_Sch2_TypeFA_Value: accessed-variable=VeCITR_b_HU_Sch2_TypeFA.Value
        PokeCITR_e_HU_Sch3_Allow
          data-send-points:
            access OUT_VeCITR_e_HU_Sch3_Allow_Value: accessed-variable=VeCITR_e_HU_Sch3_Allow.Value
            access OUT_VeCITR_b_HU_Sch3_AllowFA_Value: accessed-variable=VeCITR_b_HU_Sch3_AllowFA.Value
        PokeCITR_e_HU_Sch3_Type
          data-send-points:
            access OUT_VeCITR_e_HU_Sch3_Type_Value: accessed-variable=VeCITR_e_HU_Sch3_Type.Value
            access OUT_VeCITR_b_HU_Sch3_TypeFA_Value: accessed-variable=VeCITR_b_HU_Sch3_TypeFA.Value
        PokeCITR_e_HU_Sch4_Allow
          data-send-points:
            access OUT_VeCITR_e_HU_Sch4_Allow_Value: accessed-variable=VeCITR_e_HU_Sch4_Allow.Value
            access OUT_VeCITR_b_HU_Sch4_AllowFA_Value: accessed-variable=VeCITR_b_HU_Sch4_AllowFA.Value
        PokeCITR_e_PP2Fault
          data-send-points:
            access OUT_VeCITR_e_PP2Fault_Value: accessed-variable=VeCITR_e_PP2Fault.Value
            access OUT_VeCITR_b_PP2FaultFA_Value: accessed-variable=VeCITR_b_PP2FaultFA.Value
        PokeCITR_e_PP2FaultRsn
          data-send-points:
            access OUT_VeCITR_e_PP2FaultRsn_Value: accessed-variable=VeCITR_e_PP2FaultRsn.Value
            access OUT_VeCITR_b_PP2FaultRsnFA_Value: accessed-variable=VeCITR_b_PP2FaultRsnFA.Value
        PokeCITR_e_PP2LEDFault
          data-send-points:
            access OUT_VeCITR_e_PP2LEDFault_Value: accessed-variable=VeCITR_e_PP2LEDFault.Value
            access OUT_VeCITR_b_PP2LEDFaultFA_Value: accessed-variable=VeCITR_b_PP2LEDFaultFA.Value
        PokeCITR_e_PP2_LED_A_ColorFeedback
          data-send-points:
            access OUT_VeCITR_e_PP2_LED_A_Color_Feedback_Value: accessed-variable=VeCITR_e_PP2_LED_A_Color_Feedback.Value
            access OUT_VeCITR_b_PP2_LED_A_Color_Feedback_FA_Value: accessed-variable=VeCITR_b_PP2_LED_A_Color_Feedback_FA.Value
        PokeCITR_e_PP2_LED_A_FailSts
          data-send-points:
            access OUT_VeCITR_e_PP2_LED_A_FailStatus_Value: accessed-variable=VeCITR_e_PP2_LED_A_FailStatus.Value
            access OUT_VeCITR_b_PP2_LED_A_FailStatus_FA_Value: accessed-variable=VeCITR_b_PP2_LED_A_FailStatus_FA.Value
        PokeCITR_e_PP2_LED_A_Feedback
          data-send-points:
            access OUT_VeCITR_e_PP2_LED_A_Feedback_Value: accessed-variable=VeCITR_e_PP2_LED_A_Feedback.Value
            access OUT_VeCITR_b_PP2_LED_A_Feedback_FA_Value: accessed-variable=VeCITR_b_PP2_LED_A_Feedback_FA.Value
        PokeCITR_e_PP2_LED_B_ColorFeedback
          data-send-points:
            access OUT_VeCITR_e_PP2_LED_B_Color_Feedback_Value: accessed-variable=VeCITR_e_PP2_LED_B_Color_Feedback.Value
            access OUT_VeCITR_b_PP2_LED_B_Color_Feedback_FA_Value: accessed-variable=VeCITR_b_PP2_LED_B_Color_Feedback_FA.Value
        PokeCITR_e_PP2_LED_B_FailSts
          data-send-points:
            access OUT_VeCITR_e_PP2_LED_B_FailStatus_Value: accessed-variable=VeCITR_e_PP2_LED_B_FailStatus.Value
            access OUT_VeCITR_b_PP2_LED_B_FailStatus_FA_Value: accessed-variable=VeCITR_b_PP2_LED_B_FailStatus_FA.Value
        PokeCITR_e_PP2_LED_B_Feedback
          data-send-points:
            access OUT_VeCITR_e_PP2_LED_B_Feedback_Value: accessed-variable=VeCITR_e_PP2_LED_B_Feedback.Value
            access OUT_VeCITR_b_PP2_LED_B_Feedback_FA_Value: accessed-variable=VeCITR_b_PP2_LED_B_Feedback_FA.Value
        PokeCITR_e_PPFault
          data-send-points:
            access OUT_VeCITR_e_PPFault_Value: accessed-variable=VeCITR_e_PPFault.Value
            access OUT_VeCITR_b_PPFaultFA_Value: accessed-variable=VeCITR_b_PPFaultFA.Value
        PokeCITR_e_PPFaultRsn
          data-send-points:
            access OUT_VeCITR_e_PPFaultRsn_Value: accessed-variable=VeCITR_e_PPFaultRsn.Value
            access OUT_VeCITR_b_PPFaultRsnFA_Value: accessed-variable=VeCITR_b_PPFaultRsnFA.Value
        PokeCITR_e_PPLEDFault
          data-send-points:
            access OUT_VeCITR_e_PPLEDFault_Value: accessed-variable=VeCITR_e_PPLEDFault.Value
            access OUT_VeCITR_b_PPLEDFaultFA_Value: accessed-variable=VeCITR_b_PPLEDFaultFA.Value
        PokeCITR_e_PP_LED_A_ColorFeedback
          data-send-points:
            access OUT_VeCITR_e_PP_LED_A_Color_Feedback_Value: accessed-variable=VeCITR_e_PP_LED_A_Color_Feedback.Value
            access OUT_VeCITR_b_PP_LED_A_Color_Feedback_FA_Value: accessed-variable=VeCITR_b_PP_LED_A_Color_Feedback_FA.Value
        PokeCITR_e_PP_LED_A_FailSts
          data-send-points:
            access OUT_VeCITR_e_PP_LED_A_FailStatus_Value: accessed-variable=VeCITR_e_PP_LED_A_FailStatus.Value
            access OUT_VeCITR_b_PP_LED_A_FailStatus_FA_Value: accessed-variable=VeCITR_b_PP_LED_A_FailStatus_FA.Value
        PokeCITR_e_PP_LED_A_Feedback
          data-send-points:
            access OUT_VeCITR_e_PP_LED_A_Feedback_Value: accessed-variable=VeCITR_e_PP_LED_A_Feedback.Value
            access OUT_VeCITR_b_PP_LED_A_Feedback_FA_Value: accessed-variable=VeCITR_b_PP_LED_A_Feedback_FA.Value
        PokeCITR_e_PP_LED_B_ColorFeedback
          data-send-points:
            access OUT_VeCITR_e_PP_LED_B_Color_Feedback_Value: accessed-variable=VeCITR_e_PP_LED_B_Color_Feedback.Value
            access OUT_VeCITR_b_PP_LED_B_Color_Feedback_FA_Value: accessed-variable=VeCITR_b_PP_LED_B_Color_Feedback_FA.Value
        PokeCITR_e_PP_LED_B_FailSts
          data-send-points:
            access OUT_VeCITR_e_PP_LED_B_FailStatus_Value: accessed-variable=VeCITR_e_PP_LED_B_FailStatus.Value
            access OUT_VeCITR_b_PP_LED_B_FailStatus_FA_Value: accessed-variable=VeCITR_b_PP_LED_B_FailStatus_FA.Value
        PokeCITR_e_PP_LED_B_Feedback
          data-send-points:
            access OUT_VeCITR_e_PP_LED_B_Feedback_Value: accessed-variable=VeCITR_e_PP_LED_B_Feedback.Value
            access OUT_VeCITR_b_PP_LED_B_Feedback_FA_Value: accessed-variable=VeCITR_b_PP_LED_B_Feedback_FA.Value
        PokeCITR_e_PP_LED_C_ColorFeedback
          data-send-points:
            access OUT_VeCITR_e_PP_LED_C_Color_Feedback_Value: accessed-variable=VeCITR_e_PP_LED_C_Color_Feedback.Value
            access OUT_VeCITR_b_PP_LED_C_Color_Feedback_FA_Value: accessed-variable=VeCITR_b_PP_LED_C_Color_Feedback_FA.Value
        PokeCITR_e_PP_LED_C_FailSts
          data-send-points:
            access OUT_VeCITR_e_PP_LED_C_FailStatus_Value: accessed-variable=VeCITR_e_PP_LED_C_FailStatus.Value
            access OUT_VeCITR_b_PP_LED_C_FailStatus_FA_Value: accessed-variable=VeCITR_b_PP_LED_C_FailStatus_FA.Value
        PokeCITR_e_PP_LED_C_Feedback
          data-send-points:
            access OUT_VeCITR_e_PP_LED_C_Feedback_Value: accessed-variable=VeCITR_e_PP_LED_C_Feedback.Value
            access OUT_VeCITR_b_PP_LED_C_Feedback_FA_Value: accessed-variable=VeCITR_b_PP_LED_C_Feedback_FA.Value
        PokeCITR_e_PowerLimit_Req
          written-local-variables:
            access WV_PwrLimReq_FA_Init_write_IRV: accessed-variable=PwrLimReq_FA_Init_write_IRV
            access WV_PwrLimReq_SgnlRcvd_Init_write_IRV: accessed-variable=PwrLimReq_SgnlRcvd_Init_write_IRV
            access WV_PwrLimReq_Init_write_IRV: accessed-variable=PwrLimReq_Init_write_IRV
        PokeCITR_e_PowerLimit_Req_2
          written-local-variables:
            access WV_PwrLimReq_SgnlRcvd_2_Init_write_IRV: accessed-variable=PwrLimReq_SgnlRcvd_2_Init_write_IRV
            access WV_PwrLimReq_FA_2_Init_write_IRV: accessed-variable=PwrLimReq_FA_2_Init_write_IRV
            access WV_PwrLimReq_2_Init_write_IRV: accessed-variable=PwrLimReq_2_Init_write_IRV
        PokeCITR_e_RmtChrgPortLkCmd
          data-send-points:
            access OUT_VeCITR_e_RmtChrgPortLkCmd_Value: accessed-variable=VeCITR_e_RmtChrgPortLkCmd.Value
            access OUT_VeCITR_b_RmtChrgPortLkCmdFA_Value: accessed-variable=VeCITR_b_RmtChrgPortLkCmdFA.Value
            access OUT_VeCITR_b_RmtChrgPortLkCmd_SgnlRcvd_Value: accessed-variable=VeCITR_b_RmtChrgPortLkCmd_SgnlRcvd.Value
        PokeCITR_e_TBM_ChrgSchedType1
          data-send-points:
            access OUT_VeCITR_e_TBM_ChrgSchedType1_Value: accessed-variable=VeCITR_e_TBM_ChrgSchedType1.Value
            access OUT_VeCITR_b_TBM_ChrgSchedType1FA_Value: accessed-variable=VeCITR_b_TBM_ChrgSchedType1FA.Value
        PokeCITR_e_TBM_ChrgSchedType2
          data-send-points:
            access OUT_VeCITR_e_TBM_ChrgSchedType2_Value: accessed-variable=VeCITR_e_TBM_ChrgSchedType2.Value
            access OUT_VeCITR_b_TBM_ChrgSchedType2FA_Value: accessed-variable=VeCITR_b_TBM_ChrgSchedType2FA.Value
        PokeCITR_e_TBM_Sch1_Type
          data-send-points:
            access OUT_VeCITR_e_TBM_Sch1_Type_Value: accessed-variable=VeCITR_e_TBM_Sch1_Type.Value
            access OUT_VeCITR_b_TBM_Sch1_TypeFA_Value: accessed-variable=VeCITR_b_TBM_Sch1_TypeFA.Value
        PokeCITR_e_TBM_Sch2_Type
          data-send-points:
            access OUT_VeCITR_e_TBM_Sch2_Type_Value: accessed-variable=VeCITR_e_TBM_Sch2_Type.Value
            access OUT_VeCITR_b_TBM_Sch2_TypeFA_Value: accessed-variable=VeCITR_b_TBM_Sch2_TypeFA.Value
        PokeCITR_e_TBM_Sch3_Allow
          data-send-points:
            access OUT_VeCITR_e_TBM_Sch3_Allow_Value: accessed-variable=VeCITR_e_TBM_Sch3_Allow.Value
            access OUT_VeCITR_b_TBM_Sch3_AllowFA_Value: accessed-variable=VeCITR_b_TBM_Sch3_AllowFA.Value
        PokeCITR_e_TBM_Sch3_Type
          data-send-points:
            access OUT_VeCITR_e_TBM_Sch3_Type_Value: accessed-variable=VeCITR_e_TBM_Sch3_Type.Value
            access OUT_VeCITR_b_TBM_Sch3_TypeFA_Value: accessed-variable=VeCITR_b_TBM_Sch3_TypeFA.Value
        PokeCITR_e_TBM_Sch4_Allow
          data-send-points:
            access OUT_VeCITR_e_TBM_Sch4_Allow_Value: accessed-variable=VeCITR_e_TBM_Sch4_Allow.Value
            access OUT_VeCITR_b_TBM_Sch4_AllowFA_Value: accessed-variable=VeCITR_b_TBM_Sch4_AllowFA.Value
        PokeCITR_l_DistanceToCharge
          data-send-points:
            access OUT_VeCITR_l_DistanceToCharge_Value: accessed-variable=VeCITR_l_DistanceToCharge.Value
            access OUT_VeCITR_b_DistanceToCharge_FA_Value: accessed-variable=VeCITR_b_DistanceToCharge_FA.Value
        PokeCITR_t_TimeToCharge
          data-send-points:
            access OUT_VeCITR_t_TimeToCharge_Value: accessed-variable=VeCITR_t_TimeToCharge.Value
            access OUT_VeCITR_b_TimeToCharge_FA_Value: accessed-variable=VeCITR_b_TimeToCharge_FA.Value
        TmotCITR_b_ChrgPort_BCM_Cmd
          data-send-points:
            access OUT_VeCITR_b_ChrgPort_BCM_Cmd_Rcvd_Value: accessed-variable=VeCITR_b_ChrgPort_BCM_Cmd_Rcvd.Value
          written-local-variables:
            access WV_ChrgPort_BCM_Cmd_SgnlRcvd_Init_write_IRV: accessed-variable=ChrgPort_BCM_Cmd_SgnlRcvd_Init_write_IRV
        TmotCITR_b_DC_PwrLev
          data-send-points:
            access OUT_VeCITR_b_DC_PwrLev_SgnlRcvd_Value: accessed-variable=VeCITR_b_DC_PwrLev_SgnlRcvd.Value
        TmotCITR_b_DateTmDay
          data-send-points:
            access OUT_VeCITR_b_DateTmDay_SgnlRcvd_Value: accessed-variable=VeCITR_b_DateTmDay_SgnlRcvd.Value
        TmotCITR_b_Date_Day1
          data-send-points:
            access OUT_VeCITR_b_Date_Day1_SgnlRcvd_Value: accessed-variable=VeCITR_b_Date_Day1_SgnlRcvd.Value
        TmotCITR_b_HU_Sch1_Day
          data-send-points:
            access OUT_VeCITR_b_HU_Sch1_Day_SgnlRcvd_Value: accessed-variable=VeCITR_b_HU_Sch1_Day_SgnlRcvd.Value
        TmotCITR_b_HU_Sch2_Day
          data-send-points:
            access OUT_VeCITR_b_HU_Sch2_Day_SgnlRcvd_Value: accessed-variable=VeCITR_b_HU_Sch2_Day_SgnlRcvd.Value
        TmotCITR_b_HU_Sch3_Day
          data-send-points:
            access OUT_VeCITR_b_HU_Sch3_Day_SgnlRcvd_Value: accessed-variable=VeCITR_b_HU_Sch3_Day_SgnlRcvd.Value
        TmotCITR_b_HU_Sch4_Day
          data-send-points:
            access OUT_VeCITR_b_HU_Sch4_Day_SgnlRcvd_Value: accessed-variable=VeCITR_b_HU_Sch4_Day_SgnlRcvd.Value
        TmotCITR_b_TBM_Sch1_Day
          data-send-points:
            access OUT_VeCITR_b_TBM_Sch1_Day_SgnlRcvd_Value: accessed-variable=VeCITR_b_TBM_Sch1_Day_SgnlRcvd.Value
        TmotCITR_b_TBM_Sch2_Day
          data-send-points:
            access OUT_VeCITR_b_TBM_Sch2_Day_SgnlRcvd_Value: accessed-variable=VeCITR_b_TBM_Sch2_Day_SgnlRcvd.Value
        TmotCITR_b_TBM_Sch3_Day
          data-send-points:
            access OUT_VeCITR_b_TBM_Sch3_Day_SgnlRcvd_Value: accessed-variable=VeCITR_b_TBM_Sch3_Day_SgnlRcvd.Value
        TmotCITR_b_TBM_Sch4_Day
          data-send-points:
            access OUT_VeCITR_b_TBM_Sch4_Day_SgnlRcvd_Value: accessed-variable=VeCITR_b_TBM_Sch4_Day_SgnlRcvd.Value
        TmotCITR_e_DoorLockLastElSts
          written-local-variables:
            access WV_DoorLockLastElSts_SgnlRcvd_Init_write_IRV: accessed-variable=DoorLockLastElSts_SgnlRcvd_Init_write_IRV
        TmotCITR_e_DoorLockLastElSts_2
          written-local-variables:
            access WV_DoorLockLastElSts_2_SgnlRcvd_Init_write_IRV: accessed-variable=DoorLockLastElSts_2_SgnlRcvd_Init_write_IRV
        TmotCITR_e_PowerLimitReq
          written-local-variables:
            access WV_PwrLimReq_SgnlRcvd_Init_write_IRV: accessed-variable=PwrLimReq_SgnlRcvd_Init_write_IRV
        TmotCITR_e_PowerLimitReq_2
          written-local-variables:
            access WV_PwrLimReq_SgnlRcvd_2_Init_write_IRV: accessed-variable=PwrLimReq_SgnlRcvd_2_Init_write_IRV
        TmotCITR_e_RmtChrgPortLkCmd
          data-send-points:
            access OUT_VeCITR_b_RmtChrgPortLkCmd_SgnlRcvd_Value: accessed-variable=VeCITR_b_RmtChrgPortLkCmd_SgnlRcvd.Value
