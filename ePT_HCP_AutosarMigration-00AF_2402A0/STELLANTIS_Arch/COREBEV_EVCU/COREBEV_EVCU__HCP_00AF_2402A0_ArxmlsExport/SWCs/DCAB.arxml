[part 2 of 2: package /STELLANTIS/EPT/ASWCs]
AUTOSAR XML (schema 4-2-2)
package /STELLANTIS/EPT/ASWCs  (continued)
  application sw component type DCAB  (continued)
    behavior IB_DCAB: data-type-mapping=msADTtoIDTMapping, handle-termination-and-restart=NO-SUPPORT
      248 x operation invoked event:
        Event_DataServices_IOCD001_Data_RC: start-on-event=DataServices_IOCD001_Data_RC, operation=DataServices_IOCD001_Data.ReturnControlToECU
        Event_DataServices_IOCD001_Data_ReadData: start-on-event=DataServices_IOCD001_Data_ReadData, operation=DataServices_IOCD001_Data.ReadData
        Event_DataServices_IOCD001_Data_SA: start-on-event=DataServices_IOCD001_Data_SA, operation=DataServices_IOCD001_Data.ShortTermAdjustment
        Event_DataServices_IOCD002_Data_RC: start-on-event=DataServices_IOCD002_Data_RC, operation=DataServices_IOCD002_Data.ReturnControlToECU
        Event_DataServices_IOCD002_Data_ReadData: start-on-event=DataServices_IOCD002_Data_ReadData, operation=DataServices_IOCD002_Data.ReadData
        Event_DataServices_IOCD002_Data_SA: start-on-event=DataServices_IOCD002_Data_SA, operation=DataServices_IOCD002_Data.ShortTermAdjustment
        Event_DataServices_IOCD004_Data_RC: start-on-event=DataServices_IOCD004_Data_RC, operation=DataServices_IOCD004_Data.ReturnControlToECU
        Event_DataServices_IOCD004_Data_ReadData: start-on-event=DataServices_IOCD004_Data_ReadData, operation=DataServices_IOCD004_Data.ReadData
        Event_DataServices_IOCD004_Data_SA: start-on-event=DataServices_IOCD004_Data_SA, operation=DataServices_IOCD004_Data.ShortTermAdjustment
        Event_DataServices_IOCD006_Data_RC: start-on-event=DataServices_IOCD006_Data_RC, operation=DataServices_IOCD006_Data.ReturnControlToECU
        Event_DataServices_IOCD006_Data_RD: start-on-event=DataServices_IOCD006_Data_RD, operation=DataServices_IOCD006_Data.ResetToDefault
        Event_DataServices_IOCD006_Data_ReadData: start-on-event=DataServices_IOCD006_Data_ReadData, operation=DataServices_IOCD006_Data.ReadData
        Event_DataServices_IOCD006_Data_SA: start-on-event=DataServices_IOCD006_Data_SA, operation=DataServices_IOCD006_Data.ShortTermAdjustment
        Event_DataServices_IOCD007_Data_RC: start-on-event=DataServices_IOCD007_Data_RC, operation=DataServices_IOCD007_Data.ReturnControlToECU
        Event_DataServices_IOCD007_Data_ReadData: start-on-event=DataServices_IOCD007_Data_ReadData, operation=DataServices_IOCD007_Data.ReadData
        Event_DataServices_IOCD007_Data_SA: start-on-event=DataServices_IOCD007_Data_SA, operation=DataServices_IOCD007_Data.ShortTermAdjustment
        Event_DataServices_IOCD00D_Data_RC: start-on-event=DataServices_IOCD00D_Data_RC, operation=DataServices_IOCD00D_Data.ReturnControlToECU
        Event_DataServices_IOCD00D_Data_RD: start-on-event=DataServices_IOCD00D_Data_RD, operation=DataServices_IOCD00D_Data.ResetToDefault
        Event_DataServices_IOCD00D_Data_ReadData: start-on-event=DataServices_IOCD00D_Data_ReadData, operation=DataServices_IOCD00D_Data.ReadData
        Event_DataServices_IOCD00D_Data_SA: start-on-event=DataServices_IOCD00D_Data_SA, operation=DataServices_IOCD00D_Data.ShortTermAdjustment
        Event_DataServices_IOCD012_Data_RC: start-on-event=DataServices_IOCD012_Data_RC, operation=DataServices_IOCD012_Data.ReturnControlToECU
        Event_DataServices_IOCD012_Data_ReadData: start-on-event=DataServices_IOCD012_Data_ReadData, operation=DataServices_IOCD012_Data.ReadData
        Event_DataServices_IOCD012_Data_SA: start-on-event=DataServices_IOCD012_Data_SA, operation=DataServices_IOCD012_Data.ShortTermAdjustment
        Event_DataServices_IOCD013_Data_RC: start-on-event=DataServices_IOCD013_Data_RC, operation=DataServices_IOCD013_Data.ReturnControlToECU
        Event_DataServices_IOCD013_Data_RD: start-on-event=DataServices_IOCD013_Data_RD, operation=DataServices_IOCD013_Data.ResetToDefault
        Event_DataServices_IOCD013_Data_ReadData: start-on-event=DataServices_IOCD013_Data_ReadData, operation=DataServices_IOCD013_Data.ReadData
        Event_DataServices_IOCD013_Data_SA: start-on-event=DataServices_IOCD013_Data_SA, operation=DataServices_IOCD013_Data.ShortTermAdjustment
        Event_DataServices_IOCD014_Data_RC: start-on-event=DataServices_IOCD014_Data_RC, operation=DataServices_IOCD014_Data.ReturnControlToECU
        Event_DataServices_IOCD014_Data_RD: start-on-event=DataServices_IOCD014_Data_RD, operation=DataServices_IOCD014_Data.ResetToDefault
        Event_DataServices_IOCD014_Data_ReadData: start-on-event=DataServices_IOCD014_Data_ReadData, operation=DataServices_IOCD014_Data.ReadData
        Event_DataServices_IOCD014_Data_SA: start-on-event=DataServices_IOCD014_Data_SA, operation=DataServices_IOCD014_Data.ShortTermAdjustment
        Event_DataServices_IOCD016_Data_RC: start-on-event=DataServices_IOCD016_Data_RC, operation=DataServices_IOCD016_Data.ReturnControlToECU
        Event_DataServices_IOCD016_Data_ReadData: start-on-event=DataServices_IOCD016_Data_ReadData, operation=DataServices_IOCD016_Data.ReadData
        Event_DataServices_IOCD016_Data_SA: start-on-event=DataServices_IOCD016_Data_SA, operation=DataServices_IOCD016_Data.ShortTermAdjustment
        Event_DataServices_IOCD017_Data_RC: start-on-event=DataServices_IOCD017_Data_RC, operation=DataServices_IOCD017_Data.ReturnControlToECU
        Event_DataServices_IOCD017_Data_RD: start-on-event=DataServices_IOCD017_Data_RD, operation=DataServices_IOCD017_Data.ResetToDefault
        Event_DataServices_IOCD017_Data_ReadData: start-on-event=DataServices_IOCD017_Data_ReadData, operation=DataServices_IOCD017_Data.ReadData
        Event_DataServices_IOCD017_Data_SA: start-on-event=DataServices_IOCD017_Data_SA, operation=DataServices_IOCD017_Data.ShortTermAdjustment
        Event_DataServices_IOCD019_Data_RC: start-on-event=DataServices_IOCD019_Data_RC, operation=DataServices_IOCD019_Data.ReturnControlToECU
        Event_DataServices_IOCD019_Data_RD: start-on-event=DataServices_IOCD019_Data_RD, operation=DataServices_IOCD019_Data.ResetToDefault
        Event_DataServices_IOCD019_Data_ReadData: start-on-event=DataServices_IOCD019_Data_ReadData, operation=DataServices_IOCD019_Data.ReadData
        Event_DataServices_IOCD019_Data_SA: start-on-event=DataServices_IOCD019_Data_SA, operation=DataServices_IOCD019_Data.ShortTermAdjustment
        Event_DataServices_IOCD01A_Data_RC: start-on-event=DataServices_IOCD01A_Data_RC, operation=DataServices_IOCD01A_Data.ReturnControlToECU
        Event_DataServices_IOCD01A_Data_RD: start-on-event=DataServices_IOCD01A_Data_RD, operation=DataServices_IOCD01A_Data.ResetToDefault
        Event_DataServices_IOCD01A_Data_ReadData: start-on-event=DataServices_IOCD01A_Data_ReadData, operation=DataServices_IOCD01A_Data.ReadData
        Event_DataServices_IOCD01A_Data_SA: start-on-event=DataServices_IOCD01A_Data_SA, operation=DataServices_IOCD01A_Data.ShortTermAdjustment
        Event_DataServices_IOCD01C_Data_RC: start-on-event=DataServices_IOCD01C_Data_RC, operation=DataServices_IOCD01C_Data.ReturnControlToECU
        Event_DataServices_IOCD01C_Data_ReadData: start-on-event=DataServices_IOCD01C_Data_ReadData, operation=DataServices_IOCD01C_Data.ReadData
        Event_DataServices_IOCD01C_Data_SA: start-on-event=DataServices_IOCD01C_Data_SA, operation=DataServices_IOCD01C_Data.ShortTermAdjustment
        Event_DataServices_IOCD01E_Data_RC: start-on-event=DataServices_IOCD01E_Data_RC, operation=DataServices_IOCD01E_Data.ReturnControlToECU
        Event_DataServices_IOCD01E_Data_ReadData: start-on-event=DataServices_IOCD01E_Data_ReadData, operation=DataServices_IOCD01E_Data.ReadData
        Event_DataServices_IOCD01E_Data_SA: start-on-event=DataServices_IOCD01E_Data_SA, operation=DataServices_IOCD01E_Data.ShortTermAdjustment
        Event_DataServices_IOCD01F_Data_RC: start-on-event=DataServices_IOCD01F_Data_RC, operation=DataServices_IOCD01F_Data.ReturnControlToECU
        Event_DataServices_IOCD01F_Data_RD: start-on-event=DataServices_IOCD01F_Data_RD, operation=DataServices_IOCD01F_Data.ResetToDefault
        Event_DataServices_IOCD01F_Data_ReadData: start-on-event=DataServices_IOCD01F_Data_ReadData, operation=DataServices_IOCD01F_Data.ReadData
        Event_DataServices_IOCD01F_Data_SA: start-on-event=DataServices_IOCD01F_Data_SA, operation=DataServices_IOCD01F_Data.ShortTermAdjustment
        Event_DataServices_IOCD022_Data_RC: start-on-event=DataServices_IOCD022_Data_RC, operation=DataServices_IOCD022_Data.ReturnControlToECU
        Event_DataServices_IOCD022_Data_ReadData: start-on-event=DataServices_IOCD022_Data_ReadData, operation=DataServices_IOCD022_Data.ReadData
        Event_DataServices_IOCD022_Data_SA: start-on-event=DataServices_IOCD022_Data_SA, operation=DataServices_IOCD022_Data.ShortTermAdjustment
        Event_DataServices_IOCD023_Data_RC: start-on-event=DataServices_IOCD023_Data_RC, operation=DataServices_IOCD023_Data.ReturnControlToECU
        Event_DataServices_IOCD023_Data_ReadData: start-on-event=DataServices_IOCD023_Data_ReadData, operation=DataServices_IOCD023_Data.ReadData
        Event_DataServices_IOCD023_Data_SA: start-on-event=DataServices_IOCD023_Data_SA, operation=DataServices_IOCD023_Data.ShortTermAdjustment
        Event_DataServices_IOCD025_Data_RC: start-on-event=DataServices_IOCD025_Data_RC, operation=DataServices_IOCD025_Data.ReturnControlToECU
        Event_DataServices_IOCD025_Data_ReadData: start-on-event=DataServices_IOCD025_Data_ReadData, operation=DataServices_IOCD025_Data.ReadData
        Event_DataServices_IOCD025_Data_SA: start-on-event=DataServices_IOCD025_Data_SA, operation=DataServices_IOCD025_Data.ShortTermAdjustment
        Event_DataServices_IOCD026_Data_RC: start-on-event=DataServices_IOCD026_Data_RC, operation=DataServices_IOCD026_Data.ReturnControlToECU
        Event_DataServices_IOCD026_Data_ReadData: start-on-event=DataServices_IOCD026_Data_ReadData, operation=DataServices_IOCD026_Data.ReadData
        Event_DataServices_IOCD026_Data_SA: start-on-event=DataServices_IOCD026_Data_SA, operation=DataServices_IOCD026_Data.ShortTermAdjustment
        Event_DataServices_IOCD027_Data_RC: start-on-event=DataServices_IOCD027_Data_RC, operation=DataServices_IOCD027_Data.ReturnControlToECU
        Event_DataServices_IOCD027_Data_ReadData: start-on-event=DataServices_IOCD027_Data_ReadData, operation=DataServices_IOCD027_Data.ReadData
        Event_DataServices_IOCD027_Data_SA: start-on-event=DataServices_IOCD027_Data_SA, operation=DataServices_IOCD027_Data.ShortTermAdjustment
        Event_DataServices_IOCD028_Data_Freeze: start-on-event=DataServices_IOCD028_Data_Freeze, operation=DataServices_IOCD028_Data.FreezeCurrentState
        Event_DataServices_IOCD028_Data_RC: start-on-event=DataServices_IOCD028_Data_RC, operation=DataServices_IOCD028_Data.ReturnControlToECU
        Event_DataServices_IOCD028_Data_ReadData: start-on-event=DataServices_IOCD028_Data_ReadData, operation=DataServices_IOCD028_Data.ReadData
        Event_DataServices_IOCD028_Data_SA: start-on-event=DataServices_IOCD028_Data_SA, operation=DataServices_IOCD028_Data.ShortTermAdjustment
        Event_DataServices_IOCD030_Data_RC: start-on-event=DataServices_IOCD030_Data_RC, operation=DataServices_IOCD030_Data.ReturnControlToECU
        Event_DataServices_IOCD030_Data_ReadData: start-on-event=DataServices_IOCD030_Data_ReadData, operation=DataServices_IOCD030_Data.ReadData
        Event_DataServices_IOCD030_Data_SA: start-on-event=DataServices_IOCD030_Data_SA, operation=DataServices_IOCD030_Data.ShortTermAdjustment
        Event_DataServices_IOCD031_Data_RC: start-on-event=DataServices_IOCD031_Data_RC, operation=DataServices_IOCD031_Data.ReturnControlToECU
        Event_DataServices_IOCD031_Data_ReadData: start-on-event=DataServices_IOCD031_Data_ReadData, operation=DataServices_IOCD031_Data.ReadData
        Event_DataServices_IOCD031_Data_SA: start-on-event=DataServices_IOCD031_Data_SA, operation=DataServices_IOCD031_Data.ShortTermAdjustment
        Event_DataServices_IOCD032_Data_RC: start-on-event=DataServices_IOCD032_Data_RC, operation=DataServices_IOCD032_Data.ReturnControlToECU
        Event_DataServices_IOCD032_Data_RD: start-on-event=DataServices_IOCD032_Data_RD, operation=DataServices_IOCD032_Data.ResetToDefault
        Event_DataServices_IOCD032_Data_ReadData: start-on-event=DataServices_IOCD032_Data_ReadData, operation=DataServices_IOCD032_Data.ReadData
        Event_DataServices_IOCD032_Data_SA: start-on-event=DataServices_IOCD032_Data_SA, operation=DataServices_IOCD032_Data.ShortTermAdjustment
        Event_DataServices_IOCD033_Data_RC: start-on-event=DataServices_IOCD033_Data_RC, operation=DataServices_IOCD033_Data.ReturnControlToECU
        Event_DataServices_IOCD033_Data_RD: start-on-event=DataServices_IOCD033_Data_RD, operation=DataServices_IOCD033_Data.ResetToDefault
        Event_DataServices_IOCD033_Data_ReadData: start-on-event=DataServices_IOCD033_Data_ReadData, operation=DataServices_IOCD033_Data.ReadData
        Event_DataServices_IOCD033_Data_SA: start-on-event=DataServices_IOCD033_Data_SA, operation=DataServices_IOCD033_Data.ShortTermAdjustment
        Event_DataServices_IOCD043_Data_RC: start-on-event=DataServices_IOCD043_Data_RC, operation=DataServices_IOCD043_Data.ReturnControlToECU
        Event_DataServices_IOCD043_Data_ReadData: start-on-event=DataServices_IOCD043_Data_ReadData, operation=DataServices_IOCD043_Data.ReadData
        Event_DataServices_IOCD043_Data_SA: start-on-event=DataServices_IOCD043_Data_SA, operation=DataServices_IOCD043_Data.ShortTermAdjustment
        Event_DataServices_RD0306_Data_ReadData: start-on-event=DataServices_RD0306_Data_ReadData, operation=DataServices_RD0306_Data.ReadData
        Event_DataServices_RD0307_Data_ReadData: start-on-event=DataServices_RD0307_Data_ReadData, operation=DataServices_RD0307_Data.ReadData
        Event_DataServices_RD0507_Data_ReadData: start-on-event=DataServices_RD0507_Data_ReadData, operation=DataServices_RD0507_Data.ReadData
        Event_DataServices_RD{0800..0805}_Data_ReadData: start-on-event=DataServices_RD{0800..0805}_Data_ReadData, operation=DataServices_RD{0800..0805}_Data.ReadData
        Event_DataServices_RD1000_Data_ReadData: start-on-event=DataServices_RD1000_Data_ReadData, operation=DataServices_RD1000_Data.ReadData
        Event_DataServices_RD1002_Data_ReadData: start-on-event=DataServices_RD1002_Data_ReadData, operation=DataServices_RD1002_Data.ReadData
        Event_DataServices_RD1004_Data_ReadData: start-on-event=DataServices_RD1004_Data_ReadData, operation=DataServices_RD1004_Data.ReadData
        Event_DataServices_RD1927_Data_ReadData: start-on-event=DataServices_RD1927_Data_ReadData, operation=DataServices_RD1927_Data.ReadData
        Event_DataServices_RD19B{0..3}_Data_ReadData: start-on-event=DataServices_RD19B{0..3}_Data_ReadData, operation=DataServices_RD19B{0..3}_Data.ReadData
        Event_DataServices_RD201E_Data_ReadData: start-on-event=DataServices_RD201E_Data_ReadData, operation=DataServices_RD201E_Data.ReadData
        Event_DataServices_RD2500_Data_ReadData: start-on-event=DataServices_RD2500_Data_ReadData, operation=DataServices_RD2500_Data.ReadData
        Event_DataServices_RD2505_Data_ReadData: start-on-event=DataServices_RD2505_Data_ReadData, operation=DataServices_RD2505_Data.ReadData
        Event_DataServices_RD2518_Data_ReadData: start-on-event=DataServices_RD2518_Data_ReadData, operation=DataServices_RD2518_Data.ReadData
        Event_DataServices_RD2801_Data_ReadData: start-on-event=DataServices_RD2801_Data_ReadData, operation=DataServices_RD2801_Data.ReadData
        Event_DataServices_RD2802_Data_ReadData: start-on-event=DataServices_RD2802_Data_ReadData, operation=DataServices_RD2802_Data.ReadData
        Event_DataServices_RD2949_Data_ReadData: start-on-event=DataServices_RD2949_Data_ReadData, operation=DataServices_RD2949_Data.ReadData
        Event_DataServices_RD3004_Data_ReadData: start-on-event=DataServices_RD3004_Data_ReadData, operation=DataServices_RD3004_Data.ReadData
        Event_DataServices_RD3027_Data_ReadData: start-on-event=DataServices_RD3027_Data_ReadData, operation=DataServices_RD3027_Data.ReadData
        Event_DataServices_RD3028_Data_ReadData: start-on-event=DataServices_RD3028_Data_ReadData, operation=DataServices_RD3028_Data.ReadData
        Event_DataServices_RD3035_Data_ReadData: start-on-event=DataServices_RD3035_Data_ReadData, operation=DataServices_RD3035_Data.ReadData
        Event_DataServices_RD3036_Data_ReadData: start-on-event=DataServices_RD3036_Data_ReadData, operation=DataServices_RD3036_Data.ReadData
        Event_DataServices_RD3200_Data_ReadData: start-on-event=DataServices_RD3200_Data_ReadData, operation=DataServices_RD3200_Data.ReadData
        Event_DataServices_RD{4000..4002}_Data_ReadData: start-on-event=DataServices_RD{4000..4002}_Data_ReadData, operation=DataServices_RD{4000..4002}_Data.ReadData
        Event_DataServices_RD4004_Data_ReadData: start-on-event=DataServices_RD4004_Data_ReadData, operation=DataServices_RD4004_Data.ReadData
        Event_DataServices_RD400A_Data_ReadData: start-on-event=DataServices_RD400A_Data_ReadData, operation=DataServices_RD400A_Data.ReadData
        Event_DataServices_RD400C_Data_ReadData: start-on-event=DataServices_RD400C_Data_ReadData, operation=DataServices_RD400C_Data.ReadData
        Event_DataServices_RD{4010..4016}_Data_ReadData: start-on-event=DataServices_RD{4010..4016}_Data_ReadData, operation=DataServices_RD{4010..4016}_Data.ReadData
        Event_DataServices_RD401C_Data_ReadData: start-on-event=DataServices_RD401C_Data_ReadData, operation=DataServices_RD401C_Data.ReadData
        Event_DataServices_RD401F_Data_ReadData: start-on-event=DataServices_RD401F_Data_ReadData, operation=DataServices_RD401F_Data.ReadData
        Event_DataServices_RD4021_Data_ReadData: start-on-event=DataServices_RD4021_Data_ReadData, operation=DataServices_RD4021_Data.ReadData
        Event_DataServices_RD4036_Data_ReadData: start-on-event=DataServices_RD4036_Data_ReadData, operation=DataServices_RD4036_Data.ReadData
        Event_DataServices_RD4037_Data_ReadData: start-on-event=DataServices_RD4037_Data_ReadData, operation=DataServices_RD4037_Data.ReadData
        Event_DataServices_RD4039_Data_ReadData: start-on-event=DataServices_RD4039_Data_ReadData, operation=DataServices_RD4039_Data.ReadData
        Event_DataServices_RD403D_Data_ReadData: start-on-event=DataServices_RD403D_Data_ReadData, operation=DataServices_RD403D_Data.ReadData
        Event_DataServices_RD4040_Data_ReadData: start-on-event=DataServices_RD4040_Data_ReadData, operation=DataServices_RD4040_Data.ReadData
        Event_DataServices_RD{4050..4053}_Data_ReadData: start-on-event=DataServices_RD{4050..4053}_Data_ReadData, operation=DataServices_RD{4050..4053}_Data.ReadData
        Event_DataServices_RD4055_Data_ReadData: start-on-event=DataServices_RD4055_Data_ReadData, operation=DataServices_RD4055_Data.ReadData
        Event_DataServices_RD4056_Data_ReadData: start-on-event=DataServices_RD4056_Data_ReadData, operation=DataServices_RD4056_Data.ReadData
        Event_DataServices_RD6360_Data_ReadData: start-on-event=DataServices_RD6360_Data_ReadData, operation=DataServices_RD6360_Data.ReadData
        Event_DataServices_RD9EED_Data_ReadData: start-on-event=DataServices_RD9EED_Data_ReadData, operation=DataServices_RD9EED_Data.ReadData
        Event_DataServices_RDB000_Data_ReadData: start-on-event=DataServices_RDB000_Data_ReadData, operation=DataServices_RDB000_Data.ReadData
        Event_DataServices_RDB523_Data_ReadData: start-on-event=DataServices_RDB523_Data_ReadData, operation=DataServices_RDB523_Data.ReadData
        Event_DataServices_RDB524_Data_ReadData: start-on-event=DataServices_RDB524_Data_ReadData, operation=DataServices_RDB524_Data.ReadData
        Event_DataServices_RDB526_Data_ReadData: start-on-event=DataServices_RDB526_Data_ReadData, operation=DataServices_RDB526_Data.ReadData
        Event_DataServices_RDB605_Data_ReadData: start-on-event=DataServices_RDB605_Data_ReadData, operation=DataServices_RDB605_Data.ReadData
        Event_DataServices_RDB{612..614}_Data_ReadData: start-on-event=DataServices_RDB{612..614}_Data_ReadData, operation=DataServices_RDB{612..614}_Data.ReadData
        Event_DataServices_RDB616_Data_ReadData: start-on-event=DataServices_RDB616_Data_ReadData, operation=DataServices_RDB616_Data.ReadData
        Event_DataServices_RDB621_Data_ReadData: start-on-event=DataServices_RDB621_Data_ReadData, operation=DataServices_RDB621_Data.ReadData
        Event_DataServices_RDB622_Data_ReadData: start-on-event=DataServices_RDB622_Data_ReadData, operation=DataServices_RDB622_Data.ReadData
        Event_DataServices_RDB{626..629}_Data_ReadData: start-on-event=DataServices_RDB{626..629}_Data_ReadData, operation=DataServices_RDB{626..629}_Data.ReadData
        Event_DataServices_RDB62A_Data_ReadData: start-on-event=DataServices_RDB62A_Data_ReadData, operation=DataServices_RDB62A_Data.ReadData
        Event_DataServices_RDB62B_Data_ReadData: start-on-event=DataServices_RDB62B_Data_ReadData, operation=DataServices_RDB62B_Data.ReadData
        Event_DataServices_RDB{630..634}_Data_ReadData: start-on-event=DataServices_RDB{630..634}_Data_ReadData, operation=DataServices_RDB{630..634}_Data.ReadData
        Event_DataServices_RDB650_Data_ReadData: start-on-event=DataServices_RDB650_Data_ReadData, operation=DataServices_RDB650_Data.ReadData
        Event_DataServices_RDB651_Data_ReadData: start-on-event=DataServices_RDB651_Data_ReadData, operation=DataServices_RDB651_Data.ReadData
        Event_DataServices_RDB{653..655}_Data_ReadData: start-on-event=DataServices_RDB{653..655}_Data_ReadData, operation=DataServices_RDB{653..655}_Data.ReadData
        Event_DataServices_RDB779_Data_ReadData: start-on-event=DataServices_RDB779_Data_ReadData, operation=DataServices_RDB779_Data.ReadData
        Event_DataServices_RDB789_Data_ReadData: start-on-event=DataServices_RDB789_Data_ReadData, operation=DataServices_RDB789_Data.ReadData
        Event_DataServices_RWD2800_Data_ReadData: start-on-event=DataServices_RWD2800_Data_ReadData, operation=DataServices_RWD2800_Data.ReadData
        Event_DataServices_RWD3025_Data_ReadData: start-on-event=DataServices_RWD3025_Data_ReadData, operation=DataServices_RWD3025_Data.ReadData
        Event_DataServices_RWD3029_Data_ReadData: start-on-event=DataServices_RWD3029_Data_ReadData, operation=DataServices_RWD3029_Data.ReadData
        Event_DataServices_RWD3202_Data_ReadData: start-on-event=DataServices_RWD3202_Data_ReadData, operation=DataServices_RWD3202_Data.ReadData
        Event_DataServices_RWD9E15_Data_ReadData: start-on-event=DataServices_RWD9E15_Data_ReadData, operation=DataServices_RWD9E15_Data.ReadData
        Event_DataServices_RWD9E{20..23}_Data_ReadData: start-on-event=DataServices_RWD9E{20..23}_Data_ReadData, operation=DataServices_RWD9E{20..23}_Data.ReadData
        Event_DataServices_RWD9E3B_Data_ReadData: start-on-event=DataServices_RWD9E3B_Data_ReadData, operation=DataServices_RWD9E3B_Data.ReadData
        Event_DataServices_RWD9EEB_Data_ReadData: start-on-event=DataServices_RWD9EEB_Data_ReadData, operation=DataServices_RWD9EEB_Data.ReadData
        Event_DataServices_RWD9EEC_Data_ReadData: start-on-event=DataServices_RWD9EEC_Data_ReadData, operation=DataServices_RWD9EEC_Data.ReadData
        Event_DataServices_RWDB604_Data_ReadData: start-on-event=DataServices_RWDB604_Data_ReadData, operation=DataServices_RWDB604_Data.ReadData
        Event_DataServices_RWDB607_Data_ReadData: start-on-event=DataServices_RWDB607_Data_ReadData, operation=DataServices_RWDB607_Data.ReadData
        Event_DataServices_RWDB61B_Data_ReadData: start-on-event=DataServices_RWDB61B_Data_ReadData, operation=DataServices_RWDB61B_Data.ReadData
        Event_DataServices_RWDB62F_Data_ReadData: start-on-event=DataServices_RWDB62F_Data_ReadData, operation=DataServices_RWDB62F_Data.ReadData
        Event_DataServices_RWDB652_Data_ReadData: start-on-event=DataServices_RWDB652_Data_ReadData, operation=DataServices_RWDB652_Data.ReadData
        Event_RoutineServices_RC1300_Start: start-on-event=RoutineServices_RC1300_Start, operation=RoutineServices_RC1300.Start
        Event_RoutineServices_RC1303_RequestResults: start-on-event=RoutineServices_RC1303_RequestResults, operation=RoutineServices_RC1303.RequestResults
        Event_RoutineServices_RC1303_Start: start-on-event=RoutineServices_RC1303_Start, operation=RoutineServices_RC1303.Start
        Event_RoutineServices_RC1303_Stop: start-on-event=RoutineServices_RC1303_Stop, operation=RoutineServices_RC1303.Stop
        Event_RoutineServices_RC1309_RequestResults: start-on-event=RoutineServices_RC1309_RequestResults, operation=RoutineServices_RC1309.RequestResults
        Event_RoutineServices_RC1309_Start: start-on-event=RoutineServices_RC1309_Start, operation=RoutineServices_RC1309.Start
        Event_RoutineServices_RC130B_Start: start-on-event=RoutineServices_RC130B_Start, operation=RoutineServices_RC130B.Start
        Event_RoutineServices_RC130C_RequestResults: start-on-event=RoutineServices_RC130C_RequestResults, operation=RoutineServices_RC130C.RequestResults
        Event_RoutineServices_RC130C_Stop: start-on-event=RoutineServices_RC130C_Stop, operation=RoutineServices_RC130C.Stop
        Event_RoutineServices_RC130C_Start: start-on-event=RoutineServices_RC130C_Start, operation=RoutineServices_RC130C.Start
        Event_RoutineServices_RC130D_RequestResults: start-on-event=RoutineServices_RC130D_RequestResults, operation=RoutineServices_RC130D.RequestResults
        Event_RoutineServices_RC130D_Start: start-on-event=RoutineServices_RC130D_Start, operation=RoutineServices_RC130D.Start
        Event_RoutineServices_RC130D_Stop: start-on-event=RoutineServices_RC130D_Stop, operation=RoutineServices_RC130D.Stop
        Event_RoutineServices_RC130E_RequestResults: start-on-event=RoutineServices_RC130E_RequestResults, operation=RoutineServices_RC130E.RequestResults
        Event_RoutineServices_RC130E_Start: start-on-event=RoutineServices_RC130E_Start, operation=RoutineServices_RC130E.Start
        Event_RoutineServices_RC130F_RequestResults: start-on-event=RoutineServices_RC130F_RequestResults, operation=RoutineServices_RC130F.RequestResults
        Event_RoutineServices_RC130F_Start: start-on-event=RoutineServices_RC130F_Start, operation=RoutineServices_RC130F.Start
        Event_RoutineServices_RC1313_RequestResults: start-on-event=RoutineServices_RC1313_RequestResults, operation=RoutineServices_RC1313.RequestResults
        Event_RoutineServices_RC1313_Start: start-on-event=RoutineServices_RC1313_Start, operation=RoutineServices_RC1313.Start
        Event_RoutineServices_RC1313_Stop: start-on-event=RoutineServices_RC1313_Stop, operation=RoutineServices_RC1313.Stop
        Event_RoutineServices_RC1314_RequestResults: start-on-event=RoutineServices_RC1314_RequestResults, operation=RoutineServices_RC1314.RequestResults
        Event_RoutineServices_RC1314_Start: start-on-event=RoutineServices_RC1314_Start, operation=RoutineServices_RC1314.Start
        Event_RoutineServices_RC1314_Stop: start-on-event=RoutineServices_RC1314_Stop, operation=RoutineServices_RC1314.Stop
        Event_RoutineServices_RC1330_RequestResults: start-on-event=RoutineServices_RC1330_RequestResults, operation=RoutineServices_RC1330.RequestResults
        Event_RoutineServices_RC1330_Start: start-on-event=RoutineServices_RC1330_Start, operation=RoutineServices_RC1330.Start
        Event_RoutineServices_RC1330_Stop: start-on-event=RoutineServices_RC1330_Stop, operation=RoutineServices_RC1330.Stop
        Event_RoutineServices_RC1332_RequestResults: start-on-event=RoutineServices_RC1332_RequestResults, operation=RoutineServices_RC1332.RequestResults
        Event_RoutineServices_RC1332_Start: start-on-event=RoutineServices_RC1332_Start, operation=RoutineServices_RC1332.Start
        Event_RoutineServices_RC1332_Stop: start-on-event=RoutineServices_RC1332_Stop, operation=RoutineServices_RC1332.Stop
        Event_RoutineServices_RC1333_RequestResults: start-on-event=RoutineServices_RC1333_RequestResults, operation=RoutineServices_RC1333.RequestResults
        Event_RoutineServices_RC1333_Start: start-on-event=RoutineServices_RC1333_Start, operation=RoutineServices_RC1333.Start
        Event_RoutineServices_RC1333_Stop: start-on-event=RoutineServices_RC1333_Stop, operation=RoutineServices_RC1333.Stop
        Event_RoutineServices_RC1336_RequestResults: start-on-event=RoutineServices_RC1336_RequestResults, operation=RoutineServices_RC1336.RequestResults
        Event_RoutineServices_RC1336_Start: start-on-event=RoutineServices_RC1336_Start, operation=RoutineServices_RC1336.Start
        Event_DataServices_RWD2800_Data_WriteData: start-on-event=DataServices_RWD2800_Data_WriteData, operation=DataServices_RWD2800_Data.WriteData
        Event_DataServices_RWD3025_Data_WriteData: start-on-event=DataServices_RWD3025_Data_WriteData, operation=DataServices_RWD3025_Data.WriteData
        Event_DataServices_RWD3029_Data_WriteData: start-on-event=DataServices_RWD3029_Data_WriteData, operation=DataServices_RWD3029_Data.WriteData
        Event_DataServices_RWD3202_Data_WriteData: start-on-event=DataServices_RWD3202_Data_WriteData, operation=DataServices_RWD3202_Data.WriteData
        Event_DataServices_RWD9E15_Data_WriteData: start-on-event=DataServices_RWD9E15_Data_WriteData, operation=DataServices_RWD9E15_Data.WriteData
        Event_DataServices_RWD9E{20..23}_Data_WriteData: start-on-event=DataServices_RWD9E{20..23}_Data_WriteData, operation=DataServices_RWD9E{20..23}_Data.WriteData
        Event_DataServices_RWD9E3B_Data_WriteData: start-on-event=DataServices_RWD9E3B_Data_WriteData, operation=DataServices_RWD9E3B_Data.WriteData
        Event_DataServices_RWD9EEB_Data_WriteData: start-on-event=DataServices_RWD9EEB_Data_WriteData, operation=DataServices_RWD9EEB_Data.WriteData
        Event_DataServices_RWD9EEC_Data_WriteData: start-on-event=DataServices_RWD9EEC_Data_WriteData, operation=DataServices_RWD9EEC_Data.WriteData
        Event_DataServices_RWDB604_Data_WriteData: start-on-event=DataServices_RWDB604_Data_WriteData, operation=DataServices_RWDB604_Data.WriteData
        Event_DataServices_RWDB607_Data_WriteData: start-on-event=DataServices_RWDB607_Data_WriteData, operation=DataServices_RWDB607_Data.WriteData
        Event_DataServices_RWDB61B_Data_WriteData: start-on-event=DataServices_RWDB61B_Data_WriteData, operation=DataServices_RWDB61B_Data.WriteData
        Event_DataServices_RWDB62F_Data_WriteData: start-on-event=DataServices_RWDB62F_Data_WriteData, operation=DataServices_RWDB62F_Data.WriteData
        Event_DataServices_RWDB652_Data_WriteData: start-on-event=DataServices_RWDB652_Data_WriteData, operation=DataServices_RWDB652_Data.WriteData
      init event Event_DCAB_ac_Init: start-on-event=DCAB_ac_Init
      249 x runnable:
        DCAB_ac_Init
          data-send-points:
            44 x access:
              OUT_VeDCAB_e_IOControl_IOCD001_HigTemShuVal_Op_Value: accessed-variable=VeDCAB_e_IOControl_IOCD001_HigTemShuVal_Op.Value
              OUT_VeDCAB_e_IOControl_IOCD002_FtRfgtShtoff_VlvCmd_Op_Value: accessed-variable=VeDCAB_e_IOControl_IOCD002_FtRfgtShtoff_VlvCmd_Op.Value
              OUT_VeDCAB_e_IOControl_IOCD004_RadFanDutCycle_Op_Value: accessed-variable=VeDCAB_e_IOControl_IOCD004_RadFanDutCycle_Op.Value
              OUT_VeDCAB_e_IOControl_IOCD006_HigVolCooHeater_Op_Value: accessed-variable=VeDCAB_e_IOControl_IOCD006_HigVolCooHeater_Op.Value
              OUT_VeDCAB_e_IOControl_IOCD007_ChlrRfgtShtoff_VlvCmd_Op_Value: accessed-variable=VeDCAB_e_IOControl_IOCD007_ChlrRfgtShtoff_VlvCmd_Op.Value
              OUT_VeDCAB_e_IOControl_IOCD00D_HigTemAuxPump_Op_Value: accessed-variable=VeDCAB_e_IOControl_IOCD00D_HigTemAuxPump_Op.Value
              OUT_VeDCAB_e_IOControl_APM_Status_Op_Value: accessed-variable=VeDCAB_e_IOControl_APM_Status_Op.Value
              OUT_VeDCAB_e_IOControl_IOCD013_CompSpdTgt_Op_Value: accessed-variable=VeDCAB_e_IOControl_IOCD013_CompSpdTgt_Op.Value
              OUT_VeDCAB_e_IOControl_Charge_Port_Lock_Op_Value: accessed-variable=VeDCAB_e_IOControl_Charge_Port_Lock_Op.Value
              OUT_VeDCAB_e_IOControl_IOCD016_MtrElecCoolPmpA_Op_Value: accessed-variable=VeDCAB_e_IOControl_IOCD016_MtrElecCoolPmpA_Op.Value
              OUT_VeDCAB_e_IOControl_IOCD017_MtrElecCoolPmpB_Op_Value: accessed-variable=VeDCAB_e_IOControl_IOCD017_MtrElecCoolPmpB_Op.Value
              OUT_VeDCAB_e_IOControl_IOCD019_BatteryCoolPump_Op_Value: accessed-variable=VeDCAB_e_IOControl_IOCD019_BatteryCoolPump_Op.Value
              OUT_VeDCAB_e_IOControl_IOCDOIC_PropSysCoolCntrlValvA_Op_Value: accessed-variable=VeDCAB_e_IOControl_IOCDOIC_PropSysCoolCntrlValvA_Op.Value
              OUT_VeDCAB_e_IOControl_IOCD01F_ACRefrExpValvActACntrl_Op_Value: accessed-variable=VeDCAB_e_IOControl_IOCD01F_ACRefrExpValvActACntrl_Op.Value
              OUT_VeDCAB_e_IOControl_IOCD022_PropSysCoolCntrlValvB_Op_Value: accessed-variable=VeDCAB_e_IOControl_IOCD022_PropSysCoolCntrlValvB_Op.Value
              OUT_VeDCAB_e_IOControl_IOCD023_PropSysCoolCntrlValvC_Op_Value: accessed-variable=VeDCAB_e_IOControl_IOCD023_PropSysCoolCntrlValvC_Op.Value
              OUT_VeDCAB_e_IOCD025_AGS_PstnCmnd_Value: accessed-variable=VeDCAB_e_IOCD025_AGS_PstnCmnd.Value
              OUT_VeDCAB_e_IOControl_IOCD025_AGS_PstnCmnd_Op_Value: accessed-variable=VeDCAB_e_IOControl_IOCD025_AGS_PstnCmnd_Op.Value
              OUT_VeDCAB_e_IOCD026_AGS2_PstnCmnd_Value: accessed-variable=VeDCAB_e_IOCD026_AGS2_PstnCmnd.Value
              OUT_VeDCAB_e_IOControl_IOCD026_AGS2_PstnCmnd_Op_Value: accessed-variable=VeDCAB_e_IOControl_IOCD026_AGS2_PstnCmnd_Op.Value
              OUT_VeDCAB_e_IOControl_IOCD027_PowOilPumACon_Pump_Speed_Op_Value: accessed-variable=VeDCAB_e_IOControl_IOCD027_PowOilPumACon_Pump_Speed_Op.Value
              OUT_VeDCAB_e_IOControl_IOCD028_PowOilPumBCon_Pump_Speed_Op_Value: accessed-variable=VeDCAB_e_IOControl_IOCD028_PowOilPumBCon_Pump_Speed_Op.Value
              OUT_VeDCAB_e_IOControl_IOCD031_ACRefrExpValvActACntrl_Op_Value: accessed-variable=VeDCAB_e_IOControl_IOCD031_ACRefrExpValvActACntrl_Op.Value
              OUT_VeDCAB_e_IOControl_IOCD032_ACRefrExpValvActCCntrl_Op_Value: accessed-variable=VeDCAB_e_IOControl_IOCD032_ACRefrExpValvActCCntrl_Op.Value
              OUT_VeDCAB_e_IOControl_IOCD033_ACRefrExpValvActDCntrl_Op_Value: accessed-variable=VeDCAB_e_IOControl_IOCD033_ACRefrExpValvActDCntrl_Op.Value
              OUT_VeDCAB_e_IOControl_IOCD01A_BatCooHea_Op_Value: accessed-variable=VeDCAB_e_IOControl_IOCD01A_BatCooHea_Op.Value
              OUT_VeDCAB_e_IOControl_IOCD01E_AirHeaCon_Op_Value: accessed-variable=VeDCAB_e_IOControl_IOCD01E_AirHeaCon_Op.Value
              OUT_VeDCAB_e_IOCD030_ActAirDamCon_Value: accessed-variable=VeDCAB_e_IOCD030_ActAirDamCon.Value
              OUT_VeDCAB_e_IOControl_IOCD030_ActAirDamCon_Op_Value: accessed-variable=VeDCAB_e_IOControl_IOCD030_ActAirDamCon_Op.Value
              OUT_VeDCAB_e_IOControl_IOCD043_PWMElectricOilPump_Op_Value: accessed-variable=VeDCAB_e_IOControl_IOCD043_PWMElectricOilPump_Op.Value
              OUT_VeDCAB_e_Routine_RC130C_AccPedLea_Op_Value: accessed-variable=VeDCAB_e_Routine_RC130C_AccPedLea_Op.Value
              OUT_VeDCAB_e_Routine_RC1332_ACRefExpValActCCal_Op_Value: accessed-variable=VeDCAB_e_Routine_RC1332_ACRefExpValActCCal_Op.Value
              OUT_VeDCAB_e_Routine_RC1333_ACRefExpValActDCal_Op_Value: accessed-variable=VeDCAB_e_Routine_RC1333_ACRefExpValActDCal_Op.Value
              OUT_VeDCAB_e_Routine_RC130D_EXVValCal_Op_Value: accessed-variable=VeDCAB_e_Routine_RC130D_EXVValCal_Op.Value
              OUT_VeDCAB_e_Routine_RC1313_ActGriShu1Cal_Op_Value: accessed-variable=VeDCAB_e_Routine_RC1313_ActGriShu1Cal_Op.Value
              OUT_VeDCAB_e_Routine_RC1314_ActGriShu2Cal_Op_Value: accessed-variable=VeDCAB_e_Routine_RC1314_ActGriShu2Cal_Op.Value
              OUT_VeDCAB_e_Routine_RC1330_ActAirDamCal_Op_Value: accessed-variable=VeDCAB_e_Routine_RC1330_ActAirDamCal_Op.Value
              OUT_VeDCAB_e_Routine_RC1309_CPV_ClbrtnRtn_Op_Value: accessed-variable=VeDCAB_e_Routine_RC1309_CPV_ClbrtnRtn_Op.Value
              OUT_VeDCAB_e_Routine_RC1300_HVOpnCblReset_Op_Value: accessed-variable=VeDCAB_e_Routine_RC1300_HVOpnCblReset_Op.Value
              OUT_VeDCAB_e_Routine_RC130E_LTR_ClbrtnRtn_Op_Value: accessed-variable=VeDCAB_e_Routine_RC130E_LTR_ClbrtnRtn_Op.Value
              OUT_VeDCAB_e_Routine_RC130F_HTL_ClbrtnRtn_Op_Value: accessed-variable=VeDCAB_e_Routine_RC130F_HTL_ClbrtnRtn_Op.Value
              OUT_VeDCAB_e_Routine_RC1303_CabOveLoc_Op_Value: accessed-variable=VeDCAB_e_Routine_RC1303_CabOveLoc_Op.Value
              OUT_VeDCAB_e_Routine_RC1336_ToothAbutmentLearning_Op_Value: accessed-variable=VeDCAB_e_Routine_RC1336_ToothAbutmentLearning_Op.Value
              OUT_VeDCAB_e_Routine_RC130B_OBD2PIDsReset_Op_Value: accessed-variable=VeDCAB_e_Routine_RC130B_OBD2PIDsReset_Op.Value
        DataServices_IOCD001_Data_RC
          data-send-points:
            access OUT_VeDCAB_b_IOCD001_HigTemShuVal_Value: accessed-variable=VeDCAB_b_IOCD001_HigTemShuVal.Value
            access OUT_VeDCAB_e_IOControl_IOCD001_HigTemShuVal_Op_Value: accessed-variable=VeDCAB_e_IOControl_IOCD001_HigTemShuVal_Op.Value
        DataServices_IOCD001_Data_ReadData
        DataServices_IOCD001_Data_SA
          data-send-points:
            access OUT_VeDCAB_b_IOCD001_HigTemShuVal_Value: accessed-variable=VeDCAB_b_IOCD001_HigTemShuVal.Value
            access OUT_VeDCAB_e_IOControl_IOCD001_HigTemShuVal_Op_Value: accessed-variable=VeDCAB_e_IOControl_IOCD001_HigTemShuVal_Op.Value
        DataServices_IOCD002_Data_RC
          data-send-points:
            access OUT_VeDCAB_b_IOCD002_FtRfgtShtoff_VlvCmd_Value: accessed-variable=VeDCAB_b_IOCD002_FtRfgtShtoff_VlvCmd.Value
            access OUT_VeDCAB_e_IOControl_IOCD002_FtRfgtShtoff_VlvCmd_Op_Value: accessed-variable=VeDCAB_e_IOControl_IOCD002_FtRfgtShtoff_VlvCmd_Op.Value
        DataServices_IOCD002_Data_ReadData
        DataServices_IOCD002_Data_SA
          data-send-points:
            access OUT_VeDCAB_b_IOCD002_FtRfgtShtoff_VlvCmd_Value: accessed-variable=VeDCAB_b_IOCD002_FtRfgtShtoff_VlvCmd.Value
            access OUT_VeDCAB_e_IOControl_IOCD002_FtRfgtShtoff_VlvCmd_Op_Value: accessed-variable=VeDCAB_e_IOControl_IOCD002_FtRfgtShtoff_VlvCmd_Op.Value
        DataServices_IOCD004_Data_RC
          data-send-points:
            access OUT_VeDCAB_Pct_IOCD004_RadFanDutCycle_Value: accessed-variable=VeDCAB_Pct_IOCD004_RadFanDutCycle.Value
            access OUT_VeDCAB_e_IOControl_IOCD004_RadFanDutCycle_Op_Value: accessed-variable=VeDCAB_e_IOControl_IOCD004_RadFanDutCycle_Op.Value
        DataServices_IOCD004_Data_ReadData
        DataServices_IOCD004_Data_SA
          data-send-points:
            access OUT_VeDCAB_Pct_IOCD004_RadFanDutCycle_Value: accessed-variable=VeDCAB_Pct_IOCD004_RadFanDutCycle.Value
            access OUT_VeDCAB_e_IOControl_IOCD004_RadFanDutCycle_Op_Value: accessed-variable=VeDCAB_e_IOControl_IOCD004_RadFanDutCycle_Op.Value
        DataServices_IOCD006_Data_RC
          data-send-points:
            access OUT_VeDCAB_W_IOCD006_HigVolCooHeater_Value: accessed-variable=VeDCAB_W_IOCD006_HigVolCooHeater.Value
            access OUT_VeDCAB_e_IOControl_IOCD006_HigVolCooHeater_Op_Value: accessed-variable=VeDCAB_e_IOControl_IOCD006_HigVolCooHeater_Op.Value
        DataServices_IOCD006_Data_RD
          data-send-points:
            access OUT_VeDCAB_W_IOCD006_HigVolCooHeater_Value: accessed-variable=VeDCAB_W_IOCD006_HigVolCooHeater.Value
            access OUT_VeDCAB_e_IOControl_IOCD006_HigVolCooHeater_Op_Value: accessed-variable=VeDCAB_e_IOControl_IOCD006_HigVolCooHeater_Op.Value
        DataServices_IOCD006_Data_ReadData
        DataServices_IOCD006_Data_SA
          data-send-points:
            access OUT_VeDCAB_W_IOCD006_HigVolCooHeater_Value: accessed-variable=VeDCAB_W_IOCD006_HigVolCooHeater.Value
            access OUT_VeDCAB_e_IOControl_IOCD006_HigVolCooHeater_Op_Value: accessed-variable=VeDCAB_e_IOControl_IOCD006_HigVolCooHeater_Op.Value
        DataServices_IOCD007_Data_RC
          data-send-points:
            access OUT_VeDCAB_b_IOCD007_ChlrRfgtShtoff_VlvCmd_Value: accessed-variable=VeDCAB_b_IOCD007_ChlrRfgtShtoff_VlvCmd.Value
            access OUT_VeDCAB_e_IOControl_IOCD007_ChlrRfgtShtoff_VlvCmd_Op_Value: accessed-variable=VeDCAB_e_IOControl_IOCD007_ChlrRfgtShtoff_VlvCmd_Op.Value
        DataServices_IOCD007_Data_ReadData
        DataServices_IOCD007_Data_SA
          data-send-points:
            access OUT_VeDCAB_b_IOCD007_ChlrRfgtShtoff_VlvCmd_Value: accessed-variable=VeDCAB_b_IOCD007_ChlrRfgtShtoff_VlvCmd.Value
            access OUT_VeDCAB_e_IOControl_IOCD007_ChlrRfgtShtoff_VlvCmd_Op_Value: accessed-variable=VeDCAB_e_IOControl_IOCD007_ChlrRfgtShtoff_VlvCmd_Op.Value
        DataServices_IOCD00D_Data_RC
          data-send-points:
            access OUT_VeDCAB_Pct_IOCD00D_HigTemAuxPump_Value: accessed-variable=VeDCAB_Pct_IOCD00D_HigTemAuxPump.Value
            access OUT_VeDCAB_e_IOControl_IOCD00D_HigTemAuxPump_Op_Value: accessed-variable=VeDCAB_e_IOControl_IOCD00D_HigTemAuxPump_Op.Value
        DataServices_IOCD00D_Data_RD
          data-send-points:
            access OUT_VeDCAB_Pct_IOCD00D_HigTemAuxPump_Value: accessed-variable=VeDCAB_Pct_IOCD00D_HigTemAuxPump.Value
            access OUT_VeDCAB_e_IOControl_IOCD00D_HigTemAuxPump_Op_Value: accessed-variable=VeDCAB_e_IOControl_IOCD00D_HigTemAuxPump_Op.Value
        DataServices_IOCD00D_Data_ReadData
        DataServices_IOCD00D_Data_SA
          data-send-points:
            access OUT_VeDCAB_Pct_IOCD00D_HigTemAuxPump_Value: accessed-variable=VeDCAB_Pct_IOCD00D_HigTemAuxPump.Value
            access OUT_VeDCAB_e_IOControl_IOCD00D_HigTemAuxPump_Op_Value: accessed-variable=VeDCAB_e_IOControl_IOCD00D_HigTemAuxPump_Op.Value
        DataServices_IOCD012_Data_RC
          data-send-points:
            access OUT_VeDCAB_y_IOCtrlD012APMSts_Value: accessed-variable=VeDCAB_y_IOCtrlD012APMSts.Value
            access OUT_VeDCAB_e_IOControl_APM_Status_Op_Value: accessed-variable=VeDCAB_e_IOControl_APM_Status_Op.Value
        DataServices_IOCD012_Data_ReadData
        DataServices_IOCD012_Data_SA
          data-send-points:
            access OUT_VeDCAB_y_IOCtrlD012APMSts_Value: accessed-variable=VeDCAB_y_IOCtrlD012APMSts.Value
            access OUT_VeDCAB_e_IOControl_APM_Status_Op_Value: accessed-variable=VeDCAB_e_IOControl_APM_Status_Op.Value
        DataServices_IOCD013_Data_RC
          data-send-points:
            access OUT_VeDCAB_n_IOCD013_CompSpdTgt_Value: accessed-variable=VeDCAB_n_IOCD013_CompSpdTgt.Value
            access OUT_VeDCAB_e_IOControl_IOCD013_CompSpdTgt_Op_Value: accessed-variable=VeDCAB_e_IOControl_IOCD013_CompSpdTgt_Op.Value
        DataServices_IOCD013_Data_RD
          data-send-points:
            access OUT_VeDCAB_n_IOCD013_CompSpdTgt_Value: accessed-variable=VeDCAB_n_IOCD013_CompSpdTgt.Value
            access OUT_VeDCAB_e_IOControl_IOCD013_CompSpdTgt_Op_Value: accessed-variable=VeDCAB_e_IOControl_IOCD013_CompSpdTgt_Op.Value
        DataServices_IOCD013_Data_ReadData
        DataServices_IOCD013_Data_SA
          data-send-points:
            access OUT_VeDCAB_n_IOCD013_CompSpdTgt_Value: accessed-variable=VeDCAB_n_IOCD013_CompSpdTgt.Value
            access OUT_VeDCAB_e_IOControl_IOCD013_CompSpdTgt_Op_Value: accessed-variable=VeDCAB_e_IOControl_IOCD013_CompSpdTgt_Op.Value
        DataServices_IOCD014_Data_RC
          data-send-points:
            access OUT_VeDCAB_b_IOCtrlD014ChargePortRq_Value: accessed-variable=VeDCAB_b_IOCtrlD014ChargePortRq.Value
            access OUT_VeDCAB_e_IOControl_Charge_Port_Lock_Op_Value: accessed-variable=VeDCAB_e_IOControl_Charge_Port_Lock_Op.Value
        DataServices_IOCD014_Data_RD
          data-send-points:
            access OUT_VeDCAB_b_IOCtrlD014ChargePortRq_Value: accessed-variable=VeDCAB_b_IOCtrlD014ChargePortRq.Value
            access OUT_VeDCAB_e_IOControl_Charge_Port_Lock_Op_Value: accessed-variable=VeDCAB_e_IOControl_Charge_Port_Lock_Op.Value
        DataServices_IOCD014_Data_ReadData
          data-receive-point-by-arguments:
            access IN_VeCITR_b_ChrgPortLockSts_Value: accessed-variable=VeCITR_b_ChrgPortLockSts.Value
            access IN_VeCITR_b_DVC_ChrgPortRq_Value: accessed-variable=VeCITR_b_DVC_ChrgPortRq.Value
            access IN_VeCITR_b_PortLockBCM_Cmd_Value: accessed-variable=VeCITR_b_PortLockBCM_Cmd.Value
        DataServices_IOCD014_Data_SA
          data-send-points:
            access OUT_VeDCAB_b_IOCtrlD014ChargePortRq_Value: accessed-variable=VeDCAB_b_IOCtrlD014ChargePortRq.Value
            access OUT_VeDCAB_e_IOControl_Charge_Port_Lock_Op_Value: accessed-variable=VeDCAB_e_IOControl_Charge_Port_Lock_Op.Value
        DataServices_IOCD016_Data_RC
          data-send-points:
            access OUT_VeDCAB_Pct_IOCD016_MtrElecCoolPmpA_Value: accessed-variable=VeDCAB_Pct_IOCD016_MtrElecCoolPmpA.Value
            access OUT_VeDCAB_e_IOControl_IOCD016_MtrElecCoolPmpA_Op_Value: accessed-variable=VeDCAB_e_IOControl_IOCD016_MtrElecCoolPmpA_Op.Value
        DataServices_IOCD016_Data_ReadData
        DataServices_IOCD016_Data_SA
          data-send-points:
            access OUT_VeDCAB_Pct_IOCD016_MtrElecCoolPmpA_Value: accessed-variable=VeDCAB_Pct_IOCD016_MtrElecCoolPmpA.Value
            access OUT_VeDCAB_e_IOControl_IOCD016_MtrElecCoolPmpA_Op_Value: accessed-variable=VeDCAB_e_IOControl_IOCD016_MtrElecCoolPmpA_Op.Value
        DataServices_IOCD017_Data_RC
          data-send-points:
            access OUT_VeDCAB_Pct_IOCD017_MtrElecCoolPmpB_Value: accessed-variable=VeDCAB_Pct_IOCD017_MtrElecCoolPmpB.Value
            access OUT_VeDCAB_e_IOControl_IOCD017_MtrElecCoolPmpB_Op_Value: accessed-variable=VeDCAB_e_IOControl_IOCD017_MtrElecCoolPmpB_Op.Value
        DataServices_IOCD017_Data_RD
          data-send-points:
            access OUT_VeDCAB_Pct_IOCD017_MtrElecCoolPmpB_Value: accessed-variable=VeDCAB_Pct_IOCD017_MtrElecCoolPmpB.Value
            access OUT_VeDCAB_e_IOControl_IOCD017_MtrElecCoolPmpB_Op_Value: accessed-variable=VeDCAB_e_IOControl_IOCD017_MtrElecCoolPmpB_Op.Value
        DataServices_IOCD017_Data_ReadData
        DataServices_IOCD017_Data_SA
          data-send-points:
            access OUT_VeDCAB_Pct_IOCD017_MtrElecCoolPmpB_Value: accessed-variable=VeDCAB_Pct_IOCD017_MtrElecCoolPmpB.Value
            access OUT_VeDCAB_e_IOControl_IOCD017_MtrElecCoolPmpB_Op_Value: accessed-variable=VeDCAB_e_IOControl_IOCD017_MtrElecCoolPmpB_Op.Value
        DataServices_IOCD019_Data_RC
          data-send-points:
            access OUT_VeDCAB_Pct_IOCD019_BatteryCoolPump_Value: accessed-variable=VeDCAB_Pct_IOCD019_BatteryCoolPump.Value
            access OUT_VeDCAB_e_IOControl_IOCD019_BatteryCoolPump_Op_Value: accessed-variable=VeDCAB_e_IOControl_IOCD019_BatteryCoolPump_Op.Value
        DataServices_IOCD019_Data_RD
          data-send-points:
            access OUT_VeDCAB_Pct_IOCD019_BatteryCoolPump_Value: accessed-variable=VeDCAB_Pct_IOCD019_BatteryCoolPump.Value
            access OUT_VeDCAB_e_IOControl_IOCD019_BatteryCoolPump_Op_Value: accessed-variable=VeDCAB_e_IOControl_IOCD019_BatteryCoolPump_Op.Value
        DataServices_IOCD019_Data_ReadData
        DataServices_IOCD019_Data_SA
          data-send-points:
            access OUT_VeDCAB_Pct_IOCD019_BatteryCoolPump_Value: accessed-variable=VeDCAB_Pct_IOCD019_BatteryCoolPump.Value
            access OUT_VeDCAB_e_IOControl_IOCD019_BatteryCoolPump_Op_Value: accessed-variable=VeDCAB_e_IOControl_IOCD019_BatteryCoolPump_Op.Value
        DataServices_IOCD01A_Data_RC
          data-send-points:
            access OUT_VeDCAB_W_IOCD01A_BatCooHea_Value: accessed-variable=VeDCAB_W_IOCD01A_BatCooHea.Value
            access OUT_VeDCAB_e_IOControl_IOCD01A_BatCooHea_Op_Value: accessed-variable=VeDCAB_e_IOControl_IOCD01A_BatCooHea_Op.Value
        DataServices_IOCD01A_Data_RD
          data-send-points:
            access OUT_VeDCAB_W_IOCD01A_BatCooHea_Value: accessed-variable=VeDCAB_W_IOCD01A_BatCooHea.Value
            access OUT_VeDCAB_e_IOControl_IOCD01A_BatCooHea_Op_Value: accessed-variable=VeDCAB_e_IOControl_IOCD01A_BatCooHea_Op.Value
        DataServices_IOCD01A_Data_ReadData
        DataServices_IOCD01A_Data_SA
          data-send-points:
            access OUT_VeDCAB_W_IOCD01A_BatCooHea_Value: accessed-variable=VeDCAB_W_IOCD01A_BatCooHea.Value
            access OUT_VeDCAB_e_IOControl_IOCD01A_BatCooHea_Op_Value: accessed-variable=VeDCAB_e_IOControl_IOCD01A_BatCooHea_Op.Value
        DataServices_IOCD01C_Data_RC
          data-send-points:
            access OUT_VeDCAB_Pct_IOCDOIC_PropSysCoolCntrlValvA_Value: accessed-variable=VeDCAB_Pct_IOCDOIC_PropSysCoolCntrlValvA.Value
            access OUT_VeDCAB_e_IOControl_IOCDOIC_PropSysCoolCntrlValvA_Op_Value: accessed-variable=VeDCAB_e_IOControl_IOCDOIC_PropSysCoolCntrlValvA_Op.Value
        DataServices_IOCD01C_Data_ReadData
        DataServices_IOCD01C_Data_SA
          data-send-points:
            access OUT_VeDCAB_Pct_IOCDOIC_PropSysCoolCntrlValvA_Value: accessed-variable=VeDCAB_Pct_IOCDOIC_PropSysCoolCntrlValvA.Value
            access OUT_VeDCAB_e_IOControl_IOCDOIC_PropSysCoolCntrlValvA_Op_Value: accessed-variable=VeDCAB_e_IOControl_IOCDOIC_PropSysCoolCntrlValvA_Op.Value
        DataServices_IOCD01E_Data_RC
          data-send-points:
            access OUT_VeDCAB_Pct_IOCD01E_AirHeaCon_Value: accessed-variable=VeDCAB_Pct_IOCD01E_AirHeaCon.Value
            access OUT_VeDCAB_e_IOControl_IOCD01E_AirHeaCon_Op_Value: accessed-variable=VeDCAB_e_IOControl_IOCD01E_AirHeaCon_Op.Value
        DataServices_IOCD01E_Data_ReadData
        DataServices_IOCD01E_Data_SA
          data-send-points:
            access OUT_VeDCAB_Pct_IOCD01E_AirHeaCon_Value: accessed-variable=VeDCAB_Pct_IOCD01E_AirHeaCon.Value
            access OUT_VeDCAB_e_IOControl_IOCD01E_AirHeaCon_Op_Value: accessed-variable=VeDCAB_e_IOControl_IOCD01E_AirHeaCon_Op.Value
        DataServices_IOCD01F_Data_RC
          data-send-points:
            access OUT_VeDCAB_Pct_IOCD01F_ACRefrExpValvActACntrl_Value: accessed-variable=VeDCAB_Pct_IOCD01F_ACRefrExpValvActACntrl.Value
            access OUT_VeDCAB_e_IOControl_IOCD01F_ACRefrExpValvActACntrl_Op_Value: accessed-variable=VeDCAB_e_IOControl_IOCD01F_ACRefrExpValvActACntrl_Op.Value
        DataServices_IOCD01F_Data_RD
          data-send-points:
            access OUT_VeDCAB_Pct_IOCD01F_ACRefrExpValvActACntrl_Value: accessed-variable=VeDCAB_Pct_IOCD01F_ACRefrExpValvActACntrl.Value
            access OUT_VeDCAB_e_IOControl_IOCD01F_ACRefrExpValvActACntrl_Op_Value: accessed-variable=VeDCAB_e_IOControl_IOCD01F_ACRefrExpValvActACntrl_Op.Value
        DataServices_IOCD01F_Data_ReadData
        DataServices_IOCD01F_Data_SA
          data-send-points:
            access OUT_VeDCAB_Pct_IOCD01F_ACRefrExpValvActACntrl_Value: accessed-variable=VeDCAB_Pct_IOCD01F_ACRefrExpValvActACntrl.Value
            access OUT_VeDCAB_e_IOControl_IOCD01F_ACRefrExpValvActACntrl_Op_Value: accessed-variable=VeDCAB_e_IOControl_IOCD01F_ACRefrExpValvActACntrl_Op.Value
        DataServices_IOCD022_Data_RC
          data-send-points:
            access OUT_VeDCAB_Pct_IOCD022_PropSysCoolCntrlValvB_Value: accessed-variable=VeDCAB_Pct_IOCD022_PropSysCoolCntrlValvB.Value
            access OUT_VeDCAB_e_IOControl_IOCD022_PropSysCoolCntrlValvB_Op_Value: accessed-variable=VeDCAB_e_IOControl_IOCD022_PropSysCoolCntrlValvB_Op.Value
        DataServices_IOCD022_Data_ReadData
        DataServices_IOCD022_Data_SA
          data-send-points:
            access OUT_VeDCAB_Pct_IOCD022_PropSysCoolCntrlValvB_Value: accessed-variable=VeDCAB_Pct_IOCD022_PropSysCoolCntrlValvB.Value
            access OUT_VeDCAB_e_IOControl_IOCD022_PropSysCoolCntrlValvB_Op_Value: accessed-variable=VeDCAB_e_IOControl_IOCD022_PropSysCoolCntrlValvB_Op.Value
        DataServices_IOCD023_Data_RC
          data-send-points:
            access OUT_VeDCAB_Pct_IOCD023_PropSysCoolCntrlValvC_Value: accessed-variable=VeDCAB_Pct_IOCD023_PropSysCoolCntrlValvC.Value
            access OUT_VeDCAB_e_IOControl_IOCD023_PropSysCoolCntrlValvC_Op_Value: accessed-variable=VeDCAB_e_IOControl_IOCD023_PropSysCoolCntrlValvC_Op.Value
        DataServices_IOCD023_Data_ReadData
        DataServices_IOCD023_Data_SA
          data-send-points:
            access OUT_VeDCAB_Pct_IOCD023_PropSysCoolCntrlValvC_Value: accessed-variable=VeDCAB_Pct_IOCD023_PropSysCoolCntrlValvC.Value
            access OUT_VeDCAB_e_IOControl_IOCD023_PropSysCoolCntrlValvC_Op_Value: accessed-variable=VeDCAB_e_IOControl_IOCD023_PropSysCoolCntrlValvC_Op.Value
        DataServices_IOCD025_Data_RC
          data-send-points:
            access OUT_VeDCAB_e_IOCD025_AGS_PstnCmnd_Value: accessed-variable=VeDCAB_e_IOCD025_AGS_PstnCmnd.Value
            access OUT_VeDCAB_e_IOControl_IOCD025_AGS_PstnCmnd_Op_Value: accessed-variable=VeDCAB_e_IOControl_IOCD025_AGS_PstnCmnd_Op.Value
        DataServices_IOCD025_Data_ReadData
        DataServices_IOCD025_Data_SA
          data-send-points:
            access OUT_VeDCAB_e_IOCD025_AGS_PstnCmnd_Value: accessed-variable=VeDCAB_e_IOCD025_AGS_PstnCmnd.Value
            access OUT_VeDCAB_e_IOControl_IOCD025_AGS_PstnCmnd_Op_Value: accessed-variable=VeDCAB_e_IOControl_IOCD025_AGS_PstnCmnd_Op.Value
        DataServices_IOCD026_Data_RC
          data-send-points:
            access OUT_VeDCAB_e_IOCD026_AGS2_PstnCmnd_Value: accessed-variable=VeDCAB_e_IOCD026_AGS2_PstnCmnd.Value
            access OUT_VeDCAB_e_IOControl_IOCD026_AGS2_PstnCmnd_Op_Value: accessed-variable=VeDCAB_e_IOControl_IOCD026_AGS2_PstnCmnd_Op.Value
        DataServices_IOCD026_Data_ReadData
        DataServices_IOCD026_Data_SA
          data-send-points:
            access OUT_VeDCAB_e_IOCD026_AGS2_PstnCmnd_Value: accessed-variable=VeDCAB_e_IOCD026_AGS2_PstnCmnd.Value
            access OUT_VeDCAB_e_IOControl_IOCD026_AGS2_PstnCmnd_Op_Value: accessed-variable=VeDCAB_e_IOControl_IOCD026_AGS2_PstnCmnd_Op.Value
        DataServices_IOCD027_Data_RC
          data-send-points:
            access OUT_VeDCAB_n_IOCD027_PowOilPumACon_Pump_Speed_Value: accessed-variable=VeDCAB_n_IOCD027_PowOilPumACon_Pump_Speed.Value
            access OUT_VeDCAB_e_IOControl_IOCD027_PowOilPumACon_Pump_Speed_Op_Value: accessed-variable=VeDCAB_e_IOControl_IOCD027_PowOilPumACon_Pump_Speed_Op.Value
        DataServices_IOCD027_Data_ReadData
        DataServices_IOCD027_Data_SA
          data-send-points:
            access OUT_VeDCAB_n_IOCD027_PowOilPumACon_Pump_Speed_Value: accessed-variable=VeDCAB_n_IOCD027_PowOilPumACon_Pump_Speed.Value
            access OUT_VeDCAB_e_IOControl_IOCD027_PowOilPumACon_Pump_Speed_Op_Value: accessed-variable=VeDCAB_e_IOControl_IOCD027_PowOilPumACon_Pump_Speed_Op.Value
        DataServices_IOCD028_Data_Freeze
          data-send-points:
            access OUT_VeDCAB_n_IOCD028_PowOilPumBCon_Pump_Speed_Value: accessed-variable=VeDCAB_n_IOCD028_PowOilPumBCon_Pump_Speed.Value
            access OUT_VeDCAB_e_IOControl_IOCD028_PowOilPumBCon_Pump_Speed_Op_Value: accessed-variable=VeDCAB_e_IOControl_IOCD028_PowOilPumBCon_Pump_Speed_Op.Value
        DataServices_IOCD028_Data_RC
          data-send-points:
            access OUT_VeDCAB_n_IOCD028_PowOilPumBCon_Pump_Speed_Value: accessed-variable=VeDCAB_n_IOCD028_PowOilPumBCon_Pump_Speed.Value
            access OUT_VeDCAB_e_IOControl_IOCD028_PowOilPumBCon_Pump_Speed_Op_Value: accessed-variable=VeDCAB_e_IOControl_IOCD028_PowOilPumBCon_Pump_Speed_Op.Value
        DataServices_IOCD028_Data_ReadData
        DataServices_IOCD028_Data_SA
          data-send-points:
            access OUT_VeDCAB_n_IOCD028_PowOilPumBCon_Pump_Speed_Value: accessed-variable=VeDCAB_n_IOCD028_PowOilPumBCon_Pump_Speed.Value
            access OUT_VeDCAB_e_IOControl_IOCD028_PowOilPumBCon_Pump_Speed_Op_Value: accessed-variable=VeDCAB_e_IOControl_IOCD028_PowOilPumBCon_Pump_Speed_Op.Value
        DataServices_IOCD030_Data_RC
          data-send-points:
            access OUT_VeDCAB_e_IOCD030_ActAirDamCon_Value: accessed-variable=VeDCAB_e_IOCD030_ActAirDamCon.Value
            access OUT_VeDCAB_e_IOControl_IOCD030_ActAirDamCon_Op_Value: accessed-variable=VeDCAB_e_IOControl_IOCD030_ActAirDamCon_Op.Value
        DataServices_IOCD030_Data_ReadData
        DataServices_IOCD030_Data_SA
          data-send-points:
            access OUT_VeDCAB_e_IOCD030_ActAirDamCon_Value: accessed-variable=VeDCAB_e_IOCD030_ActAirDamCon.Value
            access OUT_VeDCAB_e_IOControl_IOCD030_ActAirDamCon_Op_Value: accessed-variable=VeDCAB_e_IOControl_IOCD030_ActAirDamCon_Op.Value
        DataServices_IOCD031_Data_RC
          data-send-points:
            access OUT_VeDCAB_Pct_IOCD031_ACRefrExpValvActACntrl_Value: accessed-variable=VeDCAB_Pct_IOCD031_ACRefrExpValvActACntrl.Value
            access OUT_VeDCAB_e_IOControl_IOCD031_ACRefrExpValvActACntrl_Op_Value: accessed-variable=VeDCAB_e_IOControl_IOCD031_ACRefrExpValvActACntrl_Op.Value
        DataServices_IOCD031_Data_ReadData
        DataServices_IOCD031_Data_SA
          data-send-points:
            access OUT_VeDCAB_Pct_IOCD031_ACRefrExpValvActACntrl_Value: accessed-variable=VeDCAB_Pct_IOCD031_ACRefrExpValvActACntrl.Value
            access OUT_VeDCAB_e_IOControl_IOCD031_ACRefrExpValvActACntrl_Op_Value: accessed-variable=VeDCAB_e_IOControl_IOCD031_ACRefrExpValvActACntrl_Op.Value
        DataServices_IOCD032_Data_RC
          data-send-points:
            access OUT_VeDCAB_Pct_IOCD032_ACRefrExpValvActCCntrl_Value: accessed-variable=VeDCAB_Pct_IOCD032_ACRefrExpValvActCCntrl.Value
            access OUT_VeDCAB_e_IOControl_IOCD032_ACRefrExpValvActCCntrl_Op_Value: accessed-variable=VeDCAB_e_IOControl_IOCD032_ACRefrExpValvActCCntrl_Op.Value
        DataServices_IOCD032_Data_RD
          data-send-points:
            access OUT_VeDCAB_Pct_IOCD032_ACRefrExpValvActCCntrl_Value: accessed-variable=VeDCAB_Pct_IOCD032_ACRefrExpValvActCCntrl.Value
            access OUT_VeDCAB_e_IOControl_IOCD032_ACRefrExpValvActCCntrl_Op_Value: accessed-variable=VeDCAB_e_IOControl_IOCD032_ACRefrExpValvActCCntrl_Op.Value
        DataServices_IOCD032_Data_ReadData
        DataServices_IOCD032_Data_SA
          data-send-points:
            access OUT_VeDCAB_Pct_IOCD032_ACRefrExpValvActCCntrl_Value: accessed-variable=VeDCAB_Pct_IOCD032_ACRefrExpValvActCCntrl.Value
            access OUT_VeDCAB_e_IOControl_IOCD032_ACRefrExpValvActCCntrl_Op_Value: accessed-variable=VeDCAB_e_IOControl_IOCD032_ACRefrExpValvActCCntrl_Op.Value
        DataServices_IOCD033_Data_RC
          data-send-points:
            access OUT_VeDCAB_Pct_IOCD033_ACRefrExpValvActDCntrl_Value: accessed-variable=VeDCAB_Pct_IOCD033_ACRefrExpValvActDCntrl.Value
            access OUT_VeDCAB_e_IOControl_IOCD033_ACRefrExpValvActDCntrl_Op_Value: accessed-variable=VeDCAB_e_IOControl_IOCD033_ACRefrExpValvActDCntrl_Op.Value
        DataServices_IOCD033_Data_RD
          data-send-points:
            access OUT_VeDCAB_Pct_IOCD033_ACRefrExpValvActDCntrl_Value: accessed-variable=VeDCAB_Pct_IOCD033_ACRefrExpValvActDCntrl.Value
            access OUT_VeDCAB_e_IOControl_IOCD033_ACRefrExpValvActDCntrl_Op_Value: accessed-variable=VeDCAB_e_IOControl_IOCD033_ACRefrExpValvActDCntrl_Op.Value
        DataServices_IOCD033_Data_ReadData
        DataServices_IOCD033_Data_SA
          data-send-points:
            access OUT_VeDCAB_Pct_IOCD033_ACRefrExpValvActDCntrl_Value: accessed-variable=VeDCAB_Pct_IOCD033_ACRefrExpValvActDCntrl.Value
            access OUT_VeDCAB_e_IOControl_IOCD033_ACRefrExpValvActDCntrl_Op_Value: accessed-variable=VeDCAB_e_IOControl_IOCD033_ACRefrExpValvActDCntrl_Op.Value
        DataServices_IOCD043_Data_RC
          data-send-points:
            access OUT_VeDCAB_Pct_IOCD043_PWMElectricOilPump_Value: accessed-variable=VeDCAB_Pct_IOCD043_PWMElectricOilPump.Value
            access OUT_VeDCAB_e_IOControl_IOCD043_PWMElectricOilPump_Op_Value: accessed-variable=VeDCAB_e_IOControl_IOCD043_PWMElectricOilPump_Op.Value
        DataServices_IOCD043_Data_ReadData
        DataServices_IOCD043_Data_SA
          data-send-points:
            access OUT_VeDCAB_Pct_IOCD043_PWMElectricOilPump_Value: accessed-variable=VeDCAB_Pct_IOCD043_PWMElectricOilPump.Value
            access OUT_VeDCAB_e_IOControl_IOCD043_PWMElectricOilPump_Op_Value: accessed-variable=VeDCAB_e_IOControl_IOCD043_PWMElectricOilPump_Op.Value
        DataServices_RD0306_Data_ReadData
          data-receive-point-by-arguments:
            access IN_VeAPSR_U_RawPVS1_Value: accessed-variable=VeAPSR_U_RawPVS1.Value
        DataServices_RD0307_Data_ReadData
          data-receive-point-by-arguments:
            access IN_VeAPSR_U_RawPVS2_Value: accessed-variable=VeAPSR_U_RawPVS2.Value
        DataServices_RD0507_Data_ReadData
          data-receive-point-by-arguments:
            access IN_VeSRAR_b_HybPwrtrnRdcdPerfCmnd_Value: accessed-variable=VeSRAR_b_HybPwrtrnRdcdPerfCmnd.Value
        DataServices_RD0800_Data_ReadData
          data-receive-point-by-arguments:
            access IN_VeSTRR_g_AStpInhbtRsn_Value: accessed-variable=VeSTRR_g_AStpInhbtRsn.Value
        DataServices_RD0801_Data_ReadData
          data-receive-point-by-arguments:
            access IN_VeSTRR_g_StrtDisAllowRsn_Value: accessed-variable=VeSTRR_g_StrtDisAllowRsn.Value
        DataServices_RD0802_Data_ReadData
          data-receive-point-by-arguments:
            access IN_VeSRAR_y_RemedialActionHist_Value: accessed-variable=VeSRAR_y_RemedialActionHist.Value
        DataServices_RD0803_Data_ReadData
          data-receive-point-by-arguments:
            access IN_VeESSR_g_StrtStpFailRsn_Value: accessed-variable=VeESSR_g_StrtStpFailRsn.Value
        DataServices_RD0804_Data_ReadData
          data-receive-point-by-arguments:
            access IN_VeSTRR_g_ImmedStopRsn_Value: accessed-variable=VeSTRR_g_ImmedStopRsn.Value
        DataServices_RD0805_Data_ReadData
          data-receive-point-by-arguments:
            access IN_VeSTRR_g_AStpInhbtRsn2_Value: accessed-variable=VeSTRR_g_AStpInhbtRsn2.Value
        DataServices_RD1000_Data_ReadData
          data-receive-point-by-arguments:
            access IN_VeESPR_n_EngineSpeed_MCP_Value: accessed-variable=VeESPR_n_EngineSpeed_MCP.Value
        DataServices_RD1002_Data_ReadData
          data-receive-point-by-arguments:
            access IN_VeCSVR_v_VehSpd_Value: accessed-variable=VeCSVR_v_VehSpd.Value
        DataServices_RD1004_Data_ReadData
          data-receive-point-by-arguments:
            access IN_VePMDB_U_BF1_SysVolt_Value: accessed-variable=VePMDB_U_BF1_SysVolt.Value
            access IN_VePMDB_U_BF2_SysVolt_Value: accessed-variable=VePMDB_U_BF2_SysVolt.Value
        DataServices_RD1927_Data_ReadData
          data-receive-point-by-arguments:
            7 x access:
              IN_VeASLR_b_SpdLmtrOnOffSts_Value: accessed-variable=VeASLR_b_SpdLmtrOnOffSts.Value
              IN_VeCCTR_b_CcAccelSts_Value: accessed-variable=VeCCTR_b_CcAccelSts.Value
              IN_VeCCTR_b_CcCancelSw_Value: accessed-variable=VeCCTR_b_CcCancelSw.Value
              IN_VeCCTR_b_CcDecelSts_Value: accessed-variable=VeCCTR_b_CcDecelSts.Value
              IN_VeCCTR_b_CcOnOffSts_Value: accessed-variable=VeCCTR_b_CcOnOffSts.Value
              IN_VeCCTR_b_CcResumeSw_Value: accessed-variable=VeCCTR_b_CcResumeSw.Value
              IN_VePLTR_b_ACC_On_Value: accessed-variable=VePLTR_b_ACC_On.Value
        DataServices_RD19B0_Data_ReadData
          data-receive-point-by-arguments:
            access IN_VeASLR_v_SetVehSpdLimKPH_Value: accessed-variable=VeASLR_v_SetVehSpdLimKPH.Value
        DataServices_RD19B1_Data_ReadData
          data-receive-point-by-arguments:
            access IN_VeASLR_e_SpdLmtSts_Value: accessed-variable=VeASLR_e_SpdLmtSts.Value
        DataServices_RD19B2_Data_ReadData
          data-receive-point-by-arguments:
            access IN_VeCCTR_b_CcFailSts_Value: accessed-variable=VeCCTR_b_CcFailSts.Value
            access IN_VeCSVR_b_VehSpdVSOSigFailSts_Value: accessed-variable=VeCSVR_b_VehSpdVSOSigFailSts.Value
        DataServices_RD19B3_Data_ReadData
          data-receive-point-by-arguments:
            4 x access:
              IN_VeCCTR_b_Lv1CrusSwStuckFailed_Value: accessed-variable=VeCCTR_b_Lv1CrusSwStuckFailed.Value
              IN_VeSR1B_y_CruiseControlFailSts_SigSts_Value: accessed-variable=VeSR1B_y_CruiseControlFailSts_SigSts.Value
              IN_VeSR1B_y_VehicleSpeedVSOSig_FD3_SigSts_Value: accessed-variable=VeSR1B_y_VehicleSpeedVSOSig_FD3_SigSts.Value
              IN_VeSRMR_b_Lv2AccelPdlPosFlt_Value: accessed-variable=VeSRMR_b_Lv2AccelPdlPosFlt.Value
        DataServices_RD201E_Data_ReadData
          data-receive-point-by-arguments:
            access IN_VeAATR_T_CBC_AmbAirTempRaw_Value: accessed-variable=VeAATR_T_CBC_AmbAirTempRaw.Value
        DataServices_RD2500_Data_ReadData
          data-receive-point-by-arguments:
            access IN_VeBRKR_Pct_BrkTravelSts_Value: accessed-variable=VeBRKR_Pct_BrkTravelSts.Value
            access IN_VeBRKR_e_BrkPedalDscrtInpt_Value: accessed-variable=VeBRKR_e_BrkPedalDscrtInpt.Value
        DataServices_RD2505_Data_ReadData
          data-receive-point-by-arguments:
            access IN_VeHMIR_e_ShifterPOS_Value: accessed-variable=VeHMIR_e_ShifterPOS.Value
        DataServices_RD2518_Data_ReadData
          data-receive-point-by-arguments:
            access IN_VePPCR_e_PPawlFdbck_Value: accessed-variable=VePPCR_e_PPawlFdbck.Value
        DataServices_RD2801_Data_ReadData
          data-receive-point-by-arguments:
            access IN_VeTRGR_y_PRNDLTestFailStatus_Value: accessed-variable=VeTRGR_y_PRNDLTestFailStatus.Value
        DataServices_RD2802_Data_ReadData
          data-receive-point-by-arguments:
            access IN_VePMDR_e_KeyStatus_Value: accessed-variable=VePMDR_e_KeyStatus.Value
        DataServices_RD2949_Data_ReadData
          data-receive-point-by-arguments:
            access IN_VePLTR_e_ShippingMode_Value: accessed-variable=VePLTR_e_ShippingMode.Value
        DataServices_RD3004_Data_ReadData
          data-receive-point-by-arguments:
            access IN_VePWDR_Cnt_DAP_FA_KeyCylCnt_Value: accessed-variable=VePWDR_Cnt_DAP_FA_KeyCylCnt.Value
            access IN_VePWDR_l_DAP_FA_DistTravld_Value: accessed-variable=VePWDR_l_DAP_FA_DistTravld.Value
            access IN_VePWDR_t_DAP_FA_ElapsedTime_Value: accessed-variable=VePWDR_t_DAP_FA_ElapsedTime.Value
        DataServices_RD3027_Data_ReadData
          data-receive-point-by-arguments:
            access IN_VePLTR_milel_Odometer_Miles_Value: accessed-variable=VePLTR_milel_Odometer_Miles.Value
        DataServices_RD3028_Data_ReadData
          data-receive-point-by-arguments:
            access IN_VePLTR_milel_InPlntMileageLmt_Miles_Value: accessed-variable=VePLTR_milel_InPlntMileageLmt_Miles.Value
        DataServices_RD3035_Data_ReadData
          data-receive-point-by-arguments:
            access IN_VeRTMR_y_ElecOnlyTstCndtnCheck1_PID_Value: accessed-variable=VeRTMR_y_ElecOnlyTstCndtnCheck1_PID.Value
            access IN_VeRTMR_y_ElecOnlyTstCndtnCheck2_PID_Value: accessed-variable=VeRTMR_y_ElecOnlyTstCndtnCheck2_PID.Value
        DataServices_RD3036_Data_ReadData
          data-receive-point-by-arguments:
            access IN_VeRTMR_g_BSGRestartRsn_Value: accessed-variable=VeRTMR_g_BSGRestartRsn.Value
        DataServices_RD3200_Data_ReadData
          data-receive-point-by-arguments:
            11 x access:
              IN_VeIMOR_b_BCMFailedVerif_Value: accessed-variable=VeIMOR_b_BCMFailedVerif.Value
              IN_VeIMOR_b_BCMMiniKeyNotStoredRec_Value: accessed-variable=VeIMOR_b_BCMMiniKeyNotStoredRec.Value
              IN_VeIMOR_b_BCMNoENQpResponse_Value: accessed-variable=VeIMOR_b_BCMNoENQpResponse.Value
              IN_VeIMOR_b_BCMNoPRAorMiniKeyRec_Value: accessed-variable=VeIMOR_b_BCMNoPRAorMiniKeyRec.Value
              IN_VeIMOR_b_BCMNoSecondRespRec_Value: accessed-variable=VeIMOR_b_BCMNoSecondRespRec.Value
              IN_VeIMOR_b_BCMNoVerifResp_Value: accessed-variable=VeIMOR_b_BCMNoVerifResp.Value
              IN_VeIMOR_b_BCMRespBadG2Verify_Value: accessed-variable=VeIMOR_b_BCMRespBadG2Verify.Value
              IN_VeIMOR_b_BCMRespTENRec_Value: accessed-variable=VeIMOR_b_BCMRespTENRec.Value
              IN_VeIMOR_b_BCMRespTENVerify_Value: accessed-variable=VeIMOR_b_BCMRespTENVerify.Value
              IN_VeIMOR_b_BCMRespUCVerify_Value: accessed-variable=VeIMOR_b_BCMRespUCVerify.Value
              IN_VeIMOR_b_HCPNotProg_Value: accessed-variable=VeIMOR_b_HCPNotProg.Value
        DataServices_RD4000_Data_ReadData
          data-receive-point-by-arguments:
            access IN_VeTMIR_T_OnBrdChrg_ClntTmpIn_Value: accessed-variable=VeTMIR_T_OnBrdChrg_ClntTmpIn.Value
        DataServices_RD4001_Data_ReadData
          data-receive-point-by-arguments:
            access IN_VeTAIR_p_HghRfrgtPres_Value: accessed-variable=VeTAIR_p_HghRfrgtPres.Value
        DataServices_RD4002_Data_ReadData
          data-receive-point-by-arguments:
            access IN_VeTMIR_T_PsvPmpClnt_TmpIn_Value: accessed-variable=VeTMIR_T_PsvPmpClnt_TmpIn.Value
        DataServices_RD4004_Data_ReadData
          data-receive-point-by-arguments:
            access IN_VeTRIR_T_HtrCorClnt_TmpIn_Value: accessed-variable=VeTRIR_T_HtrCorClnt_TmpIn.Value
        DataServices_RD400A_Data_ReadData
          data-receive-point-by-arguments:
            access IN_VeTRIR_T_HV_BatClntTmp_In_Value: accessed-variable=VeTRIR_T_HV_BatClntTmp_In.Value
        DataServices_RD400C_Data_ReadData
          data-receive-point-by-arguments:
            access IN_VeTRIR_T_HV_BatClntTmpOut_Value: accessed-variable=VeTRIR_T_HV_BatClntTmpOut.Value
        DataServices_RD4010_Data_ReadData
          data-receive-point-by-arguments:
            access IN_VeTAIR_n_CompSpdFdb_Value: accessed-variable=VeTAIR_n_CompSpdFdb.Value
        DataServices_RD4011_Data_ReadData
          data-receive-point-by-arguments:
            access IN_VeTAIR_I_ACCElecCurr_Value: accessed-variable=VeTAIR_I_ACCElecCurr.Value
        DataServices_RD4012_Data_ReadData
          data-receive-point-by-arguments:
            access IN_VeTAIR_U_CompHVInp_Value: accessed-variable=VeTAIR_U_CompHVInp.Value
        DataServices_RD4013_Data_ReadData
          data-receive-point-by-arguments:
            access IN_VeTAIR_e_CompStat_Value: accessed-variable=VeTAIR_e_CompStat.Value
        DataServices_RD4014_Data_ReadData
          data-receive-point-by-arguments:
            access IN_VeTAIR_P_AC_CompElecPwr_Value: accessed-variable=VeTAIR_P_AC_CompElecPwr.Value
        DataServices_RD4015_Data_ReadData
          data-receive-point-by-arguments:
            access IN_VeTAIR_T_CompBoardTemp_Value: accessed-variable=VeTAIR_T_CompBoardTemp.Value
            access IN_VeTAIR_T_CompIGBTTemp_Value: accessed-variable=VeTAIR_T_CompIGBTTemp.Value
        DataServices_RD4016_Data_ReadData
          data-receive-point-by-arguments:
            access IN_VeTAIR_e_CompFltStat_Value: accessed-variable=VeTAIR_e_CompFltStat.Value
        DataServices_RD401C_Data_ReadData
          data-receive-point-by-arguments:
            13 x access:
              IN_VeTAIR_Pct_FrWyVlv_PstnAct_Value: accessed-variable=VeTAIR_Pct_FrWyVlv_PstnAct.Value
              IN_VeTAIR_U_FrWyVlv_MtrVltg_Value: accessed-variable=VeTAIR_U_FrWyVlv_MtrVltg.Value
              IN_VeTAIR_b_FrWyVlv_BlckPnt_Value: accessed-variable=VeTAIR_b_FrWyVlv_BlckPnt.Value
              IN_VeTAIR_b_FrWyVlv_Err_SNA_Value: accessed-variable=VeTAIR_b_FrWyVlv_Err_SNA.Value
              IN_VeTAIR_b_FrWyVlv_MechBrk_Value: accessed-variable=VeTAIR_b_FrWyVlv_MechBrk.Value
              IN_VeTAIR_b_FrWyVlv_OpnLd_Value: accessed-variable=VeTAIR_b_FrWyVlv_OpnLd.Value
              IN_VeTAIR_b_FrWyVlv_OvrCrnt_Value: accessed-variable=VeTAIR_b_FrWyVlv_OvrCrnt.Value
              IN_VeTAIR_b_FrWyVlv_OvrVltg_Value: accessed-variable=VeTAIR_b_FrWyVlv_OvrVltg.Value
              IN_VeTAIR_b_FrWyVlv_RsErr_Value: accessed-variable=VeTAIR_b_FrWyVlv_RsErr.Value
              IN_VeTAIR_b_FrWyVlv_ThrmlWrng_Value: accessed-variable=VeTAIR_b_FrWyVlv_ThrmlWrng.Value
              IN_VeTAIR_b_FrWyVlv_UndrVltg_Value: accessed-variable=VeTAIR_b_FrWyVlv_UndrVltg.Value
              IN_VeTAIR_e_FrWyVlv_CalSts_Value: accessed-variable=VeTAIR_e_FrWyVlv_CalSts.Value
              IN_VeTAIR_e_FrWyVlv_ErrSts_Value: accessed-variable=VeTAIR_e_FrWyVlv_ErrSts.Value
        DataServices_RD401F_Data_ReadData
          data-receive-point-by-arguments:
            10 x access:
              IN_VeTAIR_Pct_EXV_PosAct_Value: accessed-variable=VeTAIR_Pct_EXV_PosAct.Value
              IN_VeTAIR_T_EXV_BoardTemp_Value: accessed-variable=VeTAIR_T_EXV_BoardTemp.Value
              IN_VeTAIR_T_EXV_RefTemp_Value: accessed-variable=VeTAIR_T_EXV_RefTemp.Value
              IN_VeTAIR_U_EXV_SupplyVolt_Value: accessed-variable=VeTAIR_U_EXV_SupplyVolt.Value
              IN_VeTAIR_b_EXV_CalRq_Value: accessed-variable=VeTAIR_b_EXV_CalRq.Value
              IN_VeTAIR_b_EXV_RspErr_Value: accessed-variable=VeTAIR_b_EXV_RspErr.Value
              IN_VeTAIR_e_EXV_CalStat_Value: accessed-variable=VeTAIR_e_EXV_CalStat.Value
              IN_VeTAIR_e_EXV_Err_Value: accessed-variable=VeTAIR_e_EXV_Err.Value
              IN_VeTAIR_e_EXV_Sts_Value: accessed-variable=VeTAIR_e_EXV_Sts.Value
              IN_VeTAIR_p_EXV_RefPress_Value: accessed-variable=VeTAIR_p_EXV_RefPress.Value
        DataServices_RD4021_Data_ReadData
        DataServices_RD4036_Data_ReadData
          data-receive-point-by-arguments:
            17 x access:
              IN_VePMIR_I_LTPsvPumpCurrent_Value: accessed-variable=VePMIR_I_LTPsvPumpCurrent.Value
              IN_VePMIR_Pct_LTPsvPumpTgtSpd_Value: accessed-variable=VePMIR_Pct_LTPsvPumpTgtSpd.Value
              IN_VePMIR_T_LTPsvPumpTemp_Value: accessed-variable=VePMIR_T_LTPsvPumpTemp.Value
              IN_VePMIR_U_LTPsvPumpVltg_Value: accessed-variable=VePMIR_U_LTPsvPumpVltg.Value
              IN_VePMIR_b_LTPsvPumpRespErr_Value: accessed-variable=VePMIR_b_LTPsvPumpRespErr.Value
              IN_VePMIR_e_LTPsvPumpAirPresntErr_Value: accessed-variable=VePMIR_e_LTPsvPumpAirPresntErr.Value
              IN_VePMIR_e_LTPsvPumpDeblock_Value: accessed-variable=VePMIR_e_LTPsvPumpDeblock.Value
              IN_VePMIR_e_LTPsvPumpDryRun_Value: accessed-variable=VePMIR_e_LTPsvPumpDryRun.Value
              IN_VePMIR_e_LTPsvPumpFailsafe_Value: accessed-variable=VePMIR_e_LTPsvPumpFailsafe.Value
              IN_VePMIR_e_LTPsvPumpLmpHM_Value: accessed-variable=VePMIR_e_LTPsvPumpLmpHM.Value
              IN_VePMIR_e_LTPsvPumpMntrRPM_Value: accessed-variable=VePMIR_e_LTPsvPumpMntrRPM.Value
              IN_VePMIR_e_LTPsvPumpNodeErr_Value: accessed-variable=VePMIR_e_LTPsvPumpNodeErr.Value
              IN_VePMIR_e_LTPsvPumpOT_Value: accessed-variable=VePMIR_e_LTPsvPumpOT.Value
              IN_VePMIR_e_LTPsvPumpOverCurrent_Value: accessed-variable=VePMIR_e_LTPsvPumpOverCurrent.Value
              IN_VePMIR_e_LTPsvPumpSuppVltErr_Value: accessed-variable=VePMIR_e_LTPsvPumpSuppVltErr.Value
              IN_VePMPR_Pct_LTPsvPumpRPMAct_Value: accessed-variable=VePMPR_Pct_LTPsvPumpRPMAct.Value
              IN_VePMPR_e_LTPsvPump_PstRnSt_Value: accessed-variable=VePMPR_e_LTPsvPump_PstRnSt.Value
        DataServices_RD4037_Data_ReadData
          data-receive-point-by-arguments:
            17 x access:
              IN_VePMIR_I_LTPsvPump2Current_Value: accessed-variable=VePMIR_I_LTPsvPump2Current.Value
              IN_VePMIR_Pct_LTPsvPump2TgtSpd_Value: accessed-variable=VePMIR_Pct_LTPsvPump2TgtSpd.Value
              IN_VePMIR_T_LTPsvPump2Temp_Value: accessed-variable=VePMIR_T_LTPsvPump2Temp.Value
              IN_VePMIR_U_LTPsvPump2Vltg_Value: accessed-variable=VePMIR_U_LTPsvPump2Vltg.Value
              IN_VePMIR_b_LTPsvPump2RespErr_Value: accessed-variable=VePMIR_b_LTPsvPump2RespErr.Value
              IN_VePMIR_e_LTPsvPump2AirPresntErr_Value: accessed-variable=VePMIR_e_LTPsvPump2AirPresntErr.Value
              IN_VePMIR_e_LTPsvPump2Deblock_Value: accessed-variable=VePMIR_e_LTPsvPump2Deblock.Value
              IN_VePMIR_e_LTPsvPump2DryRun_Value: accessed-variable=VePMIR_e_LTPsvPump2DryRun.Value
              IN_VePMIR_e_LTPsvPump2Failsafe_Value: accessed-variable=VePMIR_e_LTPsvPump2Failsafe.Value
              IN_VePMIR_e_LTPsvPump2LmpHM_Value: accessed-variable=VePMIR_e_LTPsvPump2LmpHM.Value
              IN_VePMIR_e_LTPsvPump2MntrRPM_Value: accessed-variable=VePMIR_e_LTPsvPump2MntrRPM.Value
              IN_VePMIR_e_LTPsvPump2NodeErr_Value: accessed-variable=VePMIR_e_LTPsvPump2NodeErr.Value
              IN_VePMIR_e_LTPsvPump2OT_Value: accessed-variable=VePMIR_e_LTPsvPump2OT.Value
              IN_VePMIR_e_LTPsvPump2OverCurrent_Value: accessed-variable=VePMIR_e_LTPsvPump2OverCurrent.Value
              IN_VePMIR_e_LTPsvPump2SuppVltErr_Value: accessed-variable=VePMIR_e_LTPsvPump2SuppVltErr.Value
              IN_VePMPR_Pct_LTPsvPump2RPMAct_Value: accessed-variable=VePMPR_Pct_LTPsvPump2RPMAct.Value
              IN_VePMPR_e_LTPsvPump2_PstRnSt_Value: accessed-variable=VePMPR_e_LTPsvPump2_PstRnSt.Value
        DataServices_RD4039_Data_ReadData
          data-receive-point-by-arguments:
            17 x access:
              IN_VePMIR_I_LTActvPumpCurrent_Value: accessed-variable=VePMIR_I_LTActvPumpCurrent.Value
              IN_VePMIR_Pct_LTActvPumpActSpd_Value: accessed-variable=VePMIR_Pct_LTActvPumpActSpd.Value
              IN_VePMIR_Pct_LTActvPumpTgtSpd_Value: accessed-variable=VePMIR_Pct_LTActvPumpTgtSpd.Value
              IN_VePMIR_T_LTActvPumpTemp_Value: accessed-variable=VePMIR_T_LTActvPumpTemp.Value
              IN_VePMIR_U_LTActvPumpVlt_Value: accessed-variable=VePMIR_U_LTActvPumpVlt.Value
              IN_VePMIR_b_LTActvPumpRespErr_Value: accessed-variable=VePMIR_b_LTActvPumpRespErr.Value
              IN_VePMIR_e_LTAP_AirPrsntErr_Value: accessed-variable=VePMIR_e_LTAP_AirPrsntErr.Value
              IN_VePMIR_e_LTActvPumpDeblock_Value: accessed-variable=VePMIR_e_LTActvPumpDeblock.Value
              IN_VePMIR_e_LTActvPumpDryRun_Value: accessed-variable=VePMIR_e_LTActvPumpDryRun.Value
              IN_VePMIR_e_LTActvPumpFailsafe_Value: accessed-variable=VePMIR_e_LTActvPumpFailsafe.Value
              IN_VePMIR_e_LTActvPumpLmpHM_Value: accessed-variable=VePMIR_e_LTActvPumpLmpHM.Value
              IN_VePMIR_e_LTActvPumpMntrRPM_Value: accessed-variable=VePMIR_e_LTActvPumpMntrRPM.Value
              IN_VePMIR_e_LTActvPumpNodeErr_Value: accessed-variable=VePMIR_e_LTActvPumpNodeErr.Value
              IN_VePMIR_e_LTActvPumpOT_Value: accessed-variable=VePMIR_e_LTActvPumpOT.Value
              IN_VePMIR_e_LTActvPumpOverCurrent_Value: accessed-variable=VePMIR_e_LTActvPumpOverCurrent.Value
              IN_VePMIR_e_LTActvPumpPstRnSt_Value: accessed-variable=VePMIR_e_LTActvPumpPstRnSt.Value
              IN_VePMIR_e_LTActvPumpSuppVltErr_Value: accessed-variable=VePMIR_e_LTActvPumpSuppVltErr.Value
        DataServices_RD403D_Data_ReadData
          data-receive-point-by-arguments:
            16 x access:
              IN_VePMIR_I_HTAuxPumpCurrent_Value: accessed-variable=VePMIR_I_HTAuxPumpCurrent.Value
              IN_VePMIR_Pct_HTAuxPumpActSpd_Value: accessed-variable=VePMIR_Pct_HTAuxPumpActSpd.Value
              IN_VePMIR_Pct_HTAuxPumpTgtSpd_Value: accessed-variable=VePMIR_Pct_HTAuxPumpTgtSpd.Value
              IN_VePMIR_T_HTAuxPumpTemp_Value: accessed-variable=VePMIR_T_HTAuxPumpTemp.Value
              IN_VePMIR_U_HTAuxPumpVltg_Value: accessed-variable=VePMIR_U_HTAuxPumpVltg.Value
              IN_VePMIR_b_HTAuxPumpRespErr_Value: accessed-variable=VePMIR_b_HTAuxPumpRespErr.Value
              IN_VePMIR_e_HTAuxPumpAirPresntErr_Value: accessed-variable=VePMIR_e_HTAuxPumpAirPresntErr.Value
              IN_VePMIR_e_HTAuxPumpDeblock_Value: accessed-variable=VePMIR_e_HTAuxPumpDeblock.Value
              IN_VePMIR_e_HTAuxPumpDryRun_Value: accessed-variable=VePMIR_e_HTAuxPumpDryRun.Value
              IN_VePMIR_e_HTAuxPumpFailsafe_Value: accessed-variable=VePMIR_e_HTAuxPumpFailsafe.Value
              IN_VePMIR_e_HTAuxPumpLmpHM_Value: accessed-variable=VePMIR_e_HTAuxPumpLmpHM.Value
              IN_VePMIR_e_HTAuxPumpMntrRPM_Value: accessed-variable=VePMIR_e_HTAuxPumpMntrRPM.Value
              IN_VePMIR_e_HTAuxPumpNodeErr_Value: accessed-variable=VePMIR_e_HTAuxPumpNodeErr.Value
              IN_VePMIR_e_HTAuxPumpOT_Value: accessed-variable=VePMIR_e_HTAuxPumpOT.Value
              IN_VePMIR_e_HTAuxPumpOverCurrent_Value: accessed-variable=VePMIR_e_HTAuxPumpOverCurrent.Value
              IN_VePMIR_e_HTAuxPumpSuppVltErr_Value: accessed-variable=VePMIR_e_HTAuxPumpSuppVltErr.Value
        DataServices_RD4040_Data_ReadData
          data-receive-point-by-arguments:
            access IN_VeTAIR_Pct_RadFanSts_Value: accessed-variable=VeTAIR_Pct_RadFanSts.Value
        DataServices_RD4050_Data_ReadData
          data-receive-point-by-arguments:
            9 x access:
              IN_VeHTIR_I_HVC_Htr_HV_CrntAct_Value: accessed-variable=VeHTIR_I_HVC_Htr_HV_CrntAct.Value
              IN_VeHTIR_P_HVC_HtrPwrAct_Value: accessed-variable=VeHTIR_P_HVC_HtrPwrAct.Value
              IN_VeHTIR_P_HVC_HtrPwrExpectd_Value: accessed-variable=VeHTIR_P_HVC_HtrPwrExpectd.Value
              IN_VeHTIR_T_HVC_HtrClntIn_Temp_Value: accessed-variable=VeHTIR_T_HVC_HtrClntIn_Temp.Value
              IN_VeHTIR_T_HVC_HtrClntOut_Temp_Value: accessed-variable=VeHTIR_T_HVC_HtrClntOut_Temp.Value
              IN_VeHTIR_U_HVC_Htr_HV_VltgAct_Value: accessed-variable=VeHTIR_U_HVC_Htr_HV_VltgAct.Value
              IN_VeHTIR_e_HVC_HtrHighVol_Dwn_Value: accessed-variable=VeHTIR_e_HVC_HtrHighVol_Dwn.Value
              IN_VeHTIR_e_HVC_Htr_InterlockStat_Value: accessed-variable=VeHTIR_e_HVC_Htr_InterlockStat.Value
              IN_VeHTIR_e_HV_ElecClntHtr_Sts_Value: accessed-variable=VeHTIR_e_HV_ElecClntHtr_Sts.Value
        DataServices_RD4051_Data_ReadData
          data-receive-point-by-arguments:
            14 x access:
              IN_VeHTIR_b_HVC_Htr_LIN_ResErr_Value: accessed-variable=VeHTIR_b_HVC_Htr_LIN_ResErr.Value
              IN_VeHTIR_e_HVC_HtrClntIn_TempSensFlt_Value: accessed-variable=VeHTIR_e_HVC_HtrClntIn_TempSensFlt.Value
              IN_VeHTIR_e_HVC_HtrClntOut_TempSensFlt_Value: accessed-variable=VeHTIR_e_HVC_HtrClntOut_TempSensFlt.Value
              IN_VeHTIR_e_HVC_HtrClntTemp_OutofRng_Value: accessed-variable=VeHTIR_e_HVC_HtrClntTemp_OutofRng.Value
              IN_VeHTIR_e_HVC_HtrCoreTemp_SensFlt_Value: accessed-variable=VeHTIR_e_HVC_HtrCoreTemp_SensFlt.Value
              IN_VeHTIR_e_HVC_HtrDrvFlt_Value: accessed-variable=VeHTIR_e_HVC_HtrDrvFlt.Value
              IN_VeHTIR_e_HVC_HtrIntCom_Err_Value: accessed-variable=VeHTIR_e_HVC_HtrIntCom_Err.Value
              IN_VeHTIR_e_HVC_HtrProcesMemory_Flt_Value: accessed-variable=VeHTIR_e_HVC_HtrProcesMemory_Flt.Value
              IN_VeHTIR_e_HVC_HtrResis_PCB_OvrTemp_Value: accessed-variable=VeHTIR_e_HVC_HtrResis_PCB_OvrTemp.Value
              IN_VeHTIR_e_HVC_HtrSelfProtect_Actv_Value: accessed-variable=VeHTIR_e_HVC_HtrSelfProtect_Actv.Value
              IN_VeHTIR_e_HVC_Htr_DCDC_VltgOutofRng_Value: accessed-variable=VeHTIR_e_HVC_Htr_DCDC_VltgOutofRng.Value
              IN_VeHTIR_e_HVC_Htr_HV_CrntOutofRng_Value: accessed-variable=VeHTIR_e_HVC_Htr_HV_CrntOutofRng.Value
              IN_VeHTIR_e_HVC_Htr_HV_OutofRng_Value: accessed-variable=VeHTIR_e_HVC_Htr_HV_OutofRng.Value
              IN_VeHTIR_e_HVC_Htr_LV_OutofRng_Value: accessed-variable=VeHTIR_e_HVC_Htr_LV_OutofRng.Value
        DataServices_RD4052_Data_ReadData
          data-receive-point-by-arguments:
            4 x access:
              IN_VeHTIR_I_HVC_Htr4_HV_CrntAct_Value: accessed-variable=VeHTIR_I_HVC_Htr4_HV_CrntAct.Value
              IN_VeHTIR_P_HVC_Htr4PwrAct_Value: accessed-variable=VeHTIR_P_HVC_Htr4PwrAct.Value
              IN_VeHTIR_P_HVC_Htr4PwrExpectd_Value: accessed-variable=VeHTIR_P_HVC_Htr4PwrExpectd.Value
              IN_VeHTIR_U_HVC_Htr4_HV_VltgAct_Value: accessed-variable=VeHTIR_U_HVC_Htr4_HV_VltgAct.Value
        DataServices_RD4053_Data_ReadData
          data-receive-point-by-arguments:
            17 x access:
              IN_VeHTIR_T_HVC_Htr4ClntIn_Temp_Value: accessed-variable=VeHTIR_T_HVC_Htr4ClntIn_Temp.Value
              IN_VeHTIR_T_HVC_Htr4ClntOut_Temp_Value: accessed-variable=VeHTIR_T_HVC_Htr4ClntOut_Temp.Value
              IN_VeHTIR_b_HVC_Htr4_LIN_ResErr_Value: accessed-variable=VeHTIR_b_HVC_Htr4_LIN_ResErr.Value
              IN_VeHTIR_e_HVC_Htr4ClntIn_TempSensFlt_Value: accessed-variable=VeHTIR_e_HVC_Htr4ClntIn_TempSensFlt.Value
              IN_VeHTIR_e_HVC_Htr4ClntOut_TempSensFlt_Value: accessed-variable=VeHTIR_e_HVC_Htr4ClntOut_TempSensFlt.Value
              IN_VeHTIR_e_HVC_Htr4ClntTemp_OutofRng_Value: accessed-variable=VeHTIR_e_HVC_Htr4ClntTemp_OutofRng.Value
              IN_VeHTIR_e_HVC_Htr4CoreTemp_SensFlt_Value: accessed-variable=VeHTIR_e_HVC_Htr4CoreTemp_SensFlt.Value
              IN_VeHTIR_e_HVC_Htr4DrvFlt_Value: accessed-variable=VeHTIR_e_HVC_Htr4DrvFlt.Value
              IN_VeHTIR_e_HVC_Htr4IntCom_Err_Value: accessed-variable=VeHTIR_e_HVC_Htr4IntCom_Err.Value
              IN_VeHTIR_e_HVC_Htr4ProcesMemory_Flt_Value: accessed-variable=VeHTIR_e_HVC_Htr4ProcesMemory_Flt.Value
              IN_VeHTIR_e_HVC_Htr4Resis_PCB_OvrTemp_Value: accessed-variable=VeHTIR_e_HVC_Htr4Resis_PCB_OvrTemp.Value
              IN_VeHTIR_e_HVC_Htr4SelfProtect_Actv_Value: accessed-variable=VeHTIR_e_HVC_Htr4SelfProtect_Actv.Value
              IN_VeHTIR_e_HVC_Htr4_DCDC_VltgOutofRng_Value: accessed-variable=VeHTIR_e_HVC_Htr4_DCDC_VltgOutofRng.Value
              IN_VeHTIR_e_HVC_Htr4_HV_CrntOutofRng_Value: accessed-variable=VeHTIR_e_HVC_Htr4_HV_CrntOutofRng.Value
              IN_VeHTIR_e_HVC_Htr4_HV_OutofRng_Value: accessed-variable=VeHTIR_e_HVC_Htr4_HV_OutofRng.Value
              IN_VeHTIR_e_HVC_Htr4_LV_OutofRng_Value: accessed-variable=VeHTIR_e_HVC_Htr4_LV_OutofRng.Value
              IN_VeHTIR_e_HV_ElecClntHtr4_Sts_Value: accessed-variable=VeHTIR_e_HV_ElecClntHtr4_Sts.Value
        DataServices_RD4055_Data_ReadData
          data-receive-point-by-arguments:
            6 x access:
              IN_VeHTIR_I_HVC_Htr2_HV_CrntAct_Value: accessed-variable=VeHTIR_I_HVC_Htr2_HV_CrntAct.Value
              IN_VeHTIR_P_HVC_Htr2PwrAct_Value: accessed-variable=VeHTIR_P_HVC_Htr2PwrAct.Value
              IN_VeHTIR_T_Htr2CoreTemp_Value: accessed-variable=VeHTIR_T_Htr2CoreTemp.Value
              IN_VeHTIR_T_Htr2_PCBTemp_Value: accessed-variable=VeHTIR_T_Htr2_PCBTemp.Value
              IN_VeHTIR_U_HVC_Htr2_HV_VltgAct_Value: accessed-variable=VeHTIR_U_HVC_Htr2_HV_VltgAct.Value
              IN_VeHTIR_e_HV_ElecClntHtr2_Sts_Value: accessed-variable=VeHTIR_e_HV_ElecClntHtr2_Sts.Value
        DataServices_RD4056_Data_ReadData
          data-receive-point-by-arguments:
            14 x access:
              IN_VeHTIR_b_HVC_Htr2_LIN_ResErr_Value: accessed-variable=VeHTIR_b_HVC_Htr2_LIN_ResErr.Value
              IN_VeHTIR_e_HVC_Htr2CoreTemp_SensFlt_Value: accessed-variable=VeHTIR_e_HVC_Htr2CoreTemp_SensFlt.Value
              IN_VeHTIR_e_HVC_Htr2Core_OvrTmp_Value: accessed-variable=VeHTIR_e_HVC_Htr2Core_OvrTmp.Value
              IN_VeHTIR_e_HVC_Htr2DrvFlt_Value: accessed-variable=VeHTIR_e_HVC_Htr2DrvFlt.Value
              IN_VeHTIR_e_HVC_Htr2HVCrnt_SnsrFlt_Value: accessed-variable=VeHTIR_e_HVC_Htr2HVCrnt_SnsrFlt.Value
              IN_VeHTIR_e_HVC_Htr2IntCom_Err_Value: accessed-variable=VeHTIR_e_HVC_Htr2IntCom_Err.Value
              IN_VeHTIR_e_HVC_Htr2PCBTmp_SnsrFlt_Value: accessed-variable=VeHTIR_e_HVC_Htr2PCBTmp_SnsrFlt.Value
              IN_VeHTIR_e_HVC_Htr2ProcesMemory_Flt_Value: accessed-variable=VeHTIR_e_HVC_Htr2ProcesMemory_Flt.Value
              IN_VeHTIR_e_HVC_Htr2Resis_PCB_OvrTemp_Value: accessed-variable=VeHTIR_e_HVC_Htr2Resis_PCB_OvrTemp.Value
              IN_VeHTIR_e_HVC_Htr2SelfProtect_Actv_Value: accessed-variable=VeHTIR_e_HVC_Htr2SelfProtect_Actv.Value
              IN_VeHTIR_e_HVC_Htr2TmpOvrheatg_Value: accessed-variable=VeHTIR_e_HVC_Htr2TmpOvrheatg.Value
              IN_VeHTIR_e_HVC_Htr2_HV_CrntOutofRng_Value: accessed-variable=VeHTIR_e_HVC_Htr2_HV_CrntOutofRng.Value
              IN_VeHTIR_e_HVC_Htr2_HV_OutofRng_Value: accessed-variable=VeHTIR_e_HVC_Htr2_HV_OutofRng.Value
              IN_VeHTIR_e_HVC_Htr2_LV_OutofRng_Value: accessed-variable=VeHTIR_e_HVC_Htr2_LV_OutofRng.Value
        DataServices_RD6360_Data_ReadData
          data-receive-point-by-arguments:
            access IN_VeHMIR_e_HEV_LMP_RQ_Value: accessed-variable=VeHMIR_e_HEV_LMP_RQ.Value
        DataServices_RD9EED_Data_ReadData
          data-receive-point-by-arguments:
            access IN_VePLTR_e_ShippingMode_Value: accessed-variable=VePLTR_e_ShippingMode.Value
        DataServices_RDB000_Data_ReadData
          data-receive-point-by-arguments:
            15 x access:
              IN_VeRGNR_b_RollTestStatus_PID_BIT{0..6}_Value: accessed-variable=VeRGNR_b_RollTestStatus_PID_BIT{0..6}.Value
              IN_VeRGNR_g_RollTestOBDStatus_BIT{0..7}_Value: accessed-variable=VeRGNR_g_RollTestOBDStatus_BIT{0..7}.Value
        DataServices_RDB523_Data_ReadData
          data-receive-point-by-arguments:
            access IN_VePMDR_b_IgnRunCrnk_Value: accessed-variable=VePMDR_b_IgnRunCrnk.Value
            access IN_VePWDR_b_HV_VoltTooLow_Value: accessed-variable=VePWDR_b_HV_VoltTooLow.Value
        DataServices_RDB524_Data_ReadData
          data-receive-point-by-arguments:
            access IN_VePWDR_y_DID_B524_Value: accessed-variable=VePWDR_y_DID_B524.Value
        DataServices_RDB526_Data_ReadData
          data-receive-point-by-arguments:
            4 x access:
              IN_VeHTIR_Cnt_HVC_HtrUnlckCntr_Value: accessed-variable=VeHTIR_Cnt_HVC_HtrUnlckCntr.Value
              IN_VeHTIR_e_HV_ElecClntHtr_Sts_Value: accessed-variable=VeHTIR_e_HV_ElecClntHtr_Sts.Value
              IN_VeHTRR_b_HVC_Htr_CoreTemp_BL_Value: accessed-variable=VeHTRR_b_HVC_Htr_CoreTemp_BL.Value
              IN_VeHTRR_b_HVC_Htr_HtrClntIn_Temp_BL_Value: accessed-variable=VeHTRR_b_HVC_Htr_HtrClntIn_Temp_BL.Value
        DataServices_RDB605_Data_ReadData
          data-receive-point-by-arguments:
            5 x access:
              IN_VeOBCR_K_ChargingFailure{1..5}_Value: accessed-variable=VeOBCR_K_ChargingFailure{1..5}.Value
        DataServices_RDB612_Data_ReadData
          data-receive-point-by-arguments:
            6 x access:
              IN_VeBPCR_e_HVBatIntrlkIntrnlStat_Value: accessed-variable=VeBPCR_e_HVBatIntrlkIntrnlStat.Value
              IN_VeBPCR_e_HV_BatInrlkStat_Value: accessed-variable=VeBPCR_e_HV_BatInrlkStat.Value
              IN_VeHTIR_e_HVC_Htr_InterlockStat_Value: accessed-variable=VeHTIR_e_HVC_Htr_InterlockStat.Value
              IN_VeIDCR_e_OBCM_HVILSts_Value: accessed-variable=VeIDCR_e_OBCM_HVILSts.Value
              IN_VeINVR_e_MCPA_HVILSts_Value: accessed-variable=VeINVR_e_MCPA_HVILSts.Value
              IN_VeINVR_e_MCPB_HVILSts_Value: accessed-variable=VeINVR_e_MCPB_HVILSts.Value
        DataServices_RDB613_Data_ReadData
          data-receive-point-by-arguments:
            access IN_VeIDCR_I_IBS_I_Converted_Value: accessed-variable=VeIDCR_I_IBS_I_Converted.Value
        DataServices_RDB614_Data_ReadData
          data-receive-point-by-arguments:
            13 x access:
              IN_VeTAIR_Pct_LTR_BypsVlv_ActlPstn_Value: accessed-variable=VeTAIR_Pct_LTR_BypsVlv_ActlPstn.Value
              IN_VeTAIR_U_LTR_BypsVlv_MtrVltg_Value: accessed-variable=VeTAIR_U_LTR_BypsVlv_MtrVltg.Value
              IN_VeTAIR_b_LTR_BypsVlv_BlckPnt_Value: accessed-variable=VeTAIR_b_LTR_BypsVlv_BlckPnt.Value
              IN_VeTAIR_b_LTR_BypsVlv_Err_SNA_Value: accessed-variable=VeTAIR_b_LTR_BypsVlv_Err_SNA.Value
              IN_VeTAIR_b_LTR_BypsVlv_MechBrk_Value: accessed-variable=VeTAIR_b_LTR_BypsVlv_MechBrk.Value
              IN_VeTAIR_b_LTR_BypsVlv_OpnLd_Value: accessed-variable=VeTAIR_b_LTR_BypsVlv_OpnLd.Value
              IN_VeTAIR_b_LTR_BypsVlv_OvrCrnt_Value: accessed-variable=VeTAIR_b_LTR_BypsVlv_OvrCrnt.Value
              IN_VeTAIR_b_LTR_BypsVlv_OvrVltg_Value: accessed-variable=VeTAIR_b_LTR_BypsVlv_OvrVltg.Value
              IN_VeTAIR_b_LTR_BypsVlv_RsErr_Value: accessed-variable=VeTAIR_b_LTR_BypsVlv_RsErr.Value
              IN_VeTAIR_b_LTR_BypsVlv_ThrmlWrng_Value: accessed-variable=VeTAIR_b_LTR_BypsVlv_ThrmlWrng.Value
              IN_VeTAIR_b_LTR_BypsVlv_UndrVltg_Value: accessed-variable=VeTAIR_b_LTR_BypsVlv_UndrVltg.Value
              IN_VeTAIR_e_LTR_BypsVlv_CalSts_Value: accessed-variable=VeTAIR_e_LTR_BypsVlv_CalSts.Value
              IN_VeTAIR_e_LTR_BypsVlv_ErrSts_Value: accessed-variable=VeTAIR_e_LTR_BypsVlv_ErrSts.Value
        DataServices_RDB616_Data_ReadData
          data-receive-point-by-arguments:
            13 x access:
              IN_VeTAIR_Pct_HTL_BypsVlv_ActlPstn_Value: accessed-variable=VeTAIR_Pct_HTL_BypsVlv_ActlPstn.Value
              IN_VeTAIR_U_HTL_BypsVlv_MtrVltg_Value: accessed-variable=VeTAIR_U_HTL_BypsVlv_MtrVltg.Value
              IN_VeTAIR_b_HTL_BypsVlv_BlckPnt_Value: accessed-variable=VeTAIR_b_HTL_BypsVlv_BlckPnt.Value
              IN_VeTAIR_b_HTL_BypsVlv_Err_SNA_Value: accessed-variable=VeTAIR_b_HTL_BypsVlv_Err_SNA.Value
              IN_VeTAIR_b_HTL_BypsVlv_MechBrk_Value: accessed-variable=VeTAIR_b_HTL_BypsVlv_MechBrk.Value
              IN_VeTAIR_b_HTL_BypsVlv_OpnLd_Value: accessed-variable=VeTAIR_b_HTL_BypsVlv_OpnLd.Value
              IN_VeTAIR_b_HTL_BypsVlv_OvrCrnt_Value: accessed-variable=VeTAIR_b_HTL_BypsVlv_OvrCrnt.Value
              IN_VeTAIR_b_HTL_BypsVlv_OvrVltg_Value: accessed-variable=VeTAIR_b_HTL_BypsVlv_OvrVltg.Value
              IN_VeTAIR_b_HTL_BypsVlv_RsErr_Value: accessed-variable=VeTAIR_b_HTL_BypsVlv_RsErr.Value
              IN_VeTAIR_b_HTL_BypsVlv_ThrmlWrng_Value: accessed-variable=VeTAIR_b_HTL_BypsVlv_ThrmlWrng.Value
              IN_VeTAIR_b_HTL_BypsVlv_UndrVltg_Value: accessed-variable=VeTAIR_b_HTL_BypsVlv_UndrVltg.Value
              IN_VeTAIR_e_HTL_BypsVlv_CalSts_Value: accessed-variable=VeTAIR_e_HTL_BypsVlv_CalSts.Value
              IN_VeTAIR_e_HTL_BypsVlv_ErrSts_Value: accessed-variable=VeTAIR_e_HTL_BypsVlv_ErrSts.Value
        DataServices_RDB621_Data_ReadData
          data-receive-point-by-arguments:
            11 x access:
              IN_VeTAIR_b_AGS_BoostSts_Value: accessed-variable=VeTAIR_b_AGS_BoostSts.Value
              IN_VeTAIR_b_AGS_CalibrationActv_Value: accessed-variable=VeTAIR_b_AGS_CalibrationActv.Value
              IN_VeTAIR_b_AGS_ErrMechBreak_Value: accessed-variable=VeTAIR_b_AGS_ErrMechBreak.Value
              IN_VeTAIR_b_AGS_ErrMechStuck_Value: accessed-variable=VeTAIR_b_AGS_ErrMechStuck.Value
              IN_VeTAIR_b_AGS_ErrOverTemp_Value: accessed-variable=VeTAIR_b_AGS_ErrOverTemp.Value
              IN_VeTAIR_b_AGS_ErrOverVolt_Value: accessed-variable=VeTAIR_b_AGS_ErrOverVolt.Value
              IN_VeTAIR_b_AGS_ErrUnderVolt_Value: accessed-variable=VeTAIR_b_AGS_ErrUnderVolt.Value
              IN_VeTAIR_b_AGS_ResErr_Value: accessed-variable=VeTAIR_b_AGS_ResErr.Value
              IN_VeTAIR_e_AGS_CalibrationSts_Value: accessed-variable=VeTAIR_e_AGS_CalibrationSts.Value
              IN_VeTAIR_e_AGS_CurrPos_Value: accessed-variable=VeTAIR_e_AGS_CurrPos.Value
              IN_VeTAIR_e_AGS_ErrFdb_Value: accessed-variable=VeTAIR_e_AGS_ErrFdb.Value
        DataServices_RDB622_Data_ReadData
          data-receive-point-by-arguments:
            11 x access:
              IN_VeTAIR_b_AGS2_BoostSts_Value: accessed-variable=VeTAIR_b_AGS2_BoostSts.Value
              IN_VeTAIR_b_AGS2_CalibrationActv_Value: accessed-variable=VeTAIR_b_AGS2_CalibrationActv.Value
              IN_VeTAIR_b_AGS2_ErrMechBreak_Value: accessed-variable=VeTAIR_b_AGS2_ErrMechBreak.Value
              IN_VeTAIR_b_AGS2_ErrMechStuck_Value: accessed-variable=VeTAIR_b_AGS2_ErrMechStuck.Value
              IN_VeTAIR_b_AGS2_ErrOverTemp_Value: accessed-variable=VeTAIR_b_AGS2_ErrOverTemp.Value
              IN_VeTAIR_b_AGS2_ErrOverVolt_Value: accessed-variable=VeTAIR_b_AGS2_ErrOverVolt.Value
              IN_VeTAIR_b_AGS2_ErrUnderVolt_Value: accessed-variable=VeTAIR_b_AGS2_ErrUnderVolt.Value
              IN_VeTAIR_b_AGS2_ResErr_Value: accessed-variable=VeTAIR_b_AGS2_ResErr.Value
              IN_VeTAIR_e_AGS2_CalibrationSts_Value: accessed-variable=VeTAIR_e_AGS2_CalibrationSts.Value
              IN_VeTAIR_e_AGS2_CurrPos_Value: accessed-variable=VeTAIR_e_AGS2_CurrPos.Value
              IN_VeTAIR_e_AGS2_ErrFdb_Value: accessed-variable=VeTAIR_e_AGS2_ErrFdb.Value
        DataServices_RDB626_Data_ReadData
          data-receive-point-by-arguments:
            15 x access:
              IN_VePMIR_I_TransAuxPumpCurrent_Value: accessed-variable=VePMIR_I_TransAuxPumpCurrent.Value
              IN_VePMIR_T_TransAuxPumpTemp_Value: accessed-variable=VePMIR_T_TransAuxPumpTemp.Value
              IN_VePMIR_U_TransAuxPumpVoltage_Value: accessed-variable=VePMIR_U_TransAuxPumpVoltage.Value
              IN_VePMIR_b_TransAuxPumpRespError_Value: accessed-variable=VePMIR_b_TransAuxPumpRespError.Value
              IN_VePMIR_e_TAP_ColdBiasSts_Value: accessed-variable=VePMIR_e_TAP_ColdBiasSts.Value
              IN_VePMIR_e_TransAuxPumpCurrentError_Value: accessed-variable=VePMIR_e_TransAuxPumpCurrentError.Value
              IN_VePMIR_e_TransAuxPumpDryRun_Value: accessed-variable=VePMIR_e_TransAuxPumpDryRun.Value
              IN_VePMIR_e_TransAuxPumpLmpHM_Value: accessed-variable=VePMIR_e_TransAuxPumpLmpHM.Value
              IN_VePMIR_e_TransAuxPumpMntrRPM_Value: accessed-variable=VePMIR_e_TransAuxPumpMntrRPM.Value
              IN_VePMIR_e_TransAuxPumpPstRnSt_Value: accessed-variable=VePMIR_e_TransAuxPumpPstRnSt.Value
              IN_VePMIR_e_TransAuxPumpStallEvent_Value: accessed-variable=VePMIR_e_TransAuxPumpStallEvent.Value
              IN_VePMIR_e_TransAuxPumpTempError_Value: accessed-variable=VePMIR_e_TransAuxPumpTempError.Value
              IN_VePMIR_e_TransAuxPumpVoltageError_Value: accessed-variable=VePMIR_e_TransAuxPumpVoltageError.Value
              IN_VePMIR_n_AuxPumpSpdAct_Value: accessed-variable=VePMIR_n_AuxPumpSpdAct.Value
              IN_VePMIR_n_TransAuxPump_RPMTgt_Value: accessed-variable=VePMIR_n_TransAuxPump_RPMTgt.Value
        DataServices_RDB627_Data_ReadData
          data-receive-point-by-arguments:
            access IN_VePMIR_T_TransAuxPumpOilTemp_Value: accessed-variable=VePMIR_T_TransAuxPumpOilTemp.Value
        DataServices_RDB628_Data_ReadData
          data-receive-point-by-arguments:
            access IN_VePMIR_y_TransAuxPmp_TAP_HW_VER_Value: accessed-variable=VePMIR_y_TransAuxPmp_TAP_HW_VER.Value
            access IN_VePMIR_y_TransAuxPmp_TAP_SW_VER_Value: accessed-variable=VePMIR_y_TransAuxPmp_TAP_SW_VER.Value
        DataServices_RDB629_Data_ReadData
          data-receive-point-by-arguments:
            15 x access:
              IN_VePMIR_I_TransAuxPump2Current_Value: accessed-variable=VePMIR_I_TransAuxPump2Current.Value
              IN_VePMIR_T_TransAuxPump2Temp_Value: accessed-variable=VePMIR_T_TransAuxPump2Temp.Value
              IN_VePMIR_U_TransAuxPump2Voltage_Value: accessed-variable=VePMIR_U_TransAuxPump2Voltage.Value
              IN_VePMIR_b_TransAuxPump2RespError_Value: accessed-variable=VePMIR_b_TransAuxPump2RespError.Value
              IN_VePMIR_e_TransAuxPmp2ColdBiasSts_Value: accessed-variable=VePMIR_e_TransAuxPmp2ColdBiasSts.Value
              IN_VePMIR_e_TransAuxPmp2LmpHM_Value: accessed-variable=VePMIR_e_TransAuxPmp2LmpHM.Value
              IN_VePMIR_e_TransAuxPump2CurrentError_Value: accessed-variable=VePMIR_e_TransAuxPump2CurrentError.Value
              IN_VePMIR_e_TransAuxPump2DryRun_Value: accessed-variable=VePMIR_e_TransAuxPump2DryRun.Value
              IN_VePMIR_e_TransAuxPump2MntrRPM_Value: accessed-variable=VePMIR_e_TransAuxPump2MntrRPM.Value
              IN_VePMIR_e_TransAuxPump2PstRnSt_Value: accessed-variable=VePMIR_e_TransAuxPump2PstRnSt.Value
              IN_VePMIR_e_TransAuxPump2StallEvent_Value: accessed-variable=VePMIR_e_TransAuxPump2StallEvent.Value
              IN_VePMIR_e_TransAuxPump2TempError_Value: accessed-variable=VePMIR_e_TransAuxPump2TempError.Value
              IN_VePMIR_e_TransAuxPump2VoltageError_Value: accessed-variable=VePMIR_e_TransAuxPump2VoltageError.Value
              IN_VePMIR_n_TransAuxPump2SpdAct_Value: accessed-variable=VePMIR_n_TransAuxPump2SpdAct.Value
              IN_VePMIR_n_TransAuxPump2TgtSpd_Value: accessed-variable=VePMIR_n_TransAuxPump2TgtSpd.Value
        DataServices_RDB62A_Data_ReadData
          data-receive-point-by-arguments:
            access IN_VePMIR_T_TransAuxPump2OilTemp_Value: accessed-variable=VePMIR_T_TransAuxPump2OilTemp.Value
        DataServices_RDB62B_Data_ReadData
          data-receive-point-by-arguments:
            access IN_VePMIR_y_TransAuxPmp2_TAP_HW_VER_Value: accessed-variable=VePMIR_y_TransAuxPmp2_TAP_HW_VER.Value
            access IN_VePMIR_y_TransAuxPmp2_TAP_SW_VER_Value: accessed-variable=VePMIR_y_TransAuxPmp2_TAP_SW_VER.Value
        DataServices_RDB630_Data_ReadData
          data-receive-point-by-arguments:
            9 x access:
              IN_VeAADR_Pct_AAD_CurrPos_Value: accessed-variable=VeAADR_Pct_AAD_CurrPos.Value
              IN_VeAADR_b_AAD_CalibrationActv_Value: accessed-variable=VeAADR_b_AAD_CalibrationActv.Value
              IN_VeAADR_b_AAD_ErrMechBreak_Value: accessed-variable=VeAADR_b_AAD_ErrMechBreak.Value
              IN_VeAADR_b_AAD_ErrMechStuck_Value: accessed-variable=VeAADR_b_AAD_ErrMechStuck.Value
              IN_VeAADR_b_AAD_ErrOverTemp_Value: accessed-variable=VeAADR_b_AAD_ErrOverTemp.Value
              IN_VeAADR_b_AAD_ErrOverVolt_Value: accessed-variable=VeAADR_b_AAD_ErrOverVolt.Value
              IN_VeAADR_b_AAD_ErrUnderVolt_Value: accessed-variable=VeAADR_b_AAD_ErrUnderVolt.Value
              IN_VeAADR_b_AAD_ResErr_Value: accessed-variable=VeAADR_b_AAD_ResErr.Value
              IN_VeAADR_e_AAD_CalibrationSts_Value: accessed-variable=VeAADR_e_AAD_CalibrationSts.Value
        DataServices_RDB631_Data_ReadData
          data-receive-point-by-arguments:
            10 x access:
              IN_VeTAIR_Pct_EXV_PosAct_Value: accessed-variable=VeTAIR_Pct_EXV_PosAct.Value
              IN_VeTAIR_T_EXV_BoardTemp_Value: accessed-variable=VeTAIR_T_EXV_BoardTemp.Value
              IN_VeTAIR_T_EXV_RefTemp_Value: accessed-variable=VeTAIR_T_EXV_RefTemp.Value
              IN_VeTAIR_U_EXV_SupplyVolt_Value: accessed-variable=VeTAIR_U_EXV_SupplyVolt.Value
              IN_VeTAIR_b_EXV_CalRq_Value: accessed-variable=VeTAIR_b_EXV_CalRq.Value
              IN_VeTAIR_b_EXV_RspErr_Value: accessed-variable=VeTAIR_b_EXV_RspErr.Value
              IN_VeTAIR_e_EXV_CalStat_Value: accessed-variable=VeTAIR_e_EXV_CalStat.Value
              IN_VeTAIR_e_EXV_Err_Value: accessed-variable=VeTAIR_e_EXV_Err.Value
              IN_VeTAIR_e_EXV_Sts_Value: accessed-variable=VeTAIR_e_EXV_Sts.Value
              IN_VeTAIR_p_EXV_RefPress_Value: accessed-variable=VeTAIR_p_EXV_RefPress.Value
        DataServices_RDB632_Data_ReadData
          data-receive-point-by-arguments:
            10 x access:
              IN_VeTAIR_Pct_EEXV_PosAct_Value: accessed-variable=VeTAIR_Pct_EEXV_PosAct.Value
              IN_VeTAIR_T_EEXV_BoardTemp_Value: accessed-variable=VeTAIR_T_EEXV_BoardTemp.Value
              IN_VeTAIR_T_EEXV_RefTemp_Value: accessed-variable=VeTAIR_T_EEXV_RefTemp.Value
              IN_VeTAIR_U_EEXV_SupplyVolt_Value: accessed-variable=VeTAIR_U_EEXV_SupplyVolt.Value
              IN_VeTAIR_b_EEXV_CalRq_Value: accessed-variable=VeTAIR_b_EEXV_CalRq.Value
              IN_VeTAIR_b_EEXV_RspErr_Value: accessed-variable=VeTAIR_b_EEXV_RspErr.Value
              IN_VeTAIR_e_EEXV_CalStat_Value: accessed-variable=VeTAIR_e_EEXV_CalStat.Value
              IN_VeTAIR_e_EEXV_Err_Value: accessed-variable=VeTAIR_e_EEXV_Err.Value
              IN_VeTAIR_e_EEXV_Sts_Value: accessed-variable=VeTAIR_e_EEXV_Sts.Value
              IN_VeTAIR_p_EEXV_RefPress_Value: accessed-variable=VeTAIR_p_EEXV_RefPress.Value
        DataServices_RDB633_Data_ReadData
          data-receive-point-by-arguments:
            10 x access:
              IN_VeTAIR_Pct_OEXV_PosAct_Value: accessed-variable=VeTAIR_Pct_OEXV_PosAct.Value
              IN_VeTAIR_T_OEXV_BoardTemp_Value: accessed-variable=VeTAIR_T_OEXV_BoardTemp.Value
              IN_VeTAIR_T_OEXV_RefTemp_Value: accessed-variable=VeTAIR_T_OEXV_RefTemp.Value
              IN_VeTAIR_U_OEXV_SupplyVolt_Value: accessed-variable=VeTAIR_U_OEXV_SupplyVolt.Value
              IN_VeTAIR_b_OEXV_CalRq_Value: accessed-variable=VeTAIR_b_OEXV_CalRq.Value
              IN_VeTAIR_b_OEXV_RspErr_Value: accessed-variable=VeTAIR_b_OEXV_RspErr.Value
              IN_VeTAIR_e_OEXV_CalStat_Value: accessed-variable=VeTAIR_e_OEXV_CalStat.Value
              IN_VeTAIR_e_OEXV_Err_Value: accessed-variable=VeTAIR_e_OEXV_Err.Value
              IN_VeTAIR_e_OEXV_Sts_Value: accessed-variable=VeTAIR_e_OEXV_Sts.Value
              IN_VeTAIR_p_OEXV_RefPress_Value: accessed-variable=VeTAIR_p_OEXV_RefPress.Value
        DataServices_RDB634_Data_ReadData
          data-receive-point-by-arguments:
            access IN_VeTAIB_T_OEXV_InTempSnsr_Value: accessed-variable=VeTAIB_T_OEXV_InTempSnsr.Value
        DataServices_RDB650_Data_ReadData
          data-receive-point-by-arguments:
            access IN_VeADAR_e_LeftActuationStatus_Value: accessed-variable=VeADAR_e_LeftActuationStatus.Value
            access IN_VeADAR_e_RightActuationStatus_Value: accessed-variable=VeADAR_e_RightActuationStatus.Value
        DataServices_RDB651_Data_ReadData
          data-receive-point-by-arguments:
            access IN_VeADIB_Pct_WEDPosnSnsLeft_Value: accessed-variable=VeADIB_Pct_WEDPosnSnsLeft.Value
            access IN_VeADIB_Pct_WEDPosnSnsRight_Value: accessed-variable=VeADIB_Pct_WEDPosnSnsRight.Value
        DataServices_RDB653_Data_ReadData
          data-receive-point-by-arguments:
            access IN_VeRTMR_y_WEDRoutinePreConds_Value: accessed-variable=VeRTMR_y_WEDRoutinePreConds.Value
        DataServices_RDB654_Data_ReadData
          data-receive-point-by-arguments:
            access IN_VeRTMR_d_WEDRoutineFailConds_Value: accessed-variable=VeRTMR_d_WEDRoutineFailConds.Value
        DataServices_RDB655_Data_ReadData
          data-receive-point-by-arguments:
            access IN_VeADAR_L_LftTAPos_Value: accessed-variable=VeADAR_L_LftTAPos.Value
            access IN_VeADAR_L_RtTAPos_Value: accessed-variable=VeADAR_L_RtTAPos.Value
        DataServices_RDB779_Data_ReadData
          data-receive-point-by-arguments:
            access IN_VeBRDR_e_HV_Bat_CltLvlLo_Value: accessed-variable=VeBRDR_e_HV_Bat_CltLvlLo.Value
            access IN_VeTRIR_U_BatBotlClnt_LoLvlVolt_Value: accessed-variable=VeTRIR_U_BatBotlClnt_LoLvlVolt.Value
        DataServices_RDB789_Data_ReadData
          data-receive-point-by-arguments:
            access IN_VeHSWB_U_HoodAjarSns_Value: accessed-variable=VeHSWB_U_HoodAjarSns.Value
            access IN_VeHSWR_b_SecHoodSts_Value: accessed-variable=VeHSWR_b_SecHoodSts.Value
        DataServices_RWD2800_Data_ReadData
          data-receive-point-by-arguments:
            access IN_VeTRGR_d_IP_PRNDLTestFlags_Value: accessed-variable=VeTRGR_d_IP_PRNDLTestFlags.Value
        DataServices_RWD3025_Data_ReadData
          data-receive-point-by-arguments:
            5 x access:
              IN_VePLTR_b_InFieldMode_Value: accessed-variable=VePLTR_b_InFieldMode.Value
              IN_VePLTR_b_REMDisabled_Value: accessed-variable=VePLTR_b_REMDisabled.Value
              IN_VePLTR_b_RadFanHndShk_dsbld_Value: accessed-variable=VePLTR_b_RadFanHndShk_dsbld.Value
              IN_VeRTMR_b_ElectricOnlyTest_Enabled_Value: accessed-variable=VeRTMR_b_ElectricOnlyTest_Enabled.Value
              IN_VeRTMR_y_RWD3025_EOMTest_Value: accessed-variable=VeRTMR_y_RWD3025_EOMTest.Value
        DataServices_RWD3029_Data_ReadData
          data-receive-point-by-arguments:
            access IN_VeFSCR_b_RadFanTst_Failed_Value: accessed-variable=VeFSCR_b_RadFanTst_Failed.Value
            access IN_VeFSCR_b_RadFanTst_NotCmplte_Value: accessed-variable=VeFSCR_b_RadFanTst_NotCmplte.Value
        DataServices_RWD3202_Data_ReadData
          data-receive-point-by-arguments:
            access IN_VeIMPR_b_HighVoltageRapidShtdwnCmnd_Value: accessed-variable=VeIMPR_b_HighVoltageRapidShtdwnCmnd.Value
        DataServices_RWD9E15_Data_ReadData
          data-receive-point-by-arguments:
            8 x access:
              IN_VeAPSR_b_Pv1MaxTestFailed_Value: accessed-variable=VeAPSR_b_Pv1MaxTestFailed.Value
              IN_VeAPSR_b_Pv1MaxTestNotCmplt_Value: accessed-variable=VeAPSR_b_Pv1MaxTestNotCmplt.Value
              IN_VeAPSR_b_Pv1MinTestFailed_Value: accessed-variable=VeAPSR_b_Pv1MinTestFailed.Value
              IN_VeAPSR_b_Pv1MinTestNotCmplt_Value: accessed-variable=VeAPSR_b_Pv1MinTestNotCmplt.Value
              IN_VeAPSR_b_Pv2MaxTestFailed_Value: accessed-variable=VeAPSR_b_Pv2MaxTestFailed.Value
              IN_VeAPSR_b_Pv2MaxTestNotCmplt_Value: accessed-variable=VeAPSR_b_Pv2MaxTestNotCmplt.Value
              IN_VeAPSR_b_Pv2MinTestFailed_Value: accessed-variable=VeAPSR_b_Pv2MinTestFailed.Value
              IN_VeAPSR_b_Pv2MinTestNotCmplt_Value: accessed-variable=VeAPSR_b_Pv2MinTestNotCmplt.Value
        DataServices_RWD9E20_Data_ReadData
          data-receive-point-by-arguments:
            access IN_VeAPSR_U_Pvs1MinValue_Value: accessed-variable=VeAPSR_U_Pvs1MinValue.Value
        DataServices_RWD9E21_Data_ReadData
          data-receive-point-by-arguments:
            access IN_VeAPSR_U_Pvs1MaxValue_Value: accessed-variable=VeAPSR_U_Pvs1MaxValue.Value
        DataServices_RWD9E22_Data_ReadData
          data-receive-point-by-arguments:
            access IN_VeAPSR_U_Pvs2MinValue_Value: accessed-variable=VeAPSR_U_Pvs2MinValue.Value
        DataServices_RWD9E23_Data_ReadData
          data-receive-point-by-arguments:
            access IN_VeAPSR_U_Pvs2MaxValue_Value: accessed-variable=VeAPSR_U_Pvs2MaxValue.Value
        DataServices_RWD9E3B_Data_ReadData
          data-receive-point-by-arguments:
            access IN_VePLTR_milel_IPEETestMileageLimit_Value: accessed-variable=VePLTR_milel_IPEETestMileageLimit.Value
        DataServices_RWD9EEB_Data_ReadData
          data-receive-point-by-arguments:
            access IN_VePLTR_Pct_InPlant_SOCSetPt_Value: accessed-variable=VePLTR_Pct_InPlant_SOCSetPt.Value
        DataServices_RWD9EEC_Data_ReadData
          data-receive-point-by-arguments:
            access IN_VePLTR_Pct_REMLogisticSOCSetPt_Value: accessed-variable=VePLTR_Pct_REMLogisticSOCSetPt.Value
        DataServices_RWDB604_Data_ReadData
          data-receive-point-by-arguments:
            access IN_VeOBCR_e_DCChrg_TestSts_Value: accessed-variable=VeOBCR_e_DCChrg_TestSts.Value
        DataServices_RWDB607_Data_ReadData
          data-receive-point-by-arguments:
            access IN_VeSRAR_b_CreepTorqMode_Value: accessed-variable=VeSRAR_b_CreepTorqMode.Value
        DataServices_RWDB61B_Data_ReadData
          data-receive-point-by-arguments:
            access IN_VeASLR_v_STSLSpdLimMPH_Value: accessed-variable=VeASLR_v_STSLSpdLimMPH.Value
        DataServices_RWDB62F_Data_ReadData
          data-receive-point-by-arguments:
            access IN_VeAADR_b_AAD_OperationModeEnbl_Value: accessed-variable=VeAADR_b_AAD_OperationModeEnbl.Value
        DataServices_RWDB652_Data_ReadData
          data-receive-point-by-arguments:
            access IN_VeADIR_e_WEDExtToolCmd_Value: accessed-variable=VeADIR_e_WEDExtToolCmd.Value
        RoutineServices_RC1300_Start
          data-receive-point-by-arguments:
            access IN_VePWDR_b_RC1300_RoutineResults_Value: accessed-variable=VePWDR_b_RC1300_RoutineResults.Value
          data-send-points:
            access OUT_VeDCAB_e_Routine_RC1300_HVOpnCblReset_Op_Value: accessed-variable=VeDCAB_e_Routine_RC1300_HVOpnCblReset_Op.Value
        RoutineServices_RC1303_RequestResults
          data-send-points:
            access OUT_VeDCAB_e_Routine_RC1303_CabOveLoc_Op_Value: accessed-variable=VeDCAB_e_Routine_RC1303_CabOveLoc_Op.Value
        RoutineServices_RC1303_Start
          data-receive-point-by-arguments:
            access IN_VeHTRR_Cnt_Htr_Unlck_RstSts_Value: accessed-variable=VeHTRR_Cnt_Htr_Unlck_RstSts.Value
          data-send-points:
            access OUT_VeDCAB_e_Routine_RC1303_CabOveLoc_Op_Value: accessed-variable=VeDCAB_e_Routine_RC1303_CabOveLoc_Op.Value
        RoutineServices_RC1303_Stop
          data-send-points:
            access OUT_VeDCAB_e_Routine_RC1303_CabOveLoc_Op_Value: accessed-variable=VeDCAB_e_Routine_RC1303_CabOveLoc_Op.Value
        RoutineServices_RC1309_RequestResults
          data-receive-point-by-arguments:
            access IN_VeRCVR_e_CPV_RtnSts_Value: accessed-variable=VeRCVR_e_CPV_RtnSts.Value
          data-send-points:
            access OUT_VeDCAB_e_Routine_RC1309_CPV_ClbrtnRtn_Op_Value: accessed-variable=VeDCAB_e_Routine_RC1309_CPV_ClbrtnRtn_Op.Value
        RoutineServices_RC1309_Start
          data-receive-point-by-arguments:
            access IN_VeRCVR_e_CPV_RtnSts_Value: accessed-variable=VeRCVR_e_CPV_RtnSts.Value
          data-send-points:
            access OUT_VeDCAB_e_Routine_RC1309_CPV_ClbrtnRtn_Op_Value: accessed-variable=VeDCAB_e_Routine_RC1309_CPV_ClbrtnRtn_Op.Value
        RoutineServices_RC130B_Start
          data-send-points:
            access OUT_VeDCAB_e_Routine_RC130B_OBD2PIDsReset_Op_Value: accessed-variable=VeDCAB_e_Routine_RC130B_OBD2PIDsReset_Op.Value
        RoutineServices_RC130C_RequestResults
          data-receive-point-by-arguments:
            access IN_VeAPSR_b_PVSMaxLearnt_Value: accessed-variable=VeAPSR_b_PVSMaxLearnt.Value
            access IN_VeAPSR_b_PVSMinLearnt_Value: accessed-variable=VeAPSR_b_PVSMinLearnt.Value
          data-send-points:
            access OUT_VeDCAB_e_Routine_RC130C_AccPedLea_Op_Value: accessed-variable=VeDCAB_e_Routine_RC130C_AccPedLea_Op.Value
        RoutineServices_RC130C_Stop
          data-send-points:
            access OUT_VeDCAB_e_Routine_RC130C_AccPedLea_Op_Value: accessed-variable=VeDCAB_e_Routine_RC130C_AccPedLea_Op.Value
        RoutineServices_RC130C_Start
          data-send-points:
            access OUT_VeDCAB_e_Routine_RC130C_AccPedLea_Op_Value: accessed-variable=VeDCAB_e_Routine_RC130C_AccPedLea_Op.Value
        RoutineServices_RC130D_RequestResults
          data-receive-point-by-arguments:
            access IN_VeRCVR_e_EXV_RtnSts_Value: accessed-variable=VeRCVR_e_EXV_RtnSts.Value
          data-send-points:
            access OUT_VeDCAB_e_Routine_RC130D_EXVValCal_Op_Value: accessed-variable=VeDCAB_e_Routine_RC130D_EXVValCal_Op.Value
        RoutineServices_RC130D_Start
          data-receive-point-by-arguments:
            access IN_VeRCVR_e_EXV_RtnSts_Value: accessed-variable=VeRCVR_e_EXV_RtnSts.Value
          data-send-points:
            access OUT_VeDCAB_e_Routine_RC130D_EXVValCal_Op_Value: accessed-variable=VeDCAB_e_Routine_RC130D_EXVValCal_Op.Value
        RoutineServices_RC130D_Stop
          data-send-points:
            access OUT_VeDCAB_e_Routine_RC130D_EXVValCal_Op_Value: accessed-variable=VeDCAB_e_Routine_RC130D_EXVValCal_Op.Value
        RoutineServices_RC130E_RequestResults
          data-receive-point-by-arguments:
            access IN_VeRCVR_e_LTR_RtnSts_Value: accessed-variable=VeRCVR_e_LTR_RtnSts.Value
          data-send-points:
            access OUT_VeDCAB_e_Routine_RC130E_LTR_ClbrtnRtn_Op_Value: accessed-variable=VeDCAB_e_Routine_RC130E_LTR_ClbrtnRtn_Op.Value
        RoutineServices_RC130E_Start
          data-receive-point-by-arguments:
            access IN_VeRCVR_e_LTR_RtnSts_Value: accessed-variable=VeRCVR_e_LTR_RtnSts.Value
          data-send-points:
            access OUT_VeDCAB_e_Routine_RC130E_LTR_ClbrtnRtn_Op_Value: accessed-variable=VeDCAB_e_Routine_RC130E_LTR_ClbrtnRtn_Op.Value
        RoutineServices_RC130F_RequestResults
          data-receive-point-by-arguments:
            access IN_VeRCVR_e_HTL_RtnSts_Value: accessed-variable=VeRCVR_e_HTL_RtnSts.Value
          data-send-points:
            access OUT_VeDCAB_e_Routine_RC130F_HTL_ClbrtnRtn_Op_Value: accessed-variable=VeDCAB_e_Routine_RC130F_HTL_ClbrtnRtn_Op.Value
        RoutineServices_RC130F_Start
          data-receive-point-by-arguments:
            access IN_VeRCVR_e_HTL_RtnSts_Value: accessed-variable=VeRCVR_e_HTL_RtnSts.Value
          data-send-points:
            access OUT_VeDCAB_e_Routine_RC130F_HTL_ClbrtnRtn_Op_Value: accessed-variable=VeDCAB_e_Routine_RC130F_HTL_ClbrtnRtn_Op.Value
        RoutineServices_RC1313_RequestResults
          data-receive-point-by-arguments:
            access IN_VeFSCR_e_AGS_RoutineControl_Value: accessed-variable=VeFSCR_e_AGS_RoutineControl.Value
          data-send-points:
            access OUT_VeDCAB_e_Routine_RC1313_ActGriShu1Cal_Op_Value: accessed-variable=VeDCAB_e_Routine_RC1313_ActGriShu1Cal_Op.Value
        RoutineServices_RC1313_Start
          data-send-points:
            access OUT_VeDCAB_e_Routine_RC1313_ActGriShu1Cal_Op_Value: accessed-variable=VeDCAB_e_Routine_RC1313_ActGriShu1Cal_Op.Value
        RoutineServices_RC1313_Stop
          data-send-points:
            access OUT_VeDCAB_e_Routine_RC1313_ActGriShu1Cal_Op_Value: accessed-variable=VeDCAB_e_Routine_RC1313_ActGriShu1Cal_Op.Value
        RoutineServices_RC1314_RequestResults
          data-receive-point-by-arguments:
            access IN_VeFSCR_e_AGS2_RoutineControl_Value: accessed-variable=VeFSCR_e_AGS2_RoutineControl.Value
          data-send-points:
            access OUT_VeDCAB_e_Routine_RC1314_ActGriShu2Cal_Op_Value: accessed-variable=VeDCAB_e_Routine_RC1314_ActGriShu2Cal_Op.Value
        RoutineServices_RC1314_Start
          data-send-points:
            access OUT_VeDCAB_e_Routine_RC1314_ActGriShu2Cal_Op_Value: accessed-variable=VeDCAB_e_Routine_RC1314_ActGriShu2Cal_Op.Value
        RoutineServices_RC1314_Stop
          data-send-points:
            access OUT_VeDCAB_e_Routine_RC1314_ActGriShu2Cal_Op_Value: accessed-variable=VeDCAB_e_Routine_RC1314_ActGriShu2Cal_Op.Value
        RoutineServices_RC1330_RequestResults
          data-receive-point-by-arguments:
            access IN_VeAADR_e_AAD_EOLCalResults_Value: accessed-variable=VeAADR_e_AAD_EOLCalResults.Value
          data-send-points:
            access OUT_VeDCAB_e_Routine_RC1330_ActAirDamCal_Op_Value: accessed-variable=VeDCAB_e_Routine_RC1330_ActAirDamCal_Op.Value
        RoutineServices_RC1330_Start
          data-send-points:
            access OUT_VeDCAB_e_Routine_RC1330_ActAirDamCal_Op_Value: accessed-variable=VeDCAB_e_Routine_RC1330_ActAirDamCal_Op.Value
        RoutineServices_RC1330_Stop
          data-send-points:
            access OUT_VeDCAB_e_Routine_RC1330_ActAirDamCal_Op_Value: accessed-variable=VeDCAB_e_Routine_RC1330_ActAirDamCal_Op.Value
        RoutineServices_RC1332_RequestResults
          data-receive-point-by-arguments:
            access IN_VeRCVR_e_EEXV_RtnSts_Value: accessed-variable=VeRCVR_e_EEXV_RtnSts.Value
          data-send-points:
            access OUT_VeDCAB_e_Routine_RC1332_ACRefExpValActCCal_Op_Value: accessed-variable=VeDCAB_e_Routine_RC1332_ACRefExpValActCCal_Op.Value
        RoutineServices_RC1332_Start
          data-receive-point-by-arguments:
            access IN_VeRCVR_e_EEXV_RtnSts_Value: accessed-variable=VeRCVR_e_EEXV_RtnSts.Value
          data-send-points:
            access OUT_VeDCAB_e_Routine_RC1332_ACRefExpValActCCal_Op_Value: accessed-variable=VeDCAB_e_Routine_RC1332_ACRefExpValActCCal_Op.Value
        RoutineServices_RC1332_Stop
          data-send-points:
            access OUT_VeDCAB_e_Routine_RC1332_ACRefExpValActCCal_Op_Value: accessed-variable=VeDCAB_e_Routine_RC1332_ACRefExpValActCCal_Op.Value
        RoutineServices_RC1333_RequestResults
          data-receive-point-by-arguments:
            access IN_VeRCVR_e_OEXV_RtnSts_Value: accessed-variable=VeRCVR_e_OEXV_RtnSts.Value
          data-send-points:
            access OUT_VeDCAB_e_Routine_RC1333_ACRefExpValActDCal_Op_Value: accessed-variable=VeDCAB_e_Routine_RC1333_ACRefExpValActDCal_Op.Value
        RoutineServices_RC1333_Start
          data-receive-point-by-arguments:
            access IN_VeRCVR_e_OEXV_RtnSts_Value: accessed-variable=VeRCVR_e_OEXV_RtnSts.Value
          data-send-points:
            access OUT_VeDCAB_e_Routine_RC1333_ACRefExpValActDCal_Op_Value: accessed-variable=VeDCAB_e_Routine_RC1333_ACRefExpValActDCal_Op.Value
        RoutineServices_RC1333_Stop
          data-send-points:
            access OUT_VeDCAB_e_Routine_RC1333_ACRefExpValActDCal_Op_Value: accessed-variable=VeDCAB_e_Routine_RC1333_ACRefExpValActDCal_Op.Value
        RoutineServices_RC1336_RequestResults
          data-receive-point-by-arguments:
            access IN_VeRTMR_e_WED_ToothAbutResult_Value: accessed-variable=VeRTMR_e_WED_ToothAbutResult.Value
          data-send-points:
            access OUT_VeDCAB_e_Routine_RC1336_ToothAbutmentLearning_Op_Value: accessed-variable=VeDCAB_e_Routine_RC1336_ToothAbutmentLearning_Op.Value
        RoutineServices_RC1336_Start
          data-send-points:
            access OUT_VeDCAB_e_Routine_RC1336_ToothAbutmentLearning_Op_Value: accessed-variable=VeDCAB_e_Routine_RC1336_ToothAbutmentLearning_Op.Value
        DataServices_RWD2800_Data_WriteData
          data-send-points:
            access OUT_VeDCAB_d_IP_PRNDLTestFlags_DidWrite_Value: accessed-variable=VeDCAB_d_IP_PRNDLTestFlags_DidWrite.Value
        DataServices_RWD3025_Data_WriteData
          data-send-points:
            5 x access:
              OUT_VeDCAB_b_RWD3025_InFieldMode_Value: accessed-variable=VeDCAB_b_RWD3025_InFieldMode.Value
              OUT_VeDCAB_b_RWD3025_RadFanHandshake_disbld_Value: accessed-variable=VeDCAB_b_RWD3025_RadFanHandshake_disbld.Value
              OUT_VeDCAB_b_RWD3025_ElectricOnlyTest_Enabled_Value: accessed-variable=VeDCAB_b_RWD3025_ElectricOnlyTest_Enabled.Value
              OUT_VeDCAB_b_RWD3025_REMDisabled_Value: accessed-variable=VeDCAB_b_RWD3025_REMDisabled.Value
              OUT_VeDCAB_y_RWD3025_EOMTest_Value: accessed-variable=VeDCAB_y_RWD3025_EOMTest.Value
        DataServices_RWD3029_Data_WriteData
          data-send-points:
            access OUT_VeDCAB_b_RadFanTst_NotCmplte_DidWrite_Value: accessed-variable=VeDCAB_b_RadFanTst_NotCmplte_DidWrite.Value
            access OUT_VeDCAB_b_RadFanTst_Failed_DidWrite_Value: accessed-variable=VeDCAB_b_RadFanTst_Failed_DidWrite.Value
        DataServices_RWD3202_Data_WriteData
          data-send-points:
            access OUT_VeDCAB_b_RWD3202_ImpactResponse_Value: accessed-variable=VeDCAB_b_RWD3202_ImpactResponse.Value
        DataServices_RWD9E15_Data_WriteData
          data-send-points:
            8 x access:
              OUT_VeDCAB_b_Pv1MaxTestNotCmplt_DidWrite_Value: accessed-variable=VeDCAB_b_Pv1MaxTestNotCmplt_DidWrite.Value
              OUT_VeDCAB_b_Pv1MaxTestFailed_DidWrite_Value: accessed-variable=VeDCAB_b_Pv1MaxTestFailed_DidWrite.Value
              OUT_VeDCAB_b_Pv1MinTestNotCmplt_DidWrite_Value: accessed-variable=VeDCAB_b_Pv1MinTestNotCmplt_DidWrite.Value
              OUT_VeDCAB_b_Pv1MinTestFailed_DidWrite_Value: accessed-variable=VeDCAB_b_Pv1MinTestFailed_DidWrite.Value
              OUT_VeDCAB_b_Pv2MaxTestNotCmplt_DidWrite_Value: accessed-variable=VeDCAB_b_Pv2MaxTestNotCmplt_DidWrite.Value
              OUT_VeDCAB_b_Pv2MaxTestFailed_DidWrite_Value: accessed-variable=VeDCAB_b_Pv2MaxTestFailed_DidWrite.Value
              OUT_VeDCAB_b_Pv2MinTestNotCmplt_DidWrite_Value: accessed-variable=VeDCAB_b_Pv2MinTestNotCmplt_DidWrite.Value
              OUT_VeDCAB_b_Pv2MinTestFailed_DidWrite_Value: accessed-variable=VeDCAB_b_Pv2MinTestFailed_DidWrite.Value
        DataServices_RWD9E20_Data_WriteData
          data-send-points:
            access OUT_VeDCAB_U_Pvs1MinValue_DidWrite_Value: accessed-variable=VeDCAB_U_Pvs1MinValue_DidWrite.Value
        DataServices_RWD9E21_Data_WriteData
          data-send-points:
            access OUT_VeDCAB_U_Pvs1MaxValue_DidWrite_Value: accessed-variable=VeDCAB_U_Pvs1MaxValue_DidWrite.Value
        DataServices_RWD9E22_Data_WriteData
          data-send-points:
            access OUT_VeDCAB_U_Pvs2MinValue_DidWrite_Value: accessed-variable=VeDCAB_U_Pvs2MinValue_DidWrite.Value
        DataServices_RWD9E23_Data_WriteData
          data-send-points:
            access OUT_VeDCAB_U_Pvs2MaxValue_DidWrite_Value: accessed-variable=VeDCAB_U_Pvs2MaxValue_DidWrite.Value
        DataServices_RWD9E3B_Data_WriteData
          data-send-points:
            access OUT_VeDCAB_milel_RWD9E3B_IPEETstMilgeLmt_Value: accessed-variable=VeDCAB_milel_RWD9E3B_IPEETstMilgeLmt.Value
        DataServices_RWD9EEB_Data_WriteData
          data-send-points:
            access OUT_VeDCAB_Pct_RWD9EEB_InPlant_SOC_Setpoint_Value: accessed-variable=VeDCAB_Pct_RWD9EEB_InPlant_SOC_Setpoint.Value
        DataServices_RWD9EEC_Data_WriteData
          data-send-points:
            access OUT_VeDCAB_Pct_RWD9EEC_REM_Logistics_SOC_Setpoint_Value: accessed-variable=VeDCAB_Pct_RWD9EEC_REM_Logistics_SOC_Setpoint.Value
        DataServices_RWDB604_Data_WriteData
          data-send-points:
            access OUT_VeDCAB_e_RWDB604_DCChrg_TestSts_DidWrite_Value: accessed-variable=VeDCAB_e_RWDB604_DCChrg_TestSts_DidWrite.Value
        DataServices_RWDB607_Data_WriteData
          data-send-points:
            access OUT_VeDCAB_b_CreepModeReq_DidWrite_Value: accessed-variable=VeDCAB_b_CreepModeReq_DidWrite.Value
        DataServices_RWDB61B_Data_WriteData
          data-send-points:
            access OUT_VeDCAB_v_STSLSpdLimMPH_DidWrite_Value: accessed-variable=VeDCAB_v_STSLSpdLimMPH_DidWrite.Value
        DataServices_RWDB62F_Data_WriteData
          data-send-points:
            access OUT_VeDCAB_b_RWDB62F_ActAirDamOperMd_Op_Value: accessed-variable=VeDCAB_b_RWDB62F_ActAirDamOperMd_Op.Value
        DataServices_RWDB652_Data_WriteData
          data-send-points:
            access OUT_VeDCAB_e_RWDB652_WEDExtToolCmd_Value: accessed-variable=VeDCAB_e_RWDB652_WEDExtToolCmd.Value
