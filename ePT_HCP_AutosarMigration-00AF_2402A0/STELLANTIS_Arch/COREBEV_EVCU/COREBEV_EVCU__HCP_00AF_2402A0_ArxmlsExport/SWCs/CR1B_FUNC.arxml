[part 2 of 2: package /STELLANTIS/EPT/COMSWCs]
AUTOSAR XML (schema 4-2-2)
package /STELLANTIS/EPT/COMSWCs  (continued)
  application sw component type CR1B_FUNC  (continued)
    behavior IB_CR1B_FUNC: data-type-mapping=[msADTtoIDTMapping, ADTtoIDTMapping], handle-termination-and-restart=NO-SUPPORT
      timing event Event_FastTEF: start-on-event=CR1B_FUNC_FastTEF, period=0.005
      timing event Event_MedTEB: start-on-event=CR1B_FUNC_MedTEB, period=0.01
      init event Event_CR1B_FUNC_ac_Init: start-on-event=CR1B_FUNC_ac_Init
      runnable CR1B_FUNC_ac_Init
      runnable CR1B_FUNC_FastTEF
        data-receive-point-by-arguments:
          168 x access:
            IN_VeCANR_e_CanLocEnblStatus_VeCANR_e_CanLocEnblStatus: accessed-variable=VeCANR_e_CanLocEnblStatus.VeCANR_e_CanLocEnblStatus
            IN_VeSR1B_M_BrkTrq_Driver_FD3_Value: accessed-variable=VeSR1B_M_BrkTrq_Driver_FD3.Value
            IN_VeSR1B_M_BrkTrq_FD3_Value: accessed-variable=VeSR1B_M_BrkTrq_FD3.Value
            IN_VeSR1B_M_CmdTotBrkFricAxTrqFD3_Value: accessed-variable=VeSR1B_M_CmdTotBrkFricAxTrqFD3.Value
            IN_VeSR1B_M_DrvrRquestdAxlTqBSMFD3_Value: accessed-variable=VeSR1B_M_DrvrRquestdAxlTqBSMFD3.Value
            IN_VeSR1B_M_FrontAxle_Rq_BSM_FD3_Value: accessed-variable=VeSR1B_M_FrontAxle_Rq_BSM_FD3.Value
            IN_VeSR1B_M_RearAxle_Rq_BSM_FD3_Value: accessed-variable=VeSR1B_M_RearAxle_Rq_BSM_FD3.Value
            IN_VeSR1B_M_Regen_AxleTorque_Req_Value: accessed-variable=VeSR1B_M_Regen_AxleTorque_Req.Value
            IN_VeSR1B_Pct_BrakePdlPosn_FD3_Value: accessed-variable=VeSR1B_Pct_BrakePdlPosn_FD3.Value
            IN_VeSR1B_Pct_DRV_TEMP_DR_POS_Value: accessed-variable=VeSR1B_Pct_DRV_TEMP_DR_POS.Value
            IN_VeSR1B_Pct_HVAC_Blwr_Perct_Value: accessed-variable=VeSR1B_Pct_HVAC_Blwr_Perct.Value
            IN_VeSR1B_Pct_PAS_TEMP_DR_POS_Value: accessed-variable=VeSR1B_Pct_PAS_TEMP_DR_POS.Value
            IN_VeSR1B_Pct_RearAirHtrPwrTgt_Value: accessed-variable=VeSR1B_Pct_RearAirHtrPwrTgt.Value
            IN_VeSR1B_Pct_Slope_Value: accessed-variable=VeSR1B_Pct_Slope.Value
            IN_VeSR1B_T_EvapTempTar_Value: accessed-variable=VeSR1B_T_EvapTempTar.Value
            IN_VeSR1B_T_HtrCorTmp_InTgt_Value: accessed-variable=VeSR1B_T_HtrCorTmp_InTgt.Value
            IN_VeSR1B_T_VEH_INT_TEMP_Value: accessed-variable=VeSR1B_T_VEH_INT_TEMP.Value
            IN_VeSR1B_a_LatAcceleration_BSM_FD3_Value: accessed-variable=VeSR1B_a_LatAcceleration_BSM_FD3.Value
            IN_VeSR1B_a_LongAcceleration_BSM_FD3_Value: accessed-variable=VeSR1B_a_LongAcceleration_BSM_FD3.Value
            IN_VeSR1B_b_ABSActive_FD3_Value: accessed-variable=VeSR1B_b_ABSActive_FD3.Value
            IN_VeSR1B_b_ABSFailSts_FD3_Value: accessed-variable=VeSR1B_b_ABSFailSts_FD3.Value
            IN_VeSR1B_b_ACC_On_Value: accessed-variable=VeSR1B_b_ACC_On.Value
            IN_VeSR1B_b_ASRActive_FD3_Value: accessed-variable=VeSR1B_b_ASRActive_FD3.Value
            IN_VeSR1B_b_AcceleratorSts_Value: accessed-variable=VeSR1B_b_AcceleratorSts.Value
            IN_VeSR1B_b_BrakeInterventionSts_Value: accessed-variable=VeSR1B_b_BrakeInterventionSts.Value
            IN_VeSR1B_b_BrkPdl_Flt_FD3_Value: accessed-variable=VeSR1B_b_BrkPdl_Flt_FD3.Value
            IN_VeSR1B_b_Brk_Thermdl_Value: accessed-variable=VeSR1B_b_Brk_Thermdl.Value, variation-point={short-label=vpIN_VeSR1B_b_Brk_Thermdl_Value, sw-syscond=1}
            IN_VeSR1B_b_CruiseControlFailSts_Value: accessed-variable=VeSR1B_b_CruiseControlFailSts.Value
            IN_VeSR1B_b_CruiseControlOnOffSts_Value: accessed-variable=VeSR1B_b_CruiseControlOnOffSts.Value
            IN_VeSR1B_b_CrusCnclSwitch_Value: accessed-variable=VeSR1B_b_CrusCnclSwitch.Value
            IN_VeSR1B_b_DEFROST_SEL_Value: accessed-variable=VeSR1B_b_DEFROST_SEL.Value
            IN_VeSR1B_b_DeceleratorSts_Value: accessed-variable=VeSR1B_b_DeceleratorSts.Value
            IN_VeSR1B_b_ESCActive_FD3_Value: accessed-variable=VeSR1B_b_ESCActive_FD3.Value
            IN_VeSR1B_b_ESCFailSts_FD3_Value: accessed-variable=VeSR1B_b_ESCFailSts_FD3.Value
            IN_VeSR1B_b_ESCIntervention_Value: accessed-variable=VeSR1B_b_ESCIntervention.Value
            IN_VeSR1B_b_FrontAxleMax_Rq_BSMFD3_Value: accessed-variable=VeSR1B_b_FrontAxleMax_Rq_BSMFD3.Value
            IN_VeSR1B_b_FrontAxleMin_Rq_BSMFD3_Value: accessed-variable=VeSR1B_b_FrontAxleMin_Rq_BSMFD3.Value
            IN_VeSR1B_b_Function2Sts_FD3_Value: accessed-variable=VeSR1B_b_Function2Sts_FD3.Value
            IN_VeSR1B_b_HAS_OnOffSts_Value: accessed-variable=VeSR1B_b_HAS_OnOffSts.Value
            IN_VeSR1B_b_IMMO_CODE_RESPONSE_NewEvent_Value: accessed-variable=VeSR1B_b_IMMO_CODE_RESPONSE_NewEvent.Value
            IN_VeSR1B_b_ImmoParkReq_Value: accessed-variable=VeSR1B_b_ImmoParkReq.Value
            IN_VeSR1B_b_ImpendingSkid_Value: accessed-variable=VeSR1B_b_ImpendingSkid.Value
            IN_VeSR1B_b_LHFWhlSnsrFailSts_FD3_Value: accessed-variable=VeSR1B_b_LHFWhlSnsrFailSts_FD3.Value
            IN_VeSR1B_b_LHR_WhlSnsrFailStsFD3_Value: accessed-variable=VeSR1B_b_LHR_WhlSnsrFailStsFD3.Value
            IN_VeSR1B_b_RHF_WhlSnsrFailStsFD3_Value: accessed-variable=VeSR1B_b_RHF_WhlSnsrFailStsFD3.Value
            IN_VeSR1B_b_RHR_WhlSnsrFailStsFD3_Value: accessed-variable=VeSR1B_b_RHR_WhlSnsrFailStsFD3.Value
            IN_VeSR1B_b_RearAxle_Max_Rq_BSMFD3_Value: accessed-variable=VeSR1B_b_RearAxle_Max_Rq_BSMFD3.Value
            IN_VeSR1B_b_RearAxle_Min_Rq_BSMFD3_Value: accessed-variable=VeSR1B_b_RearAxle_Min_Rq_BSMFD3.Value
            IN_VeSR1B_b_ResumeSwitch_Value: accessed-variable=VeSR1B_b_ResumeSwitch.Value
            IN_VeSR1B_b_SpeedLimiterOnOffSts_Value: accessed-variable=VeSR1B_b_SpeedLimiterOnOffSts.Value
            IN_VeSR1B_l_TravelDistance_Value: accessed-variable=VeSR1B_l_TravelDistance.Value
            IN_VeSR1B_pbar_BrakeBoostPressureFD3_Value: accessed-variable=VeSR1B_pbar_BrakeBoostPressureFD3.Value
            IN_VeSR1B_pbar_BrakePedalPressure_FD3_Value: accessed-variable=VeSR1B_pbar_BrakePedalPressure_FD3.Value
            IN_VeSR1B_v_LHFWheelSpeed_FD3_Value: accessed-variable=VeSR1B_v_LHFWheelSpeed_FD3.Value
            IN_VeSR1B_v_LHRWheelSpeed_FD3_Value: accessed-variable=VeSR1B_v_LHRWheelSpeed_FD3.Value
            IN_VeSR1B_v_RHFWheelSpeed_FD3_Value: accessed-variable=VeSR1B_v_RHFWheelSpeed_FD3.Value
            IN_VeSR1B_v_RHRWheelSpeed_FD3_Value: accessed-variable=VeSR1B_v_RHRWheelSpeed_FD3.Value
            IN_VeSR1B_v_VehicleSpeedVSOSig_FD3_Value: accessed-variable=VeSR1B_v_VehicleSpeedVSOSig_FD3.Value
            IN_VeSR1B_y_ABSActive_FD3_SigSts_Value: accessed-variable=VeSR1B_y_ABSActive_FD3_SigSts.Value
            IN_VeSR1B_y_ABSFailSts_FD3_SigSts_Value: accessed-variable=VeSR1B_y_ABSFailSts_FD3_SigSts.Value
            IN_VeSR1B_y_ACC_On_SigSts_Value: accessed-variable=VeSR1B_y_ACC_On_SigSts.Value
            IN_VeSR1B_y_AHH_Ready_Status_Value: accessed-variable=VeSR1B_y_AHH_Ready_Status.Value
            IN_VeSR1B_y_AHH_Ready_Status_SigSts_Value: accessed-variable=VeSR1B_y_AHH_Ready_Status_SigSts.Value
            IN_VeSR1B_y_AHP_EnblReq_Value: accessed-variable=VeSR1B_y_AHP_EnblReq.Value
            IN_VeSR1B_y_AHP_EnblReq_SigSts_Value: accessed-variable=VeSR1B_y_AHP_EnblReq_SigSts.Value
            IN_VeSR1B_y_ASRActive_FD3_SigSts_Value: accessed-variable=VeSR1B_y_ASRActive_FD3_SigSts.Value
            IN_VeSR1B_y_AcceleratorSts_SigSts_Value: accessed-variable=VeSR1B_y_AcceleratorSts_SigSts.Value
            IN_VeSR1B_y_BrakeBoostPressureFD3_SigSts_Value: accessed-variable=VeSR1B_y_BrakeBoostPressureFD3_SigSts.Value
            IN_VeSR1B_y_BrakeInterventionSts_SigSts_Value: accessed-variable=VeSR1B_y_BrakeInterventionSts_SigSts.Value
            IN_VeSR1B_y_BrakePdlPosn_FD3_SigSts_Value: accessed-variable=VeSR1B_y_BrakePdlPosn_FD3_SigSts.Value
            IN_VeSR1B_y_BrakePedalPressure_FD3_SigSts_Value: accessed-variable=VeSR1B_y_BrakePedalPressure_FD3_SigSts.Value
            IN_VeSR1B_y_Brake_MaxRegen_Ready_FD3_Value: accessed-variable=VeSR1B_y_Brake_MaxRegen_Ready_FD3.Value
            IN_VeSR1B_y_Brake_MaxRegen_Ready_FD3_SigSts_Value: accessed-variable=VeSR1B_y_Brake_MaxRegen_Ready_FD3_SigSts.Value
            IN_VeSR1B_y_BrkPdl_Flt_FD3_SigSts_Value: accessed-variable=VeSR1B_y_BrkPdl_Flt_FD3_SigSts.Value
            IN_VeSR1B_y_BrkPdl_Stat_FD3_Value: accessed-variable=VeSR1B_y_BrkPdl_Stat_FD3.Value
            IN_VeSR1B_y_BrkPdl_Stat_FD3_SigSts_Value: accessed-variable=VeSR1B_y_BrkPdl_Stat_FD3_SigSts.Value
            IN_VeSR1B_y_BrkTrq_Driver_FD3_SigSts_Value: accessed-variable=VeSR1B_y_BrkTrq_Driver_FD3_SigSts.Value
            IN_VeSR1B_y_BrkTrq_FD3_SigSts_Value: accessed-variable=VeSR1B_y_BrkTrq_FD3_SigSts.Value
            IN_VeSR1B_y_Brk_Thermdl_SigSts_Value: accessed-variable=VeSR1B_y_Brk_Thermdl_SigSts.Value, variation-point={short-label=vpIN_VeSR1B_y_Brk_Thermdl_SigSts_Value, sw-syscond=1}
            IN_VeSR1B_y_CmdTotBrkFricAxTrqFD3_SigSts_Value: accessed-variable=VeSR1B_y_CmdTotBrkFricAxTrqFD3_SigSts.Value
            IN_VeSR1B_y_ControlEncodingRsp_Value: accessed-variable=VeSR1B_y_ControlEncodingRsp.Value
            IN_VeSR1B_y_ControlEncodingRsp_SigSts_Value: accessed-variable=VeSR1B_y_ControlEncodingRsp_SigSts.Value
            IN_VeSR1B_y_CruiseControlFailSts_SigSts_Value: accessed-variable=VeSR1B_y_CruiseControlFailSts_SigSts.Value
            IN_VeSR1B_y_CruiseControlOnOffSts_SigSts_Value: accessed-variable=VeSR1B_y_CruiseControlOnOffSts_SigSts.Value
            IN_VeSR1B_y_CrusCnclSwitch_SigSts_Value: accessed-variable=VeSR1B_y_CrusCnclSwitch_SigSts.Value
            IN_VeSR1B_y_DEFROST_SEL_SigSts_Value: accessed-variable=VeSR1B_y_DEFROST_SEL_SigSts.Value
            IN_VeSR1B_y_DRV_TEMP_DR_POS_SigSts_Value: accessed-variable=VeSR1B_y_DRV_TEMP_DR_POS_SigSts.Value
            IN_VeSR1B_y_DeceleratorSts_SigSts_Value: accessed-variable=VeSR1B_y_DeceleratorSts_SigSts.Value
            IN_VeSR1B_y_DrvrRqAxlTqEnbdBSMFD3_Value: accessed-variable=VeSR1B_y_DrvrRqAxlTqEnbdBSMFD3.Value
            IN_VeSR1B_y_DrvrRqAxlTqEnbdBSMFD3_SigSts_Value: accessed-variable=VeSR1B_y_DrvrRqAxlTqEnbdBSMFD3_SigSts.Value
            IN_VeSR1B_y_DrvrRquestdAxlTqBSMFD3_SigSts_Value: accessed-variable=VeSR1B_y_DrvrRquestdAxlTqBSMFD3_SigSts.Value
            IN_VeSR1B_y_EPBSts_FD3_Value: accessed-variable=VeSR1B_y_EPBSts_FD3.Value
            IN_VeSR1B_y_EPBSts_FD3_SigSts_Value: accessed-variable=VeSR1B_y_EPBSts_FD3_SigSts.Value
            IN_VeSR1B_y_ESCActive_FD3_SigSts_Value: accessed-variable=VeSR1B_y_ESCActive_FD3_SigSts.Value
            IN_VeSR1B_y_ESCFailSts_FD3_SigSts_Value: accessed-variable=VeSR1B_y_ESCFailSts_FD3_SigSts.Value
            IN_VeSR1B_y_ESCIntervention_SigSts_Value: accessed-variable=VeSR1B_y_ESCIntervention_SigSts.Value
            IN_VeSR1B_y_EvapTempTar_SigSts_Value: accessed-variable=VeSR1B_y_EvapTempTar_SigSts.Value
            IN_VeSR1B_y_ExternalBrkReqsDsbld_Value: accessed-variable=VeSR1B_y_ExternalBrkReqsDsbld.Value
            IN_VeSR1B_y_ExternalBrkReqsDsbld_SigSts_Value: accessed-variable=VeSR1B_y_ExternalBrkReqsDsbld_SigSts.Value
            IN_VeSR1B_y_FrontAxleMax_Rq_BSMFD3_SigSts_Value: accessed-variable=VeSR1B_y_FrontAxleMax_Rq_BSMFD3_SigSts.Value
            IN_VeSR1B_y_FrontAxleMin_Rq_BSMFD3_SigSts_Value: accessed-variable=VeSR1B_y_FrontAxleMin_Rq_BSMFD3_SigSts.Value
            IN_VeSR1B_y_FrontAxle_Rq_BSM_FD3_SigSts_Value: accessed-variable=VeSR1B_y_FrontAxle_Rq_BSM_FD3_SigSts.Value
            IN_VeSR1B_y_Function2Sts_FD3_SigSts_Value: accessed-variable=VeSR1B_y_Function2Sts_FD3_SigSts.Value
            IN_VeSR1B_y_HAS_OnOffSts_SigSts_Value: accessed-variable=VeSR1B_y_HAS_OnOffSts_SigSts.Value
            IN_VeSR1B_y_HILL_DES_STAT_Value: accessed-variable=VeSR1B_y_HILL_DES_STAT.Value
            IN_VeSR1B_y_HILL_DES_STAT_SigSts_Value: accessed-variable=VeSR1B_y_HILL_DES_STAT_SigSts.Value
            IN_VeSR1B_y_HVAC_Blwr_Perct_SigSts_Value: accessed-variable=VeSR1B_y_HVAC_Blwr_Perct_SigSts.Value
            IN_VeSR1B_y_HtrCorTmp_InTgt_SigSts_Value: accessed-variable=VeSR1B_y_HtrCorTmp_InTgt_SigSts.Value
            IN_VeSR1B_y_ImmoParkReq_SigSts_Value: accessed-variable=VeSR1B_y_ImmoParkReq_SigSts.Value
            IN_VeSR1B_y_ImpendingSkid_SigSts_Value: accessed-variable=VeSR1B_y_ImpendingSkid_SigSts.Value
            IN_VeSR1B_y_LHFWheelSpeed_FD3_SigSts_Value: accessed-variable=VeSR1B_y_LHFWheelSpeed_FD3_SigSts.Value
            IN_VeSR1B_y_LHFWhlSnsrFailSts_FD3_SigSts_Value: accessed-variable=VeSR1B_y_LHFWhlSnsrFailSts_FD3_SigSts.Value
            IN_VeSR1B_y_LHF_Spin_FD3_Value: accessed-variable=VeSR1B_y_LHF_Spin_FD3.Value
            IN_VeSR1B_y_LHF_Spin_FD3_SigSts_Value: accessed-variable=VeSR1B_y_LHF_Spin_FD3_SigSts.Value
            IN_VeSR1B_y_LHRWheelSpeed_FD3_SigSts_Value: accessed-variable=VeSR1B_y_LHRWheelSpeed_FD3_SigSts.Value
            IN_VeSR1B_y_LHR_Spin_FD3_Value: accessed-variable=VeSR1B_y_LHR_Spin_FD3.Value
            IN_VeSR1B_y_LHR_Spin_FD3_SigSts_Value: accessed-variable=VeSR1B_y_LHR_Spin_FD3_SigSts.Value
            IN_VeSR1B_y_LHR_WhlSnsrFailStsFD3_SigSts_Value: accessed-variable=VeSR1B_y_LHR_WhlSnsrFailStsFD3_SigSts.Value
            IN_VeSR1B_y_LatAcceleration_BSM_FD3_SigSts_Value: accessed-variable=VeSR1B_y_LatAcceleration_BSM_FD3_SigSts.Value
            IN_VeSR1B_y_LongAcceleration_BSM_FD3_SigSts_Value: accessed-variable=VeSR1B_y_LongAcceleration_BSM_FD3_SigSts.Value
            IN_VeSR1B_y_MKKey1org21_Value: accessed-variable=VeSR1B_y_MKKey1org21.Value
            IN_VeSR1B_y_MKKey1org21_SigSts_Value: accessed-variable=VeSR1B_y_MKKey1org21_SigSts.Value
            IN_VeSR1B_y_MKKey2org22_Value: accessed-variable=VeSR1B_y_MKKey2org22.Value
            IN_VeSR1B_y_MKKey2org22_SigSts_Value: accessed-variable=VeSR1B_y_MKKey2org22_SigSts.Value
            IN_VeSR1B_y_MKKey_3_Value: accessed-variable=VeSR1B_y_MKKey_3.Value
            IN_VeSR1B_y_MKKey_3_SigSts_Value: accessed-variable=VeSR1B_y_MKKey_3_SigSts.Value
            IN_VeSR1B_y_MKKey_4_Value: accessed-variable=VeSR1B_y_MKKey_4.Value
            IN_VeSR1B_y_MKKey_4_SigSts_Value: accessed-variable=VeSR1B_y_MKKey_4_SigSts.Value
            IN_VeSR1B_y_MKKey_5_Value: accessed-variable=VeSR1B_y_MKKey_5.Value
            IN_VeSR1B_y_MKKey_5_SigSts_Value: accessed-variable=VeSR1B_y_MKKey_5_SigSts.Value
            IN_VeSR1B_y_MKKey_6_Value: accessed-variable=VeSR1B_y_MKKey_6.Value
            IN_VeSR1B_y_MKKey_6_SigSts_Value: accessed-variable=VeSR1B_y_MKKey_6_SigSts.Value
            IN_VeSR1B_y_Not_OK_To_Race_Value: accessed-variable=VeSR1B_y_Not_OK_To_Race.Value, variation-point={short-label=vpIN_VeSR1B_y_Not_OK_To_Race_Value, sw-syscond=1}
            IN_VeSR1B_y_Not_OK_To_Race_SigSts_Value: accessed-variable=VeSR1B_y_Not_OK_To_Race_SigSts.Value, variation-point={short-label=vpIN_VeSR1B_y_Not_OK_To_Race_SigSts_Value, sw-syscond=1}
            IN_VeSR1B_y_OPD_Hold_Status_Value: accessed-variable=VeSR1B_y_OPD_Hold_Status.Value
            IN_VeSR1B_y_OPD_Hold_Status_SigSts_Value: accessed-variable=VeSR1B_y_OPD_Hold_Status_SigSts.Value
            IN_VeSR1B_y_PAS_TEMP_DR_POS_SigSts_Value: accessed-variable=VeSR1B_y_PAS_TEMP_DR_POS_SigSts.Value
            IN_VeSR1B_y_ParkingGearShiftReq_BSM_Value: accessed-variable=VeSR1B_y_ParkingGearShiftReq_BSM.Value
            IN_VeSR1B_y_ParkingGearShiftReq_BSM_SigSts_Value: accessed-variable=VeSR1B_y_ParkingGearShiftReq_BSM_SigSts.Value
            IN_VeSR1B_y_RHFWheelSpeed_FD3_SigSts_Value: accessed-variable=VeSR1B_y_RHFWheelSpeed_FD3_SigSts.Value
            IN_VeSR1B_y_RHF_Spin_FD3_Value: accessed-variable=VeSR1B_y_RHF_Spin_FD3.Value
            IN_VeSR1B_y_RHF_Spin_FD3_SigSts_Value: accessed-variable=VeSR1B_y_RHF_Spin_FD3_SigSts.Value
            IN_VeSR1B_y_RHF_WhlSnsrFailStsFD3_SigSts_Value: accessed-variable=VeSR1B_y_RHF_WhlSnsrFailStsFD3_SigSts.Value
            IN_VeSR1B_y_RHRWheelSpeed_FD3_SigSts_Value: accessed-variable=VeSR1B_y_RHRWheelSpeed_FD3_SigSts.Value
            IN_VeSR1B_y_RHR_Spin_FD3_Value: accessed-variable=VeSR1B_y_RHR_Spin_FD3.Value
            IN_VeSR1B_y_RHR_Spin_FD3_SigSts_Value: accessed-variable=VeSR1B_y_RHR_Spin_FD3_SigSts.Value
            IN_VeSR1B_y_RHR_WhlSnsrFailStsFD3_SigSts_Value: accessed-variable=VeSR1B_y_RHR_WhlSnsrFailStsFD3_SigSts.Value
            IN_VeSR1B_y_RearAirHtrPwrTgt_SigSts_Value: accessed-variable=VeSR1B_y_RearAirHtrPwrTgt_SigSts.Value
            IN_VeSR1B_y_RearAxle_Max_Rq_BSMFD3_SigSts_Value: accessed-variable=VeSR1B_y_RearAxle_Max_Rq_BSMFD3_SigSts.Value
            IN_VeSR1B_y_RearAxle_Min_Rq_BSMFD3_SigSts_Value: accessed-variable=VeSR1B_y_RearAxle_Min_Rq_BSMFD3_SigSts.Value
            IN_VeSR1B_y_RearAxle_Rq_BSM_FD3_SigSts_Value: accessed-variable=VeSR1B_y_RearAxle_Rq_BSM_FD3_SigSts.Value
            IN_VeSR1B_y_Regen_AxleTorque_Req_SigSts_Value: accessed-variable=VeSR1B_y_Regen_AxleTorque_Req_SigSts.Value
            IN_VeSR1B_y_ResumeSwitch_SigSts_Value: accessed-variable=VeSR1B_y_ResumeSwitch_SigSts.Value
            IN_VeSR1B_y_SelectSpdSts_Value: accessed-variable=VeSR1B_y_SelectSpdSts.Value
            IN_VeSR1B_y_SelectSpdSts_SigSts_Value: accessed-variable=VeSR1B_y_SelectSpdSts_SigSts.Value
            IN_VeSR1B_y_Slope_SigSts_Value: accessed-variable=VeSR1B_y_Slope_SigSts.Value
            IN_VeSR1B_y_SpeedLimiterOnOffSts_SigSts_Value: accessed-variable=VeSR1B_y_SpeedLimiterOnOffSts_SigSts.Value
            IN_VeSR1B_y_TravelDistance_SigSts_Value: accessed-variable=VeSR1B_y_TravelDistance_SigSts.Value
            IN_VeSR1B_y_Tri_Level_HSW_StatSts_Value: accessed-variable=VeSR1B_y_Tri_Level_HSW_StatSts.Value
            IN_VeSR1B_y_Tri_Level_HSW_StatSts_SigSts_Value: accessed-variable=VeSR1B_y_Tri_Level_HSW_StatSts_SigSts.Value
            IN_VeSR1B_y_VEH_INT_TEMP_SigSts_Value: accessed-variable=VeSR1B_y_VEH_INT_TEMP_SigSts.Value
            IN_VeSR1B_y_VehicleSpeedVSOSig_FD3_SigSts_Value: accessed-variable=VeSR1B_y_VehicleSpeedVSOSig_FD3_SigSts.Value
            IN_VeSR1B_y_VehicleStandStillSts_Value: accessed-variable=VeSR1B_y_VehicleStandStillSts.Value, variation-point={short-label=vpIN_VeSR1B_y_VehicleStandStillSts_Value, sw-syscond=1}
            IN_VeSR1B_y_VehicleStandStillSts_SigSts_Value: accessed-variable=VeSR1B_y_VehicleStandStillSts_SigSts.Value, variation-point={short-label=vpIN_VeSR1B_y_VehicleStandStillSts_SigSts_Value, sw-syscond=1}
            IN_VeSR1B_y_WED_MODE_RQ_Value: accessed-variable=VeSR1B_y_WED_MODE_RQ.Value
            IN_VeSR1B_y_WED_MODE_RQ_SigSts_Value: accessed-variable=VeSR1B_y_WED_MODE_RQ_SigSts.Value
            IN_VeSR1B_y_eBurn_Stages_Value: accessed-variable=VeSR1B_y_eBurn_Stages.Value
            IN_VeSR1B_y_eBurn_Stages_SigSts_Value: accessed-variable=VeSR1B_y_eBurn_Stages_SigSts.Value
        144 x sync call, all with timeout=1E-06:
          SC_FsftADIR_b_BSM_WEDModeReq_FsftADIR_b_BSM_WEDModeReq: operation=FsftADIR_b_BSM_WEDModeReq.FsftADIR_b_BSM_WEDModeReq
          SC_FsftASLR_b_Hill_Des_Status_FsftASLR_b_Hill_Des_Status: operation=FsftASLR_b_Hill_Des_Status.FsftASLR_b_Hill_Des_Status
          SC_FsftASLR_b_LaneCenteringOnOffSts_FsftASLR_b_LaneCenteringOnOffSts: operation=FsftASLR_b_LaneCenteringOnOffSts.FsftASLR_b_LaneCenteringOnOffSts
          SC_FsftASLR_b_SpdLmtrOnOffSts_FsftASLR_b_SpdLmtrOnOffSts: operation=FsftASLR_b_SpdLmtrOnOffSts.FsftASLR_b_SpdLmtrOnOffSts
          SC_FsftBRKR_P_BrkPrss_FsftBRKR_P_BrkPrss: operation=FsftBRKR_P_BrkPrss.FsftBRKR_P_BrkPrss
          SC_FsftBRKR_b_ABSActive_FsftBRKR_b_ABSActive: operation=FsftBRKR_b_ABSActive.FsftBRKR_b_ABSActive
          SC_FsftBRKR_b_ASRActive_FsftBRKR_b_ASRActive: operation=FsftBRKR_b_ASRActive.FsftBRKR_b_ASRActive
          SC_FsftBRKR_b_AeCoastReady_FsftBRKR_b_AeCoastReady: operation=FsftBRKR_b_AeCoastReady.FsftBRKR_b_AeCoastReady
          SC_FsftBRKR_b_BrkPdlFlt_FsftBRKR_b_BrkPdlFlt: operation=FsftBRKR_b_BrkPdlFlt.FsftBRKR_b_BrkPdlFlt
          SC_FsftBRKR_b_BrkPedalDscrtInpt_FsftBRKR_b_BrkPedalDscrtInpt: operation=FsftBRKR_b_BrkPedalDscrtInpt.FsftBRKR_b_BrkPedalDscrtInpt
          SC_FsftBRKR_b_BrkTmpSts_FsftBRKR_b_BrkTmpSts: operation=FsftBRKR_b_BrkTmpSts.FsftBRKR_b_BrkTmpSts, variation-point={short-label=vpSC_FsftBRKR_b_BrkTmpSts_FsftBRKR_b_BrkTmpSts, sw-syscond=1}
          SC_FsftBRKR_b_BrkTravelSts_FsftBRKR_b_BrkTravelSts: operation=FsftBRKR_b_BrkTravelSts.FsftBRKR_b_BrkTravelSts
          SC_FsftBRKR_b_ESCActive_FsftBRKR_b_ESCActive: operation=FsftBRKR_b_ESCActive.FsftBRKR_b_ESCActive
          SC_FsftBRKR_b_ESCFailSts_FsftBRKR_b_ESCFailSts: operation=FsftBRKR_b_ESCFailSts.FsftBRKR_b_ESCFailSts
          SC_FsftBRKR_b_ESCIntervention_FsftBRKR_b_ESCIntervention: operation=FsftBRKR_b_ESCIntervention.FsftBRKR_b_ESCIntervention
          SC_FsftBRKR_b_VehicleStandStillSts_FsftBRKR_b_VehicleStandStillSts: operation=FsftBRKR_b_VehicleStandStillSts.FsftBRKR_b_VehicleStandStillSts, variation-point={short-label=vpSC_FsftBRKR_b_VehicleStandStillSts_FsftBRKR_b_VehicleStandStillSts, sw-syscond=1}
          SC_FsftBRKR_e_AHH_Ready_Status_FsftBRKR_e_AHH_Ready_Status: operation=FsftBRKR_e_AHH_Ready_Status.FsftBRKR_e_AHH_Ready_Status
          SC_FsftBRKR_e_ExtBrkReqOff_FsftBRKR_e_ExtBrkReqOff: operation=FsftBRKR_e_ExtBrkReqOff.FsftBRKR_e_ExtBrkReqOff
          SC_FsftBRKR_e_Not_OK_To_Race_FsftBRKR_e_Not_OK_To_Race: operation=FsftBRKR_e_Not_OK_To_Race.FsftBRKR_e_Not_OK_To_Race, variation-point={short-label=vpSC_FsftBRKR_e_Not_OK_To_Race_FsftBRKR_e_Not_OK_To_Race, sw-syscond=1}
          SC_FsftBRKR_e_OPDHoldStatus_FsftBRKR_e_OPDHoldStatus: operation=FsftBRKR_e_OPDHoldStatus.FsftBRKR_e_OPDHoldStatus
          SC_FsftBRKR_pbar_BrakePedalPressure_FsftBRKR_pbar_BrakePedalPressure: operation=FsftBRKR_pbar_BrakePedalPressure.FsftBRKR_pbar_BrakePedalPressure
          SC_FsftBTQR_M_BrkTrq_Driver_FsftBTQR_M_BrkTrq_Driver: operation=FsftBTQR_M_BrkTrq_Driver.FsftBTQR_M_BrkTrq_Driver
          SC_FsftBTQR_M_DrvrIntndedFricBrkTrq_FsftBTQR_M_DrvrIntndedFricBrkTrq: operation=FsftBTQR_M_DrvrIntndedFricBrkTrq.FsftBTQR_M_DrvrIntndedFricBrkTrq
          SC_FsftBTQR_M_DrvrIntndedTotBrkTrq_FsftBTQR_M_DrvrIntndedTotBrkTrq: operation=FsftBTQR_M_DrvrIntndedTotBrkTrq.FsftBTQR_M_DrvrIntndedTotBrkTrq
          SC_FsftBTQR_M_RegenBrkAxleTrqReq_FsftBTQR_M_RegenBrkAxleTrqReq: operation=FsftBTQR_M_RegenBrkAxleTrqReq.FsftBTQR_M_RegenBrkAxleTrqReq
          SC_FsftBTQR_b_ESCEvntActv_FsftBTQR_b_ESCEvntActv: operation=FsftBTQR_b_ESCEvntActv.FsftBTQR_b_ESCEvntActv
          SC_FsftCCTR_M_ACCTrq_BSM_FsftCCTR_M_ACCTrq_BSM: operation=FsftCCTR_M_ACCTrq_BSM.FsftCCTR_M_ACCTrq_BSM
          SC_FsftCSVR_e_LeftFrontWhlDir_FsftCSVR_e_LeftFrontWhlDir: operation=FsftCSVR_e_LeftFrontWhlDir.FsftCSVR_e_LeftFrontWhlDir
          SC_FsftCSVR_e_LeftRearWhlDir_FsftCSVR_e_LeftRearWhlDir: operation=FsftCSVR_e_LeftRearWhlDir.FsftCSVR_e_LeftRearWhlDir
          SC_FsftCSVR_e_RightFrontWhlDir_FsftCSVR_e_RightFrontWhlDir: operation=FsftCSVR_e_RightFrontWhlDir.FsftCSVR_e_RightFrontWhlDir
          SC_FsftCSVR_e_RightRearWhlDir_FsftCSVR_e_RightRearWhlDir: operation=FsftCSVR_e_RightRearWhlDir.FsftCSVR_e_RightRearWhlDir
          SC_FsftCSVR_n_LeftFrontWhl_FsftCSVR_n_LeftFrontWhl: operation=FsftCSVR_n_LeftFrontWhl.FsftCSVR_n_LeftFrontWhl
          SC_FsftCSVR_n_LeftRearWhl_FsftCSVR_n_LeftRearWhl: operation=FsftCSVR_n_LeftRearWhl.FsftCSVR_n_LeftRearWhl
          SC_FsftCSVR_n_RightFrontWhl_FsftCSVR_n_RightFrontWhl: operation=FsftCSVR_n_RightFrontWhl.FsftCSVR_n_RightFrontWhl
          SC_FsftCSVR_n_RightRearWhl_FsftCSVR_n_RightRearWhl: operation=FsftCSVR_n_RightRearWhl.FsftCSVR_n_RightRearWhl
          SC_FsftCSVR_v_CanSigVehSpd_FsftCSVR_v_CanSigVehSpd: operation=FsftCSVR_v_CanSigVehSpd.FsftCSVR_v_CanSigVehSpd
          SC_FsftPLTR_Pct_Slope_FsftPLTR_Pct_Slope: operation=FsftPLTR_Pct_Slope.FsftPLTR_Pct_Slope
          SC_FsftPLTR_a_LongAccel_FsftPLTR_a_LongAccel: operation=FsftPLTR_a_LongAccel.FsftPLTR_a_LongAccel
          SC_FsftPLTR_a_TransAccel_FsftPLTR_a_TransAccel: operation=FsftPLTR_a_TransAccel.FsftPLTR_a_TransAccel
          SC_FsftPLTR_b_ACC_On_FsftPLTR_b_ACC_On: operation=FsftPLTR_b_ACC_On.FsftPLTR_b_ACC_On
          SC_FsftPLTR_b_ImmoParkReq_FsftPLTR_b_ImmoParkReq: operation=FsftPLTR_b_ImmoParkReq.FsftPLTR_b_ImmoParkReq
          SC_FsftPLTR_e_EPBHoldSt_FsftPLTR_e_EPBHoldSt: operation=FsftPLTR_e_EPBHoldSt.FsftPLTR_e_EPBHoldSt
          SC_FsftPLTR_e_ParkingGearShiftReq_BSM_FsftPLTR_e_ParkingGearShiftReq_BSM: operation=FsftPLTR_e_ParkingGearShiftReq_BSM.FsftPLTR_e_ParkingGearShiftReq_BSM
          SC_FsftPLTR_e_SelectSpdSts_FsftPLTR_e_SelectSpdSts: operation=FsftPLTR_e_SelectSpdSts.FsftPLTR_e_SelectSpdSts
          SC_FsftPLTR_e_eBurn_Stages_FsftPLTR_e_eBurn_Stages: operation=FsftPLTR_e_eBurn_Stages.FsftPLTR_e_eBurn_Stages
          SC_FsftPLTR_l_TravelDistance_FsftPLTR_l_TravelDistance: operation=FsftPLTR_l_TravelDistance.FsftPLTR_l_TravelDistance
          SC_FsftSCCR_M_FrntAxlRq_FsftSCCR_M_FrntAxlRq: operation=FsftSCCR_M_FrntAxlRq.FsftSCCR_M_FrntAxlRq
          SC_FsftSCCR_M_RrAxlRq_FsftSCCR_M_RrAxlRq: operation=FsftSCCR_M_RrAxlRq.FsftSCCR_M_RrAxlRq
          SC_FsftSCCR_b_FrntAxlMaxRq_FsftSCCR_b_FrntAxlMaxRq: operation=FsftSCCR_b_FrntAxlMaxRq.FsftSCCR_b_FrntAxlMaxRq
          SC_FsftSCCR_b_FrntAxlMinRq_FsftSCCR_b_FrntAxlMinRq: operation=FsftSCCR_b_FrntAxlMinRq.FsftSCCR_b_FrntAxlMinRq
          SC_FsftSCCR_b_RrAxlMaxRq_FsftSCCR_b_RrAxlMaxRq: operation=FsftSCCR_b_RrAxlMaxRq.FsftSCCR_b_RrAxlMaxRq
          SC_FsftSCCR_b_RrAxlMinRq_FsftSCCR_b_RrAxlMinRq: operation=FsftSCCR_b_RrAxlMinRq.FsftSCCR_b_RrAxlMinRq
          SC_FsftTAIR_Pct_DrvTmpDr_Pos_FsftTAIR_Pct_DrvTmpDr_Pos: operation=FsftTAIR_Pct_DrvTmpDr_Pos.FsftTAIR_Pct_DrvTmpDr_Pos
          SC_FsftTAIR_Pct_FrtBlwrCmd_FsftTAIR_Pct_FrtBlwrCmd: operation=FsftTAIR_Pct_FrtBlwrCmd.FsftTAIR_Pct_FrtBlwrCmd
          SC_FsftTAIR_Pct_PasTmpDr_Pos_FsftTAIR_Pct_PasTmpDr_Pos: operation=FsftTAIR_Pct_PasTmpDr_Pos.FsftTAIR_Pct_PasTmpDr_Pos
          SC_FsftTAIR_T_FtEvapTmp_Tgt_FsftTAIR_T_FtEvapTmp_Tgt: operation=FsftTAIR_T_FtEvapTmp_Tgt.FsftTAIR_T_FtEvapTmp_Tgt
          SC_FsftTAIR_T_HtrCoreTmp_Tgt_FsftTAIR_T_HtrCoreTmp_Tgt: operation=FsftTAIR_T_HtrCoreTmp_Tgt.FsftTAIR_T_HtrCoreTmp_Tgt
          SC_FsftTAIR_T_VhIntTmp_FsftTAIR_T_VhIntTmp: operation=FsftTAIR_T_VhIntTmp.FsftTAIR_T_VhIntTmp
          SC_FsftTRIR_Pct_AirHtwPwrTgt_FsftTRIR_Pct_AirHtwPwrTgt: operation=FsftTRIR_Pct_AirHtwPwrTgt.FsftTRIR_Pct_AirHtwPwrTgt
          SC_FsftTRIR_b_AHP_EnblReq_FsftTRIR_b_AHP_EnblReq: operation=FsftTRIR_b_AHP_EnblReq.FsftTRIR_b_AHP_EnblReq
          SC_FsftTRIR_b_HSW_Sts_FsftTRIR_b_HSW_Sts: operation=FsftTRIR_b_HSW_Sts.FsftTRIR_b_HSW_Sts
          SC_PokeADIR_e_BSM_WEDModeReq_PokeADIR_e_BSM_WEDModeReq: operation=PokeADIR_e_BSM_WEDModeReq.PokeADIR_e_BSM_WEDModeReq
          SC_PokeASLR_b_LaneCenteringOnOffSts_PokeASLR_b_LaneCenteringOnOffSts: operation=PokeASLR_b_LaneCenteringOnOffSts.PokeASLR_b_LaneCenteringOnOffSts
          SC_PokeASLR_b_SpdLmtrOnOffSts_PokeASLR_b_SpdLmtrOnOffSts: operation=PokeASLR_b_SpdLmtrOnOffSts.PokeASLR_b_SpdLmtrOnOffSts
          SC_PokeASLR_e_Hill_Des_Status_PokeASLR_e_Hill_Des_Status: operation=PokeASLR_e_Hill_Des_Status.PokeASLR_e_Hill_Des_Status
          SC_PokeBRKR_P_BrkPrss_PokeBRKR_P_BrkPrss: operation=PokeBRKR_P_BrkPrss.PokeBRKR_P_BrkPrss
          SC_PokeBRKR_Pct_BrkTravelSts_PokeBRKR_Pct_BrkTravelSts: operation=PokeBRKR_Pct_BrkTravelSts.PokeBRKR_Pct_BrkTravelSts
          SC_PokeBRKR_b_ABSActive_PokeBRKR_b_ABSActive: operation=PokeBRKR_b_ABSActive.PokeBRKR_b_ABSActive
          SC_PokeBRKR_b_ABSFailSts_PokeBRKR_b_ABSFailSts: operation=PokeBRKR_b_ABSFailSts.PokeBRKR_b_ABSFailSts
          SC_PokeBRKR_b_ASRActive_PokeBRKR_b_ASRActive: operation=PokeBRKR_b_ASRActive.PokeBRKR_b_ASRActive
          SC_PokeBRKR_b_AeCoastReady_PokeBRKR_b_AeCoastReady: operation=PokeBRKR_b_AeCoastReady.PokeBRKR_b_AeCoastReady
          SC_PokeBRKR_b_BrkPdlFlt_PokeBRKR_b_BrkPdlFlt: operation=PokeBRKR_b_BrkPdlFlt.PokeBRKR_b_BrkPdlFlt
          SC_PokeBRKR_b_BrkTmpSts_PokeBRKR_b_BrkTmpSts: operation=PokeBRKR_b_BrkTmpSts.PokeBRKR_b_BrkTmpSts, variation-point={short-label=vpSC_PokeBRKR_b_BrkTmpSts_PokeBRKR_b_BrkTmpSts, sw-syscond=1}
          SC_PokeBRKR_b_ESCActive_PokeBRKR_b_ESCActive: operation=PokeBRKR_b_ESCActive.PokeBRKR_b_ESCActive
          SC_PokeBRKR_b_ESCFailSts_PokeBRKR_b_ESCFailSts: operation=PokeBRKR_b_ESCFailSts.PokeBRKR_b_ESCFailSts
          SC_PokeBRKR_b_ESCIntervention_PokeBRKR_b_ESCIntervention: operation=PokeBRKR_b_ESCIntervention.PokeBRKR_b_ESCIntervention
          SC_PokeBRKR_b_FunctionSts_PokeBRKR_b_FunctionSts: operation=PokeBRKR_b_FunctionSts.PokeBRKR_b_FunctionSts
          SC_PokeBRKR_b_ImpndSkid_PokeBRKR_b_ImpndSkid: operation=PokeBRKR_b_ImpndSkid.PokeBRKR_b_ImpndSkid
          SC_PokeBRKR_b_VehicleStandStillSts_PokeBRKR_b_VehicleStandStillSts: operation=PokeBRKR_b_VehicleStandStillSts.PokeBRKR_b_VehicleStandStillSts, variation-point={short-label=vpSC_PokeBRKR_b_VehicleStandStillSts_PokeBRKR_b_VehicleStandStillSts, sw-syscond=1}
          SC_PokeBRKR_e_AHH_Ready_Status_PokeBRKR_e_AHH_Ready_Status: operation=PokeBRKR_e_AHH_Ready_Status.PokeBRKR_e_AHH_Ready_Status
          SC_PokeBRKR_e_BrkPedalDscrtInpt_PokeBRKR_e_BrkPedalDscrtInpt: operation=PokeBRKR_e_BrkPedalDscrtInpt.PokeBRKR_e_BrkPedalDscrtInpt
          SC_PokeBRKR_e_ExtBrkReqOff_PokeBRKR_e_ExtBrkReqOff: operation=PokeBRKR_e_ExtBrkReqOff.PokeBRKR_e_ExtBrkReqOff
          SC_PokeBRKR_e_Not_OK_To_Race_PokeBRKR_e_Not_OK_To_Race: operation=PokeBRKR_e_Not_OK_To_Race.PokeBRKR_e_Not_OK_To_Race, variation-point={short-label=vpSC_PokeBRKR_e_Not_OK_To_Race_PokeBRKR_e_Not_OK_To_Race, sw-syscond=1}
          SC_PokeBRKR_e_OPDHoldStatus_PokeBRKR_e_OPDHoldStatus: operation=PokeBRKR_e_OPDHoldStatus.PokeBRKR_e_OPDHoldStatus
          SC_PokeBRKR_pbar_BrakePedalPressure_PokeBRKR_pbar_BrakePedalPressure: operation=PokeBRKR_pbar_BrakePedalPressure.PokeBRKR_pbar_BrakePedalPressure
          SC_PokeBTQR_M_BrkTrq_Driver_PokeBTQR_M_BrkTrq_Driver: operation=PokeBTQR_M_BrkTrq_Driver.PokeBTQR_M_BrkTrq_Driver
          SC_PokeBTQR_M_DrvrIntndedFricBrkTrq_PokeBTQR_M_DrvrIntndedFricBrkTrq: operation=PokeBTQR_M_DrvrIntndedFricBrkTrq.PokeBTQR_M_DrvrIntndedFricBrkTrq
          SC_PokeBTQR_M_DrvrIntndedTotBrkTrq_PokeBTQR_M_DrvrIntndedTotBrkTrq: operation=PokeBTQR_M_DrvrIntndedTotBrkTrq.PokeBTQR_M_DrvrIntndedTotBrkTrq
          SC_PokeBTQR_M_RegenBrkAxleTrqReq_PokeBTQR_M_RegenBrkAxleTrqReq: operation=PokeBTQR_M_RegenBrkAxleTrqReq.PokeBTQR_M_RegenBrkAxleTrqReq
          SC_PokeBTQR_b_ESCEvntActv_PokeBTQR_b_ESCEvntActv: operation=PokeBTQR_b_ESCEvntActv.PokeBTQR_b_ESCEvntActv
          SC_PokeCCTR_M_ACCTrq_BSM_PokeCCTR_M_ACCTrq_BSM: operation=PokeCCTR_M_ACCTrq_BSM.PokeCCTR_M_ACCTrq_BSM
          SC_PokeCCTR_b_CcAccelSts_PokeCCTR_b_CcAccelSts: operation=PokeCCTR_b_CcAccelSts.PokeCCTR_b_CcAccelSts
          SC_PokeCCTR_b_CcCancelSw_PokeCCTR_b_CcCancelSw: operation=PokeCCTR_b_CcCancelSw.PokeCCTR_b_CcCancelSw
          SC_PokeCCTR_b_CcDecelSts_PokeCCTR_b_CcDecelSts: operation=PokeCCTR_b_CcDecelSts.PokeCCTR_b_CcDecelSts
          SC_PokeCCTR_b_CcFailSts_PokeCCTR_b_CcFailSts: operation=PokeCCTR_b_CcFailSts.PokeCCTR_b_CcFailSts
          SC_PokeCCTR_b_CcOnOffSts_PokeCCTR_b_CcOnOffSts: operation=PokeCCTR_b_CcOnOffSts.PokeCCTR_b_CcOnOffSts
          SC_PokeCCTR_b_CcResumeSw_PokeCCTR_b_CcResumeSw: operation=PokeCCTR_b_CcResumeSw.PokeCCTR_b_CcResumeSw
          SC_PokeCSVR_b_WheelSensorFailStsLHF_PokeCSVR_b_WheelSensorFailStsLHF: operation=PokeCSVR_b_WheelSensorFailStsLHF.PokeCSVR_b_WheelSensorFailStsLHF
          SC_PokeCSVR_b_WheelSensorFailStsLHR_PokeCSVR_b_WheelSensorFailStsLHR: operation=PokeCSVR_b_WheelSensorFailStsLHR.PokeCSVR_b_WheelSensorFailStsLHR
          SC_PokeCSVR_b_WheelSensorFailStsRHF_PokeCSVR_b_WheelSensorFailStsRHF: operation=PokeCSVR_b_WheelSensorFailStsRHF.PokeCSVR_b_WheelSensorFailStsRHF
          SC_PokeCSVR_b_WheelSensorFailStsRHR_PokeCSVR_b_WheelSensorFailStsRHR: operation=PokeCSVR_b_WheelSensorFailStsRHR.PokeCSVR_b_WheelSensorFailStsRHR
          SC_PokeCSVR_e_LeftFrontWhlDir_PokeCSVR_e_LeftFrontWhlDir: operation=PokeCSVR_e_LeftFrontWhlDir.PokeCSVR_e_LeftFrontWhlDir
          SC_PokeCSVR_e_LeftRearWhlDir_PokeCSVR_e_LeftRearWhlDir: operation=PokeCSVR_e_LeftRearWhlDir.PokeCSVR_e_LeftRearWhlDir
          SC_PokeCSVR_e_RightFrontWhlDir_PokeCSVR_e_RightFrontWhlDir: operation=PokeCSVR_e_RightFrontWhlDir.PokeCSVR_e_RightFrontWhlDir
          SC_PokeCSVR_e_RightRearWhlDir_PokeCSVR_e_RightRearWhlDir: operation=PokeCSVR_e_RightRearWhlDir.PokeCSVR_e_RightRearWhlDir
          SC_PokeCSVR_n_LeftFrontWhl_PokeCSVR_n_LeftFrontWhl: operation=PokeCSVR_n_LeftFrontWhl.PokeCSVR_n_LeftFrontWhl
          SC_PokeCSVR_n_LeftRearWhl_PokeCSVR_n_LeftRearWhl: operation=PokeCSVR_n_LeftRearWhl.PokeCSVR_n_LeftRearWhl
          SC_PokeCSVR_n_RightFrontWhl_PokeCSVR_n_RightFrontWhl: operation=PokeCSVR_n_RightFrontWhl.PokeCSVR_n_RightFrontWhl
          SC_PokeCSVR_n_RightRearWhl_PokeCSVR_n_RightRearWhl: operation=PokeCSVR_n_RightRearWhl.PokeCSVR_n_RightRearWhl
          SC_PokeCSVR_v_CanSigVehSpd_PokeCSVR_v_CanSigVehSpd: operation=PokeCSVR_v_CanSigVehSpd.PokeCSVR_v_CanSigVehSpd
          SC_PokeIMOR_y_CntrlEncdResp_PokeIMOR_y_CntrlEncdResp: operation=PokeIMOR_y_CntrlEncdResp.PokeIMOR_y_CntrlEncdResp
          SC_PokeIMOR_y_MMKey1org21_PokeIMOR_y_MMKey1org21: operation=PokeIMOR_y_MMKey1org21.PokeIMOR_y_MMKey1org21
          SC_PokeIMOR_y_MMKey1org22_PokeIMOR_y_MMKey1org22: operation=PokeIMOR_y_MMKey1org22.PokeIMOR_y_MMKey1org22
          SC_PokeIMOR_y_MMKey_{3..6}_PokeIMOR_y_MMKey_{3..6}: operation=PokeIMOR_y_MMKey_{3..6}.PokeIMOR_y_MMKey_{3..6}
          SC_PokePLTR_Pct_Slope_PokePLTR_Pct_Slope: operation=PokePLTR_Pct_Slope.PokePLTR_Pct_Slope
          SC_PokePLTR_a_LongAccel_PokePLTR_a_LongAccel: operation=PokePLTR_a_LongAccel.PokePLTR_a_LongAccel
          SC_PokePLTR_a_TransAccel_PokePLTR_a_TransAccel: operation=PokePLTR_a_TransAccel.PokePLTR_a_TransAccel
          SC_PokePLTR_b_ACC_On_PokePLTR_b_ACC_On: operation=PokePLTR_b_ACC_On.PokePLTR_b_ACC_On
          SC_PokePLTR_b_ImmoParkReq_PokePLTR_b_ImmoParkReq: operation=PokePLTR_b_ImmoParkReq.PokePLTR_b_ImmoParkReq
          SC_PokePLTR_e_BSM_AxleTrq_Enbld_PokePLTR_e_BSM_AxleTrq_Enbld: operation=PokePLTR_e_BSM_AxleTrq_Enbld.PokePLTR_e_BSM_AxleTrq_Enbld
          SC_PokePLTR_e_EPBHoldSt_PokePLTR_e_EPBHoldSt: operation=PokePLTR_e_EPBHoldSt.PokePLTR_e_EPBHoldSt
          SC_PokePLTR_e_ParkingGearShiftReq_BSM_PokePLTR_e_ParkingGearShiftReq_BSM: operation=PokePLTR_e_ParkingGearShiftReq_BSM.PokePLTR_e_ParkingGearShiftReq_BSM
          SC_PokePLTR_e_SelectSpdSts_PokePLTR_e_SelectSpdSts: operation=PokePLTR_e_SelectSpdSts.PokePLTR_e_SelectSpdSts
          SC_PokePLTR_e_eBurn_Stages_PokePLTR_e_eBurn_Stages: operation=PokePLTR_e_eBurn_Stages.PokePLTR_e_eBurn_Stages
          SC_PokePLTR_l_TravelDistance_PokePLTR_l_TravelDistance: operation=PokePLTR_l_TravelDistance.PokePLTR_l_TravelDistance
          SC_PokeSCCR_M_FrntAxlRq_PokeSCCR_M_FrntAxlRq: operation=PokeSCCR_M_FrntAxlRq.PokeSCCR_M_FrntAxlRq
          SC_PokeSCCR_M_RrAxlRq_PokeSCCR_M_RrAxlRq: operation=PokeSCCR_M_RrAxlRq.PokeSCCR_M_RrAxlRq
          SC_PokeSCCR_b_FrntAxlMaxRq_PokeSCCR_b_FrntAxlMaxRq: operation=PokeSCCR_b_FrntAxlMaxRq.PokeSCCR_b_FrntAxlMaxRq
          SC_PokeSCCR_b_FrntAxlMinRq_PokeSCCR_b_FrntAxlMinRq: operation=PokeSCCR_b_FrntAxlMinRq.PokeSCCR_b_FrntAxlMinRq
          SC_PokeSCCR_b_RrAxlMaxRq_PokeSCCR_b_RrAxlMaxRq: operation=PokeSCCR_b_RrAxlMaxRq.PokeSCCR_b_RrAxlMaxRq
          SC_PokeSCCR_b_RrAxlMinRq_PokeSCCR_b_RrAxlMinRq: operation=PokeSCCR_b_RrAxlMinRq.PokeSCCR_b_RrAxlMinRq
          SC_PokeTAIR_Pct_DrvTmpDr_Pos_PokeTAIR_Pct_DrvTmpDr_Pos: operation=PokeTAIR_Pct_DrvTmpDr_Pos.PokeTAIR_Pct_DrvTmpDr_Pos
          SC_PokeTAIR_Pct_FrtBlwrCmd_PokeTAIR_Pct_FrtBlwrCmd: operation=PokeTAIR_Pct_FrtBlwrCmd.PokeTAIR_Pct_FrtBlwrCmd
          SC_PokeTAIR_Pct_PasTmpDr_Pos_PokeTAIR_Pct_PasTmpDr_Pos: operation=PokeTAIR_Pct_PasTmpDr_Pos.PokeTAIR_Pct_PasTmpDr_Pos
          SC_PokeTAIR_T_FtEvapTmp_Tgt_PokeTAIR_T_FtEvapTmp_Tgt: operation=PokeTAIR_T_FtEvapTmp_Tgt.PokeTAIR_T_FtEvapTmp_Tgt
          SC_PokeTAIR_T_HtrCoreTmp_Tgt_PokeTAIR_T_HtrCoreTmp_Tgt: operation=PokeTAIR_T_HtrCoreTmp_Tgt.PokeTAIR_T_HtrCoreTmp_Tgt
          SC_PokeTAIR_T_VhIntTmp_PokeTAIR_T_VhIntTmp: operation=PokeTAIR_T_VhIntTmp.PokeTAIR_T_VhIntTmp
          SC_PokeTAIR_b_WinshldDfrst_PokeTAIR_b_WinshldDfrst: operation=PokeTAIR_b_WinshldDfrst.PokeTAIR_b_WinshldDfrst
          SC_PokeTRIR_Pct_AirHtwPwrTgt_PokeTRIR_Pct_AirHtwPwrTgt: operation=PokeTRIR_Pct_AirHtwPwrTgt.PokeTRIR_Pct_AirHtwPwrTgt
          SC_PokeTRIR_b_AHP_EnblReq_PokeTRIR_b_AHP_EnblReq: operation=PokeTRIR_b_AHP_EnblReq.PokeTRIR_b_AHP_EnblReq
          SC_PokeTRIR_e_HSW_Sts_PokeTRIR_e_HSW_Sts: operation=PokeTRIR_e_HSW_Sts.PokeTRIR_e_HSW_Sts
      runnable CR1B_FUNC_MedTEB
        data-receive-point-by-arguments:
          417 x access:
            IN_VeCANR_Pct_V2H_Reserve_Battery_VeCANR_Pct_V2H_Reserve_Battery: accessed-variable=VeCANR_Pct_V2H_Reserve_Battery.VeCANR_Pct_V2H_Reserve_Battery
            IN_VeCANR_Pct_V2L_Reserve_Battery_VeCANR_Pct_V2L_Reserve_Battery: accessed-variable=VeCANR_Pct_V2L_Reserve_Battery.VeCANR_Pct_V2L_Reserve_Battery
            IN_VeCANR_Pct_V2V_Reserve_Battery_VeCANR_Pct_V2V_Reserve_Battery: accessed-variable=VeCANR_Pct_V2V_Reserve_Battery.VeCANR_Pct_V2V_Reserve_Battery
            IN_VeCANR_T_Climate_Cabin_Temp1_VeCANR_T_Climate_Cabin_Temp1: accessed-variable=VeCANR_T_Climate_Cabin_Temp1.VeCANR_T_Climate_Cabin_Temp1
            IN_VeCANR_T_Climate_Cabin_Temp2_VeCANR_T_Climate_Cabin_Temp2: accessed-variable=VeCANR_T_Climate_Cabin_Temp2.VeCANR_T_Climate_Cabin_Temp2
            IN_VeCANR_T_Climate_TBM_CabinTemp1_VeCANR_T_Climate_TBM_CabinTemp1: accessed-variable=VeCANR_T_Climate_TBM_CabinTemp1.VeCANR_T_Climate_TBM_CabinTemp1
            IN_VeCANR_T_Climate_TBM_CabinTemp2_VeCANR_T_Climate_TBM_CabinTemp2: accessed-variable=VeCANR_T_Climate_TBM_CabinTemp2.VeCANR_T_Climate_TBM_CabinTemp2
            IN_VeCANR_b_AUD_LVL_TO_VeCANR_b_AUD_LVL_TO: accessed-variable=VeCANR_b_AUD_LVL_TO.VeCANR_b_AUD_LVL_TO
            IN_VeCANR_b_AllowClimateSchd1TO_VeCANR_b_AllowClimateSchd1TO: accessed-variable=VeCANR_b_AllowClimateSchd1TO.VeCANR_b_AllowClimateSchd1TO
            IN_VeCANR_b_AllowClimateSchd2TO_VeCANR_b_AllowClimateSchd2TO: accessed-variable=VeCANR_b_AllowClimateSchd2TO.VeCANR_b_AllowClimateSchd2TO
            IN_VeCANR_b_ChargeUntilFull1_VeCANR_b_ChargeUntilFull1: accessed-variable=VeCANR_b_ChargeUntilFull1.VeCANR_b_ChargeUntilFull1
            IN_VeCANR_b_ChargeUntilFull1TO_VeCANR_b_ChargeUntilFull1TO: accessed-variable=VeCANR_b_ChargeUntilFull1TO.VeCANR_b_ChargeUntilFull1TO
            IN_VeCANR_b_ChargeUntilFull2_VeCANR_b_ChargeUntilFull2: accessed-variable=VeCANR_b_ChargeUntilFull2.VeCANR_b_ChargeUntilFull2
            IN_VeCANR_b_ChargeUntilFull2TO_VeCANR_b_ChargeUntilFull2TO: accessed-variable=VeCANR_b_ChargeUntilFull2TO.VeCANR_b_ChargeUntilFull2TO
            IN_VeCANR_b_Charge_Schedule_Type1TO_VeCANR_b_Charge_Schedule_Type1TO: accessed-variable=VeCANR_b_Charge_Schedule_Type1TO.VeCANR_b_Charge_Schedule_Type1TO
            IN_VeCANR_b_Charge_Schedule_Type2TO_VeCANR_b_Charge_Schedule_Type2TO: accessed-variable=VeCANR_b_Charge_Schedule_Type2TO.VeCANR_b_Charge_Schedule_Type2TO
            IN_VeCANR_b_ClimateSchd1_DayTO_VeCANR_b_ClimateSchd1_DayTO: accessed-variable=VeCANR_b_ClimateSchd1_DayTO.VeCANR_b_ClimateSchd1_DayTO
            IN_VeCANR_b_ClimateSchd1_Dprtr_HrTO_VeCANR_b_ClimateSchd1_Dprtr_HrTO: accessed-variable=VeCANR_b_ClimateSchd1_Dprtr_HrTO.VeCANR_b_ClimateSchd1_Dprtr_HrTO
            IN_VeCANR_b_ClimateSchd1_Dprtr_MinTO_VeCANR_b_ClimateSchd1_Dprtr_MinTO: accessed-variable=VeCANR_b_ClimateSchd1_Dprtr_MinTO.VeCANR_b_ClimateSchd1_Dprtr_MinTO
            IN_VeCANR_b_ClimateSchd2_DayTO_VeCANR_b_ClimateSchd2_DayTO: accessed-variable=VeCANR_b_ClimateSchd2_DayTO.VeCANR_b_ClimateSchd2_DayTO
            IN_VeCANR_b_ClimateSchd2_Dprtr_HrTO_VeCANR_b_ClimateSchd2_Dprtr_HrTO: accessed-variable=VeCANR_b_ClimateSchd2_Dprtr_HrTO.VeCANR_b_ClimateSchd2_Dprtr_HrTO
            IN_VeCANR_b_ClimateSchd2_Dprtr_MinTO_VeCANR_b_ClimateSchd2_Dprtr_MinTO: accessed-variable=VeCANR_b_ClimateSchd2_Dprtr_MinTO.VeCANR_b_ClimateSchd2_Dprtr_MinTO
            IN_VeCANR_b_Climate_Cabin_Temp1TO_VeCANR_b_Climate_Cabin_Temp1TO: accessed-variable=VeCANR_b_Climate_Cabin_Temp1TO.VeCANR_b_Climate_Cabin_Temp1TO
            IN_VeCANR_b_Climate_Cabin_Temp2TO_VeCANR_b_Climate_Cabin_Temp2TO: accessed-variable=VeCANR_b_Climate_Cabin_Temp2TO.VeCANR_b_Climate_Cabin_Temp2TO
            IN_VeCANR_b_Climate_TBM_CabinTemp1TO_VeCANR_b_Climate_TBM_CabinTemp1TO: accessed-variable=VeCANR_b_Climate_TBM_CabinTemp1TO.VeCANR_b_Climate_TBM_CabinTemp1TO
            IN_VeCANR_b_Climate_TBM_CabinTemp2TO_VeCANR_b_Climate_TBM_CabinTemp2TO: accessed-variable=VeCANR_b_Climate_TBM_CabinTemp2TO.VeCANR_b_Climate_TBM_CabinTemp2TO
            IN_VeCANR_b_Command_15StsTO_VeCANR_b_Command_15StsTO: accessed-variable=VeCANR_b_Command_15StsTO.VeCANR_b_Command_15StsTO
            IN_VeCANR_b_CooperativeVehclLocatn_VeCANR_b_CooperativeVehclLocatn: accessed-variable=VeCANR_b_CooperativeVehclLocatn.VeCANR_b_CooperativeVehclLocatn
            IN_VeCANR_b_CooperativeVehclLocatnTO_VeCANR_b_CooperativeVehclLocatnTO: accessed-variable=VeCANR_b_CooperativeVehclLocatnTO.VeCANR_b_CooperativeVehclLocatnTO
            IN_VeCANR_b_Day1_TLM_TO_VeCANR_b_Day1_TLM_TO: accessed-variable=VeCANR_b_Day1_TLM_TO.VeCANR_b_Day1_TLM_TO
            IN_VeCANR_b_Day2_TLM_TO_VeCANR_b_Day2_TLM_TO: accessed-variable=VeCANR_b_Day2_TLM_TO.VeCANR_b_Day2_TLM_TO
            IN_VeCANR_b_Enable_ClimateSchd1_VeCANR_b_Enable_ClimateSchd1: accessed-variable=VeCANR_b_Enable_ClimateSchd1.VeCANR_b_Enable_ClimateSchd1
            IN_VeCANR_b_Enable_ClimateSchd1TO_VeCANR_b_Enable_ClimateSchd1TO: accessed-variable=VeCANR_b_Enable_ClimateSchd1TO.VeCANR_b_Enable_ClimateSchd1TO
            IN_VeCANR_b_Enable_ClimateSchd2_VeCANR_b_Enable_ClimateSchd2: accessed-variable=VeCANR_b_Enable_ClimateSchd2.VeCANR_b_Enable_ClimateSchd2
            IN_VeCANR_b_Enable_ClimateSchd2TO_VeCANR_b_Enable_ClimateSchd2TO: accessed-variable=VeCANR_b_Enable_ClimateSchd2TO.VeCANR_b_Enable_ClimateSchd2TO
            IN_VeCANR_b_Enable_Schedule1_VeCANR_b_Enable_Schedule1: accessed-variable=VeCANR_b_Enable_Schedule1.VeCANR_b_Enable_Schedule1
            IN_VeCANR_b_Enable_Schedule1TO_VeCANR_b_Enable_Schedule1TO: accessed-variable=VeCANR_b_Enable_Schedule1TO.VeCANR_b_Enable_Schedule1TO
            IN_VeCANR_b_Enable_Schedule2_VeCANR_b_Enable_Schedule2: accessed-variable=VeCANR_b_Enable_Schedule2.VeCANR_b_Enable_Schedule2
            IN_VeCANR_b_Enable_Schedule2TO_VeCANR_b_Enable_Schedule2TO: accessed-variable=VeCANR_b_Enable_Schedule2TO.VeCANR_b_Enable_Schedule2TO
            IN_VeCANR_b_End_Time_Hr1TO_VeCANR_b_End_Time_Hr1TO: accessed-variable=VeCANR_b_End_Time_Hr1TO.VeCANR_b_End_Time_Hr1TO
            IN_VeCANR_b_End_Time_Hr2TO_VeCANR_b_End_Time_Hr2TO: accessed-variable=VeCANR_b_End_Time_Hr2TO.VeCANR_b_End_Time_Hr2TO
            IN_VeCANR_b_End_Time_Min1TO_VeCANR_b_End_Time_Min1TO: accessed-variable=VeCANR_b_End_Time_Min1TO.VeCANR_b_End_Time_Min1TO
            IN_VeCANR_b_End_Time_Min2TO_VeCANR_b_End_Time_Min2TO: accessed-variable=VeCANR_b_End_Time_Min2TO.VeCANR_b_End_Time_Min2TO
            IN_VeCANR_b_External_ChargeTarget1TO_VeCANR_b_External_ChargeTarget1TO: accessed-variable=VeCANR_b_External_ChargeTarget1TO.VeCANR_b_External_ChargeTarget1TO
            IN_VeCANR_b_External_ChargeTarget2TO_VeCANR_b_External_ChargeTarget2TO: accessed-variable=VeCANR_b_External_ChargeTarget2TO.VeCANR_b_External_ChargeTarget2TO
            IN_VeCANR_b_GPS_Date_DayTO_VeCANR_b_GPS_Date_DayTO: accessed-variable=VeCANR_b_GPS_Date_DayTO.VeCANR_b_GPS_Date_DayTO
            IN_VeCANR_b_GPS_Date_MonthTO_VeCANR_b_GPS_Date_MonthTO: accessed-variable=VeCANR_b_GPS_Date_MonthTO.VeCANR_b_GPS_Date_MonthTO
            IN_VeCANR_b_GPS_Date_YearTO_VeCANR_b_GPS_Date_YearTO: accessed-variable=VeCANR_b_GPS_Date_YearTO.VeCANR_b_GPS_Date_YearTO
            IN_VeCANR_b_GPS_UTC_HourTO_VeCANR_b_GPS_UTC_HourTO: accessed-variable=VeCANR_b_GPS_UTC_HourTO.VeCANR_b_GPS_UTC_HourTO
            IN_VeCANR_b_GPS_UTC_MinuteTO_VeCANR_b_GPS_UTC_MinuteTO: accessed-variable=VeCANR_b_GPS_UTC_MinuteTO.VeCANR_b_GPS_UTC_MinuteTO
            IN_VeCANR_b_GPS_UTC_SecondTO_VeCANR_b_GPS_UTC_SecondTO: accessed-variable=VeCANR_b_GPS_UTC_SecondTO.VeCANR_b_GPS_UTC_SecondTO
            IN_VeCANR_b_HAS_TelltaleStsTO_VeCANR_b_HAS_TelltaleStsTO: accessed-variable=VeCANR_b_HAS_TelltaleStsTO.VeCANR_b_HAS_TelltaleStsTO
            IN_VeCANR_b_Hour1_TLM_TO_VeCANR_b_Hour1_TLM_TO: accessed-variable=VeCANR_b_Hour1_TLM_TO.VeCANR_b_Hour1_TLM_TO
            IN_VeCANR_b_Hour2_TLM_TO_VeCANR_b_Hour2_TLM_TO: accessed-variable=VeCANR_b_Hour2_TLM_TO.VeCANR_b_Hour2_TLM_TO
            IN_VeCANR_b_ImmediateChargeTarget1TO_VeCANR_b_ImmediateChargeTarget1TO: accessed-variable=VeCANR_b_ImmediateChargeTarget1TO.VeCANR_b_ImmediateChargeTarget1TO
            IN_VeCANR_b_ImmediateChargeTarget2TO_VeCANR_b_ImmediateChargeTarget2TO: accessed-variable=VeCANR_b_ImmediateChargeTarget2TO.VeCANR_b_ImmediateChargeTarget2TO
            IN_VeCANR_b_Minute1_TLM_TO_VeCANR_b_Minute1_TLM_TO: accessed-variable=VeCANR_b_Minute1_TLM_TO.VeCANR_b_Minute1_TLM_TO
            IN_VeCANR_b_Minute2_TLM_TO_VeCANR_b_Minute2_TLM_TO: accessed-variable=VeCANR_b_Minute2_TLM_TO.VeCANR_b_Minute2_TLM_TO
            IN_VeCANR_b_Month1_TLM_TO_VeCANR_b_Month1_TLM_TO: accessed-variable=VeCANR_b_Month1_TLM_TO.VeCANR_b_Month1_TLM_TO
            IN_VeCANR_b_Month2_TLM_TO_VeCANR_b_Month2_TLM_TO: accessed-variable=VeCANR_b_Month2_TLM_TO.VeCANR_b_Month2_TLM_TO
            IN_VeCANR_b_RACE_CLDWN_ON_OFF_REQ_VeCANR_b_RACE_CLDWN_ON_OFF_REQ: accessed-variable=VeCANR_b_RACE_CLDWN_ON_OFF_REQ.VeCANR_b_RACE_CLDWN_ON_OFF_REQ, variation-point={short-label=vpIN_VeCANR_b_RACE_CLDWN_ON_OFF_REQ_VeCANR_b_RACE_CLDWN_ON_OFF_REQ, sw-syscond=1}
            IN_VeCANR_b_RACE_CLDWN_ON_OFF_REQ_TO_VeCANR_b_RACE_CLDWN_ON_OFF_REQ_TO: accessed-variable=VeCANR_b_RACE_CLDWN_ON_OFF_REQ_TO.VeCANR_b_RACE_CLDWN_ON_OFF_REQ_TO, variation-point={short-label=vpIN_VeCANR_b_RACE_CLDWN_ON_OFF_REQ_TO_VeCANR_b_RACE_CLDWN_ON_OFF_REQ_TO, sw-syscond=1}
            IN_VeCANR_b_Remote_Chargeport_CmndTO_VeCANR_b_Remote_Chargeport_CmndTO: accessed-variable=VeCANR_b_Remote_Chargeport_CmndTO.VeCANR_b_Remote_Chargeport_CmndTO
            IN_VeCANR_b_Schedule_Day1TO_VeCANR_b_Schedule_Day1TO: accessed-variable=VeCANR_b_Schedule_Day1TO.VeCANR_b_Schedule_Day1TO
            IN_VeCANR_b_Schedule_Day2TO_VeCANR_b_Schedule_Day2TO: accessed-variable=VeCANR_b_Schedule_Day2TO.VeCANR_b_Schedule_Day2TO
            IN_VeCANR_b_Start_Time_Hr1TO_VeCANR_b_Start_Time_Hr1TO: accessed-variable=VeCANR_b_Start_Time_Hr1TO.VeCANR_b_Start_Time_Hr1TO
            IN_VeCANR_b_Start_Time_Hr2TO_VeCANR_b_Start_Time_Hr2TO: accessed-variable=VeCANR_b_Start_Time_Hr2TO.VeCANR_b_Start_Time_Hr2TO
            IN_VeCANR_b_Start_Time_Min1TO_VeCANR_b_Start_Time_Min1TO: accessed-variable=VeCANR_b_Start_Time_Min1TO.VeCANR_b_Start_Time_Min1TO
            IN_VeCANR_b_Start_Time_Min2TO_VeCANR_b_Start_Time_Min2TO: accessed-variable=VeCANR_b_Start_Time_Min2TO.VeCANR_b_Start_Time_Min2TO
            IN_VeCANR_b_Submit_ClimateSchd1_VeCANR_b_Submit_ClimateSchd1: accessed-variable=VeCANR_b_Submit_ClimateSchd1.VeCANR_b_Submit_ClimateSchd1
            IN_VeCANR_b_Submit_ClimateSchd1TO_VeCANR_b_Submit_ClimateSchd1TO: accessed-variable=VeCANR_b_Submit_ClimateSchd1TO.VeCANR_b_Submit_ClimateSchd1TO
            IN_VeCANR_b_Submit_ClimateSchd2_VeCANR_b_Submit_ClimateSchd2: accessed-variable=VeCANR_b_Submit_ClimateSchd2.VeCANR_b_Submit_ClimateSchd2
            IN_VeCANR_b_Submit_ClimateSchd2TO_VeCANR_b_Submit_ClimateSchd2TO: accessed-variable=VeCANR_b_Submit_ClimateSchd2TO.VeCANR_b_Submit_ClimateSchd2TO
            IN_VeCANR_b_Submit_Schedule1_VeCANR_b_Submit_Schedule1: accessed-variable=VeCANR_b_Submit_Schedule1.VeCANR_b_Submit_Schedule1
            IN_VeCANR_b_Submit_Schedule1TO_VeCANR_b_Submit_Schedule1TO: accessed-variable=VeCANR_b_Submit_Schedule1TO.VeCANR_b_Submit_Schedule1TO
            IN_VeCANR_b_Submit_Schedule2_VeCANR_b_Submit_Schedule2: accessed-variable=VeCANR_b_Submit_Schedule2.VeCANR_b_Submit_Schedule2
            IN_VeCANR_b_Submit_Schedule2TO_VeCANR_b_Submit_Schedule2TO: accessed-variable=VeCANR_b_Submit_Schedule2TO.VeCANR_b_Submit_Schedule2TO
            IN_VeCANR_b_TBMChrgSchedulType1ReqTO_VeCANR_b_TBMChrgSchedulType1ReqTO: accessed-variable=VeCANR_b_TBMChrgSchedulType1ReqTO.VeCANR_b_TBMChrgSchedulType1ReqTO
            IN_VeCANR_b_TBMChrgSchedulType2ReqTO_VeCANR_b_TBMChrgSchedulType2ReqTO: accessed-variable=VeCANR_b_TBMChrgSchedulType2ReqTO.VeCANR_b_TBMChrgSchedulType2ReqTO
            IN_VeCANR_b_TBMCooperativeChrgCmndTO_VeCANR_b_TBMCooperativeChrgCmndTO: accessed-variable=VeCANR_b_TBMCooperativeChrgCmndTO.VeCANR_b_TBMCooperativeChrgCmndTO
            IN_VeCANR_b_TBMExtrnlChrgTarget1TO_VeCANR_b_TBMExtrnlChrgTarget1TO: accessed-variable=VeCANR_b_TBMExtrnlChrgTarget1TO.VeCANR_b_TBMExtrnlChrgTarget1TO
            IN_VeCANR_b_TBMImmediatChrgTarget1TO_VeCANR_b_TBMImmediatChrgTarget1TO: accessed-variable=VeCANR_b_TBMImmediatChrgTarget1TO.VeCANR_b_TBMImmediatChrgTarget1TO
            IN_VeCANR_b_TBMImmediatChrgTarget2TO_VeCANR_b_TBMImmediatChrgTarget2TO: accessed-variable=VeCANR_b_TBMImmediatChrgTarget2TO.VeCANR_b_TBMImmediatChrgTarget2TO
            IN_VeCANR_b_TBM_AllowClimateSchd1TO_VeCANR_b_TBM_AllowClimateSchd1TO: accessed-variable=VeCANR_b_TBM_AllowClimateSchd1TO.VeCANR_b_TBM_AllowClimateSchd1TO
            IN_VeCANR_b_TBM_AllowClimateSchd2TO_VeCANR_b_TBM_AllowClimateSchd2TO: accessed-variable=VeCANR_b_TBM_AllowClimateSchd2TO.VeCANR_b_TBM_AllowClimateSchd2TO
            IN_VeCANR_b_TBM_ChargeUntilFull1_VeCANR_b_TBM_ChargeUntilFull1: accessed-variable=VeCANR_b_TBM_ChargeUntilFull1.VeCANR_b_TBM_ChargeUntilFull1
            IN_VeCANR_b_TBM_ChargeUntilFull1TO_VeCANR_b_TBM_ChargeUntilFull1TO: accessed-variable=VeCANR_b_TBM_ChargeUntilFull1TO.VeCANR_b_TBM_ChargeUntilFull1TO
            IN_VeCANR_b_TBM_ChargeUntilFull2_VeCANR_b_TBM_ChargeUntilFull2: accessed-variable=VeCANR_b_TBM_ChargeUntilFull2.VeCANR_b_TBM_ChargeUntilFull2
            IN_VeCANR_b_TBM_ChargeUntilFull2TO_VeCANR_b_TBM_ChargeUntilFull2TO: accessed-variable=VeCANR_b_TBM_ChargeUntilFull2TO.VeCANR_b_TBM_ChargeUntilFull2TO
            IN_VeCANR_b_TBM_Charge_Now_VeCANR_b_TBM_Charge_Now: accessed-variable=VeCANR_b_TBM_Charge_Now.VeCANR_b_TBM_Charge_Now
            IN_VeCANR_b_TBM_Charge_NowTO_VeCANR_b_TBM_Charge_NowTO: accessed-variable=VeCANR_b_TBM_Charge_NowTO.VeCANR_b_TBM_Charge_NowTO
            IN_VeCANR_b_TBM_ClimSchd1DprtrHrTO_VeCANR_b_TBM_ClimSchd1DprtrHrTO: accessed-variable=VeCANR_b_TBM_ClimSchd1DprtrHrTO.VeCANR_b_TBM_ClimSchd1DprtrHrTO
            IN_VeCANR_b_TBM_ClimSchd1DprtrMinTO_VeCANR_b_TBM_ClimSchd1DprtrMinTO: accessed-variable=VeCANR_b_TBM_ClimSchd1DprtrMinTO.VeCANR_b_TBM_ClimSchd1DprtrMinTO
            IN_VeCANR_b_TBM_ClimSchd2DprtrHrTO_VeCANR_b_TBM_ClimSchd2DprtrHrTO: accessed-variable=VeCANR_b_TBM_ClimSchd2DprtrHrTO.VeCANR_b_TBM_ClimSchd2DprtrHrTO
            IN_VeCANR_b_TBM_ClimSchd2DprtrMinTO_VeCANR_b_TBM_ClimSchd2DprtrMinTO: accessed-variable=VeCANR_b_TBM_ClimSchd2DprtrMinTO.VeCANR_b_TBM_ClimSchd2DprtrMinTO
            IN_VeCANR_b_TBM_ClimateSchd1_DayTO_VeCANR_b_TBM_ClimateSchd1_DayTO: accessed-variable=VeCANR_b_TBM_ClimateSchd1_DayTO.VeCANR_b_TBM_ClimateSchd1_DayTO
            IN_VeCANR_b_TBM_ClimateSchd2_DayTO_VeCANR_b_TBM_ClimateSchd2_DayTO: accessed-variable=VeCANR_b_TBM_ClimateSchd2_DayTO.VeCANR_b_TBM_ClimateSchd2_DayTO
            IN_VeCANR_b_TBM_EnableClimateSchd1_VeCANR_b_TBM_EnableClimateSchd1: accessed-variable=VeCANR_b_TBM_EnableClimateSchd1.VeCANR_b_TBM_EnableClimateSchd1
            IN_VeCANR_b_TBM_EnableClimateSchd1TO_VeCANR_b_TBM_EnableClimateSchd1TO: accessed-variable=VeCANR_b_TBM_EnableClimateSchd1TO.VeCANR_b_TBM_EnableClimateSchd1TO
            IN_VeCANR_b_TBM_EnableClimateSchd2_VeCANR_b_TBM_EnableClimateSchd2: accessed-variable=VeCANR_b_TBM_EnableClimateSchd2.VeCANR_b_TBM_EnableClimateSchd2
            IN_VeCANR_b_TBM_EnableClimateSchd2TO_VeCANR_b_TBM_EnableClimateSchd2TO: accessed-variable=VeCANR_b_TBM_EnableClimateSchd2TO.VeCANR_b_TBM_EnableClimateSchd2TO
            IN_VeCANR_b_TBM_Enable_Schedule1_VeCANR_b_TBM_Enable_Schedule1: accessed-variable=VeCANR_b_TBM_Enable_Schedule1.VeCANR_b_TBM_Enable_Schedule1
            IN_VeCANR_b_TBM_Enable_Schedule1TO_VeCANR_b_TBM_Enable_Schedule1TO: accessed-variable=VeCANR_b_TBM_Enable_Schedule1TO.VeCANR_b_TBM_Enable_Schedule1TO
            IN_VeCANR_b_TBM_Enable_Schedule2_VeCANR_b_TBM_Enable_Schedule2: accessed-variable=VeCANR_b_TBM_Enable_Schedule2.VeCANR_b_TBM_Enable_Schedule2
            IN_VeCANR_b_TBM_Enable_Schedule2TO_VeCANR_b_TBM_Enable_Schedule2TO: accessed-variable=VeCANR_b_TBM_Enable_Schedule2TO.VeCANR_b_TBM_Enable_Schedule2TO
            IN_VeCANR_b_TBM_End_Time_Hr1TO_VeCANR_b_TBM_End_Time_Hr1TO: accessed-variable=VeCANR_b_TBM_End_Time_Hr1TO.VeCANR_b_TBM_End_Time_Hr1TO
            IN_VeCANR_b_TBM_End_Time_Hr2TO_VeCANR_b_TBM_End_Time_Hr2TO: accessed-variable=VeCANR_b_TBM_End_Time_Hr2TO.VeCANR_b_TBM_End_Time_Hr2TO
            IN_VeCANR_b_TBM_End_Time_Min1TO_VeCANR_b_TBM_End_Time_Min1TO: accessed-variable=VeCANR_b_TBM_End_Time_Min1TO.VeCANR_b_TBM_End_Time_Min1TO
            IN_VeCANR_b_TBM_End_Time_Min2TO_VeCANR_b_TBM_End_Time_Min2TO: accessed-variable=VeCANR_b_TBM_End_Time_Min2TO.VeCANR_b_TBM_End_Time_Min2TO
            IN_VeCANR_b_TBM_ExtrnlChargTarget2TO_VeCANR_b_TBM_ExtrnlChargTarget2TO: accessed-variable=VeCANR_b_TBM_ExtrnlChargTarget2TO.VeCANR_b_TBM_ExtrnlChargTarget2TO
            IN_VeCANR_b_TBM_Schedule_Day1TO_VeCANR_b_TBM_Schedule_Day1TO: accessed-variable=VeCANR_b_TBM_Schedule_Day1TO.VeCANR_b_TBM_Schedule_Day1TO
            IN_VeCANR_b_TBM_Schedule_Day2TO_VeCANR_b_TBM_Schedule_Day2TO: accessed-variable=VeCANR_b_TBM_Schedule_Day2TO.VeCANR_b_TBM_Schedule_Day2TO
            IN_VeCANR_b_TBM_Start_Time_Hr1TO_VeCANR_b_TBM_Start_Time_Hr1TO: accessed-variable=VeCANR_b_TBM_Start_Time_Hr1TO.VeCANR_b_TBM_Start_Time_Hr1TO
            IN_VeCANR_b_TBM_Start_Time_Hr2TO_VeCANR_b_TBM_Start_Time_Hr2TO: accessed-variable=VeCANR_b_TBM_Start_Time_Hr2TO.VeCANR_b_TBM_Start_Time_Hr2TO
            IN_VeCANR_b_TBM_Start_Time_Min1TO_VeCANR_b_TBM_Start_Time_Min1TO: accessed-variable=VeCANR_b_TBM_Start_Time_Min1TO.VeCANR_b_TBM_Start_Time_Min1TO
            IN_VeCANR_b_TBM_Start_Time_Min2TO_VeCANR_b_TBM_Start_Time_Min2TO: accessed-variable=VeCANR_b_TBM_Start_Time_Min2TO.VeCANR_b_TBM_Start_Time_Min2TO
            IN_VeCANR_b_TBM_StopCharge_VeCANR_b_TBM_StopCharge: accessed-variable=VeCANR_b_TBM_StopCharge.VeCANR_b_TBM_StopCharge
            IN_VeCANR_b_TBM_StopChargeTO_VeCANR_b_TBM_StopChargeTO: accessed-variable=VeCANR_b_TBM_StopChargeTO.VeCANR_b_TBM_StopChargeTO
            IN_VeCANR_b_TBM_SubmitClimateSchd1_VeCANR_b_TBM_SubmitClimateSchd1: accessed-variable=VeCANR_b_TBM_SubmitClimateSchd1.VeCANR_b_TBM_SubmitClimateSchd1
            IN_VeCANR_b_TBM_SubmitClimateSchd1TO_VeCANR_b_TBM_SubmitClimateSchd1TO: accessed-variable=VeCANR_b_TBM_SubmitClimateSchd1TO.VeCANR_b_TBM_SubmitClimateSchd1TO
            IN_VeCANR_b_TBM_SubmitClimateSchd2_VeCANR_b_TBM_SubmitClimateSchd2: accessed-variable=VeCANR_b_TBM_SubmitClimateSchd2.VeCANR_b_TBM_SubmitClimateSchd2
            IN_VeCANR_b_TBM_SubmitClimateSchd2TO_VeCANR_b_TBM_SubmitClimateSchd2TO: accessed-variable=VeCANR_b_TBM_SubmitClimateSchd2TO.VeCANR_b_TBM_SubmitClimateSchd2TO
            IN_VeCANR_b_TBM_Submit_Schedule1_VeCANR_b_TBM_Submit_Schedule1: accessed-variable=VeCANR_b_TBM_Submit_Schedule1.VeCANR_b_TBM_Submit_Schedule1
            IN_VeCANR_b_TBM_Submit_Schedule1TO_VeCANR_b_TBM_Submit_Schedule1TO: accessed-variable=VeCANR_b_TBM_Submit_Schedule1TO.VeCANR_b_TBM_Submit_Schedule1TO
            IN_VeCANR_b_TBM_Submit_Schedule2_VeCANR_b_TBM_Submit_Schedule2: accessed-variable=VeCANR_b_TBM_Submit_Schedule2.VeCANR_b_TBM_Submit_Schedule2
            IN_VeCANR_b_TBM_Submit_Schedule2TO_VeCANR_b_TBM_Submit_Schedule2TO: accessed-variable=VeCANR_b_TBM_Submit_Schedule2TO.VeCANR_b_TBM_Submit_Schedule2TO
            IN_VeCANR_b_Trns_DrvMdReqTO_VeCANR_b_Trns_DrvMdReqTO: accessed-variable=VeCANR_b_Trns_DrvMdReqTO.VeCANR_b_Trns_DrvMdReqTO
            IN_VeCANR_b_V2H_Mode_Req_VeCANR_b_V2H_Mode_Req: accessed-variable=VeCANR_b_V2H_Mode_Req.VeCANR_b_V2H_Mode_Req
            IN_VeCANR_b_V2H_Mode_ReqTO_VeCANR_b_V2H_Mode_ReqTO: accessed-variable=VeCANR_b_V2H_Mode_ReqTO.VeCANR_b_V2H_Mode_ReqTO
            IN_VeCANR_b_V2H_Req_VeCANR_b_V2H_Req: accessed-variable=VeCANR_b_V2H_Req.VeCANR_b_V2H_Req
            IN_VeCANR_b_V2H_ReqTO_VeCANR_b_V2H_ReqTO: accessed-variable=VeCANR_b_V2H_ReqTO.VeCANR_b_V2H_ReqTO
            IN_VeCANR_b_V2H_Reserve_BatteryTO_VeCANR_b_V2H_Reserve_BatteryTO: accessed-variable=VeCANR_b_V2H_Reserve_BatteryTO.VeCANR_b_V2H_Reserve_BatteryTO
            IN_VeCANR_b_V2H_Submit_VeCANR_b_V2H_Submit: accessed-variable=VeCANR_b_V2H_Submit.VeCANR_b_V2H_Submit
            IN_VeCANR_b_V2H_SubmitTO_VeCANR_b_V2H_SubmitTO: accessed-variable=VeCANR_b_V2H_SubmitTO.VeCANR_b_V2H_SubmitTO
            IN_VeCANR_b_V2L_All_Req_VeCANR_b_V2L_All_Req: accessed-variable=VeCANR_b_V2L_All_Req.VeCANR_b_V2L_All_Req
            IN_VeCANR_b_V2L_All_ReqTO_VeCANR_b_V2L_All_ReqTO: accessed-variable=VeCANR_b_V2L_All_ReqTO.VeCANR_b_V2L_All_ReqTO
            IN_VeCANR_b_V2L_Frunk_Req_VeCANR_b_V2L_Frunk_Req: accessed-variable=VeCANR_b_V2L_Frunk_Req.VeCANR_b_V2L_Frunk_Req
            IN_VeCANR_b_V2L_Frunk_ReqTO_VeCANR_b_V2L_Frunk_ReqTO: accessed-variable=VeCANR_b_V2L_Frunk_ReqTO.VeCANR_b_V2L_Frunk_ReqTO
            IN_VeCANR_b_V2L_Mode_Req_VeCANR_b_V2L_Mode_Req: accessed-variable=VeCANR_b_V2L_Mode_Req.VeCANR_b_V2L_Mode_Req
            IN_VeCANR_b_V2L_Mode_ReqTO_VeCANR_b_V2L_Mode_ReqTO: accessed-variable=VeCANR_b_V2L_Mode_ReqTO.VeCANR_b_V2L_Mode_ReqTO
            IN_VeCANR_b_V2L_Reserve_BatteryTO_VeCANR_b_V2L_Reserve_BatteryTO: accessed-variable=VeCANR_b_V2L_Reserve_BatteryTO.VeCANR_b_V2L_Reserve_BatteryTO
            IN_VeCANR_b_V2L_Submit_VeCANR_b_V2L_Submit: accessed-variable=VeCANR_b_V2L_Submit.VeCANR_b_V2L_Submit
            IN_VeCANR_b_V2L_SubmitTO_VeCANR_b_V2L_SubmitTO: accessed-variable=VeCANR_b_V2L_SubmitTO.VeCANR_b_V2L_SubmitTO
            IN_VeCANR_b_V2L_Trunk_Req_VeCANR_b_V2L_Trunk_Req: accessed-variable=VeCANR_b_V2L_Trunk_Req.VeCANR_b_V2L_Trunk_Req
            IN_VeCANR_b_V2L_Trunk_ReqTO_VeCANR_b_V2L_Trunk_ReqTO: accessed-variable=VeCANR_b_V2L_Trunk_ReqTO.VeCANR_b_V2L_Trunk_ReqTO
            IN_VeCANR_b_V2V_Mode_Req_VeCANR_b_V2V_Mode_Req: accessed-variable=VeCANR_b_V2V_Mode_Req.VeCANR_b_V2V_Mode_Req
            IN_VeCANR_b_V2V_Mode_ReqTO_VeCANR_b_V2V_Mode_ReqTO: accessed-variable=VeCANR_b_V2V_Mode_ReqTO.VeCANR_b_V2V_Mode_ReqTO
            IN_VeCANR_b_V2V_Req_VeCANR_b_V2V_Req: accessed-variable=VeCANR_b_V2V_Req.VeCANR_b_V2V_Req
            IN_VeCANR_b_V2V_ReqTO_VeCANR_b_V2V_ReqTO: accessed-variable=VeCANR_b_V2V_ReqTO.VeCANR_b_V2V_ReqTO
            IN_VeCANR_b_V2V_Reserve_BatteryTO_VeCANR_b_V2V_Reserve_BatteryTO: accessed-variable=VeCANR_b_V2V_Reserve_BatteryTO.VeCANR_b_V2V_Reserve_BatteryTO
            IN_VeCANR_b_V2V_Submit_VeCANR_b_V2V_Submit: accessed-variable=VeCANR_b_V2V_Submit.VeCANR_b_V2V_Submit
            IN_VeCANR_b_V2V_SubmitTO_VeCANR_b_V2V_SubmitTO: accessed-variable=VeCANR_b_V2V_SubmitTO.VeCANR_b_V2V_SubmitTO
            IN_VeCANR_b_Year{1..4}_TLM_TO_VeCANR_b_Year{1..4}_TLM_TO: accessed-variable=VeCANR_b_Year{1..4}_TLM_TO.VeCANR_b_Year{1..4}_TLM_TO
            IN_VeCANR_cmp_GPS_Date_Month_VeCANR_cmp_GPS_Date_Month: accessed-variable=VeCANR_cmp_GPS_Date_Month.VeCANR_cmp_GPS_Date_Month
            IN_VeCANR_e_AllowClimateSchd1_VeCANR_e_AllowClimateSchd1: accessed-variable=VeCANR_e_AllowClimateSchd1.VeCANR_e_AllowClimateSchd1
            IN_VeCANR_e_AllowClimateSchd2_VeCANR_e_AllowClimateSchd2: accessed-variable=VeCANR_e_AllowClimateSchd2.VeCANR_e_AllowClimateSchd2
            IN_VeCANR_e_CanLocEnblStatus_VeCANR_e_CanLocEnblStatus: accessed-variable=VeCANR_e_CanLocEnblStatus.VeCANR_e_CanLocEnblStatus
            IN_VeCANR_e_Charge_Schedule_Type1_VeCANR_e_Charge_Schedule_Type1: accessed-variable=VeCANR_e_Charge_Schedule_Type1.VeCANR_e_Charge_Schedule_Type1
            IN_VeCANR_e_Charge_Schedule_Type2_VeCANR_e_Charge_Schedule_Type2: accessed-variable=VeCANR_e_Charge_Schedule_Type2.VeCANR_e_Charge_Schedule_Type2
            IN_VeCANR_e_ClimateSchd1_Day_VeCANR_e_ClimateSchd1_Day: accessed-variable=VeCANR_e_ClimateSchd1_Day.VeCANR_e_ClimateSchd1_Day
            IN_VeCANR_e_ClimateSchd2_Day_VeCANR_e_ClimateSchd2_Day: accessed-variable=VeCANR_e_ClimateSchd2_Day.VeCANR_e_ClimateSchd2_Day
            IN_VeCANR_e_Command_15Sts_VeCANR_e_Command_15Sts: accessed-variable=VeCANR_e_Command_15Sts.VeCANR_e_Command_15Sts
            IN_VeCANR_e_External_ChargeTarget1_VeCANR_e_External_ChargeTarget1: accessed-variable=VeCANR_e_External_ChargeTarget1.VeCANR_e_External_ChargeTarget1
            IN_VeCANR_e_External_ChargeTarget2_VeCANR_e_External_ChargeTarget2: accessed-variable=VeCANR_e_External_ChargeTarget2.VeCANR_e_External_ChargeTarget2
            IN_VeCANR_e_HAS_TelltaleSts_VeCANR_e_HAS_TelltaleSts: accessed-variable=VeCANR_e_HAS_TelltaleSts.VeCANR_e_HAS_TelltaleSts
            IN_VeCANR_e_ImmediateChargeTarget1_VeCANR_e_ImmediateChargeTarget1: accessed-variable=VeCANR_e_ImmediateChargeTarget1.VeCANR_e_ImmediateChargeTarget1
            IN_VeCANR_e_ImmediateChargeTarget2_VeCANR_e_ImmediateChargeTarget2: accessed-variable=VeCANR_e_ImmediateChargeTarget2.VeCANR_e_ImmediateChargeTarget2
            IN_VeCANR_e_Remote_Chargeport_Cmnd_VeCANR_e_Remote_Chargeport_Cmnd: accessed-variable=VeCANR_e_Remote_Chargeport_Cmnd.VeCANR_e_Remote_Chargeport_Cmnd
            IN_VeCANR_e_Schedule_Day1_VeCANR_e_Schedule_Day1: accessed-variable=VeCANR_e_Schedule_Day1.VeCANR_e_Schedule_Day1
            IN_VeCANR_e_Schedule_Day2_VeCANR_e_Schedule_Day2: accessed-variable=VeCANR_e_Schedule_Day2.VeCANR_e_Schedule_Day2
            IN_VeCANR_e_TBMChrgSchedulType1Req_VeCANR_e_TBMChrgSchedulType1Req: accessed-variable=VeCANR_e_TBMChrgSchedulType1Req.VeCANR_e_TBMChrgSchedulType1Req
            IN_VeCANR_e_TBMChrgSchedulType2Req_VeCANR_e_TBMChrgSchedulType2Req: accessed-variable=VeCANR_e_TBMChrgSchedulType2Req.VeCANR_e_TBMChrgSchedulType2Req
            IN_VeCANR_e_TBMCooperativeChrgCmnd_VeCANR_e_TBMCooperativeChrgCmnd: accessed-variable=VeCANR_e_TBMCooperativeChrgCmnd.VeCANR_e_TBMCooperativeChrgCmnd
            IN_VeCANR_e_TBMExtrnlChrgTarget1_VeCANR_e_TBMExtrnlChrgTarget1: accessed-variable=VeCANR_e_TBMExtrnlChrgTarget1.VeCANR_e_TBMExtrnlChrgTarget1
            IN_VeCANR_e_TBMImmediatChrgTarget1_VeCANR_e_TBMImmediatChrgTarget1: accessed-variable=VeCANR_e_TBMImmediatChrgTarget1.VeCANR_e_TBMImmediatChrgTarget1
            IN_VeCANR_e_TBMImmediatChrgTarget2_VeCANR_e_TBMImmediatChrgTarget2: accessed-variable=VeCANR_e_TBMImmediatChrgTarget2.VeCANR_e_TBMImmediatChrgTarget2
            IN_VeCANR_e_TBM_AllowClimateSchd1_VeCANR_e_TBM_AllowClimateSchd1: accessed-variable=VeCANR_e_TBM_AllowClimateSchd1.VeCANR_e_TBM_AllowClimateSchd1
            IN_VeCANR_e_TBM_AllowClimateSchd2_VeCANR_e_TBM_AllowClimateSchd2: accessed-variable=VeCANR_e_TBM_AllowClimateSchd2.VeCANR_e_TBM_AllowClimateSchd2
            IN_VeCANR_e_TBM_ClimateSchd1_Day_VeCANR_e_TBM_ClimateSchd1_Day: accessed-variable=VeCANR_e_TBM_ClimateSchd1_Day.VeCANR_e_TBM_ClimateSchd1_Day
            IN_VeCANR_e_TBM_ClimateSchd2_Day_VeCANR_e_TBM_ClimateSchd2_Day: accessed-variable=VeCANR_e_TBM_ClimateSchd2_Day.VeCANR_e_TBM_ClimateSchd2_Day
            IN_VeCANR_e_TBM_ExtrnlChargTarget2_VeCANR_e_TBM_ExtrnlChargTarget2: accessed-variable=VeCANR_e_TBM_ExtrnlChargTarget2.VeCANR_e_TBM_ExtrnlChargTarget2
            IN_VeCANR_e_TBM_Schedule_Day1_VeCANR_e_TBM_Schedule_Day1: accessed-variable=VeCANR_e_TBM_Schedule_Day1.VeCANR_e_TBM_Schedule_Day1
            IN_VeCANR_e_TBM_Schedule_Day2_VeCANR_e_TBM_Schedule_Day2: accessed-variable=VeCANR_e_TBM_Schedule_Day2.VeCANR_e_TBM_Schedule_Day2
            IN_VeCANR_e_Trns_DrvMdReq_VeCANR_e_Trns_DrvMdReq: accessed-variable=VeCANR_e_Trns_DrvMdReq.VeCANR_e_Trns_DrvMdReq
            IN_VeCANR_t_ClimateSchd1_Dprtr_Hr_VeCANR_t_ClimateSchd1_Dprtr_Hr: accessed-variable=VeCANR_t_ClimateSchd1_Dprtr_Hr.VeCANR_t_ClimateSchd1_Dprtr_Hr
            IN_VeCANR_t_ClimateSchd1_Dprtr_Min_VeCANR_t_ClimateSchd1_Dprtr_Min: accessed-variable=VeCANR_t_ClimateSchd1_Dprtr_Min.VeCANR_t_ClimateSchd1_Dprtr_Min
            IN_VeCANR_t_ClimateSchd2_Dprtr_Hr_VeCANR_t_ClimateSchd2_Dprtr_Hr: accessed-variable=VeCANR_t_ClimateSchd2_Dprtr_Hr.VeCANR_t_ClimateSchd2_Dprtr_Hr
            IN_VeCANR_t_ClimateSchd2_Dprtr_Min_VeCANR_t_ClimateSchd2_Dprtr_Min: accessed-variable=VeCANR_t_ClimateSchd2_Dprtr_Min.VeCANR_t_ClimateSchd2_Dprtr_Min
            IN_VeCANR_t_End_Time_Hr1_VeCANR_t_End_Time_Hr1: accessed-variable=VeCANR_t_End_Time_Hr1.VeCANR_t_End_Time_Hr1
            IN_VeCANR_t_End_Time_Hr2_VeCANR_t_End_Time_Hr2: accessed-variable=VeCANR_t_End_Time_Hr2.VeCANR_t_End_Time_Hr2
            IN_VeCANR_t_End_Time_Min1_VeCANR_t_End_Time_Min1: accessed-variable=VeCANR_t_End_Time_Min1.VeCANR_t_End_Time_Min1
            IN_VeCANR_t_End_Time_Min2_VeCANR_t_End_Time_Min2: accessed-variable=VeCANR_t_End_Time_Min2.VeCANR_t_End_Time_Min2
            IN_VeCANR_t_GPS_Date_Day_VeCANR_t_GPS_Date_Day: accessed-variable=VeCANR_t_GPS_Date_Day.VeCANR_t_GPS_Date_Day
            IN_VeCANR_t_GPS_Date_Year_VeCANR_t_GPS_Date_Year: accessed-variable=VeCANR_t_GPS_Date_Year.VeCANR_t_GPS_Date_Year
            IN_VeCANR_t_GPS_UTC_Hour_VeCANR_t_GPS_UTC_Hour: accessed-variable=VeCANR_t_GPS_UTC_Hour.VeCANR_t_GPS_UTC_Hour
            IN_VeCANR_t_GPS_UTC_Minute_VeCANR_t_GPS_UTC_Minute: accessed-variable=VeCANR_t_GPS_UTC_Minute.VeCANR_t_GPS_UTC_Minute
            IN_VeCANR_t_GPS_UTC_Second_VeCANR_t_GPS_UTC_Second: accessed-variable=VeCANR_t_GPS_UTC_Second.VeCANR_t_GPS_UTC_Second
            IN_VeCANR_t_Start_Time_Hr1_VeCANR_t_Start_Time_Hr1: accessed-variable=VeCANR_t_Start_Time_Hr1.VeCANR_t_Start_Time_Hr1
            IN_VeCANR_t_Start_Time_Hr2_VeCANR_t_Start_Time_Hr2: accessed-variable=VeCANR_t_Start_Time_Hr2.VeCANR_t_Start_Time_Hr2
            IN_VeCANR_t_Start_Time_Min1_VeCANR_t_Start_Time_Min1: accessed-variable=VeCANR_t_Start_Time_Min1.VeCANR_t_Start_Time_Min1
            IN_VeCANR_t_Start_Time_Min2_VeCANR_t_Start_Time_Min2: accessed-variable=VeCANR_t_Start_Time_Min2.VeCANR_t_Start_Time_Min2
            IN_VeCANR_t_TBM_ClimSchd1DprtrHr_VeCANR_t_TBM_ClimSchd1DprtrHr: accessed-variable=VeCANR_t_TBM_ClimSchd1DprtrHr.VeCANR_t_TBM_ClimSchd1DprtrHr
            IN_VeCANR_t_TBM_ClimSchd1DprtrMin_VeCANR_t_TBM_ClimSchd1DprtrMin: accessed-variable=VeCANR_t_TBM_ClimSchd1DprtrMin.VeCANR_t_TBM_ClimSchd1DprtrMin
            IN_VeCANR_t_TBM_ClimSchd2DprtrHr_VeCANR_t_TBM_ClimSchd2DprtrHr: accessed-variable=VeCANR_t_TBM_ClimSchd2DprtrHr.VeCANR_t_TBM_ClimSchd2DprtrHr
            IN_VeCANR_t_TBM_ClimSchd2DprtrMin_VeCANR_t_TBM_ClimSchd2DprtrMin: accessed-variable=VeCANR_t_TBM_ClimSchd2DprtrMin.VeCANR_t_TBM_ClimSchd2DprtrMin
            IN_VeCANR_t_TBM_End_Time_Hr1_VeCANR_t_TBM_End_Time_Hr1: accessed-variable=VeCANR_t_TBM_End_Time_Hr1.VeCANR_t_TBM_End_Time_Hr1
            IN_VeCANR_t_TBM_End_Time_Hr2_VeCANR_t_TBM_End_Time_Hr2: accessed-variable=VeCANR_t_TBM_End_Time_Hr2.VeCANR_t_TBM_End_Time_Hr2
            IN_VeCANR_t_TBM_End_Time_Min1_VeCANR_t_TBM_End_Time_Min1: accessed-variable=VeCANR_t_TBM_End_Time_Min1.VeCANR_t_TBM_End_Time_Min1
            IN_VeCANR_t_TBM_End_Time_Min2_VeCANR_t_TBM_End_Time_Min2: accessed-variable=VeCANR_t_TBM_End_Time_Min2.VeCANR_t_TBM_End_Time_Min2
            IN_VeCANR_t_TBM_Start_Time_Hr1_VeCANR_t_TBM_Start_Time_Hr1: accessed-variable=VeCANR_t_TBM_Start_Time_Hr1.VeCANR_t_TBM_Start_Time_Hr1
            IN_VeCANR_t_TBM_Start_Time_Hr2_VeCANR_t_TBM_Start_Time_Hr2: accessed-variable=VeCANR_t_TBM_Start_Time_Hr2.VeCANR_t_TBM_Start_Time_Hr2
            IN_VeCANR_t_TBM_Start_Time_Min1_VeCANR_t_TBM_Start_Time_Min1: accessed-variable=VeCANR_t_TBM_Start_Time_Min1.VeCANR_t_TBM_Start_Time_Min1
            IN_VeCANR_t_TBM_Start_Time_Min2_VeCANR_t_TBM_Start_Time_Min2: accessed-variable=VeCANR_t_TBM_Start_Time_Min2.VeCANR_t_TBM_Start_Time_Min2
            IN_VeCANR_y_AUD_LVL_VeCANR_y_AUD_LVL: accessed-variable=VeCANR_y_AUD_LVL.VeCANR_y_AUD_LVL
            IN_VeCANR_y_Day1_TLM_VeCANR_y_Day1_TLM: accessed-variable=VeCANR_y_Day1_TLM.VeCANR_y_Day1_TLM
            IN_VeCANR_y_Day2_TLM_VeCANR_y_Day2_TLM: accessed-variable=VeCANR_y_Day2_TLM.VeCANR_y_Day2_TLM
            IN_VeCANR_y_Hour1_TLM_VeCANR_y_Hour1_TLM: accessed-variable=VeCANR_y_Hour1_TLM.VeCANR_y_Hour1_TLM
            IN_VeCANR_y_Hour2_TLM_VeCANR_y_Hour2_TLM: accessed-variable=VeCANR_y_Hour2_TLM.VeCANR_y_Hour2_TLM
            IN_VeCANR_y_Minute1_TLM_VeCANR_y_Minute1_TLM: accessed-variable=VeCANR_y_Minute1_TLM.VeCANR_y_Minute1_TLM
            IN_VeCANR_y_Minute2_TLM_VeCANR_y_Minute2_TLM: accessed-variable=VeCANR_y_Minute2_TLM.VeCANR_y_Minute2_TLM
            IN_VeCANR_y_Month1_TLM_VeCANR_y_Month1_TLM: accessed-variable=VeCANR_y_Month1_TLM.VeCANR_y_Month1_TLM
            IN_VeCANR_y_Month2_TLM_VeCANR_y_Month2_TLM: accessed-variable=VeCANR_y_Month2_TLM.VeCANR_y_Month2_TLM
            IN_VeCANR_y_Year{1..4}_TLM_VeCANR_y_Year{1..4}_TLM: accessed-variable=VeCANR_y_Year{1..4}_TLM.VeCANR_y_Year{1..4}_TLM
            IN_VeSR1B_I_IBS3_Ibatt_Value: accessed-variable=VeSR1B_I_IBS3_Ibatt.Value
            IN_VeSR1B_Pct_IBS3_SOC_Value: accessed-variable=VeSR1B_Pct_IBS3_SOC.Value
            IN_VeSR1B_T_EVAP_TEMP_P1C_Value: accessed-variable=VeSR1B_T_EVAP_TEMP_P1C.Value
            IN_VeSR1B_T_IBS3_T_BATT_Value: accessed-variable=VeSR1B_T_IBS3_T_BATT.Value
            IN_VeSR1B_U_BonnetAjarRawValSts_8_Value: accessed-variable=VeSR1B_U_BonnetAjarRawValSts_8.Value
            IN_VeSR1B_U_ExtTemperatureAD_Volt_Value: accessed-variable=VeSR1B_U_ExtTemperatureAD_Volt.Value
            IN_VeSR1B_U_IBS3_Vbatt_Value: accessed-variable=VeSR1B_U_IBS3_Vbatt.Value
            IN_VeSR1B_b_BonnetSts_Value: accessed-variable=VeSR1B_b_BonnetSts.Value
            IN_VeSR1B_b_ChargeNow_Value: accessed-variable=VeSR1B_b_ChargeNow.Value
            IN_VeSR1B_b_CompressorACReqSts_Value: accessed-variable=VeSR1B_b_CompressorACReqSts.Value
            IN_VeSR1B_b_Creep_Value: accessed-variable=VeSR1B_b_Creep.Value, variation-point={short-label=vpIN_VeSR1B_b_Creep_Value, sw-syscond=1}
            IN_VeSR1B_b_CurrBattFailStatus_Value: accessed-variable=VeSR1B_b_CurrBattFailStatus.Value
            IN_VeSR1B_b_DAY_LGT_MD_Value: accessed-variable=VeSR1B_b_DAY_LGT_MD.Value
            IN_VeSR1B_b_DC_PwrLev_Value: accessed-variable=VeSR1B_b_DC_PwrLev.Value, variation-point={short-label=vpIN_VeSR1B_b_DC_PwrLev_Value, sw-syscond=1}
            IN_VeSR1B_b_DRV_DR_UNLOCKING_Value: accessed-variable=VeSR1B_b_DRV_DR_UNLOCKING.Value
            IN_VeSR1B_b_DriverDoorSts_Value: accessed-variable=VeSR1B_b_DriverDoorSts.Value
            IN_VeSR1B_b_DriverEngineOffRequest_Value: accessed-variable=VeSR1B_b_DriverEngineOffRequest.Value
            IN_VeSR1B_b_DrvSeatDPFaultSts_Value: accessed-variable=VeSR1B_b_DrvSeatDPFaultSts.Value
            IN_VeSR1B_b_FL_HS_STATFailSts_Value: accessed-variable=VeSR1B_b_FL_HS_STATFailSts.Value
            IN_VeSR1B_b_FL_VS_STATFailSts_Value: accessed-variable=VeSR1B_b_FL_VS_STATFailSts.Value
            IN_VeSR1B_b_FR_HS_STATFailSts_Value: accessed-variable=VeSR1B_b_FR_HS_STATFailSts.Value
            IN_VeSR1B_b_FR_VS_STATFailSts_Value: accessed-variable=VeSR1B_b_FR_VS_STATFailSts.Value
            IN_VeSR1B_b_HSW_StatFailSts_Value: accessed-variable=VeSR1B_b_HSW_StatFailSts.Value
            IN_VeSR1B_b_IBS3_SOC_Accuracy_Value: accessed-variable=VeSR1B_b_IBS3_SOC_Accuracy.Value
            IN_VeSR1B_b_IBS3_TempFailStatus_Value: accessed-variable=VeSR1B_b_IBS3_TempFailStatus.Value
            IN_VeSR1B_b_IMPACTCommand_FD3_Value: accessed-variable=VeSR1B_b_IMPACTCommand_FD3.Value
            IN_VeSR1B_b_IMPACTConfirm_FD3_Value: accessed-variable=VeSR1B_b_IMPACTConfirm_FD3.Value
            IN_VeSR1B_b_LHRDoorSts_Value: accessed-variable=VeSR1B_b_LHRDoorSts.Value
            IN_VeSR1B_b_PN14_LS_Actv_Value: accessed-variable=VeSR1B_b_PN14_LS_Actv.Value
            IN_VeSR1B_b_PRNDFailSts_FD3_Value: accessed-variable=VeSR1B_b_PRNDFailSts_FD3.Value
            IN_VeSR1B_b_PRNDdisplayFailSts_FD3_Value: accessed-variable=VeSR1B_b_PRNDdisplayFailSts_FD3.Value
            IN_VeSR1B_b_ParkBrakeSts_Value: accessed-variable=VeSR1B_b_ParkBrakeSts.Value
            IN_VeSR1B_b_PlugAndChargeReq_Value: accessed-variable=VeSR1B_b_PlugAndChargeReq.Value
            IN_VeSR1B_b_PsngrDoorSts_Value: accessed-variable=VeSR1B_b_PsngrDoorSts.Value
            IN_VeSR1B_b_RACE_PREP_RACE_TYPE_REQ_Value: accessed-variable=VeSR1B_b_RACE_PREP_RACE_TYPE_REQ.Value, variation-point={short-label=vpIN_VeSR1B_b_RACE_PREP_RACE_TYPE_REQ_Value, sw-syscond=1}
            IN_VeSR1B_b_RHRDoorSts_Value: accessed-variable=VeSR1B_b_RHRDoorSts.Value
            IN_VeSR1B_b_RHatchSts_Value: accessed-variable=VeSR1B_b_RHatchSts.Value
            IN_VeSR1B_b_RL_HS_STATFailSts_Value: accessed-variable=VeSR1B_b_RL_HS_STATFailSts.Value
            IN_VeSR1B_b_RL_VS_STATFailSts_Value: accessed-variable=VeSR1B_b_RL_VS_STATFailSts.Value
            IN_VeSR1B_b_RR_HS_STATFailSts_Value: accessed-variable=VeSR1B_b_RR_HS_STATFailSts.Value
            IN_VeSR1B_b_RR_VS_STATFailSts_Value: accessed-variable=VeSR1B_b_RR_VS_STATFailSts.Value
            IN_VeSR1B_b_RearFogLightSts_Value: accessed-variable=VeSR1B_b_RearFogLightSts.Value
            IN_VeSR1B_b_RemStActvSts_R_Value: accessed-variable=VeSR1B_b_RemStActvSts_R.Value
            IN_VeSR1B_b_SCCActvSts_Value: accessed-variable=VeSR1B_b_SCCActvSts.Value
            IN_VeSR1B_b_SOC_Max_Lev_Value: accessed-variable=VeSR1B_b_SOC_Max_Lev.Value
            IN_VeSR1B_b_Secure_Idle_Req_Value: accessed-variable=VeSR1B_b_Secure_Idle_Req.Value
            IN_VeSR1B_b_ShiftLockFailSts_Value: accessed-variable=VeSR1B_b_ShiftLockFailSts.Value
            IN_VeSR1B_b_Speed_Unit_Value: accessed-variable=VeSR1B_b_Speed_Unit.Value
            IN_VeSR1B_b_Traffic_Sign_Info_Value: accessed-variable=VeSR1B_b_Traffic_Sign_Info.Value
            IN_VeSR1B_b_VoltBattFailStatus_Value: accessed-variable=VeSR1B_b_VoltBattFailStatus.Value
            IN_VeSR1B_y_Switch_2WD_Rq_Value: accessed-variable=VeSR1B_y_Switch_2WD_Rq.Value, variation-point={short-label=vpIN_VeSR1B_y_Switch_2WD_Rq_Value, sw-syscond=1}
            IN_VeSR1B_kl_TotalOdometer_Value: accessed-variable=VeSR1B_kl_TotalOdometer.Value
            IN_VeSR1B_y_AEB_Systemsts_Value: accessed-variable=VeSR1B_y_AEB_Systemsts.Value
            IN_VeSR1B_y_AEB_Systemsts_SigSts_Value: accessed-variable=VeSR1B_y_AEB_Systemsts_SigSts.Value
            IN_VeSR1B_y_APCM_Stat_FD3_Value: accessed-variable=VeSR1B_y_APCM_Stat_FD3.Value
            IN_VeSR1B_y_APCM_Stat_FD3_SigSts_Value: accessed-variable=VeSR1B_y_APCM_Stat_FD3_SigSts.Value
            IN_VeSR1B_y_BonnetAjarRawValSts_8_SigSts_Value: accessed-variable=VeSR1B_y_BonnetAjarRawValSts_8_SigSts.Value
            IN_VeSR1B_y_BonnetSts_SigSts_Value: accessed-variable=VeSR1B_y_BonnetSts_SigSts.Value
            IN_VeSR1B_y_ChargeNow_SigSts_Value: accessed-variable=VeSR1B_y_ChargeNow_SigSts.Value
            IN_VeSR1B_y_CmdIgnSts_Value: accessed-variable=VeSR1B_y_CmdIgnSts.Value
            IN_VeSR1B_y_CmdIgnSts_SigSts_Value: accessed-variable=VeSR1B_y_CmdIgnSts_SigSts.Value
            IN_VeSR1B_y_CompressorACReqSts_SigSts_Value: accessed-variable=VeSR1B_y_CompressorACReqSts_SigSts.Value
            IN_VeSR1B_y_Creep_SigSts_Value: accessed-variable=VeSR1B_y_Creep_SigSts.Value, variation-point={short-label=vpIN_VeSR1B_y_Creep_SigSts_Value, sw-syscond=1}
            IN_VeSR1B_y_CurrBattFailStatus_SigSts_Value: accessed-variable=VeSR1B_y_CurrBattFailStatus_SigSts.Value
            IN_VeSR1B_y_DAY_LGT_MD_SigSts_Value: accessed-variable=VeSR1B_y_DAY_LGT_MD_SigSts.Value
            IN_VeSR1B_y_DC_PwrLev_SigSts_Value: accessed-variable=VeSR1B_y_DC_PwrLev_SigSts.Value, variation-point={short-label=vpIN_VeSR1B_y_DC_PwrLev_SigSts_Value, sw-syscond=1}
            IN_VeSR1B_y_DRV_DR_UNLOCKING_SigSts_Value: accessed-variable=VeSR1B_y_DRV_DR_UNLOCKING_SigSts.Value
            IN_VeSR1B_y_DisplayedSpeedLimSts_Value: accessed-variable=VeSR1B_y_DisplayedSpeedLimSts.Value
            IN_VeSR1B_y_DisplayedSpeedLimSts_SigSts_Value: accessed-variable=VeSR1B_y_DisplayedSpeedLimSts_SigSts.Value
            IN_VeSR1B_y_DoorLockLastElSts_Value: accessed-variable=VeSR1B_y_DoorLockLastElSts.Value
            IN_VeSR1B_y_DoorLockLastElSts_SigSts_Value: accessed-variable=VeSR1B_y_DoorLockLastElSts_SigSts.Value
            IN_VeSR1B_y_DriverDoorOnOffSts_Value: accessed-variable=VeSR1B_y_DriverDoorOnOffSts.Value
            IN_VeSR1B_y_DriverDoorOnOffSts_SigSts_Value: accessed-variable=VeSR1B_y_DriverDoorOnOffSts_SigSts.Value
            IN_VeSR1B_y_DriverDoorSts_SigSts_Value: accessed-variable=VeSR1B_y_DriverDoorSts_SigSts.Value
            IN_VeSR1B_y_DriverEngineOffRequest_SigSts_Value: accessed-variable=VeSR1B_y_DriverEngineOffRequest_SigSts.Value
            IN_VeSR1B_y_DrvSeatDPFaultSts_SigSts_Value: accessed-variable=VeSR1B_y_DrvSeatDPFaultSts_SigSts.Value
            IN_VeSR1B_y_DrvSeatDPSts_Value: accessed-variable=VeSR1B_y_DrvSeatDPSts.Value
            IN_VeSR1B_y_DrvSeatDPSts_SigSts_Value: accessed-variable=VeSR1B_y_DrvSeatDPSts_SigSts.Value
            IN_VeSR1B_y_EBL_Stat_Value: accessed-variable=VeSR1B_y_EBL_Stat.Value
            IN_VeSR1B_y_EBL_Stat_SigSts_Value: accessed-variable=VeSR1B_y_EBL_Stat_SigSts.Value
            IN_VeSR1B_y_ETM_PaddlesModeReq_Value: accessed-variable=VeSR1B_y_ETM_PaddlesModeReq.Value
            IN_VeSR1B_y_ETM_PaddlesModeReq_SigSts_Value: accessed-variable=VeSR1B_y_ETM_PaddlesModeReq_SigSts.Value
            IN_VeSR1B_y_EVAP_TEMP_P1C_SigSts_Value: accessed-variable=VeSR1B_y_EVAP_TEMP_P1C_SigSts.Value
            IN_VeSR1B_y_E_Coasting_Req_Value: accessed-variable=VeSR1B_y_E_Coasting_Req.Value
            IN_VeSR1B_y_E_Coasting_Req_SigSts_Value: accessed-variable=VeSR1B_y_E_Coasting_Req_SigSts.Value
            IN_VeSR1B_y_ExtTemperatureAD_Volt_SigSts_Value: accessed-variable=VeSR1B_y_ExtTemperatureAD_Volt_SigSts.Value
            IN_VeSR1B_y_FL_HS_STATFailSts_SigSts_Value: accessed-variable=VeSR1B_y_FL_HS_STATFailSts_SigSts.Value
            IN_VeSR1B_y_FL_HS_STATSts_Value: accessed-variable=VeSR1B_y_FL_HS_STATSts.Value
            IN_VeSR1B_y_FL_HS_STATSts_SigSts_Value: accessed-variable=VeSR1B_y_FL_HS_STATSts_SigSts.Value
            IN_VeSR1B_y_FL_VS_STATFailSts_SigSts_Value: accessed-variable=VeSR1B_y_FL_VS_STATFailSts_SigSts.Value
            IN_VeSR1B_y_FL_VS_STATSts_Value: accessed-variable=VeSR1B_y_FL_VS_STATSts.Value
            IN_VeSR1B_y_FL_VS_STATSts_SigSts_Value: accessed-variable=VeSR1B_y_FL_VS_STATSts_SigSts.Value
            IN_VeSR1B_y_FOTA_Install_Type_Value: accessed-variable=VeSR1B_y_FOTA_Install_Type.Value
            IN_VeSR1B_y_FOTA_Install_Type_SigSts_Value: accessed-variable=VeSR1B_y_FOTA_Install_Type_SigSts.Value
            IN_VeSR1B_y_FOTA_Installation_Sts_Value: accessed-variable=VeSR1B_y_FOTA_Installation_Sts.Value
            IN_VeSR1B_y_FOTA_Installation_Sts_SigSts_Value: accessed-variable=VeSR1B_y_FOTA_Installation_Sts_SigSts.Value
            IN_VeSR1B_y_FR_HS_STATFailSts_SigSts_Value: accessed-variable=VeSR1B_y_FR_HS_STATFailSts_SigSts.Value
            IN_VeSR1B_y_FR_HS_STATSts_Value: accessed-variable=VeSR1B_y_FR_HS_STATSts.Value
            IN_VeSR1B_y_FR_HS_STATSts_SigSts_Value: accessed-variable=VeSR1B_y_FR_HS_STATSts_SigSts.Value
            IN_VeSR1B_y_FR_VS_STATFailSts_SigSts_Value: accessed-variable=VeSR1B_y_FR_VS_STATFailSts_SigSts.Value
            IN_VeSR1B_y_FR_VS_STATSts_Value: accessed-variable=VeSR1B_y_FR_VS_STATSts.Value
            IN_VeSR1B_y_FR_VS_STATSts_SigSts_Value: accessed-variable=VeSR1B_y_FR_VS_STATSts_SigSts.Value
            IN_VeSR1B_y_FobSearchResult_Value: accessed-variable=VeSR1B_y_FobSearchResult.Value
            IN_VeSR1B_y_FobSearchResult_SigSts_Value: accessed-variable=VeSR1B_y_FobSearchResult_SigSts.Value
            IN_VeSR1B_y_GlobDrvMdRq_Value: accessed-variable=VeSR1B_y_GlobDrvMdRq.Value
            IN_VeSR1B_y_GlobDrvMdRq_BCM_Value: accessed-variable=VeSR1B_y_GlobDrvMdRq_BCM.Value
            IN_VeSR1B_y_GlobDrvMdRq_BCM_SigSts_Value: accessed-variable=VeSR1B_y_GlobDrvMdRq_BCM_SigSts.Value
            IN_VeSR1B_y_GlobDrvMdRq_SigSts_Value: accessed-variable=VeSR1B_y_GlobDrvMdRq_SigSts.Value
            IN_VeSR1B_y_HSW_StatFailSts_SigSts_Value: accessed-variable=VeSR1B_y_HSW_StatFailSts_SigSts.Value
            IN_VeSR1B_y_HiBmLvr_Stat_Value: accessed-variable=VeSR1B_y_HiBmLvr_Stat.Value
            IN_VeSR1B_y_HiBmLvr_Stat_SigSts_Value: accessed-variable=VeSR1B_y_HiBmLvr_Stat_SigSts.Value
            IN_VeSR1B_y_IBS3_Ibatt_SigSts_Value: accessed-variable=VeSR1B_y_IBS3_Ibatt_SigSts.Value
            IN_VeSR1B_y_IBS3_SOC_Accuracy_SigSts_Value: accessed-variable=VeSR1B_y_IBS3_SOC_Accuracy_SigSts.Value
            IN_VeSR1B_y_IBS3_SOC_SigSts_Value: accessed-variable=VeSR1B_y_IBS3_SOC_SigSts.Value
            IN_VeSR1B_y_IBS3_T_BATT_SigSts_Value: accessed-variable=VeSR1B_y_IBS3_T_BATT_SigSts.Value
            IN_VeSR1B_y_IBS3_TempFailStatus_SigSts_Value: accessed-variable=VeSR1B_y_IBS3_TempFailStatus_SigSts.Value
            IN_VeSR1B_y_IBS3_Vbatt_SigSts_Value: accessed-variable=VeSR1B_y_IBS3_Vbatt_SigSts.Value
            IN_VeSR1B_y_IMPACTCommand_FD3_SigSts_Value: accessed-variable=VeSR1B_y_IMPACTCommand_FD3_SigSts.Value
            IN_VeSR1B_y_IMPACTConfirm_FD3_SigSts_Value: accessed-variable=VeSR1B_y_IMPACTConfirm_FD3_SigSts.Value
            IN_VeSR1B_y_KeyInIgnSts_Value: accessed-variable=VeSR1B_y_KeyInIgnSts.Value
            IN_VeSR1B_y_KeyInIgnSts_SigSts_Value: accessed-variable=VeSR1B_y_KeyInIgnSts_SigSts.Value
            IN_VeSR1B_y_LHRDoorSts_SigSts_Value: accessed-variable=VeSR1B_y_LHRDoorSts_SigSts.Value
            IN_VeSR1B_y_Launch_Hard_Btn_Value: accessed-variable=VeSR1B_y_Launch_Hard_Btn.Value, variation-point={short-label=vpIN_VeSR1B_y_Launch_Hard_Btn_Value, sw-syscond=1}
            IN_VeSR1B_y_Launch_Hard_Btn_SigSts_Value: accessed-variable=VeSR1B_y_Launch_Hard_Btn_SigSts.Value, variation-point={short-label=vpIN_VeSR1B_y_Launch_Hard_Btn_SigSts_Value, sw-syscond=1}
            IN_VeSR1B_y_Launch_Torque_Sft_Btn_Req_Value: accessed-variable=VeSR1B_y_Launch_Torque_Sft_Btn_Req.Value, variation-point={short-label=vpIN_VeSR1B_y_Launch_Torque_Sft_Btn_Req_Value, sw-syscond=1}
            IN_VeSR1B_y_Launch_Torque_Sft_Btn_Req_SigSts_Value: accessed-variable=VeSR1B_y_Launch_Torque_Sft_Btn_Req_SigSts.Value, variation-point={short-label=vpIN_VeSR1B_y_Launch_Torque_Sft_Btn_Req_SigSts_Value, sw-syscond=1}
            IN_VeSR1B_y_Left_Button_BCM_Value: accessed-variable=VeSR1B_y_Left_Button_BCM.Value
            IN_VeSR1B_y_Left_Button_BCM_SigSts_Value: accessed-variable=VeSR1B_y_Left_Button_BCM_SigSts.Value
            IN_VeSR1B_y_MRM_STATUS_C2_Value: accessed-variable=VeSR1B_y_MRM_STATUS_C2.Value
            IN_VeSR1B_y_MRM_STATUS_C2_SigSts_Value: accessed-variable=VeSR1B_y_MRM_STATUS_C2_SigSts.Value
            IN_VeSR1B_y_MRM_STATUS_FD3_Value: accessed-variable=VeSR1B_y_MRM_STATUS_FD3.Value
            IN_VeSR1B_y_MRM_STATUS_FD3_SigSts_Value: accessed-variable=VeSR1B_y_MRM_STATUS_FD3_SigSts.Value
            IN_VeSR1B_y_PN14_LS_Actv_SigSts_Value: accessed-variable=VeSR1B_y_PN14_LS_Actv_SigSts.Value
            IN_VeSR1B_y_PRNDFailSts_FD3_SigSts_Value: accessed-variable=VeSR1B_y_PRNDFailSts_FD3_SigSts.Value
            IN_VeSR1B_y_PRNDdisplayFailSts_FD3_SigSts_Value: accessed-variable=VeSR1B_y_PRNDdisplayFailSts_FD3_SigSts.Value
            IN_VeSR1B_y_ParkBrakeSts_SigSts_Value: accessed-variable=VeSR1B_y_ParkBrakeSts_SigSts.Value
            IN_VeSR1B_y_PlugAndChargeReq_SigSts_Value: accessed-variable=VeSR1B_y_PlugAndChargeReq_SigSts.Value
            IN_VeSR1B_y_PowerModeSts_Value: accessed-variable=VeSR1B_y_PowerModeSts.Value
            IN_VeSR1B_y_PowerModeSts_SigSts_Value: accessed-variable=VeSR1B_y_PowerModeSts_SigSts.Value
            IN_VeSR1B_y_PowerShot_BCM_Value: accessed-variable=VeSR1B_y_PowerShot_BCM.Value, variation-point={short-label=vpIN_VeSR1B_y_PowerShot_BCM_Value, sw-syscond=1}
            IN_VeSR1B_y_PowerShot_BCM_SigSts_Value: accessed-variable=VeSR1B_y_PowerShot_BCM_SigSts.Value, variation-point={short-label=vpIN_VeSR1B_y_PowerShot_BCM_SigSts_Value, sw-syscond=1}
            IN_VeSR1B_y_PreCondCabinSts_Value: accessed-variable=VeSR1B_y_PreCondCabinSts.Value
            IN_VeSR1B_y_PreCondCabinSts_SigSts_Value: accessed-variable=VeSR1B_y_PreCondCabinSts_SigSts.Value
            IN_VeSR1B_y_PsngrDoorSts_SigSts_Value: accessed-variable=VeSR1B_y_PsngrDoorSts_SigSts.Value
            IN_VeSR1B_y_PwrLev_Value: accessed-variable=VeSR1B_y_PwrLev.Value
            IN_VeSR1B_y_PwrLev_SigSts_Value: accessed-variable=VeSR1B_y_PwrLev_SigSts.Value
            IN_VeSR1B_y_RACE_PREP_RACE_TYPE_REQ_SigSts_Value: accessed-variable=VeSR1B_y_RACE_PREP_RACE_TYPE_REQ_SigSts.Value, variation-point={short-label=vpIN_VeSR1B_y_RACE_PREP_RACE_TYPE_REQ_SigSts_Value, sw-syscond=1}
            IN_VeSR1B_y_RHRDoorSts_SigSts_Value: accessed-variable=VeSR1B_y_RHRDoorSts_SigSts.Value
            IN_VeSR1B_y_RHatchSts_SigSts_Value: accessed-variable=VeSR1B_y_RHatchSts_SigSts.Value
            IN_VeSR1B_y_RL_HS_STAT_Value: accessed-variable=VeSR1B_y_RL_HS_STAT.Value
            IN_VeSR1B_y_RL_HS_STATFailSts_SigSts_Value: accessed-variable=VeSR1B_y_RL_HS_STATFailSts_SigSts.Value
            IN_VeSR1B_y_RL_HS_STAT_SigSts_Value: accessed-variable=VeSR1B_y_RL_HS_STAT_SigSts.Value
            IN_VeSR1B_y_RL_VS_STAT_Value: accessed-variable=VeSR1B_y_RL_VS_STAT.Value
            IN_VeSR1B_y_RL_VS_STATFailSts_SigSts_Value: accessed-variable=VeSR1B_y_RL_VS_STATFailSts_SigSts.Value
            IN_VeSR1B_y_RL_VS_STAT_SigSts_Value: accessed-variable=VeSR1B_y_RL_VS_STAT_SigSts.Value
            IN_VeSR1B_y_RR_HS_STAT_Value: accessed-variable=VeSR1B_y_RR_HS_STAT.Value
            IN_VeSR1B_y_RR_HS_STATFailSts_SigSts_Value: accessed-variable=VeSR1B_y_RR_HS_STATFailSts_SigSts.Value
            IN_VeSR1B_y_RR_HS_STAT_SigSts_Value: accessed-variable=VeSR1B_y_RR_HS_STAT_SigSts.Value
            IN_VeSR1B_y_RR_VS_STAT_Value: accessed-variable=VeSR1B_y_RR_VS_STAT.Value
            IN_VeSR1B_y_RR_VS_STATFailSts_SigSts_Value: accessed-variable=VeSR1B_y_RR_VS_STATFailSts_SigSts.Value
            IN_VeSR1B_y_RR_VS_STAT_SigSts_Value: accessed-variable=VeSR1B_y_RR_VS_STAT_SigSts.Value
            IN_VeSR1B_y_RearFogLightSts_SigSts_Value: accessed-variable=VeSR1B_y_RearFogLightSts_SigSts.Value
            IN_VeSR1B_y_RearHVACBlower_Sts_Value: accessed-variable=VeSR1B_y_RearHVACBlower_Sts.Value
            IN_VeSR1B_y_RearHVACBlower_Sts_SigSts_Value: accessed-variable=VeSR1B_y_RearHVACBlower_Sts_SigSts.Value
            IN_VeSR1B_y_RemStActvSts_R_SigSts_Value: accessed-variable=VeSR1B_y_RemStActvSts_R_SigSts.Value
            IN_VeSR1B_y_Right_Button_BCM_Value: accessed-variable=VeSR1B_y_Right_Button_BCM.Value
            IN_VeSR1B_y_Right_Button_BCM_SigSts_Value: accessed-variable=VeSR1B_y_Right_Button_BCM_SigSts.Value
            IN_VeSR1B_y_SBR1RowDrvrSeatStsFD3_Value: accessed-variable=VeSR1B_y_SBR1RowDrvrSeatStsFD3.Value
            IN_VeSR1B_y_SBR1RowDrvrSeatStsFD3_SigSts_Value: accessed-variable=VeSR1B_y_SBR1RowDrvrSeatStsFD3_SigSts.Value
            IN_VeSR1B_y_SCCActvSts_SigSts_Value: accessed-variable=VeSR1B_y_SCCActvSts_SigSts.Value
            IN_VeSR1B_y_SOC_Max_Lev_SigSts_Value: accessed-variable=VeSR1B_y_SOC_Max_Lev_SigSts.Value
            IN_VeSR1B_y_Secure_Idle_Req_SigSts_Value: accessed-variable=VeSR1B_y_Secure_Idle_Req_SigSts.Value
            IN_VeSR1B_y_ShiftLeverPositionReq_FD3_Value: accessed-variable=VeSR1B_y_ShiftLeverPositionReq_FD3.Value
            IN_VeSR1B_y_ShiftLeverPositionReq_FD3_SigSts_Value: accessed-variable=VeSR1B_y_ShiftLeverPositionReq_FD3_SigSts.Value
            IN_VeSR1B_y_ShiftLockFailSts_SigSts_Value: accessed-variable=VeSR1B_y_ShiftLockFailSts_SigSts.Value
            IN_VeSR1B_y_Speed_Unit_SigSts_Value: accessed-variable=VeSR1B_y_Speed_Unit_SigSts.Value
            IN_VeSR1B_y_StopStartClimateInfo_Value: accessed-variable=VeSR1B_y_StopStartClimateInfo.Value
            IN_VeSR1B_y_StopStartClimateInfo_SigSts_Value: accessed-variable=VeSR1B_y_StopStartClimateInfo_SigSts.Value
            IN_VeSR1B_y_Switch_2WD_Rq_SigSts_Value: accessed-variable=VeSR1B_y_Switch_2WD_Rq_SigSts.Value, variation-point={short-label=vpIN_VeSR1B_y_Switch_2WD_Rq_SigSts_Value, sw-syscond=1}
            IN_VeSR1B_y_TSRSts_Value: accessed-variable=VeSR1B_y_TSRSts.Value
            IN_VeSR1B_y_TSRSts_SigSts_Value: accessed-variable=VeSR1B_y_TSRSts_SigSts.Value
            IN_VeSR1B_y_TerrModIntrfcButnBCM_Value: accessed-variable=VeSR1B_y_TerrModIntrfcButnBCM.Value, variation-point={short-label=vpIN_VeSR1B_y_TerrModIntrfcButnBCM_Value, sw-syscond=1}
            IN_VeSR1B_y_TerrModIntrfcButnBCM_SigSts_Value: accessed-variable=VeSR1B_y_TerrModIntrfcButnBCM_SigSts.Value, variation-point={short-label=vpIN_VeSR1B_y_TerrModIntrfcButnBCM_SigSts_Value, sw-syscond=1}
            IN_VeSR1B_y_TerrainSwStat_Value: accessed-variable=VeSR1B_y_TerrainSwStat.Value
            IN_VeSR1B_y_TerrainSwStat_SigSts_Value: accessed-variable=VeSR1B_y_TerrainSwStat_SigSts.Value
            IN_VeSR1B_y_TotalOdometer_SigSts_Value: accessed-variable=VeSR1B_y_TotalOdometer_SigSts.Value
            IN_VeSR1B_y_Traffic_Sign_Info_SigSts_Value: accessed-variable=VeSR1B_y_Traffic_Sign_Info_SigSts.Value
            IN_VeSR1B_y_VoltBattFailStatus_SigSts_Value: accessed-variable=VeSR1B_y_VoltBattFailStatus_SigSts.Value
        357 x sync call, all with timeout=1E-06:
          SC_FsftAATR_U_CBC_AmbientAirVolt_FsftAATR_U_CBC_AmbientAirVolt: operation=FsftAATR_U_CBC_AmbientAirVolt.FsftAATR_U_CBC_AmbientAirVolt
          SC_FsftASLR_b_DsplydSpdLimSts_FsftASLR_b_DsplydSpdLimSts: operation=FsftASLR_b_DsplydSpdLimSts.FsftASLR_b_DsplydSpdLimSts
          SC_FsftASLR_b_TSRSts_FsftASLR_b_TSRSts: operation=FsftASLR_b_TSRSts.FsftASLR_b_TSRSts
          SC_FsftCITR_Pct_HU_ExtChrgTarget1_FsftCITR_Pct_HU_ExtChrgTarget1: operation=FsftCITR_Pct_HU_ExtChrgTarget1.FsftCITR_Pct_HU_ExtChrgTarget1
          SC_FsftCITR_Pct_HU_ExtChrgTarget2_FsftCITR_Pct_HU_ExtChrgTarget2: operation=FsftCITR_Pct_HU_ExtChrgTarget2.FsftCITR_Pct_HU_ExtChrgTarget2
          SC_FsftCITR_Pct_HU_ImmChrgTarget1_FsftCITR_Pct_HU_ImmChrgTarget1: operation=FsftCITR_Pct_HU_ImmChrgTarget1.FsftCITR_Pct_HU_ImmChrgTarget1
          SC_FsftCITR_Pct_HU_ImmChrgTarget2_FsftCITR_Pct_HU_ImmChrgTarget2: operation=FsftCITR_Pct_HU_ImmChrgTarget2.FsftCITR_Pct_HU_ImmChrgTarget2
          SC_FsftCITR_Pct_TBM_ExtChrgTarget1_FsftCITR_Pct_TBM_ExtChrgTarget1: operation=FsftCITR_Pct_TBM_ExtChrgTarget1.FsftCITR_Pct_TBM_ExtChrgTarget1
          SC_FsftCITR_Pct_TBM_ExtChrgTarget2_FsftCITR_Pct_TBM_ExtChrgTarget2: operation=FsftCITR_Pct_TBM_ExtChrgTarget2.FsftCITR_Pct_TBM_ExtChrgTarget2
          SC_FsftCITR_Pct_TBM_ImmChrgTarget1_FsftCITR_Pct_TBM_ImmChrgTarget1: operation=FsftCITR_Pct_TBM_ImmChrgTarget1.FsftCITR_Pct_TBM_ImmChrgTarget1
          SC_FsftCITR_Pct_TBM_ImmChrgTarget2_FsftCITR_Pct_TBM_ImmChrgTarget2: operation=FsftCITR_Pct_TBM_ImmChrgTarget2.FsftCITR_Pct_TBM_ImmChrgTarget2
          SC_FsftCITR_Pct_V2HRsrvBatt_FsftCITR_Pct_V2HRsrvBatt: operation=FsftCITR_Pct_V2HRsrvBatt.FsftCITR_Pct_V2HRsrvBatt
          SC_FsftCITR_Pct_V2LRsrvBatt_FsftCITR_Pct_V2LRsrvBatt: operation=FsftCITR_Pct_V2LRsrvBatt.FsftCITR_Pct_V2LRsrvBatt
          SC_FsftCITR_Pct_V2VRsrvBatt_FsftCITR_Pct_V2VRsrvBatt: operation=FsftCITR_Pct_V2VRsrvBatt.FsftCITR_Pct_V2VRsrvBatt
          SC_FsftCITR_b_CoopCh_VehLocation_FsftCITR_b_CoopCh_VehLocation: operation=FsftCITR_b_CoopCh_VehLocation.FsftCITR_b_CoopCh_VehLocation
          SC_FsftCITR_b_DC_PwrLev_FsftCITR_b_DC_PwrLev: operation=FsftCITR_b_DC_PwrLev.FsftCITR_b_DC_PwrLev, variation-point={short-label=vpSC_FsftCITR_b_DC_PwrLev_FsftCITR_b_DC_PwrLev, sw-syscond=1}
          SC_FsftCITR_b_Date_Day1_FsftCITR_b_Date_Day1: operation=FsftCITR_b_Date_Day1.FsftCITR_b_Date_Day1
          SC_FsftCITR_b_HU_Sch1_Day_FsftCITR_b_HU_Sch1_Day: operation=FsftCITR_b_HU_Sch1_Day.FsftCITR_b_HU_Sch1_Day
          SC_FsftCITR_b_HU_Sch1_End_Time_Hr_FsftCITR_b_HU_Sch1_End_Time_Hr: operation=FsftCITR_b_HU_Sch1_End_Time_Hr.FsftCITR_b_HU_Sch1_End_Time_Hr
          SC_FsftCITR_b_HU_Sch1_End_Time_Min_FsftCITR_b_HU_Sch1_End_Time_Min: operation=FsftCITR_b_HU_Sch1_End_Time_Min.FsftCITR_b_HU_Sch1_End_Time_Min
          SC_FsftCITR_b_HU_Sch1_Start_Time_Hr_FsftCITR_b_HU_Sch1_Start_Time_Hr: operation=FsftCITR_b_HU_Sch1_Start_Time_Hr.FsftCITR_b_HU_Sch1_Start_Time_Hr
          SC_FsftCITR_b_HU_Sch1_Start_Time_Min_FsftCITR_b_HU_Sch1_Start_Time_Min: operation=FsftCITR_b_HU_Sch1_Start_Time_Min.FsftCITR_b_HU_Sch1_Start_Time_Min
          SC_FsftCITR_b_HU_Sch2_Day_FsftCITR_b_HU_Sch2_Day: operation=FsftCITR_b_HU_Sch2_Day.FsftCITR_b_HU_Sch2_Day
          SC_FsftCITR_b_HU_Sch2_End_Time_Hr_FsftCITR_b_HU_Sch2_End_Time_Hr: operation=FsftCITR_b_HU_Sch2_End_Time_Hr.FsftCITR_b_HU_Sch2_End_Time_Hr
          SC_FsftCITR_b_HU_Sch2_End_Time_Min_FsftCITR_b_HU_Sch2_End_Time_Min: operation=FsftCITR_b_HU_Sch2_End_Time_Min.FsftCITR_b_HU_Sch2_End_Time_Min
          SC_FsftCITR_b_HU_Sch2_Start_Time_Hr_FsftCITR_b_HU_Sch2_Start_Time_Hr: operation=FsftCITR_b_HU_Sch2_Start_Time_Hr.FsftCITR_b_HU_Sch2_Start_Time_Hr
          SC_FsftCITR_b_HU_Sch2_Start_Time_Min_FsftCITR_b_HU_Sch2_Start_Time_Min: operation=FsftCITR_b_HU_Sch2_Start_Time_Min.FsftCITR_b_HU_Sch2_Start_Time_Min
          SC_FsftCITR_b_HU_Sch3_Allow_FsftCITR_b_HU_Sch3_Allow: operation=FsftCITR_b_HU_Sch3_Allow.FsftCITR_b_HU_Sch3_Allow
          SC_FsftCITR_b_HU_Sch3_CabTemp_FsftCITR_b_HU_Sch3_CabTemp: operation=FsftCITR_b_HU_Sch3_CabTemp.FsftCITR_b_HU_Sch3_CabTemp
          SC_FsftCITR_b_HU_Sch3_Day_FsftCITR_b_HU_Sch3_Day: operation=FsftCITR_b_HU_Sch3_Day.FsftCITR_b_HU_Sch3_Day
          SC_FsftCITR_b_HU_Sch3_Start_Time_Hr_FsftCITR_b_HU_Sch3_Start_Time_Hr: operation=FsftCITR_b_HU_Sch3_Start_Time_Hr.FsftCITR_b_HU_Sch3_Start_Time_Hr
          SC_FsftCITR_b_HU_Sch3_Start_Time_Min_FsftCITR_b_HU_Sch3_Start_Time_Min: operation=FsftCITR_b_HU_Sch3_Start_Time_Min.FsftCITR_b_HU_Sch3_Start_Time_Min
          SC_FsftCITR_b_HU_Sch4_Allow_FsftCITR_b_HU_Sch4_Allow: operation=FsftCITR_b_HU_Sch4_Allow.FsftCITR_b_HU_Sch4_Allow
          SC_FsftCITR_b_HU_Sch4_CabTemp_FsftCITR_b_HU_Sch4_CabTemp: operation=FsftCITR_b_HU_Sch4_CabTemp.FsftCITR_b_HU_Sch4_CabTemp
          SC_FsftCITR_b_HU_Sch4_Day_FsftCITR_b_HU_Sch4_Day: operation=FsftCITR_b_HU_Sch4_Day.FsftCITR_b_HU_Sch4_Day
          SC_FsftCITR_b_HU_Sch4_Start_Time_Hr_FsftCITR_b_HU_Sch4_Start_Time_Hr: operation=FsftCITR_b_HU_Sch4_Start_Time_Hr.FsftCITR_b_HU_Sch4_Start_Time_Hr
          SC_FsftCITR_b_HU_Sch4_Start_Time_Min_FsftCITR_b_HU_Sch4_Start_Time_Min: operation=FsftCITR_b_HU_Sch4_Start_Time_Min.FsftCITR_b_HU_Sch4_Start_Time_Min
          SC_FsftCITR_b_SOC_Max_Lev_FsftCITR_b_SOC_Max_Lev: operation=FsftCITR_b_SOC_Max_Lev.FsftCITR_b_SOC_Max_Lev
          SC_FsftCITR_b_TBMStopChrg_FsftCITR_b_TBMStopChrg: operation=FsftCITR_b_TBMStopChrg.FsftCITR_b_TBMStopChrg
          SC_FsftCITR_b_TBM_Sch1_Day_FsftCITR_b_TBM_Sch1_Day: operation=FsftCITR_b_TBM_Sch1_Day.FsftCITR_b_TBM_Sch1_Day
          SC_FsftCITR_b_TBM_Sch1_End_Time_Hr_FsftCITR_b_TBM_Sch1_End_Time_Hr: operation=FsftCITR_b_TBM_Sch1_End_Time_Hr.FsftCITR_b_TBM_Sch1_End_Time_Hr
          SC_FsftCITR_b_TBM_Sch1_End_Time_Min_FsftCITR_b_TBM_Sch1_End_Time_Min: operation=FsftCITR_b_TBM_Sch1_End_Time_Min.FsftCITR_b_TBM_Sch1_End_Time_Min
          SC_FsftCITR_b_TBM_Sch1_Start_Time_Hr_FsftCITR_b_TBM_Sch1_Start_Time_Hr: operation=FsftCITR_b_TBM_Sch1_Start_Time_Hr.FsftCITR_b_TBM_Sch1_Start_Time_Hr
          SC_FsftCITR_b_TBM_Sch1_Start_Time_Min_FsftCITR_b_TBM_Sch1_Start_Time_Min: operation=FsftCITR_b_TBM_Sch1_Start_Time_Min.FsftCITR_b_TBM_Sch1_Start_Time_Min
          SC_FsftCITR_b_TBM_Sch2_Day_FsftCITR_b_TBM_Sch2_Day: operation=FsftCITR_b_TBM_Sch2_Day.FsftCITR_b_TBM_Sch2_Day
          SC_FsftCITR_b_TBM_Sch2_End_Time_Hr_FsftCITR_b_TBM_Sch2_End_Time_Hr: operation=FsftCITR_b_TBM_Sch2_End_Time_Hr.FsftCITR_b_TBM_Sch2_End_Time_Hr
          SC_FsftCITR_b_TBM_Sch2_End_Time_Min_FsftCITR_b_TBM_Sch2_End_Time_Min: operation=FsftCITR_b_TBM_Sch2_End_Time_Min.FsftCITR_b_TBM_Sch2_End_Time_Min
          SC_FsftCITR_b_TBM_Sch2_Start_Time_Hr_FsftCITR_b_TBM_Sch2_Start_Time_Hr: operation=FsftCITR_b_TBM_Sch2_Start_Time_Hr.FsftCITR_b_TBM_Sch2_Start_Time_Hr
          SC_FsftCITR_b_TBM_Sch2_Start_Time_Min_FsftCITR_b_TBM_Sch2_Start_Time_Min: operation=FsftCITR_b_TBM_Sch2_Start_Time_Min.FsftCITR_b_TBM_Sch2_Start_Time_Min
          SC_FsftCITR_b_TBM_Sch3_Allow_FsftCITR_b_TBM_Sch3_Allow: operation=FsftCITR_b_TBM_Sch3_Allow.FsftCITR_b_TBM_Sch3_Allow
          SC_FsftCITR_b_TBM_Sch3_CabTemp_FsftCITR_b_TBM_Sch3_CabTemp: operation=FsftCITR_b_TBM_Sch3_CabTemp.FsftCITR_b_TBM_Sch3_CabTemp
          SC_FsftCITR_b_TBM_Sch3_Day_FsftCITR_b_TBM_Sch3_Day: operation=FsftCITR_b_TBM_Sch3_Day.FsftCITR_b_TBM_Sch3_Day
          SC_FsftCITR_b_TBM_Sch3_Start_Time_Hr_FsftCITR_b_TBM_Sch3_Start_Time_Hr: operation=FsftCITR_b_TBM_Sch3_Start_Time_Hr.FsftCITR_b_TBM_Sch3_Start_Time_Hr
          SC_FsftCITR_b_TBM_Sch3_Start_Time_Min_FsftCITR_b_TBM_Sch3_Start_Time_Min: operation=FsftCITR_b_TBM_Sch3_Start_Time_Min.FsftCITR_b_TBM_Sch3_Start_Time_Min
          SC_FsftCITR_b_TBM_Sch4_Allow_FsftCITR_b_TBM_Sch4_Allow: operation=FsftCITR_b_TBM_Sch4_Allow.FsftCITR_b_TBM_Sch4_Allow
          SC_FsftCITR_b_TBM_Sch4_CabTemp_FsftCITR_b_TBM_Sch4_CabTemp: operation=FsftCITR_b_TBM_Sch4_CabTemp.FsftCITR_b_TBM_Sch4_CabTemp
          SC_FsftCITR_b_TBM_Sch4_Day_FsftCITR_b_TBM_Sch4_Day: operation=FsftCITR_b_TBM_Sch4_Day.FsftCITR_b_TBM_Sch4_Day
          SC_FsftCITR_b_TBM_Sch4_Start_Time_Hr_FsftCITR_b_TBM_Sch4_Start_Time_Hr: operation=FsftCITR_b_TBM_Sch4_Start_Time_Hr.FsftCITR_b_TBM_Sch4_Start_Time_Hr
          SC_FsftCITR_b_TBM_Sch4_Start_Time_Min_FsftCITR_b_TBM_Sch4_Start_Time_Min: operation=FsftCITR_b_TBM_Sch4_Start_Time_Min.FsftCITR_b_TBM_Sch4_Start_Time_Min
          SC_FsftCITR_b_V2HModeReq_FsftCITR_b_V2HModeReq: operation=FsftCITR_b_V2HModeReq.FsftCITR_b_V2HModeReq
          SC_FsftCITR_b_V2HReq_FsftCITR_b_V2HReq: operation=FsftCITR_b_V2HReq.FsftCITR_b_V2HReq
          SC_FsftCITR_b_V2HSubmit_FsftCITR_b_V2HSubmit: operation=FsftCITR_b_V2HSubmit.FsftCITR_b_V2HSubmit
          SC_FsftCITR_b_V2LModeReq_FsftCITR_b_V2LModeReq: operation=FsftCITR_b_V2LModeReq.FsftCITR_b_V2LModeReq
          SC_FsftCITR_b_V2LSubmit_FsftCITR_b_V2LSubmit: operation=FsftCITR_b_V2LSubmit.FsftCITR_b_V2LSubmit
          SC_FsftCITR_b_V2LTrunkReq_FsftCITR_b_V2LTrunkReq: operation=FsftCITR_b_V2LTrunkReq.FsftCITR_b_V2LTrunkReq
          SC_FsftCITR_b_V2L_AllReq_FsftCITR_b_V2L_AllReq: operation=FsftCITR_b_V2L_AllReq.FsftCITR_b_V2L_AllReq
          SC_FsftCITR_b_V2L_FrunkReq_FsftCITR_b_V2L_FrunkReq: operation=FsftCITR_b_V2L_FrunkReq.FsftCITR_b_V2L_FrunkReq
          SC_FsftCITR_b_V2VModeReq_FsftCITR_b_V2VModeReq: operation=FsftCITR_b_V2VModeReq.FsftCITR_b_V2VModeReq
          SC_FsftCITR_b_V2VReq_FsftCITR_b_V2VReq: operation=FsftCITR_b_V2VReq.FsftCITR_b_V2VReq
          SC_FsftCITR_b_V2VSubmit_FsftCITR_b_V2VSubmit: operation=FsftCITR_b_V2VSubmit.FsftCITR_b_V2VSubmit
          SC_FsftCITR_e_CoopCh_ChrgCmd_FsftCITR_e_CoopCh_ChrgCmd: operation=FsftCITR_e_CoopCh_ChrgCmd.FsftCITR_e_CoopCh_ChrgCmd
          SC_FsftCITR_e_DoorLockLastElSts_FsftCITR_e_DoorLockLastElSts: operation=FsftCITR_e_DoorLockLastElSts.FsftCITR_e_DoorLockLastElSts
          SC_FsftCITR_e_FOTA_Install_Type_FsftCITR_e_FOTA_Install_Type: operation=FsftCITR_e_FOTA_Install_Type.FsftCITR_e_FOTA_Install_Type
          SC_FsftCITR_e_HU_ChrgSchedType1_FsftCITR_e_HU_ChrgSchedType1: operation=FsftCITR_e_HU_ChrgSchedType1.FsftCITR_e_HU_ChrgSchedType1
          SC_FsftCITR_e_HU_ChrgSchedType2_FsftCITR_e_HU_ChrgSchedType2: operation=FsftCITR_e_HU_ChrgSchedType2.FsftCITR_e_HU_ChrgSchedType2
          SC_FsftCITR_e_PowerLimitReq_FsftCITR_e_PowerLimitReq: operation=FsftCITR_e_PowerLimitReq.FsftCITR_e_PowerLimitReq
          SC_FsftCITR_e_RmtChrgPortLkCmd_FsftCITR_e_RmtChrgPortLkCmd: operation=FsftCITR_e_RmtChrgPortLkCmd.FsftCITR_e_RmtChrgPortLkCmd
          SC_FsftCITR_e_TBM_ChrgSchedType1_FsftCITR_e_TBM_ChrgSchedType1: operation=FsftCITR_e_TBM_ChrgSchedType1.FsftCITR_e_TBM_ChrgSchedType1
          SC_FsftCITR_e_TBM_ChrgSchedType2_FsftCITR_e_TBM_ChrgSchedType2: operation=FsftCITR_e_TBM_ChrgSchedType2.FsftCITR_e_TBM_ChrgSchedType2
          SC_FsftHSWR_b_CBC_BntAjrRwVlStsVolt_FsftHSWR_b_CBC_BntAjrRwVlStsVolt: operation=FsftHSWR_b_CBC_BntAjrRwVlStsVolt.FsftHSWR_b_CBC_BntAjrRwVlStsVolt
          SC_FsftHSWR_e_RedntHdSwStat_FsftHSWR_e_RedntHdSwStat: operation=FsftHSWR_e_RedntHdSwStat.FsftHSWR_e_RedntHdSwStat
          SC_FsftIDCR_Pct_IBS_BattSOC_FsftIDCR_Pct_IBS_BattSOC: operation=FsftIDCR_Pct_IBS_BattSOC.FsftIDCR_Pct_IBS_BattSOC
          SC_FsftIDCR_U_IBS_BattVolt_FsftIDCR_U_IBS_BattVolt: operation=FsftIDCR_U_IBS_BattVolt.FsftIDCR_U_IBS_BattVolt
          SC_FsftIDCR_b_IBS_BattTemp_FsftIDCR_b_IBS_BattTemp: operation=FsftIDCR_b_IBS_BattTemp.FsftIDCR_b_IBS_BattTemp
          SC_FsftIDCR_b_IBS_b_Batt_FsftIDCR_b_IBS_b_Batt: operation=FsftIDCR_b_IBS_b_Batt.FsftIDCR_b_IBS_b_Batt
          SC_FsftIDCR_b_PlugAndChargeReq_FsftIDCR_b_PlugAndChargeReq: operation=FsftIDCR_b_PlugAndChargeReq.FsftIDCR_b_PlugAndChargeReq
          SC_FsftIDCR_e_IBS_Current_Status_FsftIDCR_e_IBS_Current_Status: operation=FsftIDCR_e_IBS_Current_Status.FsftIDCR_e_IBS_Current_Status
          SC_FsftIMPR_b_ImpactToggle_C2_FsftIMPR_b_ImpactToggle_C2: operation=FsftIMPR_b_ImpactToggle_C2.FsftIMPR_b_ImpactToggle_C2
          SC_FsftIMPR_b_VehImpactDetected_C2_FsftIMPR_b_VehImpactDetected_C2: operation=FsftIMPR_b_VehImpactDetected_C2.FsftIMPR_b_VehImpactDetected_C2
          SC_FsftPLTR_b_DrvDrAjar_FsftPLTR_b_DrvDrAjar: operation=FsftPLTR_b_DrvDrAjar.FsftPLTR_b_DrvDrAjar
          SC_FsftPLTR_b_LHRDoorSts_FsftPLTR_b_LHRDoorSts: operation=FsftPLTR_b_LHRDoorSts.FsftPLTR_b_LHRDoorSts
          SC_FsftPLTR_b_ParkBrakeSts_FsftPLTR_b_ParkBrakeSts: operation=FsftPLTR_b_ParkBrakeSts.FsftPLTR_b_ParkBrakeSts
          SC_FsftPLTR_b_Prmry_AutoPosCorrMd_FsftPLTR_b_Prmry_AutoPosCorrMd: operation=FsftPLTR_b_Prmry_AutoPosCorrMd.FsftPLTR_b_Prmry_AutoPosCorrMd
          SC_FsftPLTR_b_Prmry_ShiftLockFA_FsftPLTR_b_Prmry_ShiftLockFA: operation=FsftPLTR_b_Prmry_ShiftLockFA.FsftPLTR_b_Prmry_ShiftLockFA
          SC_FsftPLTR_b_Prmry_ShiftSnsFA_FsftPLTR_b_Prmry_ShiftSnsFA: operation=FsftPLTR_b_Prmry_ShiftSnsFA.FsftPLTR_b_Prmry_ShiftSnsFA
          SC_FsftPLTR_b_Prmry_ShifterDispFA_FsftPLTR_b_Prmry_ShifterDispFA: operation=FsftPLTR_b_Prmry_ShifterDispFA.FsftPLTR_b_Prmry_ShifterDispFA
          SC_FsftPLTR_b_Prmry_TransShiftPstn_FsftPLTR_b_Prmry_TransShiftPstn: operation=FsftPLTR_b_Prmry_TransShiftPstn.FsftPLTR_b_Prmry_TransShiftPstn
          SC_FsftPLTR_b_PsngrDoorSts_FsftPLTR_b_PsngrDoorSts: operation=FsftPLTR_b_PsngrDoorSts.FsftPLTR_b_PsngrDoorSts
          SC_FsftPLTR_b_RHRDoorSts_FsftPLTR_b_RHRDoorSts: operation=FsftPLTR_b_RHRDoorSts.FsftPLTR_b_RHRDoorSts
          SC_FsftPLTR_b_RHatchSts_FsftPLTR_b_RHatchSts: operation=FsftPLTR_b_RHatchSts.FsftPLTR_b_RHatchSts
          SC_FsftPLTR_b_RmtVehStartReq_FsftPLTR_b_RmtVehStartReq: operation=FsftPLTR_b_RmtVehStartReq.FsftPLTR_b_RmtVehStartReq
          SC_FsftPLTR_b_Secure_Idle_Req_FsftPLTR_b_Secure_Idle_Req: operation=FsftPLTR_b_Secure_Idle_Req.FsftPLTR_b_Secure_Idle_Req
          SC_FsftPLTR_e_AEBSystemSts_FsftPLTR_e_AEBSystemSts: operation=FsftPLTR_e_AEBSystemSts.FsftPLTR_e_AEBSystemSts
          SC_FsftPLTR_e_Command_15Sts_FsftPLTR_e_Command_15Sts: operation=FsftPLTR_e_Command_15Sts.FsftPLTR_e_Command_15Sts
          SC_FsftPLTR_e_DriverDoorOnOffSts_FsftPLTR_e_DriverDoorOnOffSts: operation=FsftPLTR_e_DriverDoorOnOffSts.FsftPLTR_e_DriverDoorOnOffSts
          SC_FsftPLTR_e_DriverSeatBeltSts_FsftPLTR_e_DriverSeatBeltSts: operation=FsftPLTR_e_DriverSeatBeltSts.FsftPLTR_e_DriverSeatBeltSts
          SC_FsftPLTR_e_DrvrSeatSnsrSts_FsftPLTR_e_DrvrSeatSnsrSts: operation=FsftPLTR_e_DrvrSeatSnsrSts.FsftPLTR_e_DrvrSeatSnsrSts
          SC_FsftPLTR_e_HAS_TelltaleSts_FsftPLTR_e_HAS_TelltaleSts: operation=FsftPLTR_e_HAS_TelltaleSts.FsftPLTR_e_HAS_TelltaleSts
          SC_FsftPLTR_e_HiBmLvr_Stat_FsftPLTR_e_HiBmLvr_Stat: operation=FsftPLTR_e_HiBmLvr_Stat.FsftPLTR_e_HiBmLvr_Stat
          SC_FsftPLTR_e_MRM_Status_FsftPLTR_e_MRM_Status: operation=FsftPLTR_e_MRM_Status.FsftPLTR_e_MRM_Status
          SC_FsftPLTR_e_MRM_Status_C2_FsftPLTR_e_MRM_Status_C2: operation=FsftPLTR_e_MRM_Status_C2.FsftPLTR_e_MRM_Status_C2
          SC_FsftPLTR_l_Odometer_Km_FsftPLTR_l_Odometer_Km: operation=FsftPLTR_l_Odometer_Km.FsftPLTR_l_Odometer_Km
          SC_FsftPLTR_t_GPS_UTC_Second_FsftPLTR_t_GPS_UTC_Second: operation=FsftPLTR_t_GPS_UTC_Second.FsftPLTR_t_GPS_UTC_Second
          SC_FsftPLTR_tdy_GPS_Date_Day_FsftPLTR_tdy_GPS_Date_Day: operation=FsftPLTR_tdy_GPS_Date_Day.FsftPLTR_tdy_GPS_Date_Day
          SC_FsftPLTR_thr_GPS_UTC_Hour_FsftPLTR_thr_GPS_UTC_Hour: operation=FsftPLTR_thr_GPS_UTC_Hour.FsftPLTR_thr_GPS_UTC_Hour
          SC_FsftPLTR_tmn_GPS_UTC_Minute_FsftPLTR_tmn_GPS_UTC_Minute: operation=FsftPLTR_tmn_GPS_UTC_Minute.FsftPLTR_tmn_GPS_UTC_Minute
          SC_FsftPLTR_tmt_GPS_Date_Month_FsftPLTR_tmt_GPS_Date_Month: operation=FsftPLTR_tmt_GPS_Date_Month.FsftPLTR_tmt_GPS_Date_Month
          SC_FsftPLTR_tyr_GPS_Date_Year_FsftPLTR_tyr_GPS_Date_Year: operation=FsftPLTR_tyr_GPS_Date_Year.FsftPLTR_tyr_GPS_Date_Year
          SC_FsftPLTR_y_AUD_LVL_FsftPLTR_y_AUD_LVL: operation=FsftPLTR_y_AUD_LVL.FsftPLTR_y_AUD_LVL
          SC_FsftPLTR_y_FobSearchResult_FsftPLTR_y_FobSearchResult: operation=FsftPLTR_y_FobSearchResult.FsftPLTR_y_FobSearchResult
          SC_FsftPMDR_b_EngOffRq_C_FsftPMDR_b_EngOffRq_C: operation=FsftPMDR_b_EngOffRq_C.FsftPMDR_b_EngOffRq_C
          SC_FsftPMDR_e_KeyInIgn_FsftPMDR_e_KeyInIgn: operation=FsftPMDR_e_KeyInIgn.FsftPMDR_e_KeyInIgn
          SC_FsftPMDR_e_PowerModeRaw_FsftPMDR_e_PowerModeRaw: operation=FsftPMDR_e_PowerModeRaw.FsftPMDR_e_PowerModeRaw
          SC_FsftTAIR_T_FtEvapTmp_FsftTAIR_T_FtEvapTmp: operation=FsftTAIR_T_FtEvapTmp.FsftTAIR_T_FtEvapTmp
          SC_FsftTAIR_b_EBL_Stat_FsftTAIR_b_EBL_Stat: operation=FsftTAIR_b_EBL_Stat.FsftTAIR_b_EBL_Stat
          SC_FsftTAIR_b_RearCabinFanSts_FsftTAIR_b_RearCabinFanSts: operation=FsftTAIR_b_RearCabinFanSts.FsftTAIR_b_RearCabinFanSts
          SC_FsftTRIR_b_ClimateInfo_FsftTRIR_b_ClimateInfo: operation=FsftTRIR_b_ClimateInfo.FsftTRIR_b_ClimateInfo
          SC_FsftTRIR_b_HVACPrecCondSts_FsftTRIR_b_HVACPrecCondSts: operation=FsftTRIR_b_HVACPrecCondSts.FsftTRIR_b_HVACPrecCondSts
          SC_FsftTRIR_b_LoadShed_FsftTRIR_b_LoadShed: operation=FsftTRIR_b_LoadShed.FsftTRIR_b_LoadShed
          SC_FsftTRIR_b_SCCActv_FsftTRIR_b_SCCActv: operation=FsftTRIR_b_SCCActv.FsftTRIR_b_SCCActv
          SC_FsftTRIR_b_TrunkStatus_FsftTRIR_b_TrunkStatus: operation=FsftTRIR_b_TrunkStatus.FsftTRIR_b_TrunkStatus
          SC_PokeAATR_U_CBC_AmbientAirVolt_PokeAATR_U_CBC_AmbientAirVolt: operation=PokeAATR_U_CBC_AmbientAirVolt.PokeAATR_U_CBC_AmbientAirVolt
          SC_PokeASLR_b_TSR_Req_PokeASLR_b_TSR_Req: operation=PokeASLR_b_TSR_Req.PokeASLR_b_TSR_Req
          SC_PokeASLR_e_DsplydSpdLimSts_PokeASLR_e_DsplydSpdLimSts: operation=PokeASLR_e_DsplydSpdLimSts.PokeASLR_e_DsplydSpdLimSts
          SC_PokeASLR_e_TSRSts_PokeASLR_e_TSRSts: operation=PokeASLR_e_TSRSts.PokeASLR_e_TSRSts
          SC_PokeCITR_K_Date_Day1_PokeCITR_K_Date_Day1: operation=PokeCITR_K_Date_Day1.PokeCITR_K_Date_Day1
          SC_PokeCITR_K_Date_Day2_PokeCITR_K_Date_Day2: operation=PokeCITR_K_Date_Day2.PokeCITR_K_Date_Day2
          SC_PokeCITR_K_Date_Month1_PokeCITR_K_Date_Month1: operation=PokeCITR_K_Date_Month1.PokeCITR_K_Date_Month1
          SC_PokeCITR_K_Date_Month2_PokeCITR_K_Date_Month2: operation=PokeCITR_K_Date_Month2.PokeCITR_K_Date_Month2
          SC_PokeCITR_K_Date_Year{1..4}_PokeCITR_K_Date_Year{1..4}: operation=PokeCITR_K_Date_Year{1..4}.PokeCITR_K_Date_Year{1..4}
          SC_PokeCITR_K_HU_Sch1_Day_PokeCITR_K_HU_Sch1_Day: operation=PokeCITR_K_HU_Sch1_Day.PokeCITR_K_HU_Sch1_Day
          SC_PokeCITR_K_HU_Sch1_End_Time_Hr_PokeCITR_K_HU_Sch1_End_Time_Hr: operation=PokeCITR_K_HU_Sch1_End_Time_Hr.PokeCITR_K_HU_Sch1_End_Time_Hr
          SC_PokeCITR_K_HU_Sch1_End_Time_Min_PokeCITR_K_HU_Sch1_End_Time_Min: operation=PokeCITR_K_HU_Sch1_End_Time_Min.PokeCITR_K_HU_Sch1_End_Time_Min
          SC_PokeCITR_K_HU_Sch1_Start_Time_Hr_PokeCITR_K_HU_Sch1_Start_Time_Hr: operation=PokeCITR_K_HU_Sch1_Start_Time_Hr.PokeCITR_K_HU_Sch1_Start_Time_Hr
          SC_PokeCITR_K_HU_Sch1_Start_Time_Min_PokeCITR_K_HU_Sch1_Start_Time_Min: operation=PokeCITR_K_HU_Sch1_Start_Time_Min.PokeCITR_K_HU_Sch1_Start_Time_Min
          SC_PokeCITR_K_HU_Sch2_Day_PokeCITR_K_HU_Sch2_Day: operation=PokeCITR_K_HU_Sch2_Day.PokeCITR_K_HU_Sch2_Day
          SC_PokeCITR_K_HU_Sch2_End_Time_Hr_PokeCITR_K_HU_Sch2_End_Time_Hr: operation=PokeCITR_K_HU_Sch2_End_Time_Hr.PokeCITR_K_HU_Sch2_End_Time_Hr
          SC_PokeCITR_K_HU_Sch2_End_Time_Min_PokeCITR_K_HU_Sch2_End_Time_Min: operation=PokeCITR_K_HU_Sch2_End_Time_Min.PokeCITR_K_HU_Sch2_End_Time_Min
          SC_PokeCITR_K_HU_Sch2_Start_Time_Hr_PokeCITR_K_HU_Sch2_Start_Time_Hr: operation=PokeCITR_K_HU_Sch2_Start_Time_Hr.PokeCITR_K_HU_Sch2_Start_Time_Hr
          SC_PokeCITR_K_HU_Sch2_Start_Time_Min_PokeCITR_K_HU_Sch2_Start_Time_Min: operation=PokeCITR_K_HU_Sch2_Start_Time_Min.PokeCITR_K_HU_Sch2_Start_Time_Min
          SC_PokeCITR_K_HU_Sch3_Day_PokeCITR_K_HU_Sch3_Day: operation=PokeCITR_K_HU_Sch3_Day.PokeCITR_K_HU_Sch3_Day
          SC_PokeCITR_K_HU_Sch3_Start_Time_Hr_PokeCITR_K_HU_Sch3_Start_Time_Hr: operation=PokeCITR_K_HU_Sch3_Start_Time_Hr.PokeCITR_K_HU_Sch3_Start_Time_Hr
          SC_PokeCITR_K_HU_Sch3_Start_Time_Min_PokeCITR_K_HU_Sch3_Start_Time_Min: operation=PokeCITR_K_HU_Sch3_Start_Time_Min.PokeCITR_K_HU_Sch3_Start_Time_Min
          SC_PokeCITR_K_HU_Sch4_Day_PokeCITR_K_HU_Sch4_Day: operation=PokeCITR_K_HU_Sch4_Day.PokeCITR_K_HU_Sch4_Day
          SC_PokeCITR_K_HU_Sch4_Start_Time_Hr_PokeCITR_K_HU_Sch4_Start_Time_Hr: operation=PokeCITR_K_HU_Sch4_Start_Time_Hr.PokeCITR_K_HU_Sch4_Start_Time_Hr
          SC_PokeCITR_K_HU_Sch4_Start_Time_Min_PokeCITR_K_HU_Sch4_Start_Time_Min: operation=PokeCITR_K_HU_Sch4_Start_Time_Min.PokeCITR_K_HU_Sch4_Start_Time_Min
          SC_PokeCITR_K_TBM_Sch1_Day_PokeCITR_K_TBM_Sch1_Day: operation=PokeCITR_K_TBM_Sch1_Day.PokeCITR_K_TBM_Sch1_Day
          SC_PokeCITR_K_TBM_Sch1_End_Time_Hr_PokeCITR_K_TBM_Sch1_End_Time_Hr: operation=PokeCITR_K_TBM_Sch1_End_Time_Hr.PokeCITR_K_TBM_Sch1_End_Time_Hr
          SC_PokeCITR_K_TBM_Sch1_End_Time_Min_PokeCITR_K_TBM_Sch1_End_Time_Min: operation=PokeCITR_K_TBM_Sch1_End_Time_Min.PokeCITR_K_TBM_Sch1_End_Time_Min
          SC_PokeCITR_K_TBM_Sch1_Start_Time_Hr_PokeCITR_K_TBM_Sch1_Start_Time_Hr: operation=PokeCITR_K_TBM_Sch1_Start_Time_Hr.PokeCITR_K_TBM_Sch1_Start_Time_Hr
          SC_PokeCITR_K_TBM_Sch1_Start_Time_Min_PokeCITR_K_TBM_Sch1_Start_Time_Min: operation=PokeCITR_K_TBM_Sch1_Start_Time_Min.PokeCITR_K_TBM_Sch1_Start_Time_Min
          SC_PokeCITR_K_TBM_Sch2_Day_PokeCITR_K_TBM_Sch2_Day: operation=PokeCITR_K_TBM_Sch2_Day.PokeCITR_K_TBM_Sch2_Day
          SC_PokeCITR_K_TBM_Sch2_End_Time_Hr_PokeCITR_K_TBM_Sch2_End_Time_Hr: operation=PokeCITR_K_TBM_Sch2_End_Time_Hr.PokeCITR_K_TBM_Sch2_End_Time_Hr
          SC_PokeCITR_K_TBM_Sch2_End_Time_Min_PokeCITR_K_TBM_Sch2_End_Time_Min: operation=PokeCITR_K_TBM_Sch2_End_Time_Min.PokeCITR_K_TBM_Sch2_End_Time_Min
          SC_PokeCITR_K_TBM_Sch2_Start_Time_Hr_PokeCITR_K_TBM_Sch2_Start_Time_Hr: operation=PokeCITR_K_TBM_Sch2_Start_Time_Hr.PokeCITR_K_TBM_Sch2_Start_Time_Hr
          SC_PokeCITR_K_TBM_Sch2_Start_Time_Min_PokeCITR_K_TBM_Sch2_Start_Time_Min: operation=PokeCITR_K_TBM_Sch2_Start_Time_Min.PokeCITR_K_TBM_Sch2_Start_Time_Min
          SC_PokeCITR_K_TBM_Sch3_Day_PokeCITR_K_TBM_Sch3_Day: operation=PokeCITR_K_TBM_Sch3_Day.PokeCITR_K_TBM_Sch3_Day
          SC_PokeCITR_K_TBM_Sch3_Start_Time_Hr_PokeCITR_K_TBM_Sch3_Start_Time_Hr: operation=PokeCITR_K_TBM_Sch3_Start_Time_Hr.PokeCITR_K_TBM_Sch3_Start_Time_Hr
          SC_PokeCITR_K_TBM_Sch3_Start_Time_Min_PokeCITR_K_TBM_Sch3_Start_Time_Min: operation=PokeCITR_K_TBM_Sch3_Start_Time_Min.PokeCITR_K_TBM_Sch3_Start_Time_Min
          SC_PokeCITR_K_TBM_Sch4_Day_PokeCITR_K_TBM_Sch4_Day: operation=PokeCITR_K_TBM_Sch4_Day.PokeCITR_K_TBM_Sch4_Day
          SC_PokeCITR_K_TBM_Sch4_Start_Time_Hr_PokeCITR_K_TBM_Sch4_Start_Time_Hr: operation=PokeCITR_K_TBM_Sch4_Start_Time_Hr.PokeCITR_K_TBM_Sch4_Start_Time_Hr
          SC_PokeCITR_K_TBM_Sch4_Start_Time_Min_PokeCITR_K_TBM_Sch4_Start_Time_Min: operation=PokeCITR_K_TBM_Sch4_Start_Time_Min.PokeCITR_K_TBM_Sch4_Start_Time_Min
          SC_PokeCITR_K_Time_Hour1_PokeCITR_K_Time_Hour1: operation=PokeCITR_K_Time_Hour1.PokeCITR_K_Time_Hour1
          SC_PokeCITR_K_Time_Hour2_PokeCITR_K_Time_Hour2: operation=PokeCITR_K_Time_Hour2.PokeCITR_K_Time_Hour2
          SC_PokeCITR_K_Time_Minute1_PokeCITR_K_Time_Minute1: operation=PokeCITR_K_Time_Minute1.PokeCITR_K_Time_Minute1
          SC_PokeCITR_K_Time_Minute2_PokeCITR_K_Time_Minute2: operation=PokeCITR_K_Time_Minute2.PokeCITR_K_Time_Minute2
          SC_PokeCITR_Pct_HU_ExtChrgTarget1_PokeCITR_Pct_HU_ExtChrgTarget1: operation=PokeCITR_Pct_HU_ExtChrgTarget1.PokeCITR_Pct_HU_ExtChrgTarget1
          SC_PokeCITR_Pct_HU_ExtChrgTarget2_PokeCITR_Pct_HU_ExtChrgTarget2: operation=PokeCITR_Pct_HU_ExtChrgTarget2.PokeCITR_Pct_HU_ExtChrgTarget2
          SC_PokeCITR_Pct_HU_ImmChrgTarget1_PokeCITR_Pct_HU_ImmChrgTarget1: operation=PokeCITR_Pct_HU_ImmChrgTarget1.PokeCITR_Pct_HU_ImmChrgTarget1
          SC_PokeCITR_Pct_HU_ImmChrgTarget2_PokeCITR_Pct_HU_ImmChrgTarget2: operation=PokeCITR_Pct_HU_ImmChrgTarget2.PokeCITR_Pct_HU_ImmChrgTarget2
          SC_PokeCITR_Pct_TBM_ExtChrgTarget1_PokeCITR_Pct_TBM_ExtChrgTarget1: operation=PokeCITR_Pct_TBM_ExtChrgTarget1.PokeCITR_Pct_TBM_ExtChrgTarget1
          SC_PokeCITR_Pct_TBM_ExtChrgTarget2_PokeCITR_Pct_TBM_ExtChrgTarget2: operation=PokeCITR_Pct_TBM_ExtChrgTarget2.PokeCITR_Pct_TBM_ExtChrgTarget2
          SC_PokeCITR_Pct_TBM_ImmChrgTarget1_PokeCITR_Pct_TBM_ImmChrgTarget1: operation=PokeCITR_Pct_TBM_ImmChrgTarget1.PokeCITR_Pct_TBM_ImmChrgTarget1
          SC_PokeCITR_Pct_TBM_ImmChrgTarget2_PokeCITR_Pct_TBM_ImmChrgTarget2: operation=PokeCITR_Pct_TBM_ImmChrgTarget2.PokeCITR_Pct_TBM_ImmChrgTarget2
          SC_PokeCITR_Pct_V2HRsrvBatt_PokeCITR_Pct_V2HRsrvBatt: operation=PokeCITR_Pct_V2HRsrvBatt.PokeCITR_Pct_V2HRsrvBatt
          SC_PokeCITR_Pct_V2LRsrvBatt_PokeCITR_Pct_V2LRsrvBatt: operation=PokeCITR_Pct_V2LRsrvBatt.PokeCITR_Pct_V2LRsrvBatt
          SC_PokeCITR_Pct_V2VRsrvBatt_PokeCITR_Pct_V2VRsrvBatt: operation=PokeCITR_Pct_V2VRsrvBatt.PokeCITR_Pct_V2VRsrvBatt
          SC_PokeCITR_T_HU_Sch3_CabTemp_PokeCITR_T_HU_Sch3_CabTemp: operation=PokeCITR_T_HU_Sch3_CabTemp.PokeCITR_T_HU_Sch3_CabTemp
          SC_PokeCITR_T_HU_Sch4_CabTemp_PokeCITR_T_HU_Sch4_CabTemp: operation=PokeCITR_T_HU_Sch4_CabTemp.PokeCITR_T_HU_Sch4_CabTemp
          SC_PokeCITR_T_TBM_Sch3_CabTemp_PokeCITR_T_TBM_Sch3_CabTemp: operation=PokeCITR_T_TBM_Sch3_CabTemp.PokeCITR_T_TBM_Sch3_CabTemp
          SC_PokeCITR_T_TBM_Sch4_CabTemp_PokeCITR_T_TBM_Sch4_CabTemp: operation=PokeCITR_T_TBM_Sch4_CabTemp.PokeCITR_T_TBM_Sch4_CabTemp
          SC_PokeCITR_b_ChargeNow_PokeCITR_b_ChargeNow: operation=PokeCITR_b_ChargeNow.PokeCITR_b_ChargeNow
          SC_PokeCITR_b_CoopCh_VehLocation_PokeCITR_b_CoopCh_VehLocation: operation=PokeCITR_b_CoopCh_VehLocation.PokeCITR_b_CoopCh_VehLocation
          SC_PokeCITR_b_DC_PwrLev_PokeCITR_b_DC_PwrLev: operation=PokeCITR_b_DC_PwrLev.PokeCITR_b_DC_PwrLev, variation-point={short-label=vpSC_PokeCITR_b_DC_PwrLev_PokeCITR_b_DC_PwrLev, sw-syscond=1}
          SC_PokeCITR_b_Drv_Dr_Unlocking_PokeCITR_b_Drv_Dr_Unlocking: operation=PokeCITR_b_Drv_Dr_Unlocking.PokeCITR_b_Drv_Dr_Unlocking
          SC_PokeCITR_b_HU_Sch1_ChargeUntilFull_PokeCITR_b_HU_Sch1_ChargeUntilFull: operation=PokeCITR_b_HU_Sch1_ChargeUntilFull.PokeCITR_b_HU_Sch1_ChargeUntilFull
          SC_PokeCITR_b_HU_Sch1_Enbl_PokeCITR_b_HU_Sch1_Enbl: operation=PokeCITR_b_HU_Sch1_Enbl.PokeCITR_b_HU_Sch1_Enbl
          SC_PokeCITR_b_HU_Sch1_Submit_PokeCITR_b_HU_Sch1_Submit: operation=PokeCITR_b_HU_Sch1_Submit.PokeCITR_b_HU_Sch1_Submit
          SC_PokeCITR_b_HU_Sch2_ChargeUntilFull_PokeCITR_b_HU_Sch2_ChargeUntilFull: operation=PokeCITR_b_HU_Sch2_ChargeUntilFull.PokeCITR_b_HU_Sch2_ChargeUntilFull
          SC_PokeCITR_b_HU_Sch2_Enbl_PokeCITR_b_HU_Sch2_Enbl: operation=PokeCITR_b_HU_Sch2_Enbl.PokeCITR_b_HU_Sch2_Enbl
          SC_PokeCITR_b_HU_Sch2_Submit_PokeCITR_b_HU_Sch2_Submit: operation=PokeCITR_b_HU_Sch2_Submit.PokeCITR_b_HU_Sch2_Submit
          SC_PokeCITR_b_HU_Sch3_Enbl_PokeCITR_b_HU_Sch3_Enbl: operation=PokeCITR_b_HU_Sch3_Enbl.PokeCITR_b_HU_Sch3_Enbl
          SC_PokeCITR_b_HU_Sch3_Submit_PokeCITR_b_HU_Sch3_Submit: operation=PokeCITR_b_HU_Sch3_Submit.PokeCITR_b_HU_Sch3_Submit
          SC_PokeCITR_b_HU_Sch4_Enbl_PokeCITR_b_HU_Sch4_Enbl: operation=PokeCITR_b_HU_Sch4_Enbl.PokeCITR_b_HU_Sch4_Enbl
          SC_PokeCITR_b_HU_Sch4_Submit_PokeCITR_b_HU_Sch4_Submit: operation=PokeCITR_b_HU_Sch4_Submit.PokeCITR_b_HU_Sch4_Submit
          SC_PokeCITR_b_SOC_Max_Lev_PokeCITR_b_SOC_Max_Lev: operation=PokeCITR_b_SOC_Max_Lev.PokeCITR_b_SOC_Max_Lev
          SC_PokeCITR_b_TBMStopChrg_PokeCITR_b_TBMStopChrg: operation=PokeCITR_b_TBMStopChrg.PokeCITR_b_TBMStopChrg
          SC_PokeCITR_b_TBM_Charge_Now_PokeCITR_b_TBM_Charge_Now: operation=PokeCITR_b_TBM_Charge_Now.PokeCITR_b_TBM_Charge_Now
          SC_PokeCITR_b_TBM_Sch1_ChargeUntilFull_PokeCITR_b_TBM_Sch1_ChargeUntilFull: operation=PokeCITR_b_TBM_Sch1_ChargeUntilFull.PokeCITR_b_TBM_Sch1_ChargeUntilFull
          SC_PokeCITR_b_TBM_Sch1_Enbl_PokeCITR_b_TBM_Sch1_Enbl: operation=PokeCITR_b_TBM_Sch1_Enbl.PokeCITR_b_TBM_Sch1_Enbl
          SC_PokeCITR_b_TBM_Sch1_Submit_PokeCITR_b_TBM_Sch1_Submit: operation=PokeCITR_b_TBM_Sch1_Submit.PokeCITR_b_TBM_Sch1_Submit
          SC_PokeCITR_b_TBM_Sch2_ChargeUntilFull_PokeCITR_b_TBM_Sch2_ChargeUntilFull: operation=PokeCITR_b_TBM_Sch2_ChargeUntilFull.PokeCITR_b_TBM_Sch2_ChargeUntilFull
          SC_PokeCITR_b_TBM_Sch2_Enbl_PokeCITR_b_TBM_Sch2_Enbl: operation=PokeCITR_b_TBM_Sch2_Enbl.PokeCITR_b_TBM_Sch2_Enbl
          SC_PokeCITR_b_TBM_Sch2_Submit_PokeCITR_b_TBM_Sch2_Submit: operation=PokeCITR_b_TBM_Sch2_Submit.PokeCITR_b_TBM_Sch2_Submit
          SC_PokeCITR_b_TBM_Sch3_Enbl_PokeCITR_b_TBM_Sch3_Enbl: operation=PokeCITR_b_TBM_Sch3_Enbl.PokeCITR_b_TBM_Sch3_Enbl
          SC_PokeCITR_b_TBM_Sch3_Submit_PokeCITR_b_TBM_Sch3_Submit: operation=PokeCITR_b_TBM_Sch3_Submit.PokeCITR_b_TBM_Sch3_Submit
          SC_PokeCITR_b_TBM_Sch4_Enbl_PokeCITR_b_TBM_Sch4_Enbl: operation=PokeCITR_b_TBM_Sch4_Enbl.PokeCITR_b_TBM_Sch4_Enbl
          SC_PokeCITR_b_TBM_Sch4_Submit_PokeCITR_b_TBM_Sch4_Submit: operation=PokeCITR_b_TBM_Sch4_Submit.PokeCITR_b_TBM_Sch4_Submit
          SC_PokeCITR_b_V2HModeReq_PokeCITR_b_V2HModeReq: operation=PokeCITR_b_V2HModeReq.PokeCITR_b_V2HModeReq
          SC_PokeCITR_b_V2HReq_PokeCITR_b_V2HReq: operation=PokeCITR_b_V2HReq.PokeCITR_b_V2HReq
          SC_PokeCITR_b_V2HSubmit_PokeCITR_b_V2HSubmit: operation=PokeCITR_b_V2HSubmit.PokeCITR_b_V2HSubmit
          SC_PokeCITR_b_V2LModeReq_PokeCITR_b_V2LModeReq: operation=PokeCITR_b_V2LModeReq.PokeCITR_b_V2LModeReq
          SC_PokeCITR_b_V2LSubmit_PokeCITR_b_V2LSubmit: operation=PokeCITR_b_V2LSubmit.PokeCITR_b_V2LSubmit
          SC_PokeCITR_b_V2LTrunkReq_PokeCITR_b_V2LTrunkReq: operation=PokeCITR_b_V2LTrunkReq.PokeCITR_b_V2LTrunkReq
          SC_PokeCITR_b_V2L_AllReq_PokeCITR_b_V2L_AllReq: operation=PokeCITR_b_V2L_AllReq.PokeCITR_b_V2L_AllReq
          SC_PokeCITR_b_V2L_FrunkReq_PokeCITR_b_V2L_FrunkReq: operation=PokeCITR_b_V2L_FrunkReq.PokeCITR_b_V2L_FrunkReq
          SC_PokeCITR_b_V2VModeReq_PokeCITR_b_V2VModeReq: operation=PokeCITR_b_V2VModeReq.PokeCITR_b_V2VModeReq
          SC_PokeCITR_b_V2VReq_PokeCITR_b_V2VReq: operation=PokeCITR_b_V2VReq.PokeCITR_b_V2VReq
          SC_PokeCITR_b_V2VSubmit_PokeCITR_b_V2VSubmit: operation=PokeCITR_b_V2VSubmit.PokeCITR_b_V2VSubmit
          SC_PokeCITR_e_CoopCh_ChrgCmd_PokeCITR_e_CoopCh_ChrgCmd: operation=PokeCITR_e_CoopCh_ChrgCmd.PokeCITR_e_CoopCh_ChrgCmd
          SC_PokeCITR_e_DoorLockLastElSts_PokeCITR_e_DoorLockLastElSts: operation=PokeCITR_e_DoorLockLastElSts.PokeCITR_e_DoorLockLastElSts
          SC_PokeCITR_e_FOTA_Install_Type_PokeCITR_e_FOTA_Install_Type: operation=PokeCITR_e_FOTA_Install_Type.PokeCITR_e_FOTA_Install_Type
          SC_PokeCITR_e_FOTA_Installation_Status_PokeCITR_e_FOTA_Installation_Status: operation=PokeCITR_e_FOTA_Installation_Status.PokeCITR_e_FOTA_Installation_Status
          SC_PokeCITR_e_HU_ChrgSchedType1_PokeCITR_e_HU_ChrgSchedType1: operation=PokeCITR_e_HU_ChrgSchedType1.PokeCITR_e_HU_ChrgSchedType1
          SC_PokeCITR_e_HU_ChrgSchedType2_PokeCITR_e_HU_ChrgSchedType2: operation=PokeCITR_e_HU_ChrgSchedType2.PokeCITR_e_HU_ChrgSchedType2
          SC_PokeCITR_e_HU_Sch3_Allow_PokeCITR_e_HU_Sch3_Allow: operation=PokeCITR_e_HU_Sch3_Allow.PokeCITR_e_HU_Sch3_Allow
          SC_PokeCITR_e_HU_Sch4_Allow_PokeCITR_e_HU_Sch4_Allow: operation=PokeCITR_e_HU_Sch4_Allow.PokeCITR_e_HU_Sch4_Allow
          SC_PokeCITR_e_PowerLimit_Req_PokeCITR_e_PowerLimit_Req: operation=PokeCITR_e_PowerLimit_Req.PokeCITR_e_PowerLimit_Req
          SC_PokeCITR_e_RmtChrgPortLkCmd_PokeCITR_e_RmtChrgPortLkCmd: operation=PokeCITR_e_RmtChrgPortLkCmd.PokeCITR_e_RmtChrgPortLkCmd
          SC_PokeCITR_e_TBM_ChrgSchedType1_PokeCITR_e_TBM_ChrgSchedType1: operation=PokeCITR_e_TBM_ChrgSchedType1.PokeCITR_e_TBM_ChrgSchedType1
          SC_PokeCITR_e_TBM_ChrgSchedType2_PokeCITR_e_TBM_ChrgSchedType2: operation=PokeCITR_e_TBM_ChrgSchedType2.PokeCITR_e_TBM_ChrgSchedType2
          SC_PokeCITR_e_TBM_Sch3_Allow_PokeCITR_e_TBM_Sch3_Allow: operation=PokeCITR_e_TBM_Sch3_Allow.PokeCITR_e_TBM_Sch3_Allow
          SC_PokeCITR_e_TBM_Sch4_Allow_PokeCITR_e_TBM_Sch4_Allow: operation=PokeCITR_e_TBM_Sch4_Allow.PokeCITR_e_TBM_Sch4_Allow
          SC_PokeDMIR_e_CreepSts_PokeDMIR_e_CreepSts: operation=PokeDMIR_e_CreepSts.PokeDMIR_e_CreepSts, variation-point={short-label=vpSC_PokeDMIR_e_CreepSts_PokeDMIR_e_CreepSts, sw-syscond=1}
          SC_PokeDMIR_e_ECoastingReq_PokeDMIR_e_ECoastingReq: operation=PokeDMIR_e_ECoastingReq.PokeDMIR_e_ECoastingReq
          SC_PokeDMIR_e_PaddleModeReq_PokeDMIR_e_PaddleModeReq: operation=PokeDMIR_e_PaddleModeReq.PokeDMIR_e_PaddleModeReq
          SC_PokeDMIR_e_PowershotSts_PokeDMIR_e_PowershotSts: operation=PokeDMIR_e_PowershotSts.PokeDMIR_e_PowershotSts, variation-point={short-label=vpSC_PokeDMIR_e_PowershotSts_PokeDMIR_e_PowershotSts, sw-syscond=1}
          SC_PokeHSWR_U_CBC_BntAjrRwVlStsVolt_PokeHSWR_U_CBC_BntAjrRwVlStsVolt: operation=PokeHSWR_U_CBC_BntAjrRwVlStsVolt.PokeHSWR_U_CBC_BntAjrRwVlStsVolt
          SC_PokeHSWR_e_RedntHdSwStat_PokeHSWR_e_RedntHdSwStat: operation=PokeHSWR_e_RedntHdSwStat.PokeHSWR_e_RedntHdSwStat
          SC_PokeIDCR_I_IBS_I_Batt_PokeIDCR_I_IBS_I_Batt: operation=PokeIDCR_I_IBS_I_Batt.PokeIDCR_I_IBS_I_Batt
          SC_PokeIDCR_Pct_IBS_BattSOC_PokeIDCR_Pct_IBS_BattSOC: operation=PokeIDCR_Pct_IBS_BattSOC.PokeIDCR_Pct_IBS_BattSOC
          SC_PokeIDCR_U_IBS_BattVolt_PokeIDCR_U_IBS_BattVolt: operation=PokeIDCR_U_IBS_BattVolt.PokeIDCR_U_IBS_BattVolt
          SC_PokeIDCR_b_PlugAndChargeReq_PokeIDCR_b_PlugAndChargeReq: operation=PokeIDCR_b_PlugAndChargeReq.PokeIDCR_b_PlugAndChargeReq
          SC_PokeIDCR_e_IBS_BattSocAcc_PokeIDCR_e_IBS_BattSocAcc: operation=PokeIDCR_e_IBS_BattSocAcc.PokeIDCR_e_IBS_BattSocAcc
          SC_PokeIDCR_e_IBS_BattTempSts_PokeIDCR_e_IBS_BattTempSts: operation=PokeIDCR_e_IBS_BattTempSts.PokeIDCR_e_IBS_BattTempSts
          SC_PokeIDCR_e_IBS_BattVoltSts_PokeIDCR_e_IBS_BattVoltSts: operation=PokeIDCR_e_IBS_BattVoltSts.PokeIDCR_e_IBS_BattVoltSts
          SC_PokeIDCR_e_IBS_Current_Status_PokeIDCR_e_IBS_Current_Status: operation=PokeIDCR_e_IBS_Current_Status.PokeIDCR_e_IBS_Current_Status
          SC_PokeIDCR_t_IBS_BattTemp_PokeIDCR_t_IBS_BattTemp: operation=PokeIDCR_t_IBS_BattTemp.PokeIDCR_t_IBS_BattTemp
          SC_PokeIMPR_b_ImpactToggle_C2_PokeIMPR_b_ImpactToggle_C2: operation=PokeIMPR_b_ImpactToggle_C2.PokeIMPR_b_ImpactToggle_C2
          SC_PokeIMPR_b_VehImpactDetected_C2_PokeIMPR_b_VehImpactDetected_C2: operation=PokeIMPR_b_VehImpactDetected_C2.PokeIMPR_b_VehImpactDetected_C2
          SC_PokePLTR_b_DriverSeatBeltSts_PokePLTR_b_DriverSeatBeltSts: operation=PokePLTR_b_DriverSeatBeltSts.PokePLTR_b_DriverSeatBeltSts
          SC_PokePLTR_b_DrvDrAjar_PokePLTR_b_DrvDrAjar: operation=PokePLTR_b_DrvDrAjar.PokePLTR_b_DrvDrAjar
          SC_PokePLTR_b_DrvrSeatSnsrFailSts_PokePLTR_b_DrvrSeatSnsrFailSts: operation=PokePLTR_b_DrvrSeatSnsrFailSts.PokePLTR_b_DrvrSeatSnsrFailSts
          SC_PokePLTR_b_InternalLightSts_PokePLTR_b_InternalLightSts: operation=PokePLTR_b_InternalLightSts.PokePLTR_b_InternalLightSts
          SC_PokePLTR_b_LHRDoorSts_PokePLTR_b_LHRDoorSts: operation=PokePLTR_b_LHRDoorSts.PokePLTR_b_LHRDoorSts
          SC_PokePLTR_b_ParkBrakeSts_PokePLTR_b_ParkBrakeSts: operation=PokePLTR_b_ParkBrakeSts.PokePLTR_b_ParkBrakeSts
          SC_PokePLTR_b_Prmry_ShiftLockFA_PokePLTR_b_Prmry_ShiftLockFA: operation=PokePLTR_b_Prmry_ShiftLockFA.PokePLTR_b_Prmry_ShiftLockFA
          SC_PokePLTR_b_Prmry_ShiftSnsFA_PokePLTR_b_Prmry_ShiftSnsFA: operation=PokePLTR_b_Prmry_ShiftSnsFA.PokePLTR_b_Prmry_ShiftSnsFA
          SC_PokePLTR_b_Prmry_ShifterDispFA_PokePLTR_b_Prmry_ShifterDispFA: operation=PokePLTR_b_Prmry_ShifterDispFA.PokePLTR_b_Prmry_ShifterDispFA
          SC_PokePLTR_b_PsngrDoorSts_PokePLTR_b_PsngrDoorSts: operation=PokePLTR_b_PsngrDoorSts.PokePLTR_b_PsngrDoorSts
          SC_PokePLTR_b_RHRDoorSts_PokePLTR_b_RHRDoorSts: operation=PokePLTR_b_RHRDoorSts.PokePLTR_b_RHRDoorSts
          SC_PokePLTR_b_RHatchSts_PokePLTR_b_RHatchSts: operation=PokePLTR_b_RHatchSts.PokePLTR_b_RHatchSts
          SC_PokePLTR_b_RearFogLightSts_PokePLTR_b_RearFogLightSts: operation=PokePLTR_b_RearFogLightSts.PokePLTR_b_RearFogLightSts
          SC_PokePLTR_b_RmtVehStartReq_PokePLTR_b_RmtVehStartReq: operation=PokePLTR_b_RmtVehStartReq.PokePLTR_b_RmtVehStartReq
          SC_PokePLTR_b_Secure_Idle_Req_PokePLTR_b_Secure_Idle_Req: operation=PokePLTR_b_Secure_Idle_Req.PokePLTR_b_Secure_Idle_Req
          SC_PokePLTR_b_SpeedUnit_PokePLTR_b_SpeedUnit: operation=PokePLTR_b_SpeedUnit.PokePLTR_b_SpeedUnit
          SC_PokePLTR_e_AEBSystemSts_PokePLTR_e_AEBSystemSts: operation=PokePLTR_e_AEBSystemSts.PokePLTR_e_AEBSystemSts
          SC_PokePLTR_e_Command_15Sts_PokePLTR_e_Command_15Sts: operation=PokePLTR_e_Command_15Sts.PokePLTR_e_Command_15Sts
          SC_PokePLTR_e_DriverDoorOnOffSts_PokePLTR_e_DriverDoorOnOffSts: operation=PokePLTR_e_DriverDoorOnOffSts.PokePLTR_e_DriverDoorOnOffSts
          SC_PokePLTR_e_DrvrSeatSnsrSts_PokePLTR_e_DrvrSeatSnsrSts: operation=PokePLTR_e_DrvrSeatSnsrSts.PokePLTR_e_DrvrSeatSnsrSts
          SC_PokePLTR_e_HAS_TelltaleSts_PokePLTR_e_HAS_TelltaleSts: operation=PokePLTR_e_HAS_TelltaleSts.PokePLTR_e_HAS_TelltaleSts
          SC_PokePLTR_e_HiBmLvr_Stat_PokePLTR_e_HiBmLvr_Stat: operation=PokePLTR_e_HiBmLvr_Stat.PokePLTR_e_HiBmLvr_Stat
          SC_PokePLTR_e_MRM_Status_PokePLTR_e_MRM_Status: operation=PokePLTR_e_MRM_Status.PokePLTR_e_MRM_Status
          SC_PokePLTR_e_MRM_Status_C2_PokePLTR_e_MRM_Status_C2: operation=PokePLTR_e_MRM_Status_C2.PokePLTR_e_MRM_Status_C2
          SC_PokePLTR_e_Prmry_AutoPosCorrMd_PokePLTR_e_Prmry_AutoPosCorrMd: operation=PokePLTR_e_Prmry_AutoPosCorrMd.PokePLTR_e_Prmry_AutoPosCorrMd
          SC_PokePLTR_e_Prmry_TransShiftPstn_PokePLTR_e_Prmry_TransShiftPstn: operation=PokePLTR_e_Prmry_TransShiftPstn.PokePLTR_e_Prmry_TransShiftPstn
          SC_PokePLTR_e_ShipingMode_PokePLTR_e_ShipingMode: operation=PokePLTR_e_ShipingMode.PokePLTR_e_ShipingMode
          SC_PokePLTR_l_Odometer_Km_PokePLTR_l_Odometer_Km: operation=PokePLTR_l_Odometer_Km.PokePLTR_l_Odometer_Km
          SC_PokePLTR_t_GPS_UTC_Second_PokePLTR_t_GPS_UTC_Second: operation=PokePLTR_t_GPS_UTC_Second.PokePLTR_t_GPS_UTC_Second
          SC_PokePLTR_tdy_GPS_Date_Day_PokePLTR_tdy_GPS_Date_Day: operation=PokePLTR_tdy_GPS_Date_Day.PokePLTR_tdy_GPS_Date_Day
          SC_PokePLTR_thr_GPS_UTC_Hour_PokePLTR_thr_GPS_UTC_Hour: operation=PokePLTR_thr_GPS_UTC_Hour.PokePLTR_thr_GPS_UTC_Hour
          SC_PokePLTR_tmn_GPS_UTC_Minute_PokePLTR_tmn_GPS_UTC_Minute: operation=PokePLTR_tmn_GPS_UTC_Minute.PokePLTR_tmn_GPS_UTC_Minute
          SC_PokePLTR_tmt_GPS_Date_Month_PokePLTR_tmt_GPS_Date_Month: operation=PokePLTR_tmt_GPS_Date_Month.PokePLTR_tmt_GPS_Date_Month
          SC_PokePLTR_tyr_GPS_Date_Year_PokePLTR_tyr_GPS_Date_Year: operation=PokePLTR_tyr_GPS_Date_Year.PokePLTR_tyr_GPS_Date_Year
          SC_PokePLTR_y_AUD_LVL_PokePLTR_y_AUD_LVL: operation=PokePLTR_y_AUD_LVL.PokePLTR_y_AUD_LVL
          SC_PokePLTR_y_FobSearchResult_PokePLTR_y_FobSearchResult: operation=PokePLTR_y_FobSearchResult.PokePLTR_y_FobSearchResult
          SC_PokePMDR_b_EngOffRq_C_PokePMDR_b_EngOffRq_C: operation=PokePMDR_b_EngOffRq_C.PokePMDR_b_EngOffRq_C
          SC_PokePMDR_e_KeyInIgn_PokePMDR_e_KeyInIgn: operation=PokePMDR_e_KeyInIgn.PokePMDR_e_KeyInIgn
          SC_PokePMDR_e_PowerModeRaw_PokePMDR_e_PowerModeRaw: operation=PokePMDR_e_PowerModeRaw.PokePMDR_e_PowerModeRaw
          SC_PokeTAIR_T_FtEvapTmp_PokeTAIR_T_FtEvapTmp: operation=PokeTAIR_T_FtEvapTmp.PokeTAIR_T_FtEvapTmp
          SC_PokeTAIR_b_ACCompReq_PokeTAIR_b_ACCompReq: operation=PokeTAIR_b_ACCompReq.PokeTAIR_b_ACCompReq
          SC_PokeTAIR_e_RearDefrostSts_PokeTAIR_e_RearDefrostSts: operation=PokeTAIR_e_RearDefrostSts.PokeTAIR_e_RearDefrostSts
          SC_PokeTAIR_y_RearCabinFanSts_PokeTAIR_y_RearCabinFanSts: operation=PokeTAIR_y_RearCabinFanSts.PokeTAIR_y_RearCabinFanSts
          SC_PokeTIMR_e_CustomInterfaceBtn_PokeTIMR_e_CustomInterfaceBtn: operation=PokeTIMR_e_CustomInterfaceBtn.PokeTIMR_e_CustomInterfaceBtn, variation-point={short-label=vpSC_PokeTIMR_e_CustomInterfaceBtn_PokeTIMR_e_CustomInterfaceBtn, sw-syscond=1}
          SC_PokeTIMR_e_GlobalDrvMdReq_PokeTIMR_e_GlobalDrvMdReq: operation=PokeTIMR_e_GlobalDrvMdReq.PokeTIMR_e_GlobalDrvMdReq
          SC_PokeTIMR_e_GlobalDrvMdRq_BCM_PokeTIMR_e_GlobalDrvMdRq_BCM: operation=PokeTIMR_e_GlobalDrvMdRq_BCM.PokeTIMR_e_GlobalDrvMdRq_BCM
          SC_PokeTIMR_e_LaunchIntensity_PokeTIMR_e_LaunchIntensity: operation=PokeTIMR_e_LaunchIntensity.PokeTIMR_e_LaunchIntensity, variation-point={short-label=vpSC_PokeTIMR_e_LaunchIntensity_PokeTIMR_e_LaunchIntensity, sw-syscond=1}
          SC_PokeTIMR_e_LaunchModeSwitch_PokeTIMR_e_LaunchModeSwitch: operation=PokeTIMR_e_LaunchModeSwitch.PokeTIMR_e_LaunchModeSwitch, variation-point={short-label=vpSC_PokeTIMR_e_LaunchModeSwitch_PokeTIMR_e_LaunchModeSwitch, sw-syscond=1}
          SC_PokeTIMR_e_LeftSwitchReq_PokeTIMR_e_LeftSwitchReq: operation=PokeTIMR_e_LeftSwitchReq.PokeTIMR_e_LeftSwitchReq
          SC_PokeTIMR_e_RacePrepOnOffReq_PokeTIMR_e_RacePrepOnOffReq: operation=PokeTIMR_e_RacePrepOnOffReq.PokeTIMR_e_RacePrepOnOffReq, variation-point={short-label=vpSC_PokeTIMR_e_RacePrepOnOffReq_PokeTIMR_e_RacePrepOnOffReq, sw-syscond=1}
          SC_PokeTIMR_e_RacePrepRaceTypeReq_PokeTIMR_e_RacePrepRaceTypeReq: operation=PokeTIMR_e_RacePrepRaceTypeReq.PokeTIMR_e_RacePrepRaceTypeReq, variation-point={short-label=vpSC_PokeTIMR_e_RacePrepRaceTypeReq_PokeTIMR_e_RacePrepRaceTypeReq, sw-syscond=1}
          SC_PokeTIMR_e_RadioCustomMode_PokeTIMR_e_RadioCustomMode: operation=PokeTIMR_e_RadioCustomMode.PokeTIMR_e_RadioCustomMode
          SC_PokeTIMR_e_RightSwitchReq_PokeTIMR_e_RightSwitchReq: operation=PokeTIMR_e_RightSwitchReq.PokeTIMR_e_RightSwitchReq
          SC_PokeTIMR_e_TrrnToggleMdSwitch_PokeTIMR_e_TrrnToggleMdSwitch: operation=PokeTIMR_e_TrrnToggleMdSwitch.PokeTIMR_e_TrrnToggleMdSwitch
          SC_PokeTRIR_b_FL_HS_Fail_PokeTRIR_b_FL_HS_Fail: operation=PokeTRIR_b_FL_HS_Fail.PokeTRIR_b_FL_HS_Fail
          SC_PokeTRIR_b_FL_VS_Fail_PokeTRIR_b_FL_VS_Fail: operation=PokeTRIR_b_FL_VS_Fail.PokeTRIR_b_FL_VS_Fail
          SC_PokeTRIR_b_FR_HS_Fail_PokeTRIR_b_FR_HS_Fail: operation=PokeTRIR_b_FR_HS_Fail.PokeTRIR_b_FR_HS_Fail
          SC_PokeTRIR_b_FR_VS_Fail_PokeTRIR_b_FR_VS_Fail: operation=PokeTRIR_b_FR_VS_Fail.PokeTRIR_b_FR_VS_Fail
          SC_PokeTRIR_b_HSW_Fail_PokeTRIR_b_HSW_Fail: operation=PokeTRIR_b_HSW_Fail.PokeTRIR_b_HSW_Fail
          SC_PokeTRIR_b_LoadShed_PokeTRIR_b_LoadShed: operation=PokeTRIR_b_LoadShed.PokeTRIR_b_LoadShed
          SC_PokeTRIR_b_RL_HS_Fail_PokeTRIR_b_RL_HS_Fail: operation=PokeTRIR_b_RL_HS_Fail.PokeTRIR_b_RL_HS_Fail
          SC_PokeTRIR_b_RL_VS_Fail_PokeTRIR_b_RL_VS_Fail: operation=PokeTRIR_b_RL_VS_Fail.PokeTRIR_b_RL_VS_Fail
          SC_PokeTRIR_b_RR_HS_Fail_PokeTRIR_b_RR_HS_Fail: operation=PokeTRIR_b_RR_HS_Fail.PokeTRIR_b_RR_HS_Fail
          SC_PokeTRIR_b_RR_VS_Fail_PokeTRIR_b_RR_VS_Fail: operation=PokeTRIR_b_RR_VS_Fail.PokeTRIR_b_RR_VS_Fail
          SC_PokeTRIR_b_SCCActv_PokeTRIR_b_SCCActv: operation=PokeTRIR_b_SCCActv.PokeTRIR_b_SCCActv
          SC_PokeTRIR_b_TrunkStatus_PokeTRIR_b_TrunkStatus: operation=PokeTRIR_b_TrunkStatus.PokeTRIR_b_TrunkStatus
          SC_PokeTRIR_e_ClimateInfo_PokeTRIR_e_ClimateInfo: operation=PokeTRIR_e_ClimateInfo.PokeTRIR_e_ClimateInfo
          SC_PokeTRIR_e_FL_HS_Sts_PokeTRIR_e_FL_HS_Sts: operation=PokeTRIR_e_FL_HS_Sts.PokeTRIR_e_FL_HS_Sts
          SC_PokeTRIR_e_FL_VS_Sts_PokeTRIR_e_FL_VS_Sts: operation=PokeTRIR_e_FL_VS_Sts.PokeTRIR_e_FL_VS_Sts
          SC_PokeTRIR_e_FR_HS_Sts_PokeTRIR_e_FR_HS_Sts: operation=PokeTRIR_e_FR_HS_Sts.PokeTRIR_e_FR_HS_Sts
          SC_PokeTRIR_e_FR_VS_Sts_PokeTRIR_e_FR_VS_Sts: operation=PokeTRIR_e_FR_VS_Sts.PokeTRIR_e_FR_VS_Sts
          SC_PokeTRIR_e_HVACPrecCondSts_PokeTRIR_e_HVACPrecCondSts: operation=PokeTRIR_e_HVACPrecCondSts.PokeTRIR_e_HVACPrecCondSts
          SC_PokeTRIR_e_RL_HS_Sts_PokeTRIR_e_RL_HS_Sts: operation=PokeTRIR_e_RL_HS_Sts.PokeTRIR_e_RL_HS_Sts
          SC_PokeTRIR_e_RL_VS_Sts_PokeTRIR_e_RL_VS_Sts: operation=PokeTRIR_e_RL_VS_Sts.PokeTRIR_e_RL_VS_Sts
          SC_PokeTRIR_e_RR_HS_Sts_PokeTRIR_e_RR_HS_Sts: operation=PokeTRIR_e_RR_HS_Sts.PokeTRIR_e_RR_HS_Sts
          SC_PokeTRIR_e_RR_VS_Sts_PokeTRIR_e_RR_VS_Sts: operation=PokeTRIR_e_RR_VS_Sts.PokeTRIR_e_RR_VS_Sts
          SC_TmotAATR_U_CBC_AmbientAirVolt_TmotAATR_U_CBC_AmbientAirVolt: operation=TmotAATR_U_CBC_AmbientAirVolt.TmotAATR_U_CBC_AmbientAirVolt
          SC_TmotCITR_b_DC_PwrLev_TmotCITR_b_DC_PwrLev: operation=TmotCITR_b_DC_PwrLev.TmotCITR_b_DC_PwrLev, variation-point={short-label=vpSC_TmotCITR_b_DC_PwrLev_TmotCITR_b_DC_PwrLev, sw-syscond=1}
          SC_TmotCITR_b_Date_Day1_TmotCITR_b_Date_Day1: operation=TmotCITR_b_Date_Day1.TmotCITR_b_Date_Day1
          SC_TmotCITR_b_HU_Sch{1..4}_Day_TmotCITR_b_HU_Sch{1..4}_Day: operation=TmotCITR_b_HU_Sch{1..4}_Day.TmotCITR_b_HU_Sch{1..4}_Day
          SC_TmotCITR_b_TBM_Sch{1..4}_Day_TmotCITR_b_TBM_Sch{1..4}_Day: operation=TmotCITR_b_TBM_Sch{1..4}_Day.TmotCITR_b_TBM_Sch{1..4}_Day
          SC_TmotCITR_e_DoorLockLastElSts_TmotCITR_e_DoorLockLastElSts: operation=TmotCITR_e_DoorLockLastElSts.TmotCITR_e_DoorLockLastElSts
          SC_TmotCITR_e_PowerLimitReq_TmotCITR_e_PowerLimitReq: operation=TmotCITR_e_PowerLimitReq.TmotCITR_e_PowerLimitReq
          SC_TmotCITR_e_RmtChrgPortLkCmd_TmotCITR_e_RmtChrgPortLkCmd: operation=TmotCITR_e_RmtChrgPortLkCmd.TmotCITR_e_RmtChrgPortLkCmd
          SC_TmotIDCR_I_IBS_I_Batt_TmotIDCR_I_IBS_I_Batt: operation=TmotIDCR_I_IBS_I_Batt.TmotIDCR_I_IBS_I_Batt
          SC_TmotIDCR_b_IBS_BattTemp_TmotIDCR_b_IBS_BattTemp: operation=TmotIDCR_b_IBS_BattTemp.TmotIDCR_b_IBS_BattTemp
          SC_TmotIDCR_b_PlugAndChargeReq_TmotIDCR_b_PlugAndChargeReq: operation=TmotIDCR_b_PlugAndChargeReq.TmotIDCR_b_PlugAndChargeReq
          SC_TmotTRIR_b_HVACPrecCondSts_TmotTRIR_b_HVACPrecCondSts: operation=TmotTRIR_b_HVACPrecCondSts.TmotTRIR_b_HVACPrecCondSts
      36 x variation point proxy, all with category=CONDITION:
        VrntCR1B_BrkThermdl: condition-access=1
        VrntCR1B_CatHtgStateActive: condition-access=0
        VrntCR1B_Creep: condition-access=1
        VrntCR1B_CylOff: condition-access=0
        VrntCR1B_DCPwrLev: condition-access=1
        VrntCR1B_ECMAirflowRequest: condition-access=0
        VrntCR1B_ECMReqRemedialStop: condition-access=0
        VrntCR1B_ESSEngineStateEE: condition-access=0
        VrntCR1B_EngCmbstnCmnd: condition-access=0
        VrntCR1B_EngDFCOAllw: condition-access=0
        VrntCR1B_EngDFCOReq: condition-access=0
        VrntCR1B_EngDFCOSt: condition-access=0
        VrntCR1B_EngIntAirTmp: condition-access=0
        VrntCR1B_EngOffRecom: condition-access=0
        VrntCR1B_EngOutofFuel: condition-access=0
        VrntCR1B_EngSysFld: condition-access=0
        VrntCR1B_EngineOilTemperature: condition-access=0
        VrntCR1B_EstCatCnvTmp: condition-access=0
        VrntCR1B_ExhaustTemperature: condition-access=0
        VrntCR1B_FuelConsumptionGAG3: condition-access=0
        VrntCR1B_FuelLevel2: condition-access=0
        VrntCR1B_GFCharge: condition-access=0
        VrntCR1B_LaunchHardBtn: condition-access=1
        VrntCR1B_LaunchTorqueSftBtnReq: condition-access=1
        VrntCR1B_NotOKToRace: condition-access=1
        VrntCR1B_PowerShotBCM: condition-access=1
        VrntCR1B_RACECLDWNONOFFREQ: condition-access=1
        VrntCR1B_RACEPREPRACETYPEREQ: condition-access=1
        VrntCR1B_Switch2Rq: condition-access=0
        VrntCR1B_Switch2WDRq: condition-access=1
        VrntCR1B_Switch4AUTORq: condition-access=0
        VrntCR1B_Switch4LOCKRq: condition-access=0
        VrntCR1B_TLCLRNRq: condition-access=0
        VrntCR1B_TerrainModeInterfaceButtonBCM: condition-access=1
        VrntCR1B_TowRequest: condition-access=0
        VrntCR1B_VehicleStandStillSts: condition-access=1
