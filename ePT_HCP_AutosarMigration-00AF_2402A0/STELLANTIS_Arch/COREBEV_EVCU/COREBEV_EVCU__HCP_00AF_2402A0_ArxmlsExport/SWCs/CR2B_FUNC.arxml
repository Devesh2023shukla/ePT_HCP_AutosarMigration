[part 2 of 2: package /STELLANTIS/EPT/COMSWCs]
AUTOSAR XML (schema 4-2-2)
package /STELLANTIS/EPT/COMSWCs  (continued)
  application sw component type CR2B_FUNC  (continued)
    behavior IB_CR2B_FUNC: data-type-mapping=[msADTtoIDTMapping, ADTtoIDTMapping], handle-termination-and-restart=NO-SUPPORT
      timing event Event_MedTEB: start-on-event=CR2B_FUNC_MedTEB, period=0.01
      init event Event_CR2B_FUNC_ac_Init: start-on-event=CR2B_FUNC_ac_Init
      runnable CR2B_FUNC_ac_Init
      runnable CR2B_FUNC_MedTEB
        data-receive-point-by-arguments:
          453 x access:
            IN_VeCANR_U_EVSE_ThrshldVoltage_VeCANR_U_EVSE_ThrshldVoltage: accessed-variable=VeCANR_U_EVSE_ThrshldVoltage.VeCANR_U_EVSE_ThrshldVoltage
            IN_VeCANR_b_APM2InterlockStsTO_VeCANR_b_APM2InterlockStsTO: accessed-variable=VeCANR_b_APM2InterlockStsTO.VeCANR_b_APM2InterlockStsTO
            IN_VeCANR_b_EVSEChargingStmError_VeCANR_b_EVSEChargingStmError: accessed-variable=VeCANR_b_EVSEChargingStmError.VeCANR_b_EVSEChargingStmError
            IN_VeCANR_b_EVSEChargingStmErrorTO_VeCANR_b_EVSEChargingStmErrorTO: accessed-variable=VeCANR_b_EVSEChargingStmErrorTO.VeCANR_b_EVSEChargingStmErrorTO
            IN_VeCANR_b_EVSE_CHAdeMOProtocolTO_VeCANR_b_EVSE_CHAdeMOProtocolTO: accessed-variable=VeCANR_b_EVSE_CHAdeMOProtocolTO.VeCANR_b_EVSE_CHAdeMOProtocolTO
            IN_VeCANR_b_EVSE_EnergizingState_VeCANR_b_EVSE_EnergizingState: accessed-variable=VeCANR_b_EVSE_EnergizingState.VeCANR_b_EVSE_EnergizingState
            IN_VeCANR_b_EVSE_EnergizingStateTO_VeCANR_b_EVSE_EnergizingStateTO: accessed-variable=VeCANR_b_EVSE_EnergizingStateTO.VeCANR_b_EVSE_EnergizingStateTO
            IN_VeCANR_b_EVSE_ThrshldVoltageTO_VeCANR_b_EVSE_ThrshldVoltageTO: accessed-variable=VeCANR_b_EVSE_ThrshldVoltageTO.VeCANR_b_EVSE_ThrshldVoltageTO
            IN_VeCANR_b_IDCM_Wakeup_HCP_FD11_VeCANR_b_IDCM_Wakeup_HCP_FD11: accessed-variable=VeCANR_b_IDCM_Wakeup_HCP_FD11.VeCANR_b_IDCM_Wakeup_HCP_FD11
            IN_VeCANR_b_IDCM_Wakeup_HCP_FD11TO_VeCANR_b_IDCM_Wakeup_HCP_FD11TO: accessed-variable=VeCANR_b_IDCM_Wakeup_HCP_FD11TO.VeCANR_b_IDCM_Wakeup_HCP_FD11TO
            IN_VeCANR_e_APM2InterlockSts_VeCANR_e_APM2InterlockSts: accessed-variable=VeCANR_e_APM2InterlockSts.VeCANR_e_APM2InterlockSts
            IN_VeCANR_e_CanLocEnblStatus_VeCANR_e_CanLocEnblStatus: accessed-variable=VeCANR_e_CanLocEnblStatus.VeCANR_e_CanLocEnblStatus
            IN_VeCANR_e_EVSE_CHAdeMOProtocol_VeCANR_e_EVSE_CHAdeMOProtocol: accessed-variable=VeCANR_e_EVSE_CHAdeMOProtocol.VeCANR_e_EVSE_CHAdeMOProtocol
            IN_VeCRDB_EWhr_HVCMS_EgToBDlvd_Value: accessed-variable=VeCRDB_EWhr_HVCMS_EgToBDlvd.Value
            IN_VeCRDB_I_AC_Side_Curr{1..3}_Value: accessed-variable=VeCRDB_I_AC_Side_Curr{1..3}.Value
            IN_VeCRDB_I_APM_HV_I_Fbk_Value: accessed-variable=VeCRDB_I_APM_HV_I_Fbk.Value
            IN_VeCRDB_I_APM_IdcHvSetPFdbk_Value: accessed-variable=VeCRDB_I_APM_IdcHvSetPFdbk.Value
            IN_VeCRDB_I_APM_LV_I_Fbk_Value: accessed-variable=VeCRDB_I_APM_LV_I_Fbk.Value
            IN_VeCRDB_I_BPCM_HVChrgCurProf_Value: accessed-variable=VeCRDB_I_BPCM_HVChrgCurProf.Value
            IN_VeCRDB_I_BPCM_HV_Current_Value: accessed-variable=VeCRDB_I_BPCM_HV_Current.Value
            IN_VeCRDB_I_BPCM_HV_CurrentString2_Value: accessed-variable=VeCRDB_I_BPCM_HV_CurrentString2.Value
            IN_VeCRDB_I_BatterySideCurrent_Value: accessed-variable=VeCRDB_I_BatterySideCurrent.Value
            IN_VeCRDB_I_ChargeCurrent_Value: accessed-variable=VeCRDB_I_ChargeCurrent.Value
            IN_VeCRDB_I_ChrgCurrAvail_Value: accessed-variable=VeCRDB_I_ChrgCurrAvail.Value
            IN_VeCRDB_I_HVCMS_EVSECurRglTl_Value: accessed-variable=VeCRDB_I_HVCMS_EVSECurRglTl.Value
            IN_VeCRDB_I_HVCMS_EVSEMaxCurLm_Value: accessed-variable=VeCRDB_I_HVCMS_EVSEMaxCurLm.Value
            IN_VeCRDB_I_HVCMS_EVSEMinCurLm_Value: accessed-variable=VeCRDB_I_HVCMS_EVSEMinCurLm.Value
            IN_VeCRDB_I_HVCMS_EVSEPkCurRpl_Value: accessed-variable=VeCRDB_I_HVCMS_EVSEPkCurRpl.Value
            IN_VeCRDB_I_HVCMS_EVSEPrsntCur_Value: accessed-variable=VeCRDB_I_HVCMS_EVSEPrsntCur.Value
            IN_VeCRDB_I_InputCurrentAvail_Value: accessed-variable=VeCRDB_I_InputCurrentAvail.Value
            IN_VeCRDB_P_BPCM_HVPwrMaxChgLT_Value: accessed-variable=VeCRDB_P_BPCM_HVPwrMaxChgLT.Value
            IN_VeCRDB_P_BPCM_HVPwrMaxChgMT_Value: accessed-variable=VeCRDB_P_BPCM_HVPwrMaxChgMT.Value
            IN_VeCRDB_P_BPCM_HVPwrMaxChgST_Value: accessed-variable=VeCRDB_P_BPCM_HVPwrMaxChgST.Value
            IN_VeCRDB_P_BPCM_HVPwrMxDchgLT_Value: accessed-variable=VeCRDB_P_BPCM_HVPwrMxDchgLT.Value
            IN_VeCRDB_P_BPCM_HVPwrMxDchgMT_Value: accessed-variable=VeCRDB_P_BPCM_HVPwrMxDchgMT.Value
            IN_VeCRDB_P_BPCM_HVPwrMxDchgST_Value: accessed-variable=VeCRDB_P_BPCM_HVPwrMxDchgST.Value
            IN_VeCRDB_Pct_APMUtlPctOfDCDC_Value: accessed-variable=VeCRDB_Pct_APMUtlPctOfDCDC.Value
            IN_VeCRDB_Pct_BPCM_HV_SOC_Value: accessed-variable=VeCRDB_Pct_BPCM_HV_SOC.Value
            IN_VeCRDB_T_APM_PSFB_Temp1_Value: accessed-variable=VeCRDB_T_APM_PSFB_Temp1.Value
            IN_VeCRDB_T_APM_PSFB_Temp2_Value: accessed-variable=VeCRDB_T_APM_PSFB_Temp2.Value
            IN_VeCRDB_T_APM_TempColdPlate_Value: accessed-variable=VeCRDB_T_APM_TempColdPlate.Value
            IN_VeCRDB_T_BMS_HVLoTempThd_Value: accessed-variable=VeCRDB_T_BMS_HVLoTempThd.Value
            IN_VeCRDB_T_BMS_HV_HiTempThd_Value: accessed-variable=VeCRDB_T_BMS_HV_HiTempThd.Value
            IN_VeCRDB_T_BPCM_HV_Inlet_Temp_Value: accessed-variable=VeCRDB_T_BPCM_HV_Inlet_Temp.Value
            IN_VeCRDB_T_BPCM_HV_Outl_Temp_Value: accessed-variable=VeCRDB_T_BPCM_HV_Outl_Temp.Value
            IN_VeCRDB_T_BPCM_HV_Temp_Avg_Value: accessed-variable=VeCRDB_T_BPCM_HV_Temp_Avg.Value
            IN_VeCRDB_T_BPCM_HV_Temp_Max_Value: accessed-variable=VeCRDB_T_BPCM_HV_Temp_Max.Value
            IN_VeCRDB_T_BPCM_HV_Temp_Min_Value: accessed-variable=VeCRDB_T_BPCM_HV_Temp_Min.Value
            IN_VeCRDB_T_HVBP_BDU_Busbar_Temp_Value: accessed-variable=VeCRDB_T_HVBP_BDU_Busbar_Temp.Value
            IN_VeCRDB_T_HVBP_Busbar_Temp_Value: accessed-variable=VeCRDB_T_HVBP_Busbar_Temp.Value
            IN_VeCRDB_T_OBC_Temp{1..4}_Value: accessed-variable=VeCRDB_T_OBC_Temp{1..4}.Value
            IN_VeCRDB_U_AC_Side_Volt{1..3}_Value: accessed-variable=VeCRDB_U_AC_Side_Volt{1..3}.Value
            IN_VeCRDB_U_APM_HV_V_Fbk_Value: accessed-variable=VeCRDB_U_APM_HV_V_Fbk.Value
            IN_VeCRDB_U_APM_HvVsetPFdbk_Value: accessed-variable=VeCRDB_U_APM_HvVsetPFdbk.Value
            IN_VeCRDB_U_APM_LV_V_Fbk_Value: accessed-variable=VeCRDB_U_APM_LV_V_Fbk.Value
            IN_VeCRDB_U_BPCMMaxCelVoltAlwd_Value: accessed-variable=VeCRDB_U_BPCMMaxCelVoltAlwd.Value
            IN_VeCRDB_U_BPCMMaxPkVoltAllwd_Value: accessed-variable=VeCRDB_U_BPCMMaxPkVoltAllwd.Value
            IN_VeCRDB_U_BPCMMinCelVoltAlwd_Value: accessed-variable=VeCRDB_U_BPCMMinCelVoltAlwd.Value
            IN_VeCRDB_U_BPCMMinPkVoltAllwd_Value: accessed-variable=VeCRDB_U_BPCMMinPkVoltAllwd.Value
            IN_VeCRDB_U_BPCM_Cell_VoltAvg_Value: accessed-variable=VeCRDB_U_BPCM_Cell_VoltAvg.Value
            IN_VeCRDB_U_BPCM_Cell_Volt_Max_Value: accessed-variable=VeCRDB_U_BPCM_Cell_Volt_Max.Value
            IN_VeCRDB_U_BPCM_Cell_Volt_Min_Value: accessed-variable=VeCRDB_U_BPCM_Cell_Volt_Min.Value
            IN_VeCRDB_U_BPCM_HVIntrnlVltStrng1_Value: accessed-variable=VeCRDB_U_BPCM_HVIntrnlVltStrng1.Value
            IN_VeCRDB_U_BPCM_HVIntrnlVltStrng2_Value: accessed-variable=VeCRDB_U_BPCM_HVIntrnlVltStrng2.Value
            IN_VeCRDB_U_BPCM_HVTracBusVolt_Value: accessed-variable=VeCRDB_U_BPCM_HVTracBusVolt.Value
            IN_VeCRDB_U_BPCM_HV_IntVolt_Value: accessed-variable=VeCRDB_U_BPCM_HV_IntVolt.Value
            IN_VeCRDB_U_BPCM_OCVAvgCelVolt_Value: accessed-variable=VeCRDB_U_BPCM_OCVAvgCelVolt.Value
            IN_VeCRDB_U_BPCM_OCVMaxCelVolt_Value: accessed-variable=VeCRDB_U_BPCM_OCVMaxCelVolt.Value
            IN_VeCRDB_U_BPCM_OCVMinCelVolt_Value: accessed-variable=VeCRDB_U_BPCM_OCVMinCelVolt.Value
            IN_VeCRDB_U_BPCM_Series_Voltage_Value: accessed-variable=VeCRDB_U_BPCM_Series_Voltage.Value, variation-point={short-label=vpIN_VeCRDB_U_BPCM_Series_Voltage_Value, sw-syscond=1}
            IN_VeCRDB_U_BatterySideVoltage_Value: accessed-variable=VeCRDB_U_BatterySideVoltage.Value
            IN_VeCRDB_U_HVCMS_EVSEMaxVltLm_Value: accessed-variable=VeCRDB_U_HVCMS_EVSEMaxVltLm.Value
            IN_VeCRDB_U_HVCMS_EVSEMinVltLm_Value: accessed-variable=VeCRDB_U_HVCMS_EVSEMinVltLm.Value
            IN_VeCRDB_U_HVCMS_EVSEPrsntVlt_Value: accessed-variable=VeCRDB_U_HVCMS_EVSEPrsntVlt.Value
            IN_VeCRDB_U_OBC_Prox_Value: accessed-variable=VeCRDB_U_OBC_Prox.Value
            IN_VeCRDB_W_APM_DeratingPower_Value: accessed-variable=VeCRDB_W_APM_DeratingPower.Value
            IN_VeCRDB_W_APM_EstPwrLoss_Value: accessed-variable=VeCRDB_W_APM_EstPwrLoss.Value
            IN_VeCRDB_W_APM_InputPower_Value: accessed-variable=VeCRDB_W_APM_InputPower.Value
            IN_VeCRDB_W_APM_OutputPower_Value: accessed-variable=VeCRDB_W_APM_OutputPower.Value
            IN_VeCRDB_W_HVCMS_EVSEMaxPwrLm_Value: accessed-variable=VeCRDB_W_HVCMS_EVSEMaxPwrLm.Value
            IN_VeCRDB_b_AC_LnHi_Value: accessed-variable=VeCRDB_b_AC_LnHi.Value
            IN_VeCRDB_b_AC_LnLow_Value: accessed-variable=VeCRDB_b_AC_LnLow.Value
            IN_VeCRDB_b_AC_Present_Value: accessed-variable=VeCRDB_b_AC_Present.Value
            IN_VeCRDB_b_APMCurrentLimitMd_Value: accessed-variable=VeCRDB_b_APMCurrentLimitMd.Value
            IN_VeCRDB_b_APM_HvOverVStatus_Value: accessed-variable=VeCRDB_b_APM_HvOverVStatus.Value
            IN_VeCRDB_b_APM_PowerLimitMode_Value: accessed-variable=VeCRDB_b_APM_PowerLimitMode.Value
            IN_VeCRDB_b_BPCMCntctrsMTOWrn_Value: accessed-variable=VeCRDB_b_BPCMCntctrsMTOWrn.Value
            IN_VeCRDB_b_BPCMCntctrsSTOWrn_Value: accessed-variable=VeCRDB_b_BPCMCntctrsSTOWrn.Value
            IN_VeCRDB_b_BPCM_DCCntctrMTOW_Value: accessed-variable=VeCRDB_b_BPCM_DCCntctrMTOW.Value
            IN_VeCRDB_b_BPCM_DCCntctrSTOW_Value: accessed-variable=VeCRDB_b_BPCM_DCCntctrSTOW.Value
            IN_VeCRDB_b_BPCM_PwrLimpHm_Value: accessed-variable=VeCRDB_b_BPCM_PwrLimpHm.Value
            IN_VeCRDB_b_BPCM_ReqforAuxLoadoff_Value: accessed-variable=VeCRDB_b_BPCM_ReqforAuxLoadoff.Value, variation-point={short-label=vpIN_VeCRDB_b_BPCM_ReqforAuxLoadoff_Value, sw-syscond=1}
            IN_VeCRDB_b_DC_Isoln_Dsbl_Cmd_Value: accessed-variable=VeCRDB_b_DC_Isoln_Dsbl_Cmd.Value
            IN_VeCRDB_b_DC_TimeOut_Value: accessed-variable=VeCRDB_b_DC_TimeOut.Value
            IN_VeCRDB_b_EVCC_FailureSts_Value: accessed-variable=VeCRDB_b_EVCC_FailureSts.Value
            IN_VeCRDB_b_EVSEOfdACThreePhas_Value: accessed-variable=VeCRDB_b_EVSEOfdACThreePhas.Value
            IN_VeCRDB_b_EVSE_FreeService_Value: accessed-variable=VeCRDB_b_EVSE_FreeService.Value
            IN_VeCRDB_b_EVSE_OfdACSingPhas_Value: accessed-variable=VeCRDB_b_EVSE_OfdACSingPhas.Value
            IN_VeCRDB_b_EVSE_OfdPymtCntct_Value: accessed-variable=VeCRDB_b_EVSE_OfdPymtCntct.Value
            IN_VeCRDB_b_EVSE_OfrdPymntEIM_Value: accessed-variable=VeCRDB_b_EVSE_OfrdPymntEIM.Value
            IN_VeCRDB_b_EVSE_Srvc2Crtfct_Value: accessed-variable=VeCRDB_b_EVSE_Srvc2Crtfct.Value
            IN_VeCRDB_b_EVSE_Supportd_DIN_Value: accessed-variable=VeCRDB_b_EVSE_Supportd_DIN.Value
            IN_VeCRDB_b_EVSE_Supprtd_ISO1_Value: accessed-variable=VeCRDB_b_EVSE_Supprtd_ISO1.Value
            IN_VeCRDB_b_HEV_OnRq_BPCM_Value: accessed-variable=VeCRDB_b_HEV_OnRq_BPCM.Value
            IN_VeCRDB_b_HVBatCntctWeldChk_Value: accessed-variable=VeCRDB_b_HVBatCntctWeldChk.Value
            IN_VeCRDB_b_HVBatReady_Value: accessed-variable=VeCRDB_b_HVBatReady.Value
            IN_VeCRDB_b_HVCMS_EVSEProcg_Value: accessed-variable=VeCRDB_b_HVCMS_EVSEProcg.Value
            IN_VeCRDB_b_ImpactHardwire_Value: accessed-variable=VeCRDB_b_ImpactHardwire.Value
            IN_VeCRDB_b_ImpactHardwireV_Value: accessed-variable=VeCRDB_b_ImpactHardwireV.Value
            IN_VeCRDB_b_J1772_S2_Sts_Value: accessed-variable=VeCRDB_b_J1772_S2_Sts.Value
            IN_VeCRDB_b_OBCM_Timeout_Value: accessed-variable=VeCRDB_b_OBCM_Timeout.Value
            IN_VeCRDB_b_ReceiptRequired_Value: accessed-variable=VeCRDB_b_ReceiptRequired.Value
            IN_VeCRDB_b_TCP_ComTerminated_Value: accessed-variable=VeCRDB_b_TCP_ComTerminated.Value
            IN_VeCRDB_dT_BPCM_HVCelMxDchImp_Value: accessed-variable=VeCRDB_dT_BPCM_HVCelMxDchImp.Value
            IN_VeCRDB_dT_BPCM_HVClMinDchImp_Value: accessed-variable=VeCRDB_dT_BPCM_HVClMinDchImp.Value
            IN_VeCRDB_d_BPCM_HVNrCelMaxTmp_Value: accessed-variable=VeCRDB_d_BPCM_HVNrCelMaxTmp.Value
            IN_VeCRDB_d_BPCM_HVNrCelMaxVlt_Value: accessed-variable=VeCRDB_d_BPCM_HVNrCelMaxVlt.Value
            IN_VeCRDB_d_BPCM_HVNrCelMinTmp_Value: accessed-variable=VeCRDB_d_BPCM_HVNrCelMinTmp.Value
            IN_VeCRDB_d_BPCM_HVNrCelMinVlt_Value: accessed-variable=VeCRDB_d_BPCM_HVNrCelMinVlt.Value
            IN_VeCRDB_d_EVSE_Acptd_Prtcl_Value: accessed-variable=VeCRDB_d_EVSE_Acptd_Prtcl.Value
            IN_VeCRDB_d_EVSE_ServiceId_Value: accessed-variable=VeCRDB_d_EVSE_ServiceId.Value
            IN_VeCRDB_d_HVBatCelVoltHiThrs_Value: accessed-variable=VeCRDB_d_HVBatCelVoltHiThrs.Value
            IN_VeCRDB_g_HVCMS_EVSEID_Value: accessed-variable=VeCRDB_g_HVCMS_EVSEID.Value
            IN_VeCRDB_h_HVBatCelVoltLoThrs_Value: accessed-variable=VeCRDB_h_HVBatCelVoltLoThrs.Value
            IN_VeCRDB_qAhr_BPCM_HV_Capacity_Value: accessed-variable=VeCRDB_qAhr_BPCM_HV_Capacity.Value
            IN_VeCRDB_t_EVSE_NtfcnMaxDly_Value: accessed-variable=VeCRDB_t_EVSE_NtfcnMaxDly.Value
            IN_VeCRDB_tdy_HVBatLastSlept_Value: accessed-variable=VeCRDB_tdy_HVBatLastSlept.Value
            IN_VeCRDB_thr_HVBatCntctOpnTime_Value: accessed-variable=VeCRDB_thr_HVBatCntctOpnTime.Value
            IN_VeCRDB_y_AC_LnHi_SigSts_Value: accessed-variable=VeCRDB_y_AC_LnHi_SigSts.Value
            IN_VeCRDB_y_AC_LnLow_SigSts_Value: accessed-variable=VeCRDB_y_AC_LnLow_SigSts.Value
            IN_VeCRDB_y_AC_Present_SigSts_Value: accessed-variable=VeCRDB_y_AC_Present_SigSts.Value
            IN_VeCRDB_y_AC_Side_Curr{1..3}_SigSts_Value: accessed-variable=VeCRDB_y_AC_Side_Curr{1..3}_SigSts.Value
            IN_VeCRDB_y_AC_Side_Volt{1..3}_SigSts_Value: accessed-variable=VeCRDB_y_AC_Side_Volt{1..3}_SigSts.Value
            IN_VeCRDB_y_APMCurrentLimitMd_SigSts_Value: accessed-variable=VeCRDB_y_APMCurrentLimitMd_SigSts.Value
            IN_VeCRDB_y_APMDeratingModeSts_Value: accessed-variable=VeCRDB_y_APMDeratingModeSts.Value
            IN_VeCRDB_y_APMDeratingModeSts_SigSts_Value: accessed-variable=VeCRDB_y_APMDeratingModeSts_SigSts.Value
            IN_VeCRDB_y_APMDeratingReason_Value: accessed-variable=VeCRDB_y_APMDeratingReason.Value
            IN_VeCRDB_y_APMDeratingReason_SigSts_Value: accessed-variable=VeCRDB_y_APMDeratingReason_SigSts.Value
            IN_VeCRDB_y_APMUtlPctOfDCDC_SigSts_Value: accessed-variable=VeCRDB_y_APMUtlPctOfDCDC_SigSts.Value
            IN_VeCRDB_y_APM_CtrlSts_Fbk_Value: accessed-variable=VeCRDB_y_APM_CtrlSts_Fbk.Value
            IN_VeCRDB_y_APM_CtrlSts_Fbk_SigSts_Value: accessed-variable=VeCRDB_y_APM_CtrlSts_Fbk_SigSts.Value
            IN_VeCRDB_y_APM_DeratingPower_SigSts_Value: accessed-variable=VeCRDB_y_APM_DeratingPower_SigSts.Value
            IN_VeCRDB_y_APM_EstPwrLoss_SigSts_Value: accessed-variable=VeCRDB_y_APM_EstPwrLoss_SigSts.Value
            IN_VeCRDB_y_APM_FailureReason_Value: accessed-variable=VeCRDB_y_APM_FailureReason.Value
            IN_VeCRDB_y_APM_FailureReason_SigSts_Value: accessed-variable=VeCRDB_y_APM_FailureReason_SigSts.Value
            IN_VeCRDB_y_APM_FailureType_Value: accessed-variable=VeCRDB_y_APM_FailureType.Value
            IN_VeCRDB_y_APM_FailureType_SigSts_Value: accessed-variable=VeCRDB_y_APM_FailureType_SigSts.Value
            IN_VeCRDB_y_APM_HV_I_Fbk_SigSts_Value: accessed-variable=VeCRDB_y_APM_HV_I_Fbk_SigSts.Value
            IN_VeCRDB_y_APM_HV_V_Fbk_SigSts_Value: accessed-variable=VeCRDB_y_APM_HV_V_Fbk_SigSts.Value
            IN_VeCRDB_y_APM_HvOverVStatus_SigSts_Value: accessed-variable=VeCRDB_y_APM_HvOverVStatus_SigSts.Value
            IN_VeCRDB_y_APM_HvVsetPFdbk_SigSts_Value: accessed-variable=VeCRDB_y_APM_HvVsetPFdbk_SigSts.Value
            IN_VeCRDB_y_APM_IdcHvSetPFdbk_SigSts_Value: accessed-variable=VeCRDB_y_APM_IdcHvSetPFdbk_SigSts.Value
            IN_VeCRDB_y_APM_InputPower_SigSts_Value: accessed-variable=VeCRDB_y_APM_InputPower_SigSts.Value
            IN_VeCRDB_y_APM_LV_I_Fbk_SigSts_Value: accessed-variable=VeCRDB_y_APM_LV_I_Fbk_SigSts.Value
            IN_VeCRDB_y_APM_LV_V_Fbk_SigSts_Value: accessed-variable=VeCRDB_y_APM_LV_V_Fbk_SigSts.Value
            IN_VeCRDB_y_APM_OutputPower_SigSts_Value: accessed-variable=VeCRDB_y_APM_OutputPower_SigSts.Value
            IN_VeCRDB_y_APM_PSFB_Temp1_SigSts_Value: accessed-variable=VeCRDB_y_APM_PSFB_Temp1_SigSts.Value
            IN_VeCRDB_y_APM_PSFB_Temp2_SigSts_Value: accessed-variable=VeCRDB_y_APM_PSFB_Temp2_SigSts.Value
            IN_VeCRDB_y_APM_PowerLimitMode_SigSts_Value: accessed-variable=VeCRDB_y_APM_PowerLimitMode_SigSts.Value
            IN_VeCRDB_y_APM_TempColdPlate_SigSts_Value: accessed-variable=VeCRDB_y_APM_TempColdPlate_SigSts.Value
            IN_VeCRDB_y_APM_ThermalRunaway_Value: accessed-variable=VeCRDB_y_APM_ThermalRunaway.Value
            IN_VeCRDB_y_APM_ThermalRunaway_SigSts_Value: accessed-variable=VeCRDB_y_APM_ThermalRunaway_SigSts.Value
            IN_VeCRDB_y_BMS_HVLoTempThd_SigSts_Value: accessed-variable=VeCRDB_y_BMS_HVLoTempThd_SigSts.Value
            IN_VeCRDB_y_BMS_HV_HiTempThd_SigSts_Value: accessed-variable=VeCRDB_y_BMS_HV_HiTempThd_SigSts.Value
            IN_VeCRDB_y_BPCMCntctrsMTOWrn_SigSts_Value: accessed-variable=VeCRDB_y_BPCMCntctrsMTOWrn_SigSts.Value
            IN_VeCRDB_y_BPCMCntctrsSTOWrn_SigSts_Value: accessed-variable=VeCRDB_y_BPCMCntctrsSTOWrn_SigSts.Value
            IN_VeCRDB_y_BPCMInterlockSts_Value: accessed-variable=VeCRDB_y_BPCMInterlockSts.Value
            IN_VeCRDB_y_BPCMInterlockSts_SigSts_Value: accessed-variable=VeCRDB_y_BPCMInterlockSts_SigSts.Value
            IN_VeCRDB_y_BPCMMaxCelVoltAlwd_SigSts_Value: accessed-variable=VeCRDB_y_BPCMMaxCelVoltAlwd_SigSts.Value
            IN_VeCRDB_y_BPCMMaxPkVoltAllwd_SigSts_Value: accessed-variable=VeCRDB_y_BPCMMaxPkVoltAllwd_SigSts.Value
            IN_VeCRDB_y_BPCMMinCelVoltAlwd_SigSts_Value: accessed-variable=VeCRDB_y_BPCMMinCelVoltAlwd_SigSts.Value
            IN_VeCRDB_y_BPCMMinPkVoltAllwd_SigSts_Value: accessed-variable=VeCRDB_y_BPCMMinPkVoltAllwd_SigSts.Value
            IN_VeCRDB_y_BPCM_Cell_VoltAvg_SigSts_Value: accessed-variable=VeCRDB_y_BPCM_Cell_VoltAvg_SigSts.Value
            IN_VeCRDB_y_BPCM_Cell_Volt_Max_SigSts_Value: accessed-variable=VeCRDB_y_BPCM_Cell_Volt_Max_SigSts.Value
            IN_VeCRDB_y_BPCM_Cell_Volt_Min_SigSts_Value: accessed-variable=VeCRDB_y_BPCM_Cell_Volt_Min_SigSts.Value
            IN_VeCRDB_y_BPCM_DCCntctrMTOW_SigSts_Value: accessed-variable=VeCRDB_y_BPCM_DCCntctrMTOW_SigSts.Value
            IN_VeCRDB_y_BPCM_DCCntctrSTOW_SigSts_Value: accessed-variable=VeCRDB_y_BPCM_DCCntctrSTOW_SigSts.Value
            IN_VeCRDB_y_BPCM_HVBIIS_Value: accessed-variable=VeCRDB_y_BPCM_HVBIIS.Value
            IN_VeCRDB_y_BPCM_HVBIIS_SigSts_Value: accessed-variable=VeCRDB_y_BPCM_HVBIIS_SigSts.Value
            IN_VeCRDB_y_BPCM_HVBattGFDSts_Value: accessed-variable=VeCRDB_y_BPCM_HVBattGFDSts.Value
            IN_VeCRDB_y_BPCM_HVBattGFDSts_SigSts_Value: accessed-variable=VeCRDB_y_BPCM_HVBattGFDSts_SigSts.Value
            IN_VeCRDB_y_BPCM_HVCelMxDchImp_SigSts_Value: accessed-variable=VeCRDB_y_BPCM_HVCelMxDchImp_SigSts.Value
            IN_VeCRDB_y_BPCM_HVChrgBusSts_Value: accessed-variable=VeCRDB_y_BPCM_HVChrgBusSts.Value
            IN_VeCRDB_y_BPCM_HVChrgBusSts_SigSts_Value: accessed-variable=VeCRDB_y_BPCM_HVChrgBusSts_SigSts.Value
            IN_VeCRDB_y_BPCM_HVChrgCurProf_SigSts_Value: accessed-variable=VeCRDB_y_BPCM_HVChrgCurProf_SigSts.Value
            IN_VeCRDB_y_BPCM_HVClMinDchImp_SigSts_Value: accessed-variable=VeCRDB_y_BPCM_HVClMinDchImp_SigSts.Value
            IN_VeCRDB_y_BPCM_HVIntrnlVltStrng1_SigSts_Value: accessed-variable=VeCRDB_y_BPCM_HVIntrnlVltStrng1_SigSts.Value
            IN_VeCRDB_y_BPCM_HVIntrnlVltStrng2_SigSts_Value: accessed-variable=VeCRDB_y_BPCM_HVIntrnlVltStrng2_SigSts.Value
            IN_VeCRDB_y_BPCM_HVNrCelMaxTmp_SigSts_Value: accessed-variable=VeCRDB_y_BPCM_HVNrCelMaxTmp_SigSts.Value
            IN_VeCRDB_y_BPCM_HVNrCelMaxVlt_SigSts_Value: accessed-variable=VeCRDB_y_BPCM_HVNrCelMaxVlt_SigSts.Value
            IN_VeCRDB_y_BPCM_HVNrCelMinTmp_SigSts_Value: accessed-variable=VeCRDB_y_BPCM_HVNrCelMinTmp_SigSts.Value
            IN_VeCRDB_y_BPCM_HVNrCelMinVlt_SigSts_Value: accessed-variable=VeCRDB_y_BPCM_HVNrCelMinVlt_SigSts.Value
            IN_VeCRDB_y_BPCM_HVPwrMaxChgLT_SigSts_Value: accessed-variable=VeCRDB_y_BPCM_HVPwrMaxChgLT_SigSts.Value
            IN_VeCRDB_y_BPCM_HVPwrMaxChgMT_SigSts_Value: accessed-variable=VeCRDB_y_BPCM_HVPwrMaxChgMT_SigSts.Value
            IN_VeCRDB_y_BPCM_HVPwrMaxChgST_SigSts_Value: accessed-variable=VeCRDB_y_BPCM_HVPwrMaxChgST_SigSts.Value
            IN_VeCRDB_y_BPCM_HVPwrMxDchgLT_SigSts_Value: accessed-variable=VeCRDB_y_BPCM_HVPwrMxDchgLT_SigSts.Value
            IN_VeCRDB_y_BPCM_HVPwrMxDchgMT_SigSts_Value: accessed-variable=VeCRDB_y_BPCM_HVPwrMxDchgMT_SigSts.Value
            IN_VeCRDB_y_BPCM_HVPwrMxDchgST_SigSts_Value: accessed-variable=VeCRDB_y_BPCM_HVPwrMxDchgST_SigSts.Value
            IN_VeCRDB_y_BPCM_HVTracBusVolt_SigSts_Value: accessed-variable=VeCRDB_y_BPCM_HVTracBusVolt_SigSts.Value
            IN_VeCRDB_y_BPCM_HVTracMCS_Value: accessed-variable=VeCRDB_y_BPCM_HVTracMCS.Value
            IN_VeCRDB_y_BPCM_HVTracMCS_SigSts_Value: accessed-variable=VeCRDB_y_BPCM_HVTracMCS_SigSts.Value
            IN_VeCRDB_y_BPCM_HVTracMainCntacCfg_Value: accessed-variable=VeCRDB_y_BPCM_HVTracMainCntacCfg.Value, variation-point={short-label=vpIN_VeCRDB_y_BPCM_HVTracMainCntacCfg_Value, sw-syscond=1}
            IN_VeCRDB_y_BPCM_HVTracMainCntacCfg_SigSts_Value: accessed-variable=VeCRDB_y_BPCM_HVTracMainCntacCfg_SigSts.Value, variation-point={short-label=vpIN_VeCRDB_y_BPCM_HVTracMainCntacCfg_SigSts_Value, sw-syscond=1}
            IN_VeCRDB_y_BPCM_HV_BalngMd_Value: accessed-variable=VeCRDB_y_BPCM_HV_BalngMd.Value
            IN_VeCRDB_y_BPCM_HV_BalngMd_SigSts_Value: accessed-variable=VeCRDB_y_BPCM_HV_BalngMd_SigSts.Value
            IN_VeCRDB_y_BPCM_HV_BatChrgSts_Value: accessed-variable=VeCRDB_y_BPCM_HV_BatChrgSts.Value
            IN_VeCRDB_y_BPCM_HV_BatChrgSts_SigSts_Value: accessed-variable=VeCRDB_y_BPCM_HV_BatChrgSts_SigSts.Value
            IN_VeCRDB_y_BPCM_HV_Capacity_SigSts_Value: accessed-variable=VeCRDB_y_BPCM_HV_Capacity_SigSts.Value
            IN_VeCRDB_y_BPCM_HV_CurrentString2_SigSts_Value: accessed-variable=VeCRDB_y_BPCM_HV_CurrentString2_SigSts.Value
            IN_VeCRDB_y_BPCM_HV_Current_SigSts_Value: accessed-variable=VeCRDB_y_BPCM_HV_Current_SigSts.Value
            IN_VeCRDB_y_BPCM_HV_DCFC_IsolatnSts_Value: accessed-variable=VeCRDB_y_BPCM_HV_DCFC_IsolatnSts.Value
            IN_VeCRDB_y_BPCM_HV_DCFC_IsolatnSts_SigSts_Value: accessed-variable=VeCRDB_y_BPCM_HV_DCFC_IsolatnSts_SigSts.Value
            IN_VeCRDB_y_BPCM_HV_Inlet_Temp_SigSts_Value: accessed-variable=VeCRDB_y_BPCM_HV_Inlet_Temp_SigSts.Value
            IN_VeCRDB_y_BPCM_HV_IntVolt_SigSts_Value: accessed-variable=VeCRDB_y_BPCM_HV_IntVolt_SigSts.Value
            IN_VeCRDB_y_BPCM_HV_Outl_Temp_SigSts_Value: accessed-variable=VeCRDB_y_BPCM_HV_Outl_Temp_SigSts.Value
            IN_VeCRDB_y_BPCM_HV_SOC_SigSts_Value: accessed-variable=VeCRDB_y_BPCM_HV_SOC_SigSts.Value
            IN_VeCRDB_y_BPCM_HV_SOH_Value: accessed-variable=VeCRDB_y_BPCM_HV_SOH.Value
            IN_VeCRDB_y_BPCM_HV_SOH_Low_Value: accessed-variable=VeCRDB_y_BPCM_HV_SOH_Low.Value
            IN_VeCRDB_y_BPCM_HV_SOH_Low_SigSts_Value: accessed-variable=VeCRDB_y_BPCM_HV_SOH_Low_SigSts.Value
            IN_VeCRDB_y_BPCM_HV_SOH_SigSts_Value: accessed-variable=VeCRDB_y_BPCM_HV_SOH_SigSts.Value
            IN_VeCRDB_y_BPCM_HV_Temp_Avg_SigSts_Value: accessed-variable=VeCRDB_y_BPCM_HV_Temp_Avg_SigSts.Value
            IN_VeCRDB_y_BPCM_HV_Temp_Max_SigSts_Value: accessed-variable=VeCRDB_y_BPCM_HV_Temp_Max_SigSts.Value
            IN_VeCRDB_y_BPCM_HV_Temp_Min_SigSts_Value: accessed-variable=VeCRDB_y_BPCM_HV_Temp_Min_SigSts.Value
            IN_VeCRDB_y_BPCM_HV_ThermRnway_Value: accessed-variable=VeCRDB_y_BPCM_HV_ThermRnway.Value
            IN_VeCRDB_y_BPCM_HV_ThermRnway_SigSts_Value: accessed-variable=VeCRDB_y_BPCM_HV_ThermRnway_SigSts.Value
            IN_VeCRDB_y_BPCM_HV_TracBusSts_Value: accessed-variable=VeCRDB_y_BPCM_HV_TracBusSts.Value
            IN_VeCRDB_y_BPCM_HV_TracBusSts_SigSts_Value: accessed-variable=VeCRDB_y_BPCM_HV_TracBusSts_SigSts.Value
            IN_VeCRDB_y_BPCM_OCVAvgCelVolt_SigSts_Value: accessed-variable=VeCRDB_y_BPCM_OCVAvgCelVolt_SigSts.Value
            IN_VeCRDB_y_BPCM_OCVMaxCelVolt_SigSts_Value: accessed-variable=VeCRDB_y_BPCM_OCVMaxCelVolt_SigSts.Value
            IN_VeCRDB_y_BPCM_OCVMinCelVolt_SigSts_Value: accessed-variable=VeCRDB_y_BPCM_OCVMinCelVolt_SigSts.Value
            IN_VeCRDB_y_BPCM_PwrLimpHm_SigSts_Value: accessed-variable=VeCRDB_y_BPCM_PwrLimpHm_SigSts.Value
            IN_VeCRDB_y_BPCM_ReqforAuxLoadoff_SigSts_Value: accessed-variable=VeCRDB_y_BPCM_ReqforAuxLoadoff_SigSts.Value, variation-point={short-label=vpIN_VeCRDB_y_BPCM_ReqforAuxLoadoff_SigSts_Value, sw-syscond=1}
            IN_VeCRDB_y_BPCM_Series_Voltage_SigSts_Value: accessed-variable=VeCRDB_y_BPCM_Series_Voltage_SigSts.Value, variation-point={short-label=vpIN_VeCRDB_y_BPCM_Series_Voltage_SigSts_Value, sw-syscond=1}
            IN_VeCRDB_y_BatterySideCurrent_SigSts_Value: accessed-variable=VeCRDB_y_BatterySideCurrent_SigSts.Value
            IN_VeCRDB_y_BatterySideVoltage_SigSts_Value: accessed-variable=VeCRDB_y_BatterySideVoltage_SigSts.Value
            IN_VeCRDB_y_ChargeCurrent_SigSts_Value: accessed-variable=VeCRDB_y_ChargeCurrent_SigSts.Value
            IN_VeCRDB_y_ChargerFaultStates_Value: accessed-variable=VeCRDB_y_ChargerFaultStates.Value
            IN_VeCRDB_y_ChargerFaultStates_SigSts_Value: accessed-variable=VeCRDB_y_ChargerFaultStates_SigSts.Value
            IN_VeCRDB_y_ChrgCurrAvail_SigSts_Value: accessed-variable=VeCRDB_y_ChrgCurrAvail_SigSts.Value
            IN_VeCRDB_y_ChrgFailSts_Value: accessed-variable=VeCRDB_y_ChrgFailSts.Value
            IN_VeCRDB_y_ChrgFailSts_SigSts_Value: accessed-variable=VeCRDB_y_ChrgFailSts_SigSts.Value
            IN_VeCRDB_y_ChrgrWldDtctAvail_Value: accessed-variable=VeCRDB_y_ChrgrWldDtctAvail.Value
            IN_VeCRDB_y_ChrgrWldDtctAvail_SigSts_Value: accessed-variable=VeCRDB_y_ChrgrWldDtctAvail_SigSts.Value
            IN_VeCRDB_y_ControlPilotSts_Value: accessed-variable=VeCRDB_y_ControlPilotSts.Value
            IN_VeCRDB_y_ControlPilotSts_SigSts_Value: accessed-variable=VeCRDB_y_ControlPilotSts_SigSts.Value
            IN_VeCRDB_y_DC_Charge_Type_Status_Value: accessed-variable=VeCRDB_y_DC_Charge_Type_Status.Value, variation-point={short-label=vpIN_VeCRDB_y_DC_Charge_Type_Status_Value, sw-syscond=1}
            IN_VeCRDB_y_DC_Charge_Type_Status_SigSts_Value: accessed-variable=VeCRDB_y_DC_Charge_Type_Status_SigSts.Value, variation-point={short-label=vpIN_VeCRDB_y_DC_Charge_Type_Status_SigSts_Value, sw-syscond=1}
            IN_VeCRDB_y_DC_Isoln_Dsbl_Cmd_SigSts_Value: accessed-variable=VeCRDB_y_DC_Isoln_Dsbl_Cmd_SigSts.Value
            IN_VeCRDB_y_DC_TimeOut_SigSts_Value: accessed-variable=VeCRDB_y_DC_TimeOut_SigSts.Value
            IN_VeCRDB_y_EVCCFailrReason_Value: accessed-variable=VeCRDB_y_EVCCFailrReason.Value
            IN_VeCRDB_y_EVCCFailrReason_SigSts_Value: accessed-variable=VeCRDB_y_EVCCFailrReason_SigSts.Value
            IN_VeCRDB_y_EVCC_FailureSts_SigSts_Value: accessed-variable=VeCRDB_y_EVCC_FailureSts_SigSts.Value
            IN_VeCRDB_y_EVSEOfdACThreePhas_SigSts_Value: accessed-variable=VeCRDB_y_EVSEOfdACThreePhas_SigSts.Value
            IN_VeCRDB_y_EVSEOfrdEgyTrfTyp_Value: accessed-variable=VeCRDB_y_EVSEOfrdEgyTrfTyp.Value
            IN_VeCRDB_y_EVSEOfrdEgyTrfTyp_SigSts_Value: accessed-variable=VeCRDB_y_EVSEOfrdEgyTrfTyp_SigSts.Value
            IN_VeCRDB_y_EVSE_Acptd_Prtcl_SigSts_Value: accessed-variable=VeCRDB_y_EVSE_Acptd_Prtcl_SigSts.Value
            IN_VeCRDB_y_EVSE_ChrgStopCtrl_Value: accessed-variable=VeCRDB_y_EVSE_ChrgStopCtrl.Value
            IN_VeCRDB_y_EVSE_ChrgStopCtrl_SigSts_Value: accessed-variable=VeCRDB_y_EVSE_ChrgStopCtrl_SigSts.Value
            IN_VeCRDB_y_EVSE_Error_Value: accessed-variable=VeCRDB_y_EVSE_Error.Value
            IN_VeCRDB_y_EVSE_Error_SigSts_Value: accessed-variable=VeCRDB_y_EVSE_Error_SigSts.Value
            IN_VeCRDB_y_EVSE_FreeService_SigSts_Value: accessed-variable=VeCRDB_y_EVSE_FreeService_SigSts.Value
            IN_VeCRDB_y_EVSE_IsolationSts_Value: accessed-variable=VeCRDB_y_EVSE_IsolationSts.Value
            IN_VeCRDB_y_EVSE_IsolationSts_SigSts_Value: accessed-variable=VeCRDB_y_EVSE_IsolationSts_SigSts.Value
            IN_VeCRDB_y_EVSE_Notification_Value: accessed-variable=VeCRDB_y_EVSE_Notification.Value
            IN_VeCRDB_y_EVSE_Notification_SigSts_Value: accessed-variable=VeCRDB_y_EVSE_Notification_SigSts.Value
            IN_VeCRDB_y_EVSE_NtfcnMaxDly_SigSts_Value: accessed-variable=VeCRDB_y_EVSE_NtfcnMaxDly_SigSts.Value
            IN_VeCRDB_y_EVSE_OfdACSingPhas_SigSts_Value: accessed-variable=VeCRDB_y_EVSE_OfdACSingPhas_SigSts.Value
            IN_VeCRDB_y_EVSE_OfdPymtCntct_SigSts_Value: accessed-variable=VeCRDB_y_EVSE_OfdPymtCntct_SigSts.Value
            IN_VeCRDB_y_EVSE_OfrdPmtOptn_Value: accessed-variable=VeCRDB_y_EVSE_OfrdPmtOptn.Value
            IN_VeCRDB_y_EVSE_OfrdPmtOptn_SigSts_Value: accessed-variable=VeCRDB_y_EVSE_OfrdPmtOptn_SigSts.Value
            IN_VeCRDB_y_EVSE_OfrdPymntEIM_SigSts_Value: accessed-variable=VeCRDB_y_EVSE_OfrdPymntEIM_SigSts.Value
            IN_VeCRDB_y_EVSE_OfrdServ_Value: accessed-variable=VeCRDB_y_EVSE_OfrdServ.Value
            IN_VeCRDB_y_EVSE_OfrdServ_SigSts_Value: accessed-variable=VeCRDB_y_EVSE_OfrdServ_SigSts.Value
            IN_VeCRDB_y_EVSE_ServiceId_SigSts_Value: accessed-variable=VeCRDB_y_EVSE_ServiceId_SigSts.Value
            IN_VeCRDB_y_EVSE_Srvc2Crtfct_SigSts_Value: accessed-variable=VeCRDB_y_EVSE_Srvc2Crtfct_SigSts.Value
            IN_VeCRDB_y_EVSE_Supportd_DIN_SigSts_Value: accessed-variable=VeCRDB_y_EVSE_Supportd_DIN_SigSts.Value
            IN_VeCRDB_y_EVSE_Supprtd_ISO1_SigSts_Value: accessed-variable=VeCRDB_y_EVSE_Supprtd_ISO1_SigSts.Value
            IN_VeCRDB_y_ExtChargerSts_Value: accessed-variable=VeCRDB_y_ExtChargerSts.Value
            IN_VeCRDB_y_ExtChargerSts_SigSts_Value: accessed-variable=VeCRDB_y_ExtChargerSts_SigSts.Value
            IN_VeCRDB_y_HEV_OnRq_BPCM_SigSts_Value: accessed-variable=VeCRDB_y_HEV_OnRq_BPCM_SigSts.Value
            IN_VeCRDB_y_HVBP_BDU_Busbar_Temp_SigSts_Value: accessed-variable=VeCRDB_y_HVBP_BDU_Busbar_Temp_SigSts.Value
            IN_VeCRDB_y_HVBP_Busbar_Temp_SigSts_Value: accessed-variable=VeCRDB_y_HVBP_Busbar_Temp_SigSts.Value
            IN_VeCRDB_y_HVBatCelVoltHiThrs_SigSts_Value: accessed-variable=VeCRDB_y_HVBatCelVoltHiThrs_SigSts.Value
            IN_VeCRDB_y_HVBatCelVoltLoThrs_SigSts_Value: accessed-variable=VeCRDB_y_HVBatCelVoltLoThrs_SigSts.Value
            IN_VeCRDB_y_HVBatCntctOpnTime_SigSts_Value: accessed-variable=VeCRDB_y_HVBatCntctOpnTime_SigSts.Value
            IN_VeCRDB_y_HVBatCntctWeldChk_SigSts_Value: accessed-variable=VeCRDB_y_HVBatCntctWeldChk_SigSts.Value
            IN_VeCRDB_y_HVBatLastSlept_SigSts_Value: accessed-variable=VeCRDB_y_HVBatLastSlept_SigSts.Value
            IN_VeCRDB_y_HVBatReady_SigSts_Value: accessed-variable=VeCRDB_y_HVBatReady_SigSts.Value
            IN_VeCRDB_y_HVCMS_EVSECurLmAch_Value: accessed-variable=VeCRDB_y_HVCMS_EVSECurLmAch.Value
            IN_VeCRDB_y_HVCMS_EVSECurLmAch_SigSts_Value: accessed-variable=VeCRDB_y_HVCMS_EVSECurLmAch_SigSts.Value
            IN_VeCRDB_y_HVCMS_EVSECurRglTl_SigSts_Value: accessed-variable=VeCRDB_y_HVCMS_EVSECurRglTl_SigSts.Value
            IN_VeCRDB_y_HVCMS_EVSEID_SigSts_Value: accessed-variable=VeCRDB_y_HVCMS_EVSEID_SigSts.Value
            IN_VeCRDB_y_HVCMS_EVSEMaxCurLm_SigSts_Value: accessed-variable=VeCRDB_y_HVCMS_EVSEMaxCurLm_SigSts.Value
            IN_VeCRDB_y_HVCMS_EVSEMaxPwrLm_SigSts_Value: accessed-variable=VeCRDB_y_HVCMS_EVSEMaxPwrLm_SigSts.Value
            IN_VeCRDB_y_HVCMS_EVSEMaxVltLm_SigSts_Value: accessed-variable=VeCRDB_y_HVCMS_EVSEMaxVltLm_SigSts.Value
            IN_VeCRDB_y_HVCMS_EVSEMinCurLm_SigSts_Value: accessed-variable=VeCRDB_y_HVCMS_EVSEMinCurLm_SigSts.Value
            IN_VeCRDB_y_HVCMS_EVSEMinVltLm_SigSts_Value: accessed-variable=VeCRDB_y_HVCMS_EVSEMinVltLm_SigSts.Value
            IN_VeCRDB_y_HVCMS_EVSEPkCurRpl_SigSts_Value: accessed-variable=VeCRDB_y_HVCMS_EVSEPkCurRpl_SigSts.Value
            IN_VeCRDB_y_HVCMS_EVSEProcg_SigSts_Value: accessed-variable=VeCRDB_y_HVCMS_EVSEProcg_SigSts.Value
            IN_VeCRDB_y_HVCMS_EVSEPrsntCur_SigSts_Value: accessed-variable=VeCRDB_y_HVCMS_EVSEPrsntCur_SigSts.Value
            IN_VeCRDB_y_HVCMS_EVSEPrsntVlt_SigSts_Value: accessed-variable=VeCRDB_y_HVCMS_EVSEPrsntVlt_SigSts.Value
            IN_VeCRDB_y_HVCMS_EVSEPwrLmAch_Value: accessed-variable=VeCRDB_y_HVCMS_EVSEPwrLmAch.Value
            IN_VeCRDB_y_HVCMS_EVSEPwrLmAch_SigSts_Value: accessed-variable=VeCRDB_y_HVCMS_EVSEPwrLmAch_SigSts.Value
            IN_VeCRDB_y_HVCMS_EVSEStsCod_Value: accessed-variable=VeCRDB_y_HVCMS_EVSEStsCod.Value
            IN_VeCRDB_y_HVCMS_EVSEStsCod_SigSts_Value: accessed-variable=VeCRDB_y_HVCMS_EVSEStsCod_SigSts.Value
            IN_VeCRDB_y_HVCMS_EVSEVltLmAch_Value: accessed-variable=VeCRDB_y_HVCMS_EVSEVltLmAch.Value
            IN_VeCRDB_y_HVCMS_EVSEVltLmAch_SigSts_Value: accessed-variable=VeCRDB_y_HVCMS_EVSEVltLmAch_SigSts.Value
            IN_VeCRDB_y_HVCMS_EgToBDlvd_SigSts_Value: accessed-variable=VeCRDB_y_HVCMS_EgToBDlvd_SigSts.Value
            IN_VeCRDB_y_HVCMS_ResponseCode_Value: accessed-variable=VeCRDB_y_HVCMS_ResponseCode.Value
            IN_VeCRDB_y_HVCMS_ResponseCode_SigSts_Value: accessed-variable=VeCRDB_y_HVCMS_ResponseCode_SigSts.Value
            IN_VeCRDB_y_HVCMS_TxMsgStat_Value: accessed-variable=VeCRDB_y_HVCMS_TxMsgStat.Value
            IN_VeCRDB_y_HVCMS_TxMsgStat_SigSts_Value: accessed-variable=VeCRDB_y_HVCMS_TxMsgStat_SigSts.Value
            IN_VeCRDB_y_ImpactHardwireV_SigSts_Value: accessed-variable=VeCRDB_y_ImpactHardwireV_SigSts.Value
            IN_VeCRDB_y_ImpactHardwire_SigSts_Value: accessed-variable=VeCRDB_y_ImpactHardwire_SigSts.Value
            IN_VeCRDB_y_InputCurrentAvail_SigSts_Value: accessed-variable=VeCRDB_y_InputCurrentAvail_SigSts.Value
            IN_VeCRDB_y_J1772_S2_Sts_SigSts_Value: accessed-variable=VeCRDB_y_J1772_S2_Sts_SigSts.Value
            IN_VeCRDB_y_J1772_State_Value: accessed-variable=VeCRDB_y_J1772_State.Value
            IN_VeCRDB_y_J1772_State_SigSts_Value: accessed-variable=VeCRDB_y_J1772_State_SigSts.Value
            IN_VeCRDB_y_OBCInterlockSts_Value: accessed-variable=VeCRDB_y_OBCInterlockSts.Value
            IN_VeCRDB_y_OBCInterlockSts_SigSts_Value: accessed-variable=VeCRDB_y_OBCInterlockSts_SigSts.Value
            IN_VeCRDB_y_OBCM_CCSts_Value: accessed-variable=VeCRDB_y_OBCM_CCSts.Value
            IN_VeCRDB_y_OBCM_CCSts_SigSts_Value: accessed-variable=VeCRDB_y_OBCM_CCSts_SigSts.Value
            IN_VeCRDB_y_OBCM_CP1Sts_Value: accessed-variable=VeCRDB_y_OBCM_CP1Sts.Value
            IN_VeCRDB_y_OBCM_CP1Sts_SigSts_Value: accessed-variable=VeCRDB_y_OBCM_CP1Sts_SigSts.Value
            IN_VeCRDB_y_OBCM_CP2Sts_Value: accessed-variable=VeCRDB_y_OBCM_CP2Sts.Value
            IN_VeCRDB_y_OBCM_CP2Sts_SigSts_Value: accessed-variable=VeCRDB_y_OBCM_CP2Sts_SigSts.Value
            IN_VeCRDB_y_OBCM_CP3Sts_Value: accessed-variable=VeCRDB_y_OBCM_CP3Sts.Value
            IN_VeCRDB_y_OBCM_CP3Sts_SigSts_Value: accessed-variable=VeCRDB_y_OBCM_CP3Sts_SigSts.Value
            IN_VeCRDB_y_OBCM_CSSts_Value: accessed-variable=VeCRDB_y_OBCM_CSSts.Value
            IN_VeCRDB_y_OBCM_CSSts_SigSts_Value: accessed-variable=VeCRDB_y_OBCM_CSSts_SigSts.Value
            IN_VeCRDB_y_OBCM_PLCTypeSts_Value: accessed-variable=VeCRDB_y_OBCM_PLCTypeSts.Value
            IN_VeCRDB_y_OBCM_PLCTypeSts_SigSts_Value: accessed-variable=VeCRDB_y_OBCM_PLCTypeSts_SigSts.Value
            IN_VeCRDB_y_OBCM_SdpSts_Value: accessed-variable=VeCRDB_y_OBCM_SdpSts.Value
            IN_VeCRDB_y_OBCM_SdpSts_SigSts_Value: accessed-variable=VeCRDB_y_OBCM_SdpSts_SigSts.Value
            IN_VeCRDB_y_OBCM_SlacSts_Value: accessed-variable=VeCRDB_y_OBCM_SlacSts.Value
            IN_VeCRDB_y_OBCM_SlacSts_SigSts_Value: accessed-variable=VeCRDB_y_OBCM_SlacSts_SigSts.Value
            IN_VeCRDB_y_OBCM_Timeout_SigSts_Value: accessed-variable=VeCRDB_y_OBCM_Timeout_SigSts.Value
            IN_VeCRDB_y_OBC_Prox_SigSts_Value: accessed-variable=VeCRDB_y_OBC_Prox_SigSts.Value
            IN_VeCRDB_y_OBC_Temp{1..4}_SigSts_Value: accessed-variable=VeCRDB_y_OBC_Temp{1..4}_SigSts.Value
            IN_VeCRDB_y_OnboardChargerMode_Value: accessed-variable=VeCRDB_y_OnboardChargerMode.Value
            IN_VeCRDB_y_OnboardChargerMode_SigSts_Value: accessed-variable=VeCRDB_y_OnboardChargerMode_SigSts.Value
            IN_VeCRDB_y_OnboardChrgrReady_Value: accessed-variable=VeCRDB_y_OnboardChrgrReady.Value
            IN_VeCRDB_y_OnboardChrgrReady_SigSts_Value: accessed-variable=VeCRDB_y_OnboardChrgrReady_SigSts.Value
            IN_VeCRDB_y_ProximitySts_Value: accessed-variable=VeCRDB_y_ProximitySts.Value
            IN_VeCRDB_y_ProximitySts_SigSts_Value: accessed-variable=VeCRDB_y_ProximitySts_SigSts.Value
            IN_VeCRDB_y_ReceiptRequired_SigSts_Value: accessed-variable=VeCRDB_y_ReceiptRequired_SigSts.Value
            IN_VeCRDB_y_Supported_SchemaID_Value: accessed-variable=VeCRDB_y_Supported_SchemaID.Value
            IN_VeCRDB_y_Supported_SchemaID_SigSts_Value: accessed-variable=VeCRDB_y_Supported_SchemaID_SigSts.Value
            IN_VeCRDB_y_SuprtdProtocolName_Value: accessed-variable=VeCRDB_y_SuprtdProtocolName.Value
            IN_VeCRDB_y_SuprtdProtocolName_SigSts_Value: accessed-variable=VeCRDB_y_SuprtdProtocolName_SigSts.Value
            IN_VeCRDB_y_SuprtdVerNrMajor_Value: accessed-variable=VeCRDB_y_SuprtdVerNrMajor.Value
            IN_VeCRDB_y_SuprtdVerNrMajor_SigSts_Value: accessed-variable=VeCRDB_y_SuprtdVerNrMajor_SigSts.Value
            IN_VeCRDB_y_SuprtdVerNrMinor_Value: accessed-variable=VeCRDB_y_SuprtdVerNrMinor.Value
            IN_VeCRDB_y_SuprtdVerNrMinor_SigSts_Value: accessed-variable=VeCRDB_y_SuprtdVerNrMinor_SigSts.Value
            IN_VeCRDB_y_TCP_ComTerminated_SigSts_Value: accessed-variable=VeCRDB_y_TCP_ComTerminated_SigSts.Value
            IN_VeSR1B_I_ACOutputCurrent{1..3}_Value: accessed-variable=VeSR1B_I_ACOutputCurrent{1..3}.Value
            IN_VeSR1B_I_AcOuputCurrent_Value: accessed-variable=VeSR1B_I_AcOuputCurrent.Value
            IN_VeSR1B_I_AcOutputFrequency_Value: accessed-variable=VeSR1B_I_AcOutputFrequency.Value
            IN_VeSR1B_I_DCInputCurrent_Value: accessed-variable=VeSR1B_I_DCInputCurrent.Value
            IN_VeSR1B_I_V2X_InputCurrent_Value: accessed-variable=VeSR1B_I_V2X_InputCurrent.Value
            IN_VeSR1B_P_Available_Power_Value: accessed-variable=VeSR1B_P_Available_Power.Value
            IN_VeSR1B_P_V2X_Frequency_Value: accessed-variable=VeSR1B_P_V2X_Frequency.Value
            IN_VeSR1B_U_ACOutputVoltage{1..3}_Value: accessed-variable=VeSR1B_U_ACOutputVoltage{1..3}.Value
            IN_VeSR1B_U_AcOutputVoltage_Value: accessed-variable=VeSR1B_U_AcOutputVoltage.Value
            IN_VeSR1B_U_DCInputVoltage_Value: accessed-variable=VeSR1B_U_DCInputVoltage.Value
            IN_VeSR1B_U_V2X_InputVoltage_Value: accessed-variable=VeSR1B_U_V2X_InputVoltage.Value
            IN_VeSR1B_U_V2X_LV_Feed_Value: accessed-variable=VeSR1B_U_V2X_LV_Feed.Value
            IN_VeSR1B_b_EVSEServ1ChargnFD11_Value: accessed-variable=VeSR1B_b_EVSEServ1ChargnFD11.Value
            IN_VeSR1B_b_EVSE_Ofd_DC_Extended_Value: accessed-variable=VeSR1B_b_EVSE_Ofd_DC_Extended.Value
            IN_VeSR1B_b_EVSE_Service1_FreeFD11_Value: accessed-variable=VeSR1B_b_EVSE_Service1_FreeFD11.Value
            IN_VeSR1B_b_IDCM_GFCI_Fault_Status_Value: accessed-variable=VeSR1B_b_IDCM_GFCI_Fault_Status.Value, variation-point={short-label=vpIN_VeSR1B_b_IDCM_GFCI_Fault_Status_Value, sw-syscond=1}
            IN_VeSR1B_b_ISO15118_TLSoffrdFD11_Value: accessed-variable=VeSR1B_b_ISO15118_TLSoffrdFD11.Value
            IN_VeSR1B_b_V2X_Derate_Status_Value: accessed-variable=VeSR1B_b_V2X_Derate_Status.Value
            IN_VeSR1B_b_V2X_EVSE_Service5_Free_Value: accessed-variable=VeSR1B_b_V2X_EVSE_Service5_Free.Value
            IN_VeSR1B_b_V2X_EVSE_Service_5_V2H_Value: accessed-variable=VeSR1B_b_V2X_EVSE_Service_5_V2H.Value
            IN_VeSR1B_b_V2X_FailSts_Value: accessed-variable=VeSR1B_b_V2X_FailSts.Value
            IN_VeSR1B_cmp_ISO15118EVSETiStFD11_Value: accessed-variable=VeSR1B_cmp_ISO15118EVSETiStFD11.Value
            IN_VeSR1B_d_ISO15118_ServiceIDFD11_Value: accessed-variable=VeSR1B_d_ISO15118_ServiceIDFD11.Value
            IN_VeSR1B_t_ISO15118NtfcnMxDlyFD11_Value: accessed-variable=VeSR1B_t_ISO15118NtfcnMxDlyFD11.Value
            IN_VeSR1B_y_ACOutputCurrent{1..3}_SigSts_Value: accessed-variable=VeSR1B_y_ACOutputCurrent{1..3}_SigSts.Value
            IN_VeSR1B_y_ACOutputVoltage{1..3}_SigSts_Value: accessed-variable=VeSR1B_y_ACOutputVoltage{1..3}_SigSts.Value
            IN_VeSR1B_y_ACOutput_Frequency_Value: accessed-variable=VeSR1B_y_ACOutput_Frequency.Value
            IN_VeSR1B_y_ACOutput_Frequency_SigSts_Value: accessed-variable=VeSR1B_y_ACOutput_Frequency_SigSts.Value
            IN_VeSR1B_y_AcOuputCurrent_SigSts_Value: accessed-variable=VeSR1B_y_AcOuputCurrent_SigSts.Value
            IN_VeSR1B_y_AcOutputFrequency_SigSts_Value: accessed-variable=VeSR1B_y_AcOutputFrequency_SigSts.Value
            IN_VeSR1B_y_AcOutputVoltage_SigSts_Value: accessed-variable=VeSR1B_y_AcOutputVoltage_SigSts.Value
            IN_VeSR1B_y_Available_Power_SigSts_Value: accessed-variable=VeSR1B_y_Available_Power_SigSts.Value
            IN_VeSR1B_y_DCInputCurrent_SigSts_Value: accessed-variable=VeSR1B_y_DCInputCurrent_SigSts.Value
            IN_VeSR1B_y_DCInputVoltage_SigSts_Value: accessed-variable=VeSR1B_y_DCInputVoltage_SigSts.Value
            IN_VeSR1B_y_DischargeFaultStatus_Value: accessed-variable=VeSR1B_y_DischargeFaultStatus.Value
            IN_VeSR1B_y_DischargeFaultStatus_SigSts_Value: accessed-variable=VeSR1B_y_DischargeFaultStatus_SigSts.Value
            IN_VeSR1B_y_EVSEServ1ChargnFD11_SigSts_Value: accessed-variable=VeSR1B_y_EVSEServ1ChargnFD11_SigSts.Value
            IN_VeSR1B_y_EVSE_Ofd_DC_Extended_SigSts_Value: accessed-variable=VeSR1B_y_EVSE_Ofd_DC_Extended_SigSts.Value
            IN_VeSR1B_y_EVSE_Service1_FreeFD11_SigSts_Value: accessed-variable=VeSR1B_y_EVSE_Service1_FreeFD11_SigSts.Value
            IN_VeSR1B_y_IDCM_GFCI_Fault_Status_SigSts_Value: accessed-variable=VeSR1B_y_IDCM_GFCI_Fault_Status_SigSts.Value, variation-point={short-label=vpIN_VeSR1B_y_IDCM_GFCI_Fault_Status_SigSts_Value, sw-syscond=1}
            IN_VeSR1B_y_ISO15118EVSETiStFD11_SigSts_Value: accessed-variable=VeSR1B_y_ISO15118EVSETiStFD11_SigSts.Value
            IN_VeSR1B_y_ISO15118NtfcnMxDlyFD11_SigSts_Value: accessed-variable=VeSR1B_y_ISO15118NtfcnMxDlyFD11_SigSts.Value
            IN_VeSR1B_y_ISO15118SAScdlTlIDFD11_Value: accessed-variable=VeSR1B_y_ISO15118SAScdlTlIDFD11.Value
            IN_VeSR1B_y_ISO15118SAScdlTlIDFD11_SigSts_Value: accessed-variable=VeSR1B_y_ISO15118SAScdlTlIDFD11_SigSts.Value
            IN_VeSR1B_y_ISO15118VrsnNmMajrFD11_Value: accessed-variable=VeSR1B_y_ISO15118VrsnNmMajrFD11.Value
            IN_VeSR1B_y_ISO15118VrsnNmMajrFD11_SigSts_Value: accessed-variable=VeSR1B_y_ISO15118VrsnNmMajrFD11_SigSts.Value
            IN_VeSR1B_y_ISO15118VrsnNmMinrFD11_Value: accessed-variable=VeSR1B_y_ISO15118VrsnNmMinrFD11.Value
            IN_VeSR1B_y_ISO15118VrsnNmMinrFD11_SigSts_Value: accessed-variable=VeSR1B_y_ISO15118VrsnNmMinrFD11_SigSts.Value
            IN_VeSR1B_y_ISO15118_MsgRespFD11_Value: accessed-variable=VeSR1B_y_ISO15118_MsgRespFD11.Value
            IN_VeSR1B_y_ISO15118_MsgRespFD11_SigSts_Value: accessed-variable=VeSR1B_y_ISO15118_MsgRespFD11_SigSts.Value
            IN_VeSR1B_y_ISO15118_RespCodFD11_Value: accessed-variable=VeSR1B_y_ISO15118_RespCodFD11.Value
            IN_VeSR1B_y_ISO15118_RespCodFD11_SigSts_Value: accessed-variable=VeSR1B_y_ISO15118_RespCodFD11_SigSts.Value
            IN_VeSR1B_y_ISO15118_SchemaID_FD11_Value: accessed-variable=VeSR1B_y_ISO15118_SchemaID_FD11.Value
            IN_VeSR1B_y_ISO15118_SchemaID_FD11_SigSts_Value: accessed-variable=VeSR1B_y_ISO15118_SchemaID_FD11_SigSts.Value
            IN_VeSR1B_y_ISO15118_ServiceIDFD11_SigSts_Value: accessed-variable=VeSR1B_y_ISO15118_ServiceIDFD11_SigSts.Value
            IN_VeSR1B_y_ISO15118_TLSStatusFD11_Value: accessed-variable=VeSR1B_y_ISO15118_TLSStatusFD11.Value
            IN_VeSR1B_y_ISO15118_TLSStatusFD11_SigSts_Value: accessed-variable=VeSR1B_y_ISO15118_TLSStatusFD11_SigSts.Value
            IN_VeSR1B_y_ISO15118_TLSoffrdFD11_SigSts_Value: accessed-variable=VeSR1B_y_ISO15118_TLSoffrdFD11_SigSts.Value
            IN_VeSR1B_y_V2X_Derate_Reason_Value: accessed-variable=VeSR1B_y_V2X_Derate_Reason.Value
            IN_VeSR1B_y_V2X_Derate_Reason_SigSts_Value: accessed-variable=VeSR1B_y_V2X_Derate_Reason_SigSts.Value
            IN_VeSR1B_y_V2X_Derate_Status_SigSts_Value: accessed-variable=VeSR1B_y_V2X_Derate_Status_SigSts.Value
            IN_VeSR1B_y_V2X_EVSE_Service5_Free_SigSts_Value: accessed-variable=VeSR1B_y_V2X_EVSE_Service5_Free_SigSts.Value
            IN_VeSR1B_y_V2X_EVSE_Service_5_V2H_SigSts_Value: accessed-variable=VeSR1B_y_V2X_EVSE_Service_5_V2H_SigSts.Value
            IN_VeSR1B_y_V2X_FailSts_SigSts_Value: accessed-variable=VeSR1B_y_V2X_FailSts_SigSts.Value
            IN_VeSR1B_y_V2X_FaultRsn_Value: accessed-variable=VeSR1B_y_V2X_FaultRsn.Value
            IN_VeSR1B_y_V2X_FaultRsn_SigSts_Value: accessed-variable=VeSR1B_y_V2X_FaultRsn_SigSts.Value
            IN_VeSR1B_y_V2X_Frequency_SigSts_Value: accessed-variable=VeSR1B_y_V2X_Frequency_SigSts.Value
            IN_VeSR1B_y_V2X_InputCurrent_SigSts_Value: accessed-variable=VeSR1B_y_V2X_InputCurrent_SigSts.Value
            IN_VeSR1B_y_V2X_InputVoltage_SigSts_Value: accessed-variable=VeSR1B_y_V2X_InputVoltage_SigSts.Value
            IN_VeSR1B_y_V2X_InterlockSts_Value: accessed-variable=VeSR1B_y_V2X_InterlockSts.Value
            IN_VeSR1B_y_V2X_InterlockSts_SigSts_Value: accessed-variable=VeSR1B_y_V2X_InterlockSts_SigSts.Value
            IN_VeSR1B_y_V2X_LV_Feed_SigSts_Value: accessed-variable=VeSR1B_y_V2X_LV_Feed_SigSts.Value
            IN_VeSR1B_y_V2X_Modefeedback_Value: accessed-variable=VeSR1B_y_V2X_Modefeedback.Value
            IN_VeSR1B_y_V2X_Modefeedback_SigSts_Value: accessed-variable=VeSR1B_y_V2X_Modefeedback_SigSts.Value
            IN_VeSR1B_y_V2X_Status_Value: accessed-variable=VeSR1B_y_V2X_Status.Value
            IN_VeSR1B_y_V2X_Status_SigSts_Value: accessed-variable=VeSR1B_y_V2X_Status_SigSts.Value
        419 x sync call, all with timeout=1E-06:
          SC_FsftBPCR_I_HV_BatCurr_FsftBPCR_I_HV_BatCurr: operation=FsftBPCR_I_HV_BatCurr.FsftBPCR_I_HV_BatCurr
          SC_FsftBPCR_I_MaxChgCurrAlwd_FsftBPCR_I_MaxChgCurrAlwd: operation=FsftBPCR_I_MaxChgCurrAlwd.FsftBPCR_I_MaxChgCurrAlwd
          SC_FsftBPCR_U_CellVoltHighThrsh_FsftBPCR_U_CellVoltHighThrsh: operation=FsftBPCR_U_CellVoltHighThrsh.FsftBPCR_U_CellVoltHighThrsh
          SC_FsftBPCR_U_CellVoltLowThrsh_FsftBPCR_U_CellVoltLowThrsh: operation=FsftBPCR_U_CellVoltLowThrsh.FsftBPCR_U_CellVoltLowThrsh
          SC_FsftBPCR_U_HV_BatModVoltAvg_FsftBPCR_U_HV_BatModVoltAvg: operation=FsftBPCR_U_HV_BatModVoltAvg.FsftBPCR_U_HV_BatModVoltAvg
          SC_FsftBPCR_U_HV_BatModVoltMax_FsftBPCR_U_HV_BatModVoltMax: operation=FsftBPCR_U_HV_BatModVoltMax.FsftBPCR_U_HV_BatModVoltMax
          SC_FsftBPCR_U_HV_BatModVoltMin_FsftBPCR_U_HV_BatModVoltMin: operation=FsftBPCR_U_HV_BatModVoltMin.FsftBPCR_U_HV_BatModVoltMin
          SC_FsftBPCR_U_HV_BatVolt_FsftBPCR_U_HV_BatVolt: operation=FsftBPCR_U_HV_BatVolt.FsftBPCR_U_HV_BatVolt
          SC_FsftBPCR_U_MaxCellVltAlld_FsftBPCR_U_MaxCellVltAlld: operation=FsftBPCR_U_MaxCellVltAlld.FsftBPCR_U_MaxCellVltAlld
          SC_FsftBPCR_U_MaxPkVltAlld_FsftBPCR_U_MaxPkVltAlld: operation=FsftBPCR_U_MaxPkVltAlld.FsftBPCR_U_MaxPkVltAlld
          SC_FsftBPCR_U_MinCellVltAlld_FsftBPCR_U_MinCellVltAlld: operation=FsftBPCR_U_MinCellVltAlld.FsftBPCR_U_MinCellVltAlld
          SC_FsftBPCR_U_MinPkVltAlld_FsftBPCR_U_MinPkVltAlld: operation=FsftBPCR_U_MinPkVltAlld.FsftBPCR_U_MinPkVltAlld
          SC_FsftBPCR_U_OCVAveCellVoltage_FsftBPCR_U_OCVAveCellVoltage: operation=FsftBPCR_U_OCVAveCellVoltage.FsftBPCR_U_OCVAveCellVoltage
          SC_FsftBPCR_U_OCVMaxCellVoltage_FsftBPCR_U_OCVMaxCellVoltage: operation=FsftBPCR_U_OCVMaxCellVoltage.FsftBPCR_U_OCVMaxCellVoltage
          SC_FsftBPCR_U_OCVMinCellVoltage_FsftBPCR_U_OCVMinCellVoltage: operation=FsftBPCR_U_OCVMinCellVoltage.FsftBPCR_U_OCVMinCellVoltage
          SC_FsftBPCR_Z_MaxCellDischargeImpedance_FsftBPCR_Z_MaxCellDischargeImpedance: operation=FsftBPCR_Z_MaxCellDischargeImpedance.FsftBPCR_Z_MaxCellDischargeImpedance
          SC_FsftBPCR_Z_MinCellDischargeImpedance_FsftBPCR_Z_MinCellDischargeImpedance: operation=FsftBPCR_Z_MinCellDischargeImpedance.FsftBPCR_Z_MinCellDischargeImpedance
          SC_FsftBPCR_b_HVBatCntrWeld_ImpdOpn_FsftBPCR_b_HVBatCntrWeld_ImpdOpn: operation=FsftBPCR_b_HVBatCntrWeld_ImpdOpn.FsftBPCR_b_HVBatCntrWeld_ImpdOpn
          SC_FsftBPCR_b_HVBatRdy_FsftBPCR_b_HVBatRdy: operation=FsftBPCR_b_HVBatRdy.FsftBPCR_b_HVBatRdy
          SC_FsftBPCR_b_HVBat_DC_CntctrStat_FsftBPCR_b_HVBat_DC_CntctrStat: operation=FsftBPCR_b_HVBat_DC_CntctrStat.FsftBPCR_b_HVBat_DC_CntctrStat
          SC_FsftBPCR_b_HV_AuxLoadOffReq_FsftBPCR_b_HV_AuxLoadOffReq: operation=FsftBPCR_b_HV_AuxLoadOffReq.FsftBPCR_b_HV_AuxLoadOffReq, variation-point={short-label=vpSC_FsftBPCR_b_HV_AuxLoadOffReq_FsftBPCR_b_HV_AuxLoadOffReq, sw-syscond=1}
          SC_FsftBPCR_b_HV_BatChrgPwrET_FsftBPCR_b_HV_BatChrgPwrET: operation=FsftBPCR_b_HV_BatChrgPwrET.FsftBPCR_b_HV_BatChrgPwrET
          SC_FsftBPCR_b_HV_BatChrgPwrLT_FsftBPCR_b_HV_BatChrgPwrLT: operation=FsftBPCR_b_HV_BatChrgPwrLT.FsftBPCR_b_HV_BatChrgPwrLT
          SC_FsftBPCR_b_HV_BatChrgPwrST_FsftBPCR_b_HV_BatChrgPwrST: operation=FsftBPCR_b_HV_BatChrgPwrST.FsftBPCR_b_HV_BatChrgPwrST
          SC_FsftBPCR_b_HV_BatCurrString2_FsftBPCR_b_HV_BatCurrString2: operation=FsftBPCR_b_HV_BatCurrString2.FsftBPCR_b_HV_BatCurrString2
          SC_FsftBPCR_b_HV_BatDschrgPwrET_FsftBPCR_b_HV_BatDschrgPwrET: operation=FsftBPCR_b_HV_BatDschrgPwrET.FsftBPCR_b_HV_BatDschrgPwrET
          SC_FsftBPCR_b_HV_BatDschrgPwrLT_FsftBPCR_b_HV_BatDschrgPwrLT: operation=FsftBPCR_b_HV_BatDschrgPwrLT.FsftBPCR_b_HV_BatDschrgPwrLT
          SC_FsftBPCR_b_HV_BatDschrgPwrST_FsftBPCR_b_HV_BatDschrgPwrST: operation=FsftBPCR_b_HV_BatDschrgPwrST.FsftBPCR_b_HV_BatDschrgPwrST
          SC_FsftBPCR_b_HV_BatModTempAvg_FsftBPCR_b_HV_BatModTempAvg: operation=FsftBPCR_b_HV_BatModTempAvg.FsftBPCR_b_HV_BatModTempAvg
          SC_FsftBPCR_b_HV_BatModTempMax_FsftBPCR_b_HV_BatModTempMax: operation=FsftBPCR_b_HV_BatModTempMax.FsftBPCR_b_HV_BatModTempMax
          SC_FsftBPCR_b_HV_BatModTempMin_FsftBPCR_b_HV_BatModTempMin: operation=FsftBPCR_b_HV_BatModTempMin.FsftBPCR_b_HV_BatModTempMin
          SC_FsftBPCR_b_HV_BatPackSOC_FsftBPCR_b_HV_BatPackSOC: operation=FsftBPCR_b_HV_BatPackSOC.FsftBPCR_b_HV_BatPackSOC
          SC_FsftBPCR_b_HV_DcChargeTypeStat_FsftBPCR_b_HV_DcChargeTypeStat: operation=FsftBPCR_b_HV_DcChargeTypeStat.FsftBPCR_b_HV_DcChargeTypeStat, variation-point={short-label=vpSC_FsftBPCR_b_HV_DcChargeTypeStat_FsftBPCR_b_HV_DcChargeTypeStat, sw-syscond=1}
          SC_FsftBPCR_b_HV_InternalStringVolt1_FsftBPCR_b_HV_InternalStringVolt1: operation=FsftBPCR_b_HV_InternalStringVolt1.FsftBPCR_b_HV_InternalStringVolt1
          SC_FsftBPCR_b_HV_InternalStringVolt2_FsftBPCR_b_HV_InternalStringVolt2: operation=FsftBPCR_b_HV_InternalStringVolt2.FsftBPCR_b_HV_InternalStringVolt2
          SC_FsftBPCR_b_HV_InternalVolt_FsftBPCR_b_HV_InternalVolt: operation=FsftBPCR_b_HV_InternalVolt.FsftBPCR_b_HV_InternalVolt
          SC_FsftBPCR_b_HV_SeriesVolt_FsftBPCR_b_HV_SeriesVolt: operation=FsftBPCR_b_HV_SeriesVolt.FsftBPCR_b_HV_SeriesVolt, variation-point={short-label=vpSC_FsftBPCR_b_HV_SeriesVolt_FsftBPCR_b_HV_SeriesVolt, sw-syscond=1}
          SC_FsftBPCR_b_HV_TracBatCntctrConfig_FsftBPCR_b_HV_TracBatCntctrConfig: operation=FsftBPCR_b_HV_TracBatCntctrConfig.FsftBPCR_b_HV_TracBatCntctrConfig, variation-point={short-label=vpSC_FsftBPCR_b_HV_TracBatCntctrConfig_FsftBPCR_b_HV_TracBatCntctrConfig, sw-syscond=1}
          SC_FsftBPCR_b_ThrmlRnawy_Warn_FsftBPCR_b_ThrmlRnawy_Warn: operation=FsftBPCR_b_ThrmlRnawy_Warn.FsftBPCR_b_ThrmlRnawy_Warn
          SC_FsftBPCR_e_ChargingStat_BPCM_FsftBPCR_e_ChargingStat_BPCM: operation=FsftBPCR_e_ChargingStat_BPCM.FsftBPCR_e_ChargingStat_BPCM
          SC_FsftBPCR_e_DCIsolSts_FsftBPCR_e_DCIsolSts: operation=FsftBPCR_e_DCIsolSts.FsftBPCR_e_DCIsolSts
          SC_FsftBPCR_e_HVBatIntrlkIntrnlStat_FsftBPCR_e_HVBatIntrlkIntrnlStat: operation=FsftBPCR_e_HVBatIntrlkIntrnlStat.FsftBPCR_e_HVBatIntrlkIntrnlStat
          SC_FsftBPCR_e_HV_BatCntctrStat_FsftBPCR_e_HV_BatCntctrStat: operation=FsftBPCR_e_HV_BatCntctrStat.FsftBPCR_e_HV_BatCntctrStat
          SC_FsftBPCR_e_HV_BatInrlkStat_FsftBPCR_e_HV_BatInrlkStat: operation=FsftBPCR_e_HV_BatInrlkStat.FsftBPCR_e_HV_BatInrlkStat
          SC_FsftBPCR_e_HV_BatIsolStat_FsftBPCR_e_HV_BatIsolStat: operation=FsftBPCR_e_HV_BatIsolStat.FsftBPCR_e_HV_BatIsolStat
          SC_FsftBPCR_q_FullAmpHrCap_FsftBPCR_q_FullAmpHrCap: operation=FsftBPCR_q_FullAmpHrCap.FsftBPCR_q_FullAmpHrCap
          SC_FsftBPCR_t_HVBattCntctrOpnTm_FsftBPCR_t_HVBattCntctrOpnTm: operation=FsftBPCR_t_HVBattCntctrOpnTm.FsftBPCR_t_HVBattCntctrOpnTm
          SC_FsftIDCR_E_EVSE_EnrgyToBeDlvrd_FsftIDCR_E_EVSE_EnrgyToBeDlvrd: operation=FsftIDCR_E_EVSE_EnrgyToBeDlvrd.FsftIDCR_E_EVSE_EnrgyToBeDlvrd
          SC_FsftIDCR_I_ACOutCurrent{1..3}_FsftIDCR_I_ACOutCurrent{1..3}: operation=FsftIDCR_I_ACOutCurrent{1..3}.FsftIDCR_I_ACOutCurrent{1..3}
          SC_FsftIDCR_I_ACSideCurr_L2_FsftIDCR_I_ACSideCurr_L2: operation=FsftIDCR_I_ACSideCurr_L2.FsftIDCR_I_ACSideCurr_L2
          SC_FsftIDCR_I_ACSideCurr_L3_FsftIDCR_I_ACSideCurr_L3: operation=FsftIDCR_I_ACSideCurr_L3.FsftIDCR_I_ACSideCurr_L3
          SC_FsftIDCR_I_AC_Side_Curr_FsftIDCR_I_AC_Side_Curr: operation=FsftIDCR_I_AC_Side_Curr.FsftIDCR_I_AC_Side_Curr
          SC_FsftIDCR_I_APM_HV_Current_FsftIDCR_I_APM_HV_Current: operation=FsftIDCR_I_APM_HV_Current.FsftIDCR_I_APM_HV_Current
          SC_FsftIDCR_I_APM_LV_Current_FsftIDCR_I_APM_LV_Current: operation=FsftIDCR_I_APM_LV_Current.FsftIDCR_I_APM_LV_Current
          SC_FsftIDCR_I_AcOutCurrent_FsftIDCR_I_AcOutCurrent: operation=FsftIDCR_I_AcOutCurrent.FsftIDCR_I_AcOutCurrent
          SC_FsftIDCR_I_BattSide_Curr_FsftIDCR_I_BattSide_Curr: operation=FsftIDCR_I_BattSide_Curr.FsftIDCR_I_BattSide_Curr
          SC_FsftIDCR_I_ChrgCrntAvail_FsftIDCR_I_ChrgCrntAvail: operation=FsftIDCR_I_ChrgCrntAvail.FsftIDCR_I_ChrgCrntAvail
          SC_FsftIDCR_I_ChrgCurrent_FsftIDCR_I_ChrgCurrent: operation=FsftIDCR_I_ChrgCurrent.FsftIDCR_I_ChrgCurrent
          SC_FsftIDCR_I_DCInCurrent_FsftIDCR_I_DCInCurrent: operation=FsftIDCR_I_DCInCurrent.FsftIDCR_I_DCInCurrent
          SC_FsftIDCR_I_EVSECurr_RegTol_FsftIDCR_I_EVSECurr_RegTol: operation=FsftIDCR_I_EVSECurr_RegTol.FsftIDCR_I_EVSECurr_RegTol
          SC_FsftIDCR_I_EVSEMaxCurrLmt_FsftIDCR_I_EVSEMaxCurrLmt: operation=FsftIDCR_I_EVSEMaxCurrLmt.FsftIDCR_I_EVSEMaxCurrLmt
          SC_FsftIDCR_I_EVSEMinCurrLmt_FsftIDCR_I_EVSEMinCurrLmt: operation=FsftIDCR_I_EVSEMinCurrLmt.FsftIDCR_I_EVSEMinCurrLmt
          SC_FsftIDCR_I_EVSEOutputCurr_FsftIDCR_I_EVSEOutputCurr: operation=FsftIDCR_I_EVSEOutputCurr.FsftIDCR_I_EVSEOutputCurr
          SC_FsftIDCR_I_EVSEPeakCurrRip_FsftIDCR_I_EVSEPeakCurrRip: operation=FsftIDCR_I_EVSEPeakCurrRip.FsftIDCR_I_EVSEPeakCurrRip
          SC_FsftIDCR_I_IdcHvSetPFdbk_FsftIDCR_I_IdcHvSetPFdbk: operation=FsftIDCR_I_IdcHvSetPFdbk.FsftIDCR_I_IdcHvSetPFdbk
          SC_FsftIDCR_I_J1772InputCrntAval_FsftIDCR_I_J1772InputCrntAval: operation=FsftIDCR_I_J1772InputCrntAval.FsftIDCR_I_J1772InputCrntAval
          SC_FsftIDCR_I_V2XInCurrent_FsftIDCR_I_V2XInCurrent: operation=FsftIDCR_I_V2XInCurrent.FsftIDCR_I_V2XInCurrent
          SC_FsftIDCR_P_APM_InputPower_FsftIDCR_P_APM_InputPower: operation=FsftIDCR_P_APM_InputPower.FsftIDCR_P_APM_InputPower
          SC_FsftIDCR_P_APM_OutputPower_FsftIDCR_P_APM_OutputPower: operation=FsftIDCR_P_APM_OutputPower.FsftIDCR_P_APM_OutputPower
          SC_FsftIDCR_P_APM_PwrLoss_FsftIDCR_P_APM_PwrLoss: operation=FsftIDCR_P_APM_PwrLoss.FsftIDCR_P_APM_PwrLoss
          SC_FsftIDCR_P_AvailablePower_FsftIDCR_P_AvailablePower: operation=FsftIDCR_P_AvailablePower.FsftIDCR_P_AvailablePower
          SC_FsftIDCR_P_EVSEMaxPwrLmt_FsftIDCR_P_EVSEMaxPwrLmt: operation=FsftIDCR_P_EVSEMaxPwrLmt.FsftIDCR_P_EVSEMaxPwrLmt
          SC_FsftIDCR_Pct_UtilPctOfDCDC_FsftIDCR_Pct_UtilPctOfDCDC: operation=FsftIDCR_Pct_UtilPctOfDCDC.FsftIDCR_Pct_UtilPctOfDCDC
          SC_FsftIDCR_T_APM_TempColdPlate_FsftIDCR_T_APM_TempColdPlate: operation=FsftIDCR_T_APM_TempColdPlate.FsftIDCR_T_APM_TempColdPlate
          SC_FsftIDCR_T_Temp1_FsftIDCR_T_Temp1: operation=FsftIDCR_T_Temp1.FsftIDCR_T_Temp1
          SC_FsftIDCR_T_Temp2_FsftIDCR_T_Temp2: operation=FsftIDCR_T_Temp2.FsftIDCR_T_Temp2
          SC_FsftIDCR_U_ACOutVoltage{1..3}_FsftIDCR_U_ACOutVoltage{1..3}: operation=FsftIDCR_U_ACOutVoltage{1..3}.FsftIDCR_U_ACOutVoltage{1..3}
          SC_FsftIDCR_U_ACSideVolt_L2_FsftIDCR_U_ACSideVolt_L2: operation=FsftIDCR_U_ACSideVolt_L2.FsftIDCR_U_ACSideVolt_L2
          SC_FsftIDCR_U_ACSideVolt_L3_FsftIDCR_U_ACSideVolt_L3: operation=FsftIDCR_U_ACSideVolt_L3.FsftIDCR_U_ACSideVolt_L3
          SC_FsftIDCR_U_AC_InputVltOBCM_FsftIDCR_U_AC_InputVltOBCM: operation=FsftIDCR_U_AC_InputVltOBCM.FsftIDCR_U_AC_InputVltOBCM
          SC_FsftIDCR_U_APM_HV_Voltage_FsftIDCR_U_APM_HV_Voltage: operation=FsftIDCR_U_APM_HV_Voltage.FsftIDCR_U_APM_HV_Voltage
          SC_FsftIDCR_U_APM_HvVsetPFdbk_FsftIDCR_U_APM_HvVsetPFdbk: operation=FsftIDCR_U_APM_HvVsetPFdbk.FsftIDCR_U_APM_HvVsetPFdbk
          SC_FsftIDCR_U_APM_LV_Voltage_FsftIDCR_U_APM_LV_Voltage: operation=FsftIDCR_U_APM_LV_Voltage.FsftIDCR_U_APM_LV_Voltage
          SC_FsftIDCR_U_AcOutVoltage_FsftIDCR_U_AcOutVoltage: operation=FsftIDCR_U_AcOutVoltage.FsftIDCR_U_AcOutVoltage
          SC_FsftIDCR_U_BattSideVolt_FsftIDCR_U_BattSideVolt: operation=FsftIDCR_U_BattSideVolt.FsftIDCR_U_BattSideVolt
          SC_FsftIDCR_U_DCInVoltage_FsftIDCR_U_DCInVoltage: operation=FsftIDCR_U_DCInVoltage.FsftIDCR_U_DCInVoltage
          SC_FsftIDCR_U_EVSEMaxVoltLmt_FsftIDCR_U_EVSEMaxVoltLmt: operation=FsftIDCR_U_EVSEMaxVoltLmt.FsftIDCR_U_EVSEMaxVoltLmt
          SC_FsftIDCR_U_EVSEMinVoltLmt_FsftIDCR_U_EVSEMinVoltLmt: operation=FsftIDCR_U_EVSEMinVoltLmt.FsftIDCR_U_EVSEMinVoltLmt
          SC_FsftIDCR_U_EVSEOutputVolt_FsftIDCR_U_EVSEOutputVolt: operation=FsftIDCR_U_EVSEOutputVolt.FsftIDCR_U_EVSEOutputVolt
          SC_FsftIDCR_U_EVSE_ThrshldVoltage_FsftIDCR_U_EVSE_ThrshldVoltage: operation=FsftIDCR_U_EVSE_ThrshldVoltage.FsftIDCR_U_EVSE_ThrshldVoltage
          SC_FsftIDCR_U_OBC_Prox_FsftIDCR_U_OBC_Prox: operation=FsftIDCR_U_OBC_Prox.FsftIDCR_U_OBC_Prox
          SC_FsftIDCR_U_V2XInVoltage_FsftIDCR_U_V2XInVoltage: operation=FsftIDCR_U_V2XInVoltage.FsftIDCR_U_V2XInVoltage
          SC_FsftIDCR_U_V2XLVFeed_FsftIDCR_U_V2XLVFeed: operation=FsftIDCR_U_V2XLVFeed.FsftIDCR_U_V2XLVFeed
          SC_FsftIDCR_b_DC_Isolation_Disable_Cmd_FsftIDCR_b_DC_Isolation_Disable_Cmd: operation=FsftIDCR_b_DC_Isolation_Disable_Cmd.FsftIDCR_b_DC_Isolation_Disable_Cmd
          SC_FsftIDCR_b_EVCC_FailureSts_FsftIDCR_b_EVCC_FailureSts: operation=FsftIDCR_b_EVCC_FailureSts.FsftIDCR_b_EVCC_FailureSts
          SC_FsftIDCR_b_EVSEIsolSts_FsftIDCR_b_EVSEIsolSts: operation=FsftIDCR_b_EVSEIsolSts.FsftIDCR_b_EVSEIsolSts
          SC_FsftIDCR_b_EVSE_ChargingSystemError_FsftIDCR_b_EVSE_ChargingSystemError: operation=FsftIDCR_b_EVSE_ChargingSystemError.FsftIDCR_b_EVSE_ChargingSystemError
          SC_FsftIDCR_b_EVSE_EnergizingState_FsftIDCR_b_EVSE_EnergizingState: operation=FsftIDCR_b_EVSE_EnergizingState.FsftIDCR_b_EVSE_EnergizingState
          SC_FsftIDCR_b_EVSE_Offered_AC_Single_Phase_FsftIDCR_b_EVSE_Offered_AC_Single_Phase: operation=FsftIDCR_b_EVSE_Offered_AC_Single_Phase.FsftIDCR_b_EVSE_Offered_AC_Single_Phase
          SC_FsftIDCR_b_EVSE_Offered_AC_Three_Phase_FsftIDCR_b_EVSE_Offered_AC_Three_Phase: operation=FsftIDCR_b_EVSE_Offered_AC_Three_Phase.FsftIDCR_b_EVSE_Offered_AC_Three_Phase
          SC_FsftIDCR_b_EVSE_Offered_DC_Extended_FsftIDCR_b_EVSE_Offered_DC_Extended: operation=FsftIDCR_b_EVSE_Offered_DC_Extended.FsftIDCR_b_EVSE_Offered_DC_Extended
          SC_FsftIDCR_b_EVSE_Service1_Charging_FsftIDCR_b_EVSE_Service1_Charging: operation=FsftIDCR_b_EVSE_Service1_Charging.FsftIDCR_b_EVSE_Service1_Charging
          SC_FsftIDCR_b_EVSE_Service1_Free_FsftIDCR_b_EVSE_Service1_Free: operation=FsftIDCR_b_EVSE_Service1_Free.FsftIDCR_b_EVSE_Service1_Free
          SC_FsftIDCR_b_IDCM_GFCI_FaultSts_FsftIDCR_b_IDCM_GFCI_FaultSts: operation=FsftIDCR_b_IDCM_GFCI_FaultSts.FsftIDCR_b_IDCM_GFCI_FaultSts, variation-point={short-label=vpSC_FsftIDCR_b_IDCM_GFCI_FaultSts_FsftIDCR_b_IDCM_GFCI_FaultSts, sw-syscond=1}
          SC_FsftIDCR_b_IDCM_Wakeup_HCP_FsftIDCR_b_IDCM_Wakeup_HCP: operation=FsftIDCR_b_IDCM_Wakeup_HCP.FsftIDCR_b_IDCM_Wakeup_HCP
          SC_FsftIDCR_b_ISO15118_TLS_Offered_FsftIDCR_b_ISO15118_TLS_Offered: operation=FsftIDCR_b_ISO15118_TLS_Offered.FsftIDCR_b_ISO15118_TLS_Offered
          SC_FsftIDCR_b_J1772_S2_StatusFA_FsftIDCR_b_J1772_S2_StatusFA: operation=FsftIDCR_b_J1772_S2_StatusFA.FsftIDCR_b_J1772_S2_StatusFA
          SC_FsftIDCR_b_OBCM_Timeout_FsftIDCR_b_OBCM_Timeout: operation=FsftIDCR_b_OBCM_Timeout.FsftIDCR_b_OBCM_Timeout
          SC_FsftIDCR_b_OffrdEnrgyTxType_FsftIDCR_b_OffrdEnrgyTxType: operation=FsftIDCR_b_OffrdEnrgyTxType.FsftIDCR_b_OffrdEnrgyTxType
          SC_FsftIDCR_b_OffrdPayOptn_FsftIDCR_b_OffrdPayOptn: operation=FsftIDCR_b_OffrdPayOptn.FsftIDCR_b_OffrdPayOptn
          SC_FsftIDCR_b_ReceiptRequired_FsftIDCR_b_ReceiptRequired: operation=FsftIDCR_b_ReceiptRequired.FsftIDCR_b_ReceiptRequired
          SC_FsftIDCR_b_Resp_Code_FsftIDCR_b_Resp_Code: operation=FsftIDCR_b_Resp_Code.FsftIDCR_b_Resp_Code
          SC_FsftIDCR_b_SDP_Sts_FsftIDCR_b_SDP_Sts: operation=FsftIDCR_b_SDP_Sts.FsftIDCR_b_SDP_Sts
          SC_FsftIDCR_b_SLAC_Sts_FsftIDCR_b_SLAC_Sts: operation=FsftIDCR_b_SLAC_Sts.FsftIDCR_b_SLAC_Sts
          SC_FsftIDCR_b_SupProtoNm_FsftIDCR_b_SupProtoNm: operation=FsftIDCR_b_SupProtoNm.FsftIDCR_b_SupProtoNm
          SC_FsftIDCR_b_SupSchemaID_FsftIDCR_b_SupSchemaID: operation=FsftIDCR_b_SupSchemaID.FsftIDCR_b_SupSchemaID
          SC_FsftIDCR_b_SupVerNumMajor_FsftIDCR_b_SupVerNumMajor: operation=FsftIDCR_b_SupVerNumMajor.FsftIDCR_b_SupVerNumMajor
          SC_FsftIDCR_b_SupVerNumMinor_FsftIDCR_b_SupVerNumMinor: operation=FsftIDCR_b_SupVerNumMinor.FsftIDCR_b_SupVerNumMinor
          SC_FsftIDCR_b_TxMessageRequest_FsftIDCR_b_TxMessageRequest: operation=FsftIDCR_b_TxMessageRequest.FsftIDCR_b_TxMessageRequest
          SC_FsftIDCR_b_V2XDerateSts_FsftIDCR_b_V2XDerateSts: operation=FsftIDCR_b_V2XDerateSts.FsftIDCR_b_V2XDerateSts
          SC_FsftIDCR_b_V2XFailSts_FsftIDCR_b_V2XFailSts: operation=FsftIDCR_b_V2XFailSts.FsftIDCR_b_V2XFailSts
          SC_FsftIDCR_b_V2XSts_FsftIDCR_b_V2XSts: operation=FsftIDCR_b_V2XSts.FsftIDCR_b_V2XSts
          SC_FsftIDCR_b_V2X_EVSE_Service_5_Free_FsftIDCR_b_V2X_EVSE_Service_5_Free: operation=FsftIDCR_b_V2X_EVSE_Service_5_Free.FsftIDCR_b_V2X_EVSE_Service_5_Free
          SC_FsftIDCR_b_V2X_EVSE_Service_5_V2H_FsftIDCR_b_V2X_EVSE_Service_5_V2H: operation=FsftIDCR_b_V2X_EVSE_Service_5_V2H.FsftIDCR_b_V2X_EVSE_Service_5_V2H
          SC_FsftIDCR_cmp_ISO15118_EVSETimeStamp_FsftIDCR_cmp_ISO15118_EVSETimeStamp: operation=FsftIDCR_cmp_ISO15118_EVSETimeStamp.FsftIDCR_cmp_ISO15118_EVSETimeStamp
          SC_FsftIDCR_d_EVSE_Accepted_Protocol_FsftIDCR_d_EVSE_Accepted_Protocol: operation=FsftIDCR_d_EVSE_Accepted_Protocol.FsftIDCR_d_EVSE_Accepted_Protocol
          SC_FsftIDCR_d_ISO15118_ServiceID_FsftIDCR_d_ISO15118_ServiceID: operation=FsftIDCR_d_ISO15118_ServiceID.FsftIDCR_d_ISO15118_ServiceID
          SC_FsftIDCR_e_APM2InterlockSts_FsftIDCR_e_APM2InterlockSts: operation=FsftIDCR_e_APM2InterlockSts.FsftIDCR_e_APM2InterlockSts
          SC_FsftIDCR_e_Charger_WeldingDetectAvail_FsftIDCR_e_Charger_WeldingDetectAvail: operation=FsftIDCR_e_Charger_WeldingDetectAvail.FsftIDCR_e_Charger_WeldingDetectAvail
          SC_FsftIDCR_e_ChrgrModeStat_OBCM_FsftIDCR_e_ChrgrModeStat_OBCM: operation=FsftIDCR_e_ChrgrModeStat_OBCM.FsftIDCR_e_ChrgrModeStat_OBCM
          SC_FsftIDCR_e_Chrgr_FaultStates_FsftIDCR_e_Chrgr_FaultStates: operation=FsftIDCR_e_Chrgr_FaultStates.FsftIDCR_e_Chrgr_FaultStates
          SC_FsftIDCR_e_DschrgFaultSts_FsftIDCR_e_DschrgFaultSts: operation=FsftIDCR_e_DschrgFaultSts.FsftIDCR_e_DschrgFaultSts
          SC_FsftIDCR_e_EVCC_FailureRsn_FsftIDCR_e_EVCC_FailureRsn: operation=FsftIDCR_e_EVCC_FailureRsn.FsftIDCR_e_EVCC_FailureRsn
          SC_FsftIDCR_e_EVSE_CHAdeMOProtocol_FsftIDCR_e_EVSE_CHAdeMOProtocol: operation=FsftIDCR_e_EVSE_CHAdeMOProtocol.FsftIDCR_e_EVSE_CHAdeMOProtocol
          SC_FsftIDCR_e_EVSE_ChrgStopControl_FsftIDCR_e_EVSE_ChrgStopControl: operation=FsftIDCR_e_EVSE_ChrgStopControl.FsftIDCR_e_EVSE_ChrgStopControl
          SC_FsftIDCR_e_EVSE_Error_FsftIDCR_e_EVSE_Error: operation=FsftIDCR_e_EVSE_Error.FsftIDCR_e_EVSE_Error
          SC_FsftIDCR_e_EVSE_Notification_FsftIDCR_e_EVSE_Notification: operation=FsftIDCR_e_EVSE_Notification.FsftIDCR_e_EVSE_Notification
          SC_FsftIDCR_e_EVSE_OfferedService_FsftIDCR_e_EVSE_OfferedService: operation=FsftIDCR_e_EVSE_OfferedService.FsftIDCR_e_EVSE_OfferedService
          SC_FsftIDCR_e_EVSE_PilotStat_OBCM_FsftIDCR_e_EVSE_PilotStat_OBCM: operation=FsftIDCR_e_EVSE_PilotStat_OBCM.FsftIDCR_e_EVSE_PilotStat_OBCM
          SC_FsftIDCR_e_ExtChargerSts_FsftIDCR_e_ExtChargerSts: operation=FsftIDCR_e_ExtChargerSts.FsftIDCR_e_ExtChargerSts
          SC_FsftIDCR_e_ISO15118_MessageResponse_FsftIDCR_e_ISO15118_MessageResponse: operation=FsftIDCR_e_ISO15118_MessageResponse.FsftIDCR_e_ISO15118_MessageResponse
          SC_FsftIDCR_e_ISO15118_ResponseCode_FsftIDCR_e_ISO15118_ResponseCode: operation=FsftIDCR_e_ISO15118_ResponseCode.FsftIDCR_e_ISO15118_ResponseCode
          SC_FsftIDCR_e_ISO15118_TLS_Status_FsftIDCR_e_ISO15118_TLS_Status: operation=FsftIDCR_e_ISO15118_TLS_Status.FsftIDCR_e_ISO15118_TLS_Status
          SC_FsftIDCR_e_J1772Stat_FsftIDCR_e_J1772Stat: operation=FsftIDCR_e_J1772Stat.FsftIDCR_e_J1772Stat
          SC_FsftIDCR_e_OBCM_CP{1..3}Sts_FsftIDCR_e_OBCM_CP{1..3}Sts: operation=FsftIDCR_e_OBCM_CP{1..3}Sts.FsftIDCR_e_OBCM_CP{1..3}Sts
          SC_FsftIDCR_e_OBCM_CSSts_FsftIDCR_e_OBCM_CSSts: operation=FsftIDCR_e_OBCM_CSSts.FsftIDCR_e_OBCM_CSSts
          SC_FsftIDCR_e_OBCM_Charger_Ready_FsftIDCR_e_OBCM_Charger_Ready: operation=FsftIDCR_e_OBCM_Charger_Ready.FsftIDCR_e_OBCM_Charger_Ready
          SC_FsftIDCR_e_OBCM_HVILSts_FsftIDCR_e_OBCM_HVILSts: operation=FsftIDCR_e_OBCM_HVILSts.FsftIDCR_e_OBCM_HVILSts
          SC_FsftIDCR_e_ProxStat_FsftIDCR_e_ProxStat: operation=FsftIDCR_e_ProxStat.FsftIDCR_e_ProxStat
          SC_FsftIDCR_e_V2XDerateRsn_FsftIDCR_e_V2XDerateRsn: operation=FsftIDCR_e_V2XDerateRsn.FsftIDCR_e_V2XDerateRsn
          SC_FsftIDCR_e_V2XFaultRsn_FsftIDCR_e_V2XFaultRsn: operation=FsftIDCR_e_V2XFaultRsn.FsftIDCR_e_V2XFaultRsn
          SC_FsftIDCR_e_V2XInterlockSts_FsftIDCR_e_V2XInterlockSts: operation=FsftIDCR_e_V2XInterlockSts.FsftIDCR_e_V2XInterlockSts
          SC_FsftIDCR_e_V2XModeFeedback_FsftIDCR_e_V2XModeFeedback: operation=FsftIDCR_e_V2XModeFeedback.FsftIDCR_e_V2XModeFeedback
          SC_FsftIDCR_f_ACOutFreq_FsftIDCR_f_ACOutFreq: operation=FsftIDCR_f_ACOutFreq.FsftIDCR_f_ACOutFreq
          SC_FsftIDCR_f_AcOutFrequency_FsftIDCR_f_AcOutFrequency: operation=FsftIDCR_f_AcOutFrequency.FsftIDCR_f_AcOutFrequency
          SC_FsftIDCR_f_V2XFrequency_FsftIDCR_f_V2XFrequency: operation=FsftIDCR_f_V2XFrequency.FsftIDCR_f_V2XFrequency
          SC_FsftIDCR_g_HVCMS_EVSEID_FsftIDCR_g_HVCMS_EVSEID: operation=FsftIDCR_g_HVCMS_EVSEID.FsftIDCR_g_HVCMS_EVSEID
          SC_FsftIDCR_i_ISO15118_SAScheduleTupleID_FsftIDCR_i_ISO15118_SAScheduleTupleID: operation=FsftIDCR_i_ISO15118_SAScheduleTupleID.FsftIDCR_i_ISO15118_SAScheduleTupleID
          SC_FsftIDCR_t_EVSE_NotificationMaxDelay_FsftIDCR_t_EVSE_NotificationMaxDelay: operation=FsftIDCR_t_EVSE_NotificationMaxDelay.FsftIDCR_t_EVSE_NotificationMaxDelay
          SC_FsftIDCR_t_ISO15118_NotificationMaxDelay_FsftIDCR_t_ISO15118_NotificationMaxDelay: operation=FsftIDCR_t_ISO15118_NotificationMaxDelay.FsftIDCR_t_ISO15118_NotificationMaxDelay
          SC_FsftIDCR_y_ISO15118_SchemaID_FsftIDCR_y_ISO15118_SchemaID: operation=FsftIDCR_y_ISO15118_SchemaID.FsftIDCR_y_ISO15118_SchemaID
          SC_FsftIDCR_y_ISO15118_VersionNumMajor_FsftIDCR_y_ISO15118_VersionNumMajor: operation=FsftIDCR_y_ISO15118_VersionNumMajor.FsftIDCR_y_ISO15118_VersionNumMajor
          SC_FsftIDCR_y_ISO15118_VersionNumMinor_FsftIDCR_y_ISO15118_VersionNumMinor: operation=FsftIDCR_y_ISO15118_VersionNumMinor.FsftIDCR_y_ISO15118_VersionNumMinor
          SC_FsftIMPR_b_ImpactHardwire_FsftIMPR_b_ImpactHardwire: operation=FsftIMPR_b_ImpactHardwire.FsftIMPR_b_ImpactHardwire
          SC_FsftIMPR_b_ImpactHardwireV_FsftIMPR_b_ImpactHardwireV: operation=FsftIMPR_b_ImpactHardwireV.FsftIMPR_b_ImpactHardwireV
          SC_FsftTMIR_T_HV_BatHghTmp_Thrsh_FsftTMIR_T_HV_BatHghTmp_Thrsh: operation=FsftTMIR_T_HV_BatHghTmp_Thrsh.FsftTMIR_T_HV_BatHghTmp_Thrsh
          SC_FsftTMIR_T_HV_BatLowTmp_Thrsh_FsftTMIR_T_HV_BatLowTmp_Thrsh: operation=FsftTMIR_T_HV_BatLowTmp_Thrsh.FsftTMIR_T_HV_BatLowTmp_Thrsh
          SC_FsftTMIR_T_OBCMTemp{1..4}_FsftTMIR_T_OBCMTemp{1..4}: operation=FsftTMIR_T_OBCMTemp{1..4}.FsftTMIR_T_OBCMTemp{1..4}
          SC_FsftTRIR_T_HV_BatClntTmpOut_FsftTRIR_T_HV_BatClntTmpOut: operation=FsftTRIR_T_HV_BatClntTmpOut.FsftTRIR_T_HV_BatClntTmpOut
          SC_FsftTRIR_T_HV_BatClntTmp_In_FsftTRIR_T_HV_BatClntTmp_In: operation=FsftTRIR_T_HV_BatClntTmp_In.FsftTRIR_T_HV_BatClntTmp_In
          SC_PokeBPCR_Cnt_HVBatt_NumMaxVlt_PokeBPCR_Cnt_HVBatt_NumMaxVlt: operation=PokeBPCR_Cnt_HVBatt_NumMaxVlt.PokeBPCR_Cnt_HVBatt_NumMaxVlt
          SC_PokeBPCR_Cnt_HVBatt_NumMinVlt_PokeBPCR_Cnt_HVBatt_NumMinVlt: operation=PokeBPCR_Cnt_HVBatt_NumMinVlt.PokeBPCR_Cnt_HVBatt_NumMinVlt
          SC_PokeBPCR_I_HV_BatCurr_PokeBPCR_I_HV_BatCurr: operation=PokeBPCR_I_HV_BatCurr.PokeBPCR_I_HV_BatCurr
          SC_PokeBPCR_I_HV_BatCurrString2_PokeBPCR_I_HV_BatCurrString2: operation=PokeBPCR_I_HV_BatCurrString2.PokeBPCR_I_HV_BatCurrString2
          SC_PokeBPCR_I_MaxChgCurrAlwd_PokeBPCR_I_MaxChgCurrAlwd: operation=PokeBPCR_I_MaxChgCurrAlwd.PokeBPCR_I_MaxChgCurrAlwd
          SC_PokeBPCR_P_HV_BatChrgPwrET_PokeBPCR_P_HV_BatChrgPwrET: operation=PokeBPCR_P_HV_BatChrgPwrET.PokeBPCR_P_HV_BatChrgPwrET
          SC_PokeBPCR_P_HV_BatChrgPwrLT_PokeBPCR_P_HV_BatChrgPwrLT: operation=PokeBPCR_P_HV_BatChrgPwrLT.PokeBPCR_P_HV_BatChrgPwrLT
          SC_PokeBPCR_P_HV_BatChrgPwrST_PokeBPCR_P_HV_BatChrgPwrST: operation=PokeBPCR_P_HV_BatChrgPwrST.PokeBPCR_P_HV_BatChrgPwrST
          SC_PokeBPCR_P_HV_BatDschrgPwrET_PokeBPCR_P_HV_BatDschrgPwrET: operation=PokeBPCR_P_HV_BatDschrgPwrET.PokeBPCR_P_HV_BatDschrgPwrET
          SC_PokeBPCR_P_HV_BatDschrgPwrLT_PokeBPCR_P_HV_BatDschrgPwrLT: operation=PokeBPCR_P_HV_BatDschrgPwrLT.PokeBPCR_P_HV_BatDschrgPwrLT
          SC_PokeBPCR_P_HV_BatDschrgPwrST_PokeBPCR_P_HV_BatDschrgPwrST: operation=PokeBPCR_P_HV_BatDschrgPwrST.PokeBPCR_P_HV_BatDschrgPwrST
          SC_PokeBPCR_Pct_HVBatSOH_PokeBPCR_Pct_HVBatSOH: operation=PokeBPCR_Pct_HVBatSOH.PokeBPCR_Pct_HVBatSOH
          SC_PokeBPCR_Pct_HVBatSOHLow_PokeBPCR_Pct_HVBatSOHLow: operation=PokeBPCR_Pct_HVBatSOHLow.PokeBPCR_Pct_HVBatSOHLow
          SC_PokeBPCR_Pct_HV_BatPackSOC_PokeBPCR_Pct_HV_BatPackSOC: operation=PokeBPCR_Pct_HV_BatPackSOC.PokeBPCR_Pct_HV_BatPackSOC
          SC_PokeBPCR_T_BDUBusBarTemp_PokeBPCR_T_BDUBusBarTemp: operation=PokeBPCR_T_BDUBusBarTemp.PokeBPCR_T_BDUBusBarTemp
          SC_PokeBPCR_T_BusBarTemp_PokeBPCR_T_BusBarTemp: operation=PokeBPCR_T_BusBarTemp.PokeBPCR_T_BusBarTemp
          SC_PokeBPCR_T_HV_BatModTempAvg_PokeBPCR_T_HV_BatModTempAvg: operation=PokeBPCR_T_HV_BatModTempAvg.PokeBPCR_T_HV_BatModTempAvg
          SC_PokeBPCR_T_HV_BatModTempMax_PokeBPCR_T_HV_BatModTempMax: operation=PokeBPCR_T_HV_BatModTempMax.PokeBPCR_T_HV_BatModTempMax
          SC_PokeBPCR_T_HV_BatModTempMin_PokeBPCR_T_HV_BatModTempMin: operation=PokeBPCR_T_HV_BatModTempMin.PokeBPCR_T_HV_BatModTempMin
          SC_PokeBPCR_U_CellVoltHighThrsh_PokeBPCR_U_CellVoltHighThrsh: operation=PokeBPCR_U_CellVoltHighThrsh.PokeBPCR_U_CellVoltHighThrsh
          SC_PokeBPCR_U_CellVoltLowThrsh_PokeBPCR_U_CellVoltLowThrsh: operation=PokeBPCR_U_CellVoltLowThrsh.PokeBPCR_U_CellVoltLowThrsh
          SC_PokeBPCR_U_HV_BatModVoltAvg_PokeBPCR_U_HV_BatModVoltAvg: operation=PokeBPCR_U_HV_BatModVoltAvg.PokeBPCR_U_HV_BatModVoltAvg
          SC_PokeBPCR_U_HV_BatModVoltMax_PokeBPCR_U_HV_BatModVoltMax: operation=PokeBPCR_U_HV_BatModVoltMax.PokeBPCR_U_HV_BatModVoltMax
          SC_PokeBPCR_U_HV_BatModVoltMin_PokeBPCR_U_HV_BatModVoltMin: operation=PokeBPCR_U_HV_BatModVoltMin.PokeBPCR_U_HV_BatModVoltMin
          SC_PokeBPCR_U_HV_BatVolt_PokeBPCR_U_HV_BatVolt: operation=PokeBPCR_U_HV_BatVolt.PokeBPCR_U_HV_BatVolt
          SC_PokeBPCR_U_HV_InternalStringVolt1_PokeBPCR_U_HV_InternalStringVolt1: operation=PokeBPCR_U_HV_InternalStringVolt1.PokeBPCR_U_HV_InternalStringVolt1
          SC_PokeBPCR_U_HV_InternalStringVolt2_PokeBPCR_U_HV_InternalStringVolt2: operation=PokeBPCR_U_HV_InternalStringVolt2.PokeBPCR_U_HV_InternalStringVolt2
          SC_PokeBPCR_U_HV_InternalVolt_PokeBPCR_U_HV_InternalVolt: operation=PokeBPCR_U_HV_InternalVolt.PokeBPCR_U_HV_InternalVolt
          SC_PokeBPCR_U_HV_SeriesVolt_PokeBPCR_U_HV_SeriesVolt: operation=PokeBPCR_U_HV_SeriesVolt.PokeBPCR_U_HV_SeriesVolt, variation-point={short-label=vpSC_PokeBPCR_U_HV_SeriesVolt_PokeBPCR_U_HV_SeriesVolt, sw-syscond=1}
          SC_PokeBPCR_U_MaxCellVltAlld_PokeBPCR_U_MaxCellVltAlld: operation=PokeBPCR_U_MaxCellVltAlld.PokeBPCR_U_MaxCellVltAlld
          SC_PokeBPCR_U_MaxPkVltAlld_PokeBPCR_U_MaxPkVltAlld: operation=PokeBPCR_U_MaxPkVltAlld.PokeBPCR_U_MaxPkVltAlld
          SC_PokeBPCR_U_MinCellVltAlld_PokeBPCR_U_MinCellVltAlld: operation=PokeBPCR_U_MinCellVltAlld.PokeBPCR_U_MinCellVltAlld
          SC_PokeBPCR_U_MinPkVltAlld_PokeBPCR_U_MinPkVltAlld: operation=PokeBPCR_U_MinPkVltAlld.PokeBPCR_U_MinPkVltAlld
          SC_PokeBPCR_U_OCVAveCellVoltage_PokeBPCR_U_OCVAveCellVoltage: operation=PokeBPCR_U_OCVAveCellVoltage.PokeBPCR_U_OCVAveCellVoltage
          SC_PokeBPCR_U_OCVMaxCellVoltage_PokeBPCR_U_OCVMaxCellVoltage: operation=PokeBPCR_U_OCVMaxCellVoltage.PokeBPCR_U_OCVMaxCellVoltage
          SC_PokeBPCR_U_OCVMinCellVoltage_PokeBPCR_U_OCVMinCellVoltage: operation=PokeBPCR_U_OCVMinCellVoltage.PokeBPCR_U_OCVMinCellVoltage
          SC_PokeBPCR_Z_MaxCellDischargeImpedance_PokeBPCR_Z_MaxCellDischargeImpedance: operation=PokeBPCR_Z_MaxCellDischargeImpedance.PokeBPCR_Z_MaxCellDischargeImpedance
          SC_PokeBPCR_Z_MinCellDischargeImpedance_PokeBPCR_Z_MinCellDischargeImpedance: operation=PokeBPCR_Z_MinCellDischargeImpedance.PokeBPCR_Z_MinCellDischargeImpedance
          SC_PokeBPCR_b_BalMd_PokeBPCR_b_BalMd: operation=PokeBPCR_b_BalMd.PokeBPCR_b_BalMd
          SC_PokeBPCR_b_HEVOnRqBPCM_PokeBPCR_b_HEVOnRqBPCM: operation=PokeBPCR_b_HEVOnRqBPCM.PokeBPCR_b_HEVOnRqBPCM
          SC_PokeBPCR_b_HVBatRdy_PokeBPCR_b_HVBatRdy: operation=PokeBPCR_b_HVBatRdy.PokeBPCR_b_HVBatRdy
          SC_PokeBPCR_b_HVBat_DC_CntctrOpn_PokeBPCR_b_HVBat_DC_CntctrOpn: operation=PokeBPCR_b_HVBat_DC_CntctrOpn.PokeBPCR_b_HVBat_DC_CntctrOpn
          SC_PokeBPCR_b_HVBat_DC_CntctrReq_PokeBPCR_b_HVBat_DC_CntctrReq: operation=PokeBPCR_b_HVBat_DC_CntctrReq.PokeBPCR_b_HVBat_DC_CntctrReq
          SC_PokeBPCR_b_HV_AuxLoadOffReq_PokeBPCR_b_HV_AuxLoadOffReq: operation=PokeBPCR_b_HV_AuxLoadOffReq.PokeBPCR_b_HV_AuxLoadOffReq, variation-point={short-label=vpSC_PokeBPCR_b_HV_AuxLoadOffReq_PokeBPCR_b_HV_AuxLoadOffReq, sw-syscond=1}
          SC_PokeBPCR_b_HV_BatCntctrOpenPending_PokeBPCR_b_HV_BatCntctrOpenPending: operation=PokeBPCR_b_HV_BatCntctrOpenPending.PokeBPCR_b_HV_BatCntctrOpenPending
          SC_PokeBPCR_b_HV_BatCntctrOpenReq_PokeBPCR_b_HV_BatCntctrOpenReq: operation=PokeBPCR_b_HV_BatCntctrOpenReq.PokeBPCR_b_HV_BatCntctrOpenReq
          SC_PokeBPCR_b_PwrLimON_PokeBPCR_b_PwrLimON: operation=PokeBPCR_b_PwrLimON.PokeBPCR_b_PwrLimON
          SC_PokeBPCR_b_StkOpnChkCmpl_PokeBPCR_b_StkOpnChkCmpl: operation=PokeBPCR_b_StkOpnChkCmpl.PokeBPCR_b_StkOpnChkCmpl
          SC_PokeBPCR_cnt_HVBatt_ModNumMaxTmp_PokeBPCR_cnt_HVBatt_ModNumMaxTmp: operation=PokeBPCR_cnt_HVBatt_ModNumMaxTmp.PokeBPCR_cnt_HVBatt_ModNumMaxTmp
          SC_PokeBPCR_cnt_HVBatt_ModNumMinTmp_PokeBPCR_cnt_HVBatt_ModNumMinTmp: operation=PokeBPCR_cnt_HVBatt_ModNumMinTmp.PokeBPCR_cnt_HVBatt_ModNumMinTmp
          SC_PokeBPCR_e_ChargingStat_BPCM_PokeBPCR_e_ChargingStat_BPCM: operation=PokeBPCR_e_ChargingStat_BPCM.PokeBPCR_e_ChargingStat_BPCM
          SC_PokeBPCR_e_DCIsolSts_PokeBPCR_e_DCIsolSts: operation=PokeBPCR_e_DCIsolSts.PokeBPCR_e_DCIsolSts
          SC_PokeBPCR_e_HVBatCntrWeld_ImpdOpn_PokeBPCR_e_HVBatCntrWeld_ImpdOpn: operation=PokeBPCR_e_HVBatCntrWeld_ImpdOpn.PokeBPCR_e_HVBatCntrWeld_ImpdOpn
          SC_PokeBPCR_e_HVBatIntrlkIntrnlStat_PokeBPCR_e_HVBatIntrlkIntrnlStat: operation=PokeBPCR_e_HVBatIntrlkIntrnlStat.PokeBPCR_e_HVBatIntrlkIntrnlStat
          SC_PokeBPCR_e_HVBat_DC_CntctrStat_PokeBPCR_e_HVBat_DC_CntctrStat: operation=PokeBPCR_e_HVBat_DC_CntctrStat.PokeBPCR_e_HVBat_DC_CntctrStat
          SC_PokeBPCR_e_HV_BatCntctrStat_PokeBPCR_e_HV_BatCntctrStat: operation=PokeBPCR_e_HV_BatCntctrStat.PokeBPCR_e_HV_BatCntctrStat
          SC_PokeBPCR_e_HV_BatInrlkStat_PokeBPCR_e_HV_BatInrlkStat: operation=PokeBPCR_e_HV_BatInrlkStat.PokeBPCR_e_HV_BatInrlkStat
          SC_PokeBPCR_e_HV_BatIsolStat_PokeBPCR_e_HV_BatIsolStat: operation=PokeBPCR_e_HV_BatIsolStat.PokeBPCR_e_HV_BatIsolStat
          SC_PokeBPCR_e_HV_DcChargeTypeStat_PokeBPCR_e_HV_DcChargeTypeStat: operation=PokeBPCR_e_HV_DcChargeTypeStat.PokeBPCR_e_HV_DcChargeTypeStat, variation-point={short-label=vpSC_PokeBPCR_e_HV_DcChargeTypeStat_PokeBPCR_e_HV_DcChargeTypeStat, sw-syscond=1}
          SC_PokeBPCR_e_HV_TracBatCntctrConfig_PokeBPCR_e_HV_TracBatCntctrConfig: operation=PokeBPCR_e_HV_TracBatCntctrConfig.PokeBPCR_e_HV_TracBatCntctrConfig, variation-point={short-label=vpSC_PokeBPCR_e_HV_TracBatCntctrConfig_PokeBPCR_e_HV_TracBatCntctrConfig, sw-syscond=1}
          SC_PokeBPCR_e_ThrmlRnawy_Warn_PokeBPCR_e_ThrmlRnawy_Warn: operation=PokeBPCR_e_ThrmlRnawy_Warn.PokeBPCR_e_ThrmlRnawy_Warn
          SC_PokeBPCR_i_DC_Isolation_Sts_M182_PokeBPCR_i_DC_Isolation_Sts_M182: operation=PokeBPCR_i_DC_Isolation_Sts_M182.PokeBPCR_i_DC_Isolation_Sts_M182
          SC_PokeBPCR_q_FullAmpHrCap_PokeBPCR_q_FullAmpHrCap: operation=PokeBPCR_q_FullAmpHrCap.PokeBPCR_q_FullAmpHrCap
          SC_PokeBPCR_t_HVBatSleepTime_PokeBPCR_t_HVBatSleepTime: operation=PokeBPCR_t_HVBatSleepTime.PokeBPCR_t_HVBatSleepTime
          SC_PokeBPCR_t_HVBattCntctrOpnTm_PokeBPCR_t_HVBattCntctrOpnTm: operation=PokeBPCR_t_HVBattCntctrOpnTm.PokeBPCR_t_HVBattCntctrOpnTm
          SC_PokeIDCR_E_EVSE_EnrgyToBeDlvrd_PokeIDCR_E_EVSE_EnrgyToBeDlvrd: operation=PokeIDCR_E_EVSE_EnrgyToBeDlvrd.PokeIDCR_E_EVSE_EnrgyToBeDlvrd
          SC_PokeIDCR_I_ACOutCurrent{1..3}_PokeIDCR_I_ACOutCurrent{1..3}: operation=PokeIDCR_I_ACOutCurrent{1..3}.PokeIDCR_I_ACOutCurrent{1..3}
          SC_PokeIDCR_I_ACSideCurr_L2_PokeIDCR_I_ACSideCurr_L2: operation=PokeIDCR_I_ACSideCurr_L2.PokeIDCR_I_ACSideCurr_L2
          SC_PokeIDCR_I_ACSideCurr_L3_PokeIDCR_I_ACSideCurr_L3: operation=PokeIDCR_I_ACSideCurr_L3.PokeIDCR_I_ACSideCurr_L3
          SC_PokeIDCR_I_AC_Side_Curr_PokeIDCR_I_AC_Side_Curr: operation=PokeIDCR_I_AC_Side_Curr.PokeIDCR_I_AC_Side_Curr
          SC_PokeIDCR_I_APM_HV_Current_PokeIDCR_I_APM_HV_Current: operation=PokeIDCR_I_APM_HV_Current.PokeIDCR_I_APM_HV_Current
          SC_PokeIDCR_I_APM_LV_Current_PokeIDCR_I_APM_LV_Current: operation=PokeIDCR_I_APM_LV_Current.PokeIDCR_I_APM_LV_Current
          SC_PokeIDCR_I_AcOutCurrent_PokeIDCR_I_AcOutCurrent: operation=PokeIDCR_I_AcOutCurrent.PokeIDCR_I_AcOutCurrent
          SC_PokeIDCR_I_BattSide_Curr_PokeIDCR_I_BattSide_Curr: operation=PokeIDCR_I_BattSide_Curr.PokeIDCR_I_BattSide_Curr
          SC_PokeIDCR_I_ChrgCrntAvail_PokeIDCR_I_ChrgCrntAvail: operation=PokeIDCR_I_ChrgCrntAvail.PokeIDCR_I_ChrgCrntAvail
          SC_PokeIDCR_I_ChrgCurrent_PokeIDCR_I_ChrgCurrent: operation=PokeIDCR_I_ChrgCurrent.PokeIDCR_I_ChrgCurrent
          SC_PokeIDCR_I_DCInCurrent_PokeIDCR_I_DCInCurrent: operation=PokeIDCR_I_DCInCurrent.PokeIDCR_I_DCInCurrent
          SC_PokeIDCR_I_EVSECurr_RegTol_PokeIDCR_I_EVSECurr_RegTol: operation=PokeIDCR_I_EVSECurr_RegTol.PokeIDCR_I_EVSECurr_RegTol
          SC_PokeIDCR_I_EVSEMaxCurrLmt_PokeIDCR_I_EVSEMaxCurrLmt: operation=PokeIDCR_I_EVSEMaxCurrLmt.PokeIDCR_I_EVSEMaxCurrLmt
          SC_PokeIDCR_I_EVSEMinCurrLmt_PokeIDCR_I_EVSEMinCurrLmt: operation=PokeIDCR_I_EVSEMinCurrLmt.PokeIDCR_I_EVSEMinCurrLmt
          SC_PokeIDCR_I_EVSEOutputCurr_PokeIDCR_I_EVSEOutputCurr: operation=PokeIDCR_I_EVSEOutputCurr.PokeIDCR_I_EVSEOutputCurr
          SC_PokeIDCR_I_EVSEPeakCurrRip_PokeIDCR_I_EVSEPeakCurrRip: operation=PokeIDCR_I_EVSEPeakCurrRip.PokeIDCR_I_EVSEPeakCurrRip
          SC_PokeIDCR_I_IdcHvSetPFdbk_PokeIDCR_I_IdcHvSetPFdbk: operation=PokeIDCR_I_IdcHvSetPFdbk.PokeIDCR_I_IdcHvSetPFdbk
          SC_PokeIDCR_I_J1772InputCrntAval_PokeIDCR_I_J1772InputCrntAval: operation=PokeIDCR_I_J1772InputCrntAval.PokeIDCR_I_J1772InputCrntAval
          SC_PokeIDCR_I_V2XInCurrent_PokeIDCR_I_V2XInCurrent: operation=PokeIDCR_I_V2XInCurrent.PokeIDCR_I_V2XInCurrent
          SC_PokeIDCR_K_Service_ID_PokeIDCR_K_Service_ID: operation=PokeIDCR_K_Service_ID.PokeIDCR_K_Service_ID
          SC_PokeIDCR_P_APM_DeratingPower_PokeIDCR_P_APM_DeratingPower: operation=PokeIDCR_P_APM_DeratingPower.PokeIDCR_P_APM_DeratingPower
          SC_PokeIDCR_P_APM_InputPower_PokeIDCR_P_APM_InputPower: operation=PokeIDCR_P_APM_InputPower.PokeIDCR_P_APM_InputPower
          SC_PokeIDCR_P_APM_OutputPower_PokeIDCR_P_APM_OutputPower: operation=PokeIDCR_P_APM_OutputPower.PokeIDCR_P_APM_OutputPower
          SC_PokeIDCR_P_APM_PwrLoss_PokeIDCR_P_APM_PwrLoss: operation=PokeIDCR_P_APM_PwrLoss.PokeIDCR_P_APM_PwrLoss
          SC_PokeIDCR_P_AvailablePower_PokeIDCR_P_AvailablePower: operation=PokeIDCR_P_AvailablePower.PokeIDCR_P_AvailablePower
          SC_PokeIDCR_P_EVSEMaxPwrLmt_PokeIDCR_P_EVSEMaxPwrLmt: operation=PokeIDCR_P_EVSEMaxPwrLmt.PokeIDCR_P_EVSEMaxPwrLmt
          SC_PokeIDCR_Pct_UtilPctOfDCDC_PokeIDCR_Pct_UtilPctOfDCDC: operation=PokeIDCR_Pct_UtilPctOfDCDC.PokeIDCR_Pct_UtilPctOfDCDC
          SC_PokeIDCR_T_APM_TempColdPlate_PokeIDCR_T_APM_TempColdPlate: operation=PokeIDCR_T_APM_TempColdPlate.PokeIDCR_T_APM_TempColdPlate
          SC_PokeIDCR_T_Temp1_PokeIDCR_T_Temp1: operation=PokeIDCR_T_Temp1.PokeIDCR_T_Temp1
          SC_PokeIDCR_T_Temp2_PokeIDCR_T_Temp2: operation=PokeIDCR_T_Temp2.PokeIDCR_T_Temp2
          SC_PokeIDCR_U_ACOutVoltage{1..3}_PokeIDCR_U_ACOutVoltage{1..3}: operation=PokeIDCR_U_ACOutVoltage{1..3}.PokeIDCR_U_ACOutVoltage{1..3}
          SC_PokeIDCR_U_ACSideVolt_L2_PokeIDCR_U_ACSideVolt_L2: operation=PokeIDCR_U_ACSideVolt_L2.PokeIDCR_U_ACSideVolt_L2
          SC_PokeIDCR_U_ACSideVolt_L3_PokeIDCR_U_ACSideVolt_L3: operation=PokeIDCR_U_ACSideVolt_L3.PokeIDCR_U_ACSideVolt_L3
          SC_PokeIDCR_U_AC_InputVltOBCM_PokeIDCR_U_AC_InputVltOBCM: operation=PokeIDCR_U_AC_InputVltOBCM.PokeIDCR_U_AC_InputVltOBCM
          SC_PokeIDCR_U_APM_HV_Voltage_PokeIDCR_U_APM_HV_Voltage: operation=PokeIDCR_U_APM_HV_Voltage.PokeIDCR_U_APM_HV_Voltage
          SC_PokeIDCR_U_APM_HvVsetPFdbk_PokeIDCR_U_APM_HvVsetPFdbk: operation=PokeIDCR_U_APM_HvVsetPFdbk.PokeIDCR_U_APM_HvVsetPFdbk
          SC_PokeIDCR_U_APM_LV_Voltage_PokeIDCR_U_APM_LV_Voltage: operation=PokeIDCR_U_APM_LV_Voltage.PokeIDCR_U_APM_LV_Voltage
          SC_PokeIDCR_U_AcOutVoltage_PokeIDCR_U_AcOutVoltage: operation=PokeIDCR_U_AcOutVoltage.PokeIDCR_U_AcOutVoltage
          SC_PokeIDCR_U_BattSideVolt_PokeIDCR_U_BattSideVolt: operation=PokeIDCR_U_BattSideVolt.PokeIDCR_U_BattSideVolt
          SC_PokeIDCR_U_DCInVoltage_PokeIDCR_U_DCInVoltage: operation=PokeIDCR_U_DCInVoltage.PokeIDCR_U_DCInVoltage
          SC_PokeIDCR_U_EVSEMaxVoltLmt_PokeIDCR_U_EVSEMaxVoltLmt: operation=PokeIDCR_U_EVSEMaxVoltLmt.PokeIDCR_U_EVSEMaxVoltLmt
          SC_PokeIDCR_U_EVSEMinVoltLmt_PokeIDCR_U_EVSEMinVoltLmt: operation=PokeIDCR_U_EVSEMinVoltLmt.PokeIDCR_U_EVSEMinVoltLmt
          SC_PokeIDCR_U_EVSEOutputVolt_PokeIDCR_U_EVSEOutputVolt: operation=PokeIDCR_U_EVSEOutputVolt.PokeIDCR_U_EVSEOutputVolt
          SC_PokeIDCR_U_EVSE_ThrshldVoltage_PokeIDCR_U_EVSE_ThrshldVoltage: operation=PokeIDCR_U_EVSE_ThrshldVoltage.PokeIDCR_U_EVSE_ThrshldVoltage
          SC_PokeIDCR_U_OBC_Prox_PokeIDCR_U_OBC_Prox: operation=PokeIDCR_U_OBC_Prox.PokeIDCR_U_OBC_Prox
          SC_PokeIDCR_U_V2XInVoltage_PokeIDCR_U_V2XInVoltage: operation=PokeIDCR_U_V2XInVoltage.PokeIDCR_U_V2XInVoltage
          SC_PokeIDCR_U_V2XLVFeed_PokeIDCR_U_V2XLVFeed: operation=PokeIDCR_U_V2XLVFeed.PokeIDCR_U_V2XLVFeed
          SC_PokeIDCR_b_AC_LnHi_PokeIDCR_b_AC_LnHi: operation=PokeIDCR_b_AC_LnHi.PokeIDCR_b_AC_LnHi
          SC_PokeIDCR_b_AC_LnLow_PokeIDCR_b_AC_LnLow: operation=PokeIDCR_b_AC_LnLow.PokeIDCR_b_AC_LnLow
          SC_PokeIDCR_b_DC_Isolation_Disable_Cmd_PokeIDCR_b_DC_Isolation_Disable_Cmd: operation=PokeIDCR_b_DC_Isolation_Disable_Cmd.PokeIDCR_b_DC_Isolation_Disable_Cmd
          SC_PokeIDCR_b_DC_TimeOut_PokeIDCR_b_DC_TimeOut: operation=PokeIDCR_b_DC_TimeOut.PokeIDCR_b_DC_TimeOut
          SC_PokeIDCR_b_EVCC_FailureSts_PokeIDCR_b_EVCC_FailureSts: operation=PokeIDCR_b_EVCC_FailureSts.PokeIDCR_b_EVCC_FailureSts
          SC_PokeIDCR_b_EVSECurrLmtAchvd_PokeIDCR_b_EVSECurrLmtAchvd: operation=PokeIDCR_b_EVSECurrLmtAchvd.PokeIDCR_b_EVSECurrLmtAchvd
          SC_PokeIDCR_b_EVSEProcessing_PokeIDCR_b_EVSEProcessing: operation=PokeIDCR_b_EVSEProcessing.PokeIDCR_b_EVSEProcessing
          SC_PokeIDCR_b_EVSEPwrLmtAchvd_PokeIDCR_b_EVSEPwrLmtAchvd: operation=PokeIDCR_b_EVSEPwrLmtAchvd.PokeIDCR_b_EVSEPwrLmtAchvd
          SC_PokeIDCR_b_EVSEVoltLmtAchvd_PokeIDCR_b_EVSEVoltLmtAchvd: operation=PokeIDCR_b_EVSEVoltLmtAchvd.PokeIDCR_b_EVSEVoltLmtAchvd
          SC_PokeIDCR_b_EVSE_ChargingSystemError_PokeIDCR_b_EVSE_ChargingSystemError: operation=PokeIDCR_b_EVSE_ChargingSystemError.PokeIDCR_b_EVSE_ChargingSystemError
          SC_PokeIDCR_b_EVSE_EnergizingState_PokeIDCR_b_EVSE_EnergizingState: operation=PokeIDCR_b_EVSE_EnergizingState.PokeIDCR_b_EVSE_EnergizingState
          SC_PokeIDCR_b_EVSE_FreeService_PokeIDCR_b_EVSE_FreeService: operation=PokeIDCR_b_EVSE_FreeService.PokeIDCR_b_EVSE_FreeService
          SC_PokeIDCR_b_EVSE_OfferedPaymentContract_PokeIDCR_b_EVSE_OfferedPaymentContract: operation=PokeIDCR_b_EVSE_OfferedPaymentContract.PokeIDCR_b_EVSE_OfferedPaymentContract
          SC_PokeIDCR_b_EVSE_OfferedPaymentEIM_PokeIDCR_b_EVSE_OfferedPaymentEIM: operation=PokeIDCR_b_EVSE_OfferedPaymentEIM.PokeIDCR_b_EVSE_OfferedPaymentEIM
          SC_PokeIDCR_b_EVSE_Offered_AC_Single_Phase_PokeIDCR_b_EVSE_Offered_AC_Single_Phase: operation=PokeIDCR_b_EVSE_Offered_AC_Single_Phase.PokeIDCR_b_EVSE_Offered_AC_Single_Phase
          SC_PokeIDCR_b_EVSE_Offered_AC_Three_Phase_PokeIDCR_b_EVSE_Offered_AC_Three_Phase: operation=PokeIDCR_b_EVSE_Offered_AC_Three_Phase.PokeIDCR_b_EVSE_Offered_AC_Three_Phase
          SC_PokeIDCR_b_EVSE_Offered_DC_Extended_PokeIDCR_b_EVSE_Offered_DC_Extended: operation=PokeIDCR_b_EVSE_Offered_DC_Extended.PokeIDCR_b_EVSE_Offered_DC_Extended
          SC_PokeIDCR_b_EVSE_Service1_Charging_PokeIDCR_b_EVSE_Service1_Charging: operation=PokeIDCR_b_EVSE_Service1_Charging.PokeIDCR_b_EVSE_Service1_Charging
          SC_PokeIDCR_b_EVSE_Service1_Free_PokeIDCR_b_EVSE_Service1_Free: operation=PokeIDCR_b_EVSE_Service1_Free.PokeIDCR_b_EVSE_Service1_Free
          SC_PokeIDCR_b_EVSE_Service2_Certificate_PokeIDCR_b_EVSE_Service2_Certificate: operation=PokeIDCR_b_EVSE_Service2_Certificate.PokeIDCR_b_EVSE_Service2_Certificate
          SC_PokeIDCR_b_EVSE_Supported_DIN_PokeIDCR_b_EVSE_Supported_DIN: operation=PokeIDCR_b_EVSE_Supported_DIN.PokeIDCR_b_EVSE_Supported_DIN
          SC_PokeIDCR_b_EVSE_Supported_ISO1_PokeIDCR_b_EVSE_Supported_ISO1: operation=PokeIDCR_b_EVSE_Supported_ISO1.PokeIDCR_b_EVSE_Supported_ISO1
          SC_PokeIDCR_b_HvOverVStatus_PokeIDCR_b_HvOverVStatus: operation=PokeIDCR_b_HvOverVStatus.PokeIDCR_b_HvOverVStatus
          SC_PokeIDCR_b_HvTooHighIStatus_PokeIDCR_b_HvTooHighIStatus: operation=PokeIDCR_b_HvTooHighIStatus.PokeIDCR_b_HvTooHighIStatus
          SC_PokeIDCR_b_HvTooLowVStatus_PokeIDCR_b_HvTooLowVStatus: operation=PokeIDCR_b_HvTooLowVStatus.PokeIDCR_b_HvTooLowVStatus
          SC_PokeIDCR_b_IDCM_GFCI_FaultSts_PokeIDCR_b_IDCM_GFCI_FaultSts: operation=PokeIDCR_b_IDCM_GFCI_FaultSts.PokeIDCR_b_IDCM_GFCI_FaultSts, variation-point={short-label=vpSC_PokeIDCR_b_IDCM_GFCI_FaultSts_PokeIDCR_b_IDCM_GFCI_FaultSts, sw-syscond=1}
          SC_PokeIDCR_b_IDCM_Wakeup_HCP_PokeIDCR_b_IDCM_Wakeup_HCP: operation=PokeIDCR_b_IDCM_Wakeup_HCP.PokeIDCR_b_IDCM_Wakeup_HCP
          SC_PokeIDCR_b_ISO15118_TLS_Offered_PokeIDCR_b_ISO15118_TLS_Offered: operation=PokeIDCR_b_ISO15118_TLS_Offered.PokeIDCR_b_ISO15118_TLS_Offered
          SC_PokeIDCR_b_J1772_S2_Status_PokeIDCR_b_J1772_S2_Status: operation=PokeIDCR_b_J1772_S2_Status.PokeIDCR_b_J1772_S2_Status
          SC_PokeIDCR_b_OBCM_Timeout_PokeIDCR_b_OBCM_Timeout: operation=PokeIDCR_b_OBCM_Timeout.PokeIDCR_b_OBCM_Timeout
          SC_PokeIDCR_b_ReceiptRequired_PokeIDCR_b_ReceiptRequired: operation=PokeIDCR_b_ReceiptRequired.PokeIDCR_b_ReceiptRequired
          SC_PokeIDCR_b_StatusACPresent_PokeIDCR_b_StatusACPresent: operation=PokeIDCR_b_StatusACPresent.PokeIDCR_b_StatusACPresent
          SC_PokeIDCR_b_TCPCommTerminated_PokeIDCR_b_TCPCommTerminated: operation=PokeIDCR_b_TCPCommTerminated.PokeIDCR_b_TCPCommTerminated
          SC_PokeIDCR_b_V2XDerateSts_PokeIDCR_b_V2XDerateSts: operation=PokeIDCR_b_V2XDerateSts.PokeIDCR_b_V2XDerateSts
          SC_PokeIDCR_b_V2XFailSts_PokeIDCR_b_V2XFailSts: operation=PokeIDCR_b_V2XFailSts.PokeIDCR_b_V2XFailSts
          SC_PokeIDCR_b_V2XSts_PokeIDCR_b_V2XSts: operation=PokeIDCR_b_V2XSts.PokeIDCR_b_V2XSts
          SC_PokeIDCR_b_V2X_EVSE_Service_5_Free_PokeIDCR_b_V2X_EVSE_Service_5_Free: operation=PokeIDCR_b_V2X_EVSE_Service_5_Free.PokeIDCR_b_V2X_EVSE_Service_5_Free
          SC_PokeIDCR_b_V2X_EVSE_Service_5_V2H_PokeIDCR_b_V2X_EVSE_Service_5_V2H: operation=PokeIDCR_b_V2X_EVSE_Service_5_V2H.PokeIDCR_b_V2X_EVSE_Service_5_V2H
          SC_PokeIDCR_cmp_ISO15118_EVSETimeStamp_PokeIDCR_cmp_ISO15118_EVSETimeStamp: operation=PokeIDCR_cmp_ISO15118_EVSETimeStamp.PokeIDCR_cmp_ISO15118_EVSETimeStamp
          SC_PokeIDCR_d_EVSE_Accepted_Protocol_PokeIDCR_d_EVSE_Accepted_Protocol: operation=PokeIDCR_d_EVSE_Accepted_Protocol.PokeIDCR_d_EVSE_Accepted_Protocol
          SC_PokeIDCR_d_ISO15118_ServiceID_PokeIDCR_d_ISO15118_ServiceID: operation=PokeIDCR_d_ISO15118_ServiceID.PokeIDCR_d_ISO15118_ServiceID
          SC_PokeIDCR_e_APM2InterlockSts_PokeIDCR_e_APM2InterlockSts: operation=PokeIDCR_e_APM2InterlockSts.PokeIDCR_e_APM2InterlockSts
          SC_PokeIDCR_e_APM_DeratingModeStatus_PokeIDCR_e_APM_DeratingModeStatus: operation=PokeIDCR_e_APM_DeratingModeStatus.PokeIDCR_e_APM_DeratingModeStatus
          SC_PokeIDCR_e_APM_DeratingReason_PokeIDCR_e_APM_DeratingReason: operation=PokeIDCR_e_APM_DeratingReason.PokeIDCR_e_APM_DeratingReason
          SC_PokeIDCR_e_APM_FailureReason_PokeIDCR_e_APM_FailureReason: operation=PokeIDCR_e_APM_FailureReason.PokeIDCR_e_APM_FailureReason
          SC_PokeIDCR_e_APM_FailureType_PokeIDCR_e_APM_FailureType: operation=PokeIDCR_e_APM_FailureType.PokeIDCR_e_APM_FailureType
          SC_PokeIDCR_e_APM_ThermalRunaway_PokeIDCR_e_APM_ThermalRunaway: operation=PokeIDCR_e_APM_ThermalRunaway.PokeIDCR_e_APM_ThermalRunaway
          SC_PokeIDCR_e_Charger_WeldingDetectAvail_PokeIDCR_e_Charger_WeldingDetectAvail: operation=PokeIDCR_e_Charger_WeldingDetectAvail.PokeIDCR_e_Charger_WeldingDetectAvail
          SC_PokeIDCR_e_ChrgFailSts_PokeIDCR_e_ChrgFailSts: operation=PokeIDCR_e_ChrgFailSts.PokeIDCR_e_ChrgFailSts
          SC_PokeIDCR_e_ChrgrModeStat_OBCM_PokeIDCR_e_ChrgrModeStat_OBCM: operation=PokeIDCR_e_ChrgrModeStat_OBCM.PokeIDCR_e_ChrgrModeStat_OBCM
          SC_PokeIDCR_e_Chrgr_FaultStates_PokeIDCR_e_Chrgr_FaultStates: operation=PokeIDCR_e_Chrgr_FaultStates.PokeIDCR_e_Chrgr_FaultStates
          SC_PokeIDCR_e_DschrgFaultSts_PokeIDCR_e_DschrgFaultSts: operation=PokeIDCR_e_DschrgFaultSts.PokeIDCR_e_DschrgFaultSts
          SC_PokeIDCR_e_EVCC_FailureRsn_PokeIDCR_e_EVCC_FailureRsn: operation=PokeIDCR_e_EVCC_FailureRsn.PokeIDCR_e_EVCC_FailureRsn
          SC_PokeIDCR_e_EVSEIsolSts_PokeIDCR_e_EVSEIsolSts: operation=PokeIDCR_e_EVSEIsolSts.PokeIDCR_e_EVSEIsolSts
          SC_PokeIDCR_e_EVSEStsCode_PokeIDCR_e_EVSEStsCode: operation=PokeIDCR_e_EVSEStsCode.PokeIDCR_e_EVSEStsCode
          SC_PokeIDCR_e_EVSE_CHAdeMOProtocol_PokeIDCR_e_EVSE_CHAdeMOProtocol: operation=PokeIDCR_e_EVSE_CHAdeMOProtocol.PokeIDCR_e_EVSE_CHAdeMOProtocol
          SC_PokeIDCR_e_EVSE_ChrgStopControl_PokeIDCR_e_EVSE_ChrgStopControl: operation=PokeIDCR_e_EVSE_ChrgStopControl.PokeIDCR_e_EVSE_ChrgStopControl
          SC_PokeIDCR_e_EVSE_Error_PokeIDCR_e_EVSE_Error: operation=PokeIDCR_e_EVSE_Error.PokeIDCR_e_EVSE_Error
          SC_PokeIDCR_e_EVSE_Notification_PokeIDCR_e_EVSE_Notification: operation=PokeIDCR_e_EVSE_Notification.PokeIDCR_e_EVSE_Notification
          SC_PokeIDCR_e_EVSE_OfferedService_PokeIDCR_e_EVSE_OfferedService: operation=PokeIDCR_e_EVSE_OfferedService.PokeIDCR_e_EVSE_OfferedService
          SC_PokeIDCR_e_EVSE_PilotStat_OBCM_PokeIDCR_e_EVSE_PilotStat_OBCM: operation=PokeIDCR_e_EVSE_PilotStat_OBCM.PokeIDCR_e_EVSE_PilotStat_OBCM
          SC_PokeIDCR_e_ExtChargerSts_PokeIDCR_e_ExtChargerSts: operation=PokeIDCR_e_ExtChargerSts.PokeIDCR_e_ExtChargerSts
          SC_PokeIDCR_e_ISO15118_MessageResponse_PokeIDCR_e_ISO15118_MessageResponse: operation=PokeIDCR_e_ISO15118_MessageResponse.PokeIDCR_e_ISO15118_MessageResponse
          SC_PokeIDCR_e_ISO15118_ResponseCode_PokeIDCR_e_ISO15118_ResponseCode: operation=PokeIDCR_e_ISO15118_ResponseCode.PokeIDCR_e_ISO15118_ResponseCode
          SC_PokeIDCR_e_ISO15118_TLS_Status_PokeIDCR_e_ISO15118_TLS_Status: operation=PokeIDCR_e_ISO15118_TLS_Status.PokeIDCR_e_ISO15118_TLS_Status
          SC_PokeIDCR_e_J1772Stat_PokeIDCR_e_J1772Stat: operation=PokeIDCR_e_J1772Stat.PokeIDCR_e_J1772Stat
          SC_PokeIDCR_e_OBCM_CP{1..3}Sts_PokeIDCR_e_OBCM_CP{1..3}Sts: operation=PokeIDCR_e_OBCM_CP{1..3}Sts.PokeIDCR_e_OBCM_CP{1..3}Sts
          SC_PokeIDCR_e_OBCM_CSSts_PokeIDCR_e_OBCM_CSSts: operation=PokeIDCR_e_OBCM_CSSts.PokeIDCR_e_OBCM_CSSts
          SC_PokeIDCR_e_OBCM_Charger_Ready_PokeIDCR_e_OBCM_Charger_Ready: operation=PokeIDCR_e_OBCM_Charger_Ready.PokeIDCR_e_OBCM_Charger_Ready
          SC_PokeIDCR_e_OBCM_HVILSts_PokeIDCR_e_OBCM_HVILSts: operation=PokeIDCR_e_OBCM_HVILSts.PokeIDCR_e_OBCM_HVILSts
          SC_PokeIDCR_e_OffrdEnrgyTxType_PokeIDCR_e_OffrdEnrgyTxType: operation=PokeIDCR_e_OffrdEnrgyTxType.PokeIDCR_e_OffrdEnrgyTxType
          SC_PokeIDCR_e_OffrdPayOptn_PokeIDCR_e_OffrdPayOptn: operation=PokeIDCR_e_OffrdPayOptn.PokeIDCR_e_OffrdPayOptn
          SC_PokeIDCR_e_ProxStat_PokeIDCR_e_ProxStat: operation=PokeIDCR_e_ProxStat.PokeIDCR_e_ProxStat
          SC_PokeIDCR_e_Prox_GBT_PokeIDCR_e_Prox_GBT: operation=PokeIDCR_e_Prox_GBT.PokeIDCR_e_Prox_GBT
          SC_PokeIDCR_e_Resp_Code_PokeIDCR_e_Resp_Code: operation=PokeIDCR_e_Resp_Code.PokeIDCR_e_Resp_Code
          SC_PokeIDCR_e_SDP_Sts_PokeIDCR_e_SDP_Sts: operation=PokeIDCR_e_SDP_Sts.PokeIDCR_e_SDP_Sts
          SC_PokeIDCR_e_SLAC_Sts_PokeIDCR_e_SLAC_Sts: operation=PokeIDCR_e_SLAC_Sts.PokeIDCR_e_SLAC_Sts
          SC_PokeIDCR_e_SupProtoNm_PokeIDCR_e_SupProtoNm: operation=PokeIDCR_e_SupProtoNm.PokeIDCR_e_SupProtoNm
          SC_PokeIDCR_e_SupSchemaID_PokeIDCR_e_SupSchemaID: operation=PokeIDCR_e_SupSchemaID.PokeIDCR_e_SupSchemaID
          SC_PokeIDCR_e_SupVerNumMajor_PokeIDCR_e_SupVerNumMajor: operation=PokeIDCR_e_SupVerNumMajor.PokeIDCR_e_SupVerNumMajor
          SC_PokeIDCR_e_SupVerNumMinor_PokeIDCR_e_SupVerNumMinor: operation=PokeIDCR_e_SupVerNumMinor.PokeIDCR_e_SupVerNumMinor
          SC_PokeIDCR_e_TxMessageRequest_PokeIDCR_e_TxMessageRequest: operation=PokeIDCR_e_TxMessageRequest.PokeIDCR_e_TxMessageRequest
          SC_PokeIDCR_e_V2XDerateRsn_PokeIDCR_e_V2XDerateRsn: operation=PokeIDCR_e_V2XDerateRsn.PokeIDCR_e_V2XDerateRsn
          SC_PokeIDCR_e_V2XFaultRsn_PokeIDCR_e_V2XFaultRsn: operation=PokeIDCR_e_V2XFaultRsn.PokeIDCR_e_V2XFaultRsn
          SC_PokeIDCR_e_V2XInterlockSts_PokeIDCR_e_V2XInterlockSts: operation=PokeIDCR_e_V2XInterlockSts.PokeIDCR_e_V2XInterlockSts
          SC_PokeIDCR_e_V2XModeFeedback_PokeIDCR_e_V2XModeFeedback: operation=PokeIDCR_e_V2XModeFeedback.PokeIDCR_e_V2XModeFeedback
          SC_PokeIDCR_e_stModeRqAPM_PokeIDCR_e_stModeRqAPM: operation=PokeIDCR_e_stModeRqAPM.PokeIDCR_e_stModeRqAPM
          SC_PokeIDCR_f_ACOutFreq_PokeIDCR_f_ACOutFreq: operation=PokeIDCR_f_ACOutFreq.PokeIDCR_f_ACOutFreq
          SC_PokeIDCR_f_AcOutFrequency_PokeIDCR_f_AcOutFrequency: operation=PokeIDCR_f_AcOutFrequency.PokeIDCR_f_AcOutFrequency
          SC_PokeIDCR_f_V2XFrequency_PokeIDCR_f_V2XFrequency: operation=PokeIDCR_f_V2XFrequency.PokeIDCR_f_V2XFrequency
          SC_PokeIDCR_g_HVCMS_EVSEID_PokeIDCR_g_HVCMS_EVSEID: operation=PokeIDCR_g_HVCMS_EVSEID.PokeIDCR_g_HVCMS_EVSEID
          SC_PokeIDCR_i_IDCM_DCCA_M182_PokeIDCR_i_IDCM_DCCA_M182: operation=PokeIDCR_i_IDCM_DCCA_M182.PokeIDCR_i_IDCM_DCCA_M182
          SC_PokeIDCR_i_ISO15118_SAScheduleTupleID_PokeIDCR_i_ISO15118_SAScheduleTupleID: operation=PokeIDCR_i_ISO15118_SAScheduleTupleID.PokeIDCR_i_ISO15118_SAScheduleTupleID
          SC_PokeIDCR_t_EVSE_NotificationMaxDelay_PokeIDCR_t_EVSE_NotificationMaxDelay: operation=PokeIDCR_t_EVSE_NotificationMaxDelay.PokeIDCR_t_EVSE_NotificationMaxDelay
          SC_PokeIDCR_t_ISO15118_NotificationMaxDelay_PokeIDCR_t_ISO15118_NotificationMaxDelay: operation=PokeIDCR_t_ISO15118_NotificationMaxDelay.PokeIDCR_t_ISO15118_NotificationMaxDelay
          SC_PokeIDCR_y_ISO15118_SchemaID_PokeIDCR_y_ISO15118_SchemaID: operation=PokeIDCR_y_ISO15118_SchemaID.PokeIDCR_y_ISO15118_SchemaID
          SC_PokeIDCR_y_ISO15118_VersionNumMajor_PokeIDCR_y_ISO15118_VersionNumMajor: operation=PokeIDCR_y_ISO15118_VersionNumMajor.PokeIDCR_y_ISO15118_VersionNumMajor
          SC_PokeIDCR_y_ISO15118_VersionNumMinor_PokeIDCR_y_ISO15118_VersionNumMinor: operation=PokeIDCR_y_ISO15118_VersionNumMinor.PokeIDCR_y_ISO15118_VersionNumMinor
          SC_PokeIMPR_b_ImpactHardwire_PokeIMPR_b_ImpactHardwire: operation=PokeIMPR_b_ImpactHardwire.PokeIMPR_b_ImpactHardwire
          SC_PokeIMPR_b_ImpactHardwireV_PokeIMPR_b_ImpactHardwireV: operation=PokeIMPR_b_ImpactHardwireV.PokeIMPR_b_ImpactHardwireV
          SC_PokeTMIR_T_HV_BatHghTmp_Thrsh_PokeTMIR_T_HV_BatHghTmp_Thrsh: operation=PokeTMIR_T_HV_BatHghTmp_Thrsh.PokeTMIR_T_HV_BatHghTmp_Thrsh
          SC_PokeTMIR_T_HV_BatLowTmp_Thrsh_PokeTMIR_T_HV_BatLowTmp_Thrsh: operation=PokeTMIR_T_HV_BatLowTmp_Thrsh.PokeTMIR_T_HV_BatLowTmp_Thrsh
          SC_PokeTMIR_T_OBCMTemp{1..4}_PokeTMIR_T_OBCMTemp{1..4}: operation=PokeTMIR_T_OBCMTemp{1..4}.PokeTMIR_T_OBCMTemp{1..4}
          SC_PokeTRIR_T_HV_BatClntTmp_In_PokeTRIR_T_HV_BatClntTmp_In: operation=PokeTRIR_T_HV_BatClntTmp_In.PokeTRIR_T_HV_BatClntTmp_In
          SC_PokeTRIR_T_HV_BatClntTmp_Out_PokeTRIR_T_HV_BatClntTmp_Out: operation=PokeTRIR_T_HV_BatClntTmp_Out.PokeTRIR_T_HV_BatClntTmp_Out
          SC_TmotBPCR_b_HVBatCntrWeld_ImpdOpn_TmotBPCR_b_HVBatCntrWeld_ImpdOpn: operation=TmotBPCR_b_HVBatCntrWeld_ImpdOpn.TmotBPCR_b_HVBatCntrWeld_ImpdOpn
          SC_TmotBPCR_b_HV_BatChrgPwrET_TmotBPCR_b_HV_BatChrgPwrET: operation=TmotBPCR_b_HV_BatChrgPwrET.TmotBPCR_b_HV_BatChrgPwrET
          SC_TmotBPCR_b_HV_BatChrgPwrLT_TmotBPCR_b_HV_BatChrgPwrLT: operation=TmotBPCR_b_HV_BatChrgPwrLT.TmotBPCR_b_HV_BatChrgPwrLT
          SC_TmotBPCR_b_HV_BatChrgPwrST_TmotBPCR_b_HV_BatChrgPwrST: operation=TmotBPCR_b_HV_BatChrgPwrST.TmotBPCR_b_HV_BatChrgPwrST
          SC_TmotBPCR_b_HV_BatDschrgPwrET_TmotBPCR_b_HV_BatDschrgPwrET: operation=TmotBPCR_b_HV_BatDschrgPwrET.TmotBPCR_b_HV_BatDschrgPwrET
          SC_TmotBPCR_b_HV_BatDschrgPwrLT_TmotBPCR_b_HV_BatDschrgPwrLT: operation=TmotBPCR_b_HV_BatDschrgPwrLT.TmotBPCR_b_HV_BatDschrgPwrLT
          SC_TmotBPCR_b_HV_BatDschrgPwrST_TmotBPCR_b_HV_BatDschrgPwrST: operation=TmotBPCR_b_HV_BatDschrgPwrST.TmotBPCR_b_HV_BatDschrgPwrST
          SC_TmotBPCR_b_HV_BatModTempAvg_TmotBPCR_b_HV_BatModTempAvg: operation=TmotBPCR_b_HV_BatModTempAvg.TmotBPCR_b_HV_BatModTempAvg
          SC_TmotBPCR_b_HV_BatModTempMax_TmotBPCR_b_HV_BatModTempMax: operation=TmotBPCR_b_HV_BatModTempMax.TmotBPCR_b_HV_BatModTempMax
          SC_TmotBPCR_b_HV_BatModTempMin_TmotBPCR_b_HV_BatModTempMin: operation=TmotBPCR_b_HV_BatModTempMin.TmotBPCR_b_HV_BatModTempMin
          SC_TmotBPCR_b_HV_BatPackSOC_TmotBPCR_b_HV_BatPackSOC: operation=TmotBPCR_b_HV_BatPackSOC.TmotBPCR_b_HV_BatPackSOC
          SC_TmotTMIR_b_OBCMTemp1_TmotTMIR_b_OBCMTemp1: operation=TmotTMIR_b_OBCMTemp1.TmotTMIR_b_OBCMTemp1
          SC_TmotTMIR_b_OBCMTemp2_TmotTMIR_b_OBCMTemp2: operation=TmotTMIR_b_OBCMTemp2.TmotTMIR_b_OBCMTemp2
      5 x variation point proxy, all with category=CONDITION, condition-access=1:
        VrntCR2B_BPCMHVTracMainContacConfig
        VrntCR2B_BPCMRequestforAuxLoadoff
        VrntCR2B_BPCMSeriesVoltage
        VrntCR2B_DCChargeTypeStatus
        VrntCR2B_IDCMGFCIFaultStatus
