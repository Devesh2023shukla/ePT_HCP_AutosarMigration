AUTOSAR XML (schema 4-2-2)
package /STELLANTIS/EPT/COMSWCs
  application sw component type DNDB
    behavior IB_DNDB: data-type-mapping=msADTtoIDTMapping, handle-termination-and-restart=NO-SUPPORT
      timing event Event_MedTEF: start-on-event=DNDB_MedTEF, period=0.05
      init event Event_DNDB_ac_Init: start-on-event=DNDB_ac_Init
      runnable DNDB_ac_Init
      runnable DNDB_MedTEF
      4 x variation point proxy, all with category=CONDITION, condition-access=0:
        Variant_DNDB_IDCM_PEGASUS
        Variant_DNDB_MCPA_PEGASUS
        Variant_DNDB_MCPB_PEGASUS
        Variant_DNDB_SGCP_PEGASUS
