AUTOSAR XML (schema 4-2-2)
package /STELLANTIS/EPT/Implementations
  202 x swc implementation, all with programming-language=C:
    IMPL_LLDR_FUNC: sw-version=1.0.0, used-code-generator=TargetLink, vendor-id=35, behavior=IB_LLDR_FUNC
      code-descriptors:
        code SourceCode
          artifact-descriptors:
            short-label=ApplBEV.c, category=SWSRC
            short-label=ApplBEV.h, category=SWHDR
            short-label=HighLevelCtrl_BEV.c, category=SWSRC
            short-label=HighLevelCtrl_BEV.h, category=SWHDR
            short-label=ApplBEV_VehDyn.c, category=SWSRC
            short-label=ApplBEV_VehDyn.h, category=SWHDR
            short-label=ApplBev_Output.c, category=SWSRC
            short-label=ApplBev_Output.h, category=SWHDR
            short-label=ApplBEV_DiagQM.c, category=SWSRC
            short-label=ApplBEV_DiagQM.h, category=SWHDR
            short-label=applbev_EVCU2_io_var.h, category=SWHDR
            short-label=tl_extern.h, category=SWHDR
            short-label=tl_defines_a.h, category=SWHDR
            short-label=ApplBEV_Library.c, category=SWSRC
            short-label=ApplBEV_Library.h, category=SWHDR
            short-label=tab_fcn.h, category=SWHDR
            short-label=ApplBEV_Types.h, category=SWHDR
            short-label=ApplBEV_sched.c, category=SWSRC
            short-label=ApplBEV_sched.h, category=SWHDR
            short-label=tab_fcn.c, category=SWSRC
      resource consumption ResourceConsumption
    IMPL_SABR: sw-version=1.0.0, used-code-generator=TargetLink, vendor-id=35, behavior=IB_SABR
      code-descriptors:
        code SourceCode
          artifact-descriptors:
            short-label=VDAB_SL2outBEV.c, category=SWSRC
            short-label=VDAB_SL2outBEV.h, category=SWHDR
            short-label=VDAB_SL2outBEV_io_var.h, category=SWHDR
            short-label=tl_extern.h, category=SWHDR
            short-label=tl_defines_a.h, category=SWHDR
            short-label=VDAB_SL2outBEV_Types.h, category=SWHDR
            short-label=VDAB_Library.c, category=SWSRC
            short-label=VDAB_Library.h, category=SWHDR
            short-label=tab_fcn.h, category=SWHDR
            short-label=tab_fcn.c, category=SWSRC
      resource consumption ResourceConsumption
    IMP_AADR: sw-version=9.87.1, used-code-generator=Embedded Coder 7.5 (R2020b) 29-Jul-2020, vendor-id=0, behavior=IB_AADR
      code-descriptors:
        code Code
          artifact-descriptors:
            short-label=AADR_ac_c, category=SWSRC
            short-label=AADR_ac_h, category=SWHDR
            short-label=rt_defines_h, category=SWHDR
            short-label=rtwtypes_h, category=SWHDR
      resource consumption RsrcCons_AADR_ac
    IMP_AATR: sw-version=9.477.1, used-code-generator=Embedded Coder 7.5 (R2020b) 29-Jul-2020, vendor-id=0, behavior=IB_AATR
      code-descriptors:
        code Code
          artifact-descriptors:
            short-label=AATR_ac_c, category=SWSRC
            short-label=look1_iflf_binlca_16a_c, category=SWSRC
            short-label=AATR_ac_h, category=SWHDR
            short-label=look1_iflf_binlca_16a_h, category=SWHDR
            short-label=rt_defines_h, category=SWHDR
            short-label=rtwtypes_h, category=SWHDR
      resource consumption RsrcCons_AATR_ac
    IMP_ABCR: sw-version=9.17.1, used-code-generator=Embedded Coder 7.5 (R2020b) 29-Jul-2020, vendor-id=0, behavior=IB_ABCR
      code-descriptors:
        code Code
          artifact-descriptors:
            short-label=ABCR_ac_c, category=SWSRC
            short-label=look1_iflf_binlca_16a_c, category=SWSRC
            short-label=ABCR_ac_h, category=SWHDR
            short-label=look1_iflf_binlca_16a_h, category=SWHDR
            short-label=rtwtypes_h, category=SWHDR
      resource consumption RsrcCons_ABCR_ac
    IMP_ACCR: sw-version=9.76.1, used-code-generator=Embedded Coder 7.5 (R2020b) 29-Jul-2020, vendor-id=0, behavior=IB_ACCR
      code-descriptors:
        code Code
          artifact-descriptors:
            short-label=ACCR_ac_c, category=SWSRC
            short-label=look1_iflf_binlca_16a_c, category=SWSRC
            short-label=look2_ifbu8flf_binlca_16a_c, category=SWSRC
            short-label=look2_iflf_binlca_16a_c, category=SWSRC
            short-label=ACCR_ac_h, category=SWHDR
            short-label=look1_iflf_binlca_16a_h, category=SWHDR
            short-label=look2_ifbu8flf_binlca_16a_h, category=SWHDR
            short-label=look2_iflf_binlca_16a_h, category=SWHDR
            short-label=rtwtypes_h, category=SWHDR
      resource consumption RsrcCons_ACCR_ac
    IMP_ADAR: sw-version=9.319.1, used-code-generator=Embedded Coder 7.5 (R2020b) 29-Jul-2020, vendor-id=0, behavior=IB_ADAR
      code-descriptors:
        code Code
          artifact-descriptors:
            short-label=ADAR_ac_c, category=SWSRC
            short-label=look1_iflf_binlca_16a_c, category=SWSRC
            short-label=look2_iflf_binlca_16a_c, category=SWSRC
            short-label=ADAR_ac_h, category=SWHDR
            short-label=look1_iflf_binlca_16a_h, category=SWHDR
            short-label=look2_iflf_binlca_16a_h, category=SWHDR
            short-label=rtwtypes_h, category=SWHDR
      resource consumption RsrcCons_ADAR_ac
    IMP_ADCR: sw-version=9.324.1, used-code-generator=Embedded Coder 7.5 (R2020b) 29-Jul-2020, vendor-id=0, behavior=IB_ADCR
      code-descriptors:
        code Code
          artifact-descriptors:
            short-label=ADCR_ac_c, category=SWSRC
            short-label=look1_iflf_binlca_16a_c, category=SWSRC
            short-label=look2_iflf_binlca_16a_c, category=SWSRC
            short-label=ADCR_ac_h, category=SWHDR
            short-label=look1_iflf_binlca_16a_h, category=SWHDR
            short-label=look2_iflf_binlca_16a_h, category=SWHDR
            short-label=rtwtypes_h, category=SWHDR
      resource consumption RsrcCons_ADCR_ac
    IMP_ADFB: sw-version=1.75.1, used-code-generator=Embedded Coder 7.5 (R2020b) 29-Jul-2020, vendor-id=0, behavior=IB_ADFB
      code-descriptors:
        code Code
          artifact-descriptors:
            short-label=ADFB_ac_c, category=SWSRC
            short-label=ADFB_ac_h, category=SWHDR
            short-label=rtwtypes_h, category=SWHDR
      resource consumption RsrcCons_ADFB_ac
    IMP_ADIB: sw-version=4.653.1, used-code-generator=Embedded Coder 7.5 (R2020b) 29-Jul-2020, vendor-id=0, behavior=IB_ADIB
      code-descriptors:
        code Code
          artifact-descriptors:
            short-label=ADIB_ac_c, category=SWSRC
            short-label=look1_iflf_binlcapw_c, category=SWSRC
            short-label=look2_iflf_binlcapw_c, category=SWSRC
            short-label=ADIB_ac_h, category=SWHDR
            short-label=look1_iflf_binlcapw_h, category=SWHDR
            short-label=look2_iflf_binlcapw_h, category=SWHDR
            short-label=rtwtypes_h, category=SWHDR
      resource consumption RsrcCons_ADIB_ac
    IMP_ADIR: sw-version=9.241.1, used-code-generator=Embedded Coder 7.5 (R2020b) 29-Jul-2020, vendor-id=0, behavior=IB_ADIR
      code-descriptors:
        code Code
          artifact-descriptors:
            short-label=ADIR_ac_c, category=SWSRC
            short-label=ADIR_ac_h, category=SWHDR
            short-label=rtwtypes_h, category=SWHDR
      resource consumption RsrcCons_ADIR_ac
    IMP_AECR: sw-version=9.176.1, used-code-generator=Embedded Coder 7.5 (R2020b) 29-Jul-2020, vendor-id=0, behavior=IB_AECR
      code-descriptors:
        code Code
          artifact-descriptors:
            short-label=AECR_ac_c, category=SWSRC
            short-label=AECR_ac_h, category=SWHDR
            short-label=rtwtypes_h, category=SWHDR
            short-label=zero_crossing_types_h, category=SWHDR
      resource consumption RsrcCons_AECR_ac
    IMP_APMR: sw-version=9.208.1, used-code-generator=Embedded Coder 7.5 (R2020b) 29-Jul-2020, vendor-id=0, behavior=IB_APMR
      code-descriptors:
        code Code
          artifact-descriptors:
            short-label=APMR_ac_c, category=SWSRC
            short-label=APMR_ac_h, category=SWHDR
            short-label=rtwtypes_h, category=SWHDR
      resource consumption RsrcCons_APMR_ac
    IMP_APSB: sw-version=1.57.1, used-code-generator=Embedded Coder 7.5 (R2020b) 29-Jul-2020, vendor-id=0, behavior=IB_APSB
      code-descriptors:
        code Code
          artifact-descriptors:
            short-label=APSB_ac_c, category=SWSRC
            short-label=look1_iflf_binlca_19a_c, category=SWSRC
            short-label=APSB_ac_h, category=SWHDR
            short-label=look1_iflf_binlca_19a_h, category=SWHDR
            short-label=rtwtypes_h, category=SWHDR
      resource consumption RsrcCons_APSB_ac
    IMP_APSR: sw-version=9.303.1, used-code-generator=Embedded Coder 7.5 (R2020b) 29-Jul-2020, vendor-id=0, behavior=IB_APSR
      code-descriptors:
        code Code
          artifact-descriptors:
            short-label=APSR_ac_c, category=SWSRC
            short-label=look1_iflf_binlcapw_c, category=SWSRC
            short-label=look2_iflf_binlcapw_c, category=SWSRC
            short-label=APSR_ac_h, category=SWHDR
            short-label=look1_iflf_binlcapw_h, category=SWHDR
            short-label=look2_iflf_binlcapw_h, category=SWHDR
            short-label=rt_defines_h, category=SWHDR
            short-label=rtwtypes_h, category=SWHDR
      resource consumption RsrcCons_APSR_ac
    IMP_ASLR: sw-version=9.136.1, used-code-generator=Embedded Coder 7.5 (R2020b) 29-Jul-2020, vendor-id=0, behavior=IB_ASLR
      code-descriptors:
        code Code
          artifact-descriptors:
            short-label=ASLR_ac_c, category=SWSRC
            short-label=look1_iflf_binlca_16a_c, category=SWSRC
            short-label=ASLR_ac_h, category=SWHDR
            short-label=look1_iflf_binlca_16a_h, category=SWHDR
            short-label=rt_defines_h, category=SWHDR
            short-label=rtwtypes_h, category=SWHDR
      resource consumption RsrcCons_ASLR_ac
    IMP_ATRR: sw-version=9.151.1, used-code-generator=Embedded Coder 7.5 (R2020b) 29-Jul-2020, vendor-id=0, behavior=IB_ATRR
      code-descriptors:
        code Code
          artifact-descriptors:
            short-label=ATRR_ac_c, category=SWSRC
            short-label=look1_iflf_binlca_16a_c, category=SWSRC
            short-label=ATRR_ac_h, category=SWHDR
            short-label=look1_iflf_binlca_16a_h, category=SWHDR
            short-label=rtwtypes_h, category=SWHDR
      resource consumption RsrcCons_ATRR_ac
    IMP_AVTR: sw-version=9.55.1, used-code-generator=Embedded Coder 7.5 (R2020b) 29-Jul-2020, vendor-id=0, behavior=IB_AVTR
      code-descriptors:
        code Code
          artifact-descriptors:
            short-label=AVTR_ac_c, category=SWSRC
            short-label=AVTR_ac_h, category=SWHDR
            short-label=rtwtypes_h, category=SWHDR
      resource consumption RsrcCons_AVTR_ac
    IMP_AXLR: sw-version=9.203.1, used-code-generator=Embedded Coder 7.5 (R2020b) 29-Jul-2020, vendor-id=0, behavior=IB_AXLR
      code-descriptors:
        code Code
          artifact-descriptors:
            short-label=AXLR_ac_c, category=SWSRC
            short-label=look1_iflf_binlcapw_c, category=SWSRC
            short-label=AXLR_ac_h, category=SWHDR
            short-label=look1_iflf_binlcapw_h, category=SWHDR
            short-label=rtwtypes_h, category=SWHDR
      resource consumption RsrcCons_AXLR_ac
    IMP_BACR: sw-version=9.140.1, used-code-generator=Embedded Coder 7.5 (R2020b) 29-Jul-2020, vendor-id=0, behavior=IB_BACR
      code-descriptors:
        code Code
          artifact-descriptors:
            short-label=BACR_ac_c, category=SWSRC
            short-label=binsearch_u32f_16a_c, category=SWSRC
            short-label=intrp2d_fu32fla_16a_c, category=SWSRC
            short-label=look1_iflf_binlca_16a_c, category=SWSRC
            short-label=look2_iflf_binlca_16a_c, category=SWSRC
            short-label=plook_u32ff_binca_16a_c, category=SWSRC
            short-label=BACR_ac_h, category=SWHDR
            short-label=binsearch_u32f_16a_h, category=SWHDR
            short-label=intrp2d_fu32fla_16a_h, category=SWHDR
            short-label=look1_iflf_binlca_16a_h, category=SWHDR
            short-label=look2_iflf_binlca_16a_h, category=SWHDR
            short-label=plook_u32ff_binca_16a_h, category=SWHDR
            short-label=rtwtypes_h, category=SWHDR
      resource consumption RsrcCons_BACR_ac
    IMP_BCPR: sw-version=9.34.1, used-code-generator=Embedded Coder 7.5 (R2020b) 29-Jul-2020, vendor-id=0, behavior=IB_BCPR
      code-descriptors:
        code Code
          artifact-descriptors:
            short-label=BCPR_ac_c, category=SWSRC
            short-label=look1_iflf_binlca_16a_c, category=SWSRC
            short-label=BCPR_ac_h, category=SWHDR
            short-label=MemMap_h, category=SWHDR
            short-label=look1_iflf_binlca_16a_h, category=SWHDR
            short-label=rtwtypes_h, category=SWHDR
      resource consumption RsrcCons_BCPR_ac
    IMP_BPCR: sw-version=9.246.1, used-code-generator=Embedded Coder 7.5 (R2020b) 29-Jul-2020, vendor-id=0, behavior=IB_BPCR
      code-descriptors:
        code Code
          artifact-descriptors:
            short-label=BPCR_ac_c, category=SWSRC
            short-label=look1_iflf_binlca_16a_c, category=SWSRC
            short-label=BPCR_ac_h, category=SWHDR
            short-label=look1_iflf_binlca_16a_h, category=SWHDR
            short-label=rt_defines_h, category=SWHDR
            short-label=rtwtypes_h, category=SWHDR
      resource consumption RsrcCons_BPCR_ac
    IMP_BPDR: sw-version=9.98.1, used-code-generator=Embedded Coder 7.5 (R2020b) 29-Jul-2020, vendor-id=0, behavior=IB_BPDR
      code-descriptors:
        code Code
          artifact-descriptors:
            short-label=BPDR_ac_c, category=SWSRC
            short-label=look1_iflf_binlca_16a_c, category=SWSRC
            short-label=BPDR_ac_h, category=SWHDR
            short-label=look1_iflf_binlca_16a_h, category=SWHDR
            short-label=rtwtypes_h, category=SWHDR
      resource consumption RsrcCons_BPDR_ac
    IMP_BPSR: sw-version=9.59.1, used-code-generator=Embedded Coder 7.5 (R2020b) 29-Jul-2020, vendor-id=0, behavior=IB_BPSR
      code-descriptors:
        code Code
          artifact-descriptors:
            short-label=BPSR_ac_c, category=SWSRC
            short-label=look1_iflf_binlca_16a_c, category=SWSRC
            short-label=look2_iflf_binlca_16a_c, category=SWSRC
            short-label=BPSR_ac_h, category=SWHDR
            short-label=look1_iflf_binlca_16a_h, category=SWHDR
            short-label=look2_iflf_binlca_16a_h, category=SWHDR
            short-label=rt_defines_h, category=SWHDR
            short-label=rtwtypes_h, category=SWHDR
      resource consumption RsrcCons_BPSR_ac
    IMP_BRDR: sw-version=9.865.1, used-code-generator=Embedded Coder 7.5 (R2020b) 29-Jul-2020, vendor-id=0, behavior=IB_BRDR
      code-descriptors:
        code Code
          artifact-descriptors:
            short-label=BRDR_ac_c, category=SWSRC
            short-label=look1_iflf_binlca_16a_c, category=SWSRC
            short-label=look2_iflf_binlca_16a_c, category=SWSRC
            short-label=BRDR_ac_h, category=SWHDR
            short-label=look1_iflf_binlca_16a_h, category=SWHDR
            short-label=look2_iflf_binlca_16a_h, category=SWHDR
            short-label=rtwtypes_h, category=SWHDR
      resource consumption RsrcCons_BRDR_ac
    IMP_BRKB: sw-version=1.65.1, used-code-generator=Embedded Coder 7.5 (R2020b) 29-Jul-2020, vendor-id=0, behavior=IB_BRKB
      code-descriptors:
        code Code
          artifact-descriptors:
            short-label=BRKB_ac_c, category=SWSRC
            short-label=look1_iflf_binlca_19a_c, category=SWSRC
            short-label=BRKB_ac_h, category=SWHDR
            short-label=look1_iflf_binlca_19a_h, category=SWHDR
            short-label=rtwtypes_h, category=SWHDR
      resource consumption RsrcCons_BRKB_ac
    IMP_BRKR: sw-version=9.179.1, used-code-generator=Embedded Coder 7.5 (R2020b) 29-Jul-2020, vendor-id=0, behavior=IB_BRKR
      code-descriptors:
        code Code
          artifact-descriptors:
            short-label=BRKR_ac_c, category=SWSRC
            short-label=BRKR_ac_h, category=SWHDR
            short-label=rtwtypes_h, category=SWHDR
      resource consumption RsrcCons_BRKR_ac
    IMP_BTQR: sw-version=9.110.1, used-code-generator=Embedded Coder 7.5 (R2020b) 29-Jul-2020, vendor-id=0, behavior=IB_BTQR
      code-descriptors:
        code Code
          artifact-descriptors:
            short-label=BTQR_ac_c, category=SWSRC
            short-label=look1_iflf_binlca_16a_c, category=SWSRC
            short-label=look2_iflf_binlca_16a_c, category=SWSRC
            short-label=BTQR_ac_h, category=SWHDR
            short-label=look1_iflf_binlca_16a_h, category=SWHDR
            short-label=look2_iflf_binlca_16a_h, category=SWHDR
            short-label=rt_defines_h, category=SWHDR
            short-label=rtwtypes_h, category=SWHDR
      resource consumption RsrcCons_BTQR_ac
    IMP_BTRR: sw-version=9.228.1, used-code-generator=Embedded Coder 7.5 (R2020b) 29-Jul-2020, vendor-id=0, behavior=IB_BTRR
      code-descriptors:
        code Code
          artifact-descriptors:
            short-label=BTRR_ac_c, category=SWSRC
            short-label=look1_iflf_binlcapw_c, category=SWSRC
            short-label=BTRR_ac_h, category=SWHDR
            short-label=look1_iflf_binlcapw_h, category=SWHDR
            short-label=rtwtypes_h, category=SWHDR
      resource consumption RsrcCons_BTRR_ac
    IMP_CCCR: sw-version=9.496.1, used-code-generator=Embedded Coder 7.5 (R2020b) 29-Jul-2020, vendor-id=0, behavior=IB_CCCR
      code-descriptors:
        code Code
          artifact-descriptors:
            short-label=CCCR_ac_c, category=SWSRC
            short-label=look1_iflf_binlcapw_c, category=SWSRC
            short-label=look2_iflf_binlcapw_c, category=SWSRC
            short-label=CCCR_ac_h, category=SWHDR
            short-label=look1_iflf_binlcapw_h, category=SWHDR
            short-label=look2_iflf_binlcapw_h, category=SWHDR
            short-label=rtwtypes_h, category=SWHDR
      resource consumption RsrcCons_CCCR_ac
    IMP_CCMB: sw-version=1.347.1, used-code-generator=Embedded Coder 7.5 (R2020b) 29-Jul-2020, vendor-id=0, behavior=IB_CCMB
      code-descriptors:
        code Code
          artifact-descriptors:
            short-label=CCMB_ac_c, category=SWSRC
            short-label=CCMB_ac_h, category=SWHDR
            short-label=rtwtypes_h, category=SWHDR
      resource consumption RsrcCons_CCMB_ac
    IMP_CCTR: sw-version=9.54.1, used-code-generator=Embedded Coder 7.5 (R2020b) 29-Jul-2020, vendor-id=0, behavior=IB_CCTR
      code-descriptors:
        code Code
          artifact-descriptors:
            short-label=CCTR_ac_c, category=SWSRC
            short-label=look1_iflf_binlca_16a_c, category=SWSRC
            short-label=CCTR_ac_h, category=SWHDR
            short-label=look1_iflf_binlca_16a_h, category=SWHDR
            short-label=rt_defines_h, category=SWHDR
            short-label=rtwtypes_h, category=SWHDR
      resource consumption RsrcCons_CCTR_ac
    IMP_CDMR: sw-version=9.138.1, used-code-generator=Embedded Coder 7.5 (R2020b) 29-Jul-2020, vendor-id=0, behavior=IB_CDMR
      code-descriptors:
        code Code
          artifact-descriptors:
            short-label=CDMR_ac_c, category=SWSRC
            short-label=CDMR_ac_h, category=SWHDR
            short-label=rtwtypes_h, category=SWHDR
      resource consumption RsrcCons_CDMR_ac
    IMP_CHDR: sw-version=1.636.1, used-code-generator=Embedded Coder 7.5 (R2020b) 29-Jul-2020, vendor-id=0, behavior=IB_CHDR
      code-descriptors:
        code Code
          artifact-descriptors:
            short-label=CHDR_ac_c, category=SWSRC
            short-label=CHDR_ac_h, category=SWHDR
            short-label=rtwtypes_h, category=SWHDR
      resource consumption RsrcCons_CHDR_ac
    IMP_CHFR: sw-version=1.77.1, used-code-generator=Embedded Coder 7.5 (R2020b) 29-Jul-2020, vendor-id=0, behavior=IB_CHFR
      code-descriptors:
        code Code
          artifact-descriptors:
            short-label=CHFR_ac_c, category=SWSRC
            short-label=look1_iflf_binlcapw_c, category=SWSRC
            short-label=CHFR_ac_h, category=SWHDR
            short-label=look1_iflf_binlcapw_h, category=SWHDR
            short-label=rtwtypes_h, category=SWHDR
      resource consumption RsrcCons_CHFR_ac
    IMP_CIDB: sw-version=1.1573.1, used-code-generator=Embedded Coder 7.5 (R2020b) 29-Jul-2020, vendor-id=0, behavior=IB_CIDB
      code-descriptors:
        code Code
          artifact-descriptors:
            short-label=CIDB_ac_c, category=SWSRC
            short-label=CIDB_ac_h, category=SWHDR
            short-label=rtwtypes_h, category=SWHDR
      resource consumption RsrcCons_CIDB_ac
    IMP_CITR: sw-version=9.327.1, used-code-generator=Embedded Coder 7.5 (R2020b) 29-Jul-2020, vendor-id=0, behavior=IB_CITR
      code-descriptors:
        code Code
          artifact-descriptors:
            short-label=CITR_ac_c, category=SWSRC
            short-label=CITR_ac_h, category=SWHDR
            short-label=rt_defines_h, category=SWHDR
            short-label=rtwtypes_h, category=SWHDR
      resource consumption RsrcCons_CITR_ac
    IMP_COMR: sw-version=9.27.1, used-code-generator=Embedded Coder 7.5 (R2020b) 29-Jul-2020, vendor-id=0, behavior=IB_COMR
      code-descriptors:
        code Code
          artifact-descriptors:
            short-label=COMR_ac_c, category=SWSRC
            short-label=COMR_ac_h, category=SWHDR
            short-label=rtwtypes_h, category=SWHDR
      resource consumption RsrcCons_COMR_ac
    IMP_COUB: sw-version=1.575.1, used-code-generator=Embedded Coder 7.5 (R2020b) 29-Jul-2020, vendor-id=0, behavior=IB_COUB
      code-descriptors:
        code Code
          artifact-descriptors:
            short-label=COUB_ac_c, category=SWSRC
            short-label=COUB_ac_h, category=SWHDR
            short-label=rtwtypes_h, category=SWHDR
      resource consumption RsrcCons_COUB_ac
    IMP_CPDR: sw-version=9.216.1, used-code-generator=Embedded Coder 7.5 (R2020b) 29-Jul-2020, vendor-id=0, behavior=IB_CPDR
      code-descriptors:
        code Code
          artifact-descriptors:
            short-label=CPDR_ac_c, category=SWSRC
            short-label=look1_iflf_binlca_16a_c, category=SWSRC
            short-label=CPDR_ac_h, category=SWHDR
            short-label=look1_iflf_binlca_16a_h, category=SWHDR
            short-label=rtwtypes_h, category=SWHDR
      resource consumption RsrcCons_CPDR_ac
    IMP_CPLR: sw-version=9.319.1, used-code-generator=Embedded Coder 7.5 (R2020b) 29-Jul-2020, vendor-id=0, behavior=IB_CPLR
      code-descriptors:
        code Code
          artifact-descriptors:
            short-label=CPLR_ac_c, category=SWSRC
            short-label=CPLR_ac_h, category=SWHDR
            short-label=rtwtypes_h, category=SWHDR
      resource consumption RsrcCons_CPLR_ac
    IMP_CR1B_FUNC: sw-version=1.67.1, used-code-generator=Embedded Coder 7.5 (R2020b) 29-Jul-2020, vendor-id=0, behavior=IB_CR1B_FUNC
      code-descriptors:
        code Code
          artifact-descriptors:
            short-label=CR1B_FUNC_ac_c, category=SWSRC
            short-label=CR1B_FUNC_ac_h, category=SWHDR
            short-label=rtwtypes_h, category=SWHDR
      resource consumption RsrcCons_CR1B_FUNC_ac
    IMP_CR2B_FUNC: sw-version=1.66.1, used-code-generator=Embedded Coder 7.5 (R2020b) 29-Jul-2020, vendor-id=0, behavior=IB_CR2B_FUNC
      code-descriptors:
        code Code
          artifact-descriptors:
            short-label=CR2B_FUNC_ac_c, category=SWSRC
            short-label=CR2B_FUNC_ac_h, category=SWHDR
            short-label=rtwtypes_h, category=SWHDR
      resource consumption RsrcCons_CR2B_FUNC_ac
    IMP_CR3B_FUNC: sw-version=1.53.1, used-code-generator=Embedded Coder 7.5 (R2020b) 29-Jul-2020, vendor-id=0, behavior=IB_CR3B_FUNC
      code-descriptors:
        code Code
          artifact-descriptors:
            short-label=CR3B_FUNC_ac_c, category=SWSRC
            short-label=CR3B_FUNC_ac_h, category=SWHDR
            short-label=rtwtypes_h, category=SWHDR
      resource consumption RsrcCons_CR3B_FUNC_ac
    IMP_CR4B_FUNC: sw-version=1.53.1, used-code-generator=Embedded Coder 7.5 (R2020b) 29-Jul-2020, vendor-id=0, behavior=IB_CR4B_FUNC
      code-descriptors:
        code Code
          artifact-descriptors:
            short-label=CR4B_FUNC_ac_c, category=SWSRC
            short-label=CR4B_FUNC_ac_h, category=SWHDR
            short-label=rtwtypes_h, category=SWHDR
      resource consumption RsrcCons_CR4B_FUNC_ac
    IMP_CRDB_FUNC: sw-version=1.116.1, used-code-generator=Embedded Coder 7.5 (R2020b) 29-Jul-2020, vendor-id=0, behavior=IB_CRDB_FUNC
      code-descriptors:
        code Code
          artifact-descriptors:
            short-label=CRDB_FUNC_ac_c, category=SWSRC
            short-label=CRDB_FUNC_ac_h, category=SWHDR
            short-label=rtwtypes_h, category=SWHDR
      resource consumption RsrcCons_CRDB_FUNC_ac
    IMP_CSDR: sw-version=9.77.1, used-code-generator=Embedded Coder 7.5 (R2020b) 29-Jul-2020, vendor-id=0, behavior=IB_CSDR
      code-descriptors:
        code Code
          artifact-descriptors:
            short-label=CSDR_ac_c, category=SWSRC
            short-label=look1_iflf_binlca_16a_c, category=SWSRC
            short-label=CSDR_ac_h, category=SWHDR
            short-label=look1_iflf_binlca_16a_h, category=SWHDR
            short-label=rtwtypes_h, category=SWHDR
      resource consumption RsrcCons_CSDR_ac
    IMP_CSLR: sw-version=9.85.1, used-code-generator=Embedded Coder 7.5 (R2020b) 29-Jul-2020, vendor-id=0, behavior=IB_CSLR
      code-descriptors:
        code Code
          artifact-descriptors:
            short-label=CSLR_ac_c, category=SWSRC
            short-label=look1_iflf_binlca_16a_c, category=SWSRC
            short-label=CSLR_ac_h, category=SWHDR
            short-label=look1_iflf_binlca_16a_h, category=SWHDR
            short-label=rtwtypes_h, category=SWHDR
      resource consumption RsrcCons_CSLR_ac
    IMP_CSMR: sw-version=9.412.1, used-code-generator=Embedded Coder 7.5 (R2020b) 29-Jul-2020, vendor-id=0, behavior=IB_CSMR
      code-descriptors:
        code Code
          artifact-descriptors:
            short-label=CSMR_ac_c, category=SWSRC
            short-label=mod_JrdzB8Sm_16a_c, category=SWSRC
            short-label=CSMR_ac_h, category=SWHDR
            short-label=mod_JrdzB8Sm_16a_h, category=SWHDR
            short-label=rtwtypes_h, category=SWHDR
      resource consumption RsrcCons_CSMR_ac
    IMP_CSVR: sw-version=9.82.1, used-code-generator=Embedded Coder 7.5 (R2020b) 29-Jul-2020, vendor-id=0, behavior=IB_CSVR
      code-descriptors:
        code Code
          artifact-descriptors:
            short-label=CSVR_ac_c, category=SWSRC
            short-label=look1_iflf_binlca_16a_c, category=SWSRC
            short-label=CSVR_ac_h, category=SWHDR
            short-label=look1_iflf_binlca_16a_h, category=SWHDR
            short-label=rtwtypes_h, category=SWHDR
            short-label=zero_crossing_types_h, category=SWHDR
      resource consumption RsrcCons_CSVR_ac
    IMP_CT1B_FUNC: sw-version=1.45.1, used-code-generator=Embedded Coder 7.5 (R2020b) 29-Jul-2020, vendor-id=0, behavior=IB_CT1B_FUNC
      code-descriptors:
        code Code
          artifact-descriptors:
            short-label=CT1B_FUNC_ac_c, category=SWSRC
            short-label=CT1B_FUNC_ac_h, category=SWHDR
            short-label=rtwtypes_h, category=SWHDR
      resource consumption RsrcCons_CT1B_FUNC_ac
    IMP_CT2B_FUNC: sw-version=1.49.1, used-code-generator=Embedded Coder 7.5 (R2020b) 29-Jul-2020, vendor-id=0, behavior=IB_CT2B_FUNC
      code-descriptors:
        code Code
          artifact-descriptors:
            short-label=CT2B_FUNC_ac_c, category=SWSRC
            short-label=CT2B_FUNC_ac_h, category=SWHDR
            short-label=rtwtypes_h, category=SWHDR
      resource consumption RsrcCons_CT2B_FUNC_ac
    IMP_CT3B_FUNC: sw-version=1.41.1, used-code-generator=Embedded Coder 7.5 (R2020b) 29-Jul-2020, vendor-id=0, behavior=IB_CT3B_FUNC
      code-descriptors:
        code Code
          artifact-descriptors:
            short-label=CT3B_FUNC_ac_c, category=SWSRC
            short-label=CT3B_FUNC_ac_h, category=SWHDR
            short-label=rtwtypes_h, category=SWHDR
      resource consumption RsrcCons_CT3B_FUNC_ac
    IMP_CT4B_FUNC: sw-version=1.42.1, used-code-generator=Embedded Coder 7.5 (R2020b) 29-Jul-2020, vendor-id=0, behavior=IB_CT4B_FUNC
      code-descriptors:
        code Code
          artifact-descriptors:
            short-label=CT4B_FUNC_ac_c, category=SWSRC
            short-label=CT4B_FUNC_ac_h, category=SWHDR
            short-label=rtwtypes_h, category=SWHDR
      resource consumption RsrcCons_CT4B_FUNC_ac
    IMP_CT5B_FUNC: sw-version=1.53.1, used-code-generator=Embedded Coder 7.5 (R2020b) 29-Jul-2020, vendor-id=0, behavior=IB_CT5B_FUNC
      code-descriptors:
        code Code
          artifact-descriptors:
            short-label=CT5B_FUNC_ac_c, category=SWSRC
            short-label=CT5B_FUNC_ac_h, category=SWHDR
            short-label=rtwtypes_h, category=SWHDR
      resource consumption RsrcCons_CT5B_FUNC_ac
    IMP_CTCR: sw-version=1.211.1, used-code-generator=Embedded Coder 7.5 (R2020b) 29-Jul-2020, vendor-id=0, behavior=IB_CTCR
      code-descriptors:
        code Code
          artifact-descriptors:
            short-label=CTCR_ac_c, category=SWSRC
            short-label=look1_iflf_binlcapw_c, category=SWSRC
            short-label=look2_iflf_binlcapw_c, category=SWSRC
            short-label=CTCR_ac_h, category=SWHDR
            short-label=look1_iflf_binlcapw_h, category=SWHDR
            short-label=look2_iflf_binlcapw_h, category=SWHDR
            short-label=rtwtypes_h, category=SWHDR
      resource consumption RsrcCons_CTCR_ac
    IMP_CTMR: sw-version=9.242.1, used-code-generator=Embedded Coder 7.5 (R2020b) 29-Jul-2020, vendor-id=0, behavior=IB_CTMR
      code-descriptors:
        code Code
          artifact-descriptors:
            short-label=CTMR_ac_c, category=SWSRC
            short-label=look1_iflf_binlcapw_c, category=SWSRC
            short-label=look2_iflf_binlcapw_c, category=SWSRC
            short-label=CTMR_ac_h, category=SWHDR
            short-label=look1_iflf_binlcapw_h, category=SWHDR
            short-label=look2_iflf_binlcapw_h, category=SWHDR
            short-label=rtwtypes_h, category=SWHDR
      resource consumption RsrcCons_CTMR_ac
    IMP_CTRR: sw-version=9.126.1, used-code-generator=Embedded Coder 7.5 (R2020b) 29-Jul-2020, vendor-id=0, behavior=IB_CTRR
      code-descriptors:
        code Code
          artifact-descriptors:
            short-label=CTRR_ac_c, category=SWSRC
            short-label=look1_iflf_binlcapw_c, category=SWSRC
            short-label=look2_iflf_binlcapw_c, category=SWSRC
            short-label=CTRR_ac_h, category=SWHDR
            short-label=look1_iflf_binlcapw_h, category=SWHDR
            short-label=look2_iflf_binlcapw_h, category=SWHDR
            short-label=rtwtypes_h, category=SWHDR
      resource consumption RsrcCons_CTRR_ac
    IMP_DCAB: sw-version=1.15.1, used-code-generator=Embedded Coder 7.5 (R2020b) 29-Jul-2020, vendor-id=0, behavior=IB_DCAB
      code-descriptors:
        code Code
          artifact-descriptors:
            short-label=DCAB_ac_c, category=SWSRC
            short-label=DCAB_ac_h, category=SWHDR
            short-label=rt_defines_h, category=SWHDR
            short-label=rtwtypes_h, category=SWHDR
      resource consumption RsrcCons_DCAB_ac
    IMP_DCCR: sw-version=9.1156.1, used-code-generator=Embedded Coder 7.5 (R2020b) 29-Jul-2020, vendor-id=0, behavior=IB_DCCR
      code-descriptors:
        code Code
          artifact-descriptors:
            short-label=DCCR_ac_c, category=SWSRC
            short-label=DCCR_ac_h, category=SWHDR
            short-label=rtwtypes_h, category=SWHDR
      resource consumption RsrcCons_DCCR_ac
    IMP_DFIB: sw-version=1.830.1, used-code-generator=Embedded Coder 7.5 (R2020b) 29-Jul-2020, vendor-id=0, behavior=IB_DFIB
      code-descriptors:
        code Code
          artifact-descriptors:
            short-label=DFIB_ac_c, category=SWSRC
            short-label=DFIB_ac_h, category=SWHDR
            short-label=rtwtypes_h, category=SWHDR
      resource consumption RsrcCons_DFIB_ac
    IMP_DMAB: sw-version=1.532.1, used-code-generator=Embedded Coder 7.5 (R2020b) 29-Jul-2020, vendor-id=0, behavior=IB_DMAB
      code-descriptors:
        code Code
          artifact-descriptors:
            short-label=DMAB_ac_c, category=SWSRC
            short-label=DMAB_ac_h, category=SWHDR
            short-label=rtwtypes_h, category=SWHDR
      resource consumption RsrcCons_DMAB_ac
    IMP_DMDR: sw-version=9.509.1, used-code-generator=Embedded Coder 7.5 (R2020b) 29-Jul-2020, vendor-id=0, behavior=IB_DMDR
      code-descriptors:
        code Code
          artifact-descriptors:
            short-label=DMDR_ac_c, category=SWSRC
            short-label=look1_iflf_binlca_16a_c, category=SWSRC
            short-label=DMDR_ac_h, category=SWHDR
            short-label=look1_iflf_binlca_16a_h, category=SWHDR
            short-label=rtwtypes_h, category=SWHDR
      resource consumption RsrcCons_DMDR_ac
    IMP_DMIB: sw-version=4.239.1, used-code-generator=Embedded Coder 7.5 (R2020b) 29-Jul-2020, vendor-id=0, behavior=IB_DMIB
      code-descriptors:
        code Code
          artifact-descriptors:
            short-label=DMIB_ac_c, category=SWSRC
            short-label=DMIB_ac_h, category=SWHDR
            short-label=rtwtypes_h, category=SWHDR
      resource consumption RsrcCons_DMIB_ac
    IMP_DMIR: sw-version=9.459.1, used-code-generator=Embedded Coder 7.5 (R2020b) 29-Jul-2020, vendor-id=0, behavior=IB_DMIR
      code-descriptors:
        code Code
          artifact-descriptors:
            short-label=DMIR_ac_c, category=SWSRC
            short-label=look1_iflf_binlcapw_c, category=SWSRC
            short-label=DMIR_ac_h, category=SWHDR
            short-label=look1_iflf_binlcapw_h, category=SWHDR
            short-label=rt_defines_h, category=SWHDR
            short-label=rtwtypes_h, category=SWHDR
            short-label=zero_crossing_types_h, category=SWHDR
      resource consumption RsrcCons_DMIR_ac
    IMP_DNDB: sw-version=1.787.1, used-code-generator=Embedded Coder 7.5 (R2020b) 29-Jul-2020, vendor-id=0, behavior=IB_DNDB
      code-descriptors:
        code Code
          artifact-descriptors:
            short-label=DNDB_ac_c, category=SWSRC
            short-label=DNDB_ac_h, category=SWHDR
            short-label=rtwtypes_h, category=SWHDR
      resource consumption RsrcCons_DNDB_ac
    IMP_DTMR: sw-version=9.1463.1, used-code-generator=Embedded Coder 7.5 (R2020b) 29-Jul-2020, vendor-id=0, behavior=IB_DTMR
      code-descriptors:
        code Code
          artifact-descriptors:
            short-label=DTMR_ac_c, category=SWSRC
            short-label=look1_iflf_binlca_16a_c, category=SWSRC
            short-label=look2_iflf_binlca_16a_c, category=SWSRC
            short-label=DTMR_ac_h, category=SWHDR
            short-label=look1_iflf_binlca_16a_h, category=SWHDR
            short-label=look2_iflf_binlca_16a_h, category=SWHDR
            short-label=rtwtypes_h, category=SWHDR
      resource consumption RsrcCons_DTMR_ac
    IMP_DTRR: sw-version=9.432.1, used-code-generator=Embedded Coder 7.5 (R2020b) 29-Jul-2020, vendor-id=0, behavior=IB_DTRR
      code-descriptors:
        code Code
          artifact-descriptors:
            short-label=DTRR_ac_c, category=SWSRC
            short-label=look1_iflf_binlcapw_c, category=SWSRC
            short-label=look2_iflf_binlcapw_c, category=SWSRC
            short-label=DTRR_ac_h, category=SWHDR
            short-label=look1_iflf_binlcapw_h, category=SWHDR
            short-label=look2_iflf_binlcapw_h, category=SWHDR
            short-label=rtwtypes_h, category=SWHDR
      resource consumption RsrcCons_DTRR_ac
    IMP_EBMR: sw-version=9.168.1, used-code-generator=Embedded Coder 7.5 (R2020b) 29-Jul-2020, vendor-id=0, behavior=IB_EBMR
      code-descriptors:
        code Code
          artifact-descriptors:
            short-label=EBMR_ac_c, category=SWSRC
            short-label=EBMR_ac_h, category=SWHDR
            short-label=rtwtypes_h, category=SWHDR
      resource consumption RsrcCons_EBMR_ac
    IMP_ENGR: sw-version=9.178.1, used-code-generator=Embedded Coder 7.5 (R2020b) 29-Jul-2020, vendor-id=0, behavior=IB_ENGR
      code-descriptors:
        code Code
          artifact-descriptors:
            short-label=ENGR_ac_c, category=SWSRC
            short-label=ENGR_ac_h, category=SWHDR
            short-label=rt_defines_h, category=SWHDR
            short-label=rtwtypes_h, category=SWHDR
      resource consumption RsrcCons_ENGR_ac
    IMP_EOCR: sw-version=9.42.1, used-code-generator=Embedded Coder 7.5 (R2020b) 29-Jul-2020, vendor-id=0, behavior=IB_EOCR
      code-descriptors:
        code Code
          artifact-descriptors:
            short-label=EOCR_ac_c, category=SWSRC
            short-label=look1_iflf_binlca_16a_c, category=SWSRC
            short-label=look2_iflf_binlca_16a_c, category=SWSRC
            short-label=EOCR_ac_h, category=SWHDR
            short-label=look1_iflf_binlca_16a_h, category=SWHDR
            short-label=look2_iflf_binlca_16a_h, category=SWHDR
            short-label=rtwtypes_h, category=SWHDR
      resource consumption RsrcCons_EOCR_ac
    IMP_EPCR: sw-version=9.281.1, used-code-generator=Embedded Coder 7.5 (R2020b) 29-Jul-2020, vendor-id=0, behavior=IB_EPCR
      code-descriptors:
        code Code
          artifact-descriptors:
            short-label=EPCR_ac_c, category=SWSRC
            short-label=look1_iflf_binlca_16a_c, category=SWSRC
            short-label=look1_is32bflftf_binlca_16a_c, category=SWSRC
            short-label=EPCR_ac_h, category=SWHDR
            short-label=look1_iflf_binlca_16a_h, category=SWHDR
            short-label=look1_is32bflftf_binlca_16a_h, category=SWHDR
            short-label=rtwtypes_h, category=SWHDR
      resource consumption RsrcCons_EPCR_ac
    IMP_ERER: sw-version=9.804.1, used-code-generator=Embedded Coder 7.5 (R2020b) 29-Jul-2020, vendor-id=0, behavior=IB_ERER
      code-descriptors:
        code Code
          artifact-descriptors:
            short-label=ERER_ac_c, category=SWSRC
            short-label=look1_iflf_binlca_16a_c, category=SWSRC
            short-label=look2_iflf_binlca_16a_c, category=SWSRC
            short-label=ERER_ac_h, category=SWHDR
            short-label=look1_iflf_binlca_16a_h, category=SWHDR
            short-label=look2_iflf_binlca_16a_h, category=SWHDR
            short-label=rtwtypes_h, category=SWHDR
      resource consumption RsrcCons_ERER_ac
    IMP_ESMR: sw-version=9.144.1, used-code-generator=Embedded Coder 7.5 (R2020b) 29-Jul-2020, vendor-id=0, behavior=IB_ESMR
      code-descriptors:
        code Code
          artifact-descriptors:
            short-label=ESMR_ac_c, category=SWSRC
            short-label=look1_iflf_binlca_16a_c, category=SWSRC
            short-label=look2_iflf_binlca_16a_c, category=SWSRC
            short-label=ESMR_ac_h, category=SWHDR
            short-label=look1_iflf_binlca_16a_h, category=SWHDR
            short-label=look2_iflf_binlca_16a_h, category=SWHDR
            short-label=rtwtypes_h, category=SWHDR
      resource consumption RsrcCons_ESMR_ac
    IMP_ESPR: sw-version=9.151.1, used-code-generator=Embedded Coder 7.5 (R2020b) 29-Jul-2020, vendor-id=0, behavior=IB_ESPR
      code-descriptors:
        code Code
          artifact-descriptors:
            short-label=ESPR_ac_c, category=SWSRC
            short-label=look1_iflf_binlca_16a_c, category=SWSRC
            short-label=ESPR_ac_h, category=SWHDR
            short-label=look1_iflf_binlca_16a_h, category=SWHDR
            short-label=rt_defines_h, category=SWHDR
            short-label=rtwtypes_h, category=SWHDR
      resource consumption RsrcCons_ESPR_ac
    IMP_ESSR: sw-version=9.209.1, used-code-generator=Embedded Coder 7.5 (R2020b) 29-Jul-2020, vendor-id=0, behavior=IB_ESSR
      code-descriptors:
        code Code
          artifact-descriptors:
            short-label=ESSR_ac_c, category=SWSRC
            short-label=look1_iflf_binlcapw_c, category=SWSRC
            short-label=look2_iflf_binlcapw_c, category=SWSRC
            short-label=ESSR_ac_h, category=SWHDR
            short-label=look1_iflf_binlcapw_h, category=SWHDR
            short-label=look2_iflf_binlcapw_h, category=SWHDR
            short-label=rtwtypes_h, category=SWHDR
            short-label=zero_crossing_types_h, category=SWHDR
      resource consumption RsrcCons_ESSR_ac
    IMP_ETQR: sw-version=9.75.1, used-code-generator=Embedded Coder 7.5 (R2020b) 29-Jul-2020, vendor-id=0, behavior=IB_ETQR
      code-descriptors:
        code Code
          artifact-descriptors:
            short-label=ETQR_ac_c, category=SWSRC
            short-label=ETQR_ac_h, category=SWHDR
            short-label=MemMap_h, category=SWHDR
            short-label=rt_defines_h, category=SWHDR
            short-label=rtwtypes_h, category=SWHDR
      resource consumption RsrcCons_ETQR_ac
    IMP_FCPR: sw-version=9.109.1, used-code-generator=Embedded Coder 7.5 (R2020b) 29-Jul-2020, vendor-id=0, behavior=IB_FCPR
      code-descriptors:
        code Code
          artifact-descriptors:
            short-label=FCPR_ac_c, category=SWSRC
            short-label=look1_iflf_binlca_16a_c, category=SWSRC
            short-label=FCPR_ac_h, category=SWHDR
            short-label=look1_iflf_binlca_16a_h, category=SWHDR
            short-label=rt_defines_h, category=SWHDR
            short-label=rtwtypes_h, category=SWHDR
      resource consumption RsrcCons_FCPR_ac
    IMP_FCRR: sw-version=9.71.1, used-code-generator=Embedded Coder 7.5 (R2020b) 29-Jul-2020, vendor-id=0, behavior=IB_FCRR
      code-descriptors:
        code Code
          artifact-descriptors:
            short-label=FCRR_ac_c, category=SWSRC
            short-label=look1_iflf_binlca_16a_c, category=SWSRC
            short-label=look2_iflf_binlca_16a_c, category=SWSRC
            short-label=FCRR_ac_h, category=SWHDR
            short-label=look1_iflf_binlca_16a_h, category=SWHDR
            short-label=look2_iflf_binlca_16a_h, category=SWHDR
            short-label=rtwtypes_h, category=SWHDR
      resource consumption RsrcCons_FCRR_ac
    IMP_FSCR: sw-version=9.118.1, used-code-generator=Embedded Coder 7.5 (R2020b) 29-Jul-2020, vendor-id=0, behavior=IB_FSCR
      code-descriptors:
        code Code
          artifact-descriptors:
            short-label=FSCR_ac_c, category=SWSRC
            short-label=look1_iflf_binlca_16a_c, category=SWSRC
            short-label=look1_iu8bflftf_binlca_16a_c, category=SWSRC
            short-label=FSCR_ac_h, category=SWHDR
            short-label=look1_iflf_binlca_16a_h, category=SWHDR
            short-label=look1_iu8bflftf_binlca_16a_h, category=SWHDR
            short-label=rtwtypes_h, category=SWHDR
      resource consumption RsrcCons_FSCR_ac
    IMP_FWDR: sw-version=9.38.1, used-code-generator=Embedded Coder 7.5 (R2020b) 29-Jul-2020, vendor-id=0, behavior=IB_FWDR
      code-descriptors:
        code Code
          artifact-descriptors:
            short-label=FWDR_ac_c, category=SWSRC
            short-label=FWDR_ac_h, category=SWHDR
            short-label=rtwtypes_h, category=SWHDR
      resource consumption RsrcCons_FWDR_ac
    IMP_GENR: sw-version=9.66.1, used-code-generator=Embedded Coder 7.5 (R2020b) 29-Jul-2020, vendor-id=0, behavior=IB_GENR
      code-descriptors:
        code Code
          artifact-descriptors:
            short-label=GENR_ac_c, category=SWSRC
            short-label=look1_iflf_binlca_16a_c, category=SWSRC
            short-label=look2_iflf_binlca_16a_c, category=SWSRC
            short-label=GENR_ac_h, category=SWHDR
            short-label=look1_iflf_binlca_16a_h, category=SWHDR
            short-label=look2_iflf_binlca_16a_h, category=SWHDR
            short-label=rtwtypes_h, category=SWHDR
      resource consumption RsrcCons_GENR_ac
    IMP_GRAR: sw-version=9.1768.1, used-code-generator=Embedded Coder 7.5 (R2020b) 29-Jul-2020, vendor-id=0, behavior=IB_GRAR
      code-descriptors:
        code Code
          artifact-descriptors:
            short-label=GRAR_ac_c, category=SWSRC
            short-label=GRAR_ac_h, category=SWHDR
            short-label=rtwtypes_h, category=SWHDR
      resource consumption RsrcCons_GRAR_ac
    IMP_GSMR: sw-version=9.622.1, used-code-generator=Embedded Coder 7.5 (R2020b) 29-Jul-2020, vendor-id=0, behavior=IB_GSMR
      code-descriptors:
        code Code
          artifact-descriptors:
            short-label=GSMR_ac_c, category=SWSRC
            short-label=GSMR_ac_h, category=SWHDR
            short-label=rtwtypes_h, category=SWHDR
      resource consumption RsrcCons_GSMR_ac
    IMP_HADR: sw-version=9.268.1, used-code-generator=Embedded Coder 7.5 (R2020b) 29-Jul-2020, vendor-id=0, behavior=IB_HADR
      code-descriptors:
        code Code
          artifact-descriptors:
            short-label=HADR_ac_c, category=SWSRC
            short-label=look2_iflf_binlca_16a_c, category=SWSRC
            short-label=HADR_ac_h, category=SWHDR
            short-label=look2_iflf_binlca_16a_h, category=SWHDR
            short-label=rtwtypes_h, category=SWHDR
      resource consumption RsrcCons_HADR_ac
    IMP_HCCR: sw-version=9.82.1, used-code-generator=Embedded Coder 7.5 (R2020b) 29-Jul-2020, vendor-id=0, behavior=IB_HCCR
      code-descriptors:
        code Code
          artifact-descriptors:
            short-label=HCCR_ac_c, category=SWSRC
            short-label=look1_iflf_binlca_16a_c, category=SWSRC
            short-label=look2_iflf_binlca_16a_c, category=SWSRC
            short-label=HCCR_ac_h, category=SWHDR
            short-label=look1_iflf_binlca_16a_h, category=SWHDR
            short-label=look2_iflf_binlca_16a_h, category=SWHDR
            short-label=rtwtypes_h, category=SWHDR
      resource consumption RsrcCons_HCCR_ac
    IMP_HCDR: sw-version=9.83.1, used-code-generator=Embedded Coder 7.5 (R2020b) 29-Jul-2020, vendor-id=0, behavior=IB_HCDR
      code-descriptors:
        code Code
          artifact-descriptors:
            short-label=HCDR_ac_c, category=SWSRC
            short-label=look1_iflf_binlca_16a_c, category=SWSRC
            short-label=HCDR_ac_h, category=SWHDR
            short-label=look1_iflf_binlca_16a_h, category=SWHDR
            short-label=rtwtypes_h, category=SWHDR
      resource consumption RsrcCons_HCDR_ac
    IMP_HMIR: sw-version=9.236.1, used-code-generator=Embedded Coder 7.5 (R2020b) 29-Jul-2020, vendor-id=0, behavior=IB_HMIR
      code-descriptors:
        code Code
          artifact-descriptors:
            short-label=HMIR_ac_c, category=SWSRC
            short-label=look1_iflf_binlca_16a_c, category=SWSRC
            short-label=HMIR_ac_h, category=SWHDR
            short-label=look1_iflf_binlca_16a_h, category=SWHDR
            short-label=rt_defines_h, category=SWHDR
            short-label=rtwtypes_h, category=SWHDR
      resource consumption RsrcCons_HMIR_ac
    IMP_HPMR: sw-version=9.295.1, used-code-generator=Embedded Coder 7.5 (R2020b) 29-Jul-2020, vendor-id=0, behavior=IB_HPMR
      code-descriptors:
        code Code
          artifact-descriptors:
            short-label=HPMR_ac_c, category=SWSRC
            short-label=HPMR_ac_h, category=SWHDR
            short-label=rtwtypes_h, category=SWHDR
      resource consumption RsrcCons_HPMR_ac
    IMP_HSCR: sw-version=9.181.1, used-code-generator=Embedded Coder 7.5 (R2020b) 29-Jul-2020, vendor-id=0, behavior=IB_HSCR
      code-descriptors:
        code Code
          artifact-descriptors:
            short-label=HSCR_ac_c, category=SWSRC
            short-label=look1_iflf_binlca_16a_c, category=SWSRC
            short-label=HSCR_ac_h, category=SWHDR
            short-label=look1_iflf_binlca_16a_h, category=SWHDR
            short-label=rtwtypes_h, category=SWHDR
      resource consumption RsrcCons_HSCR_ac
    IMP_HSER: sw-version=9.473.1, used-code-generator=Embedded Coder 7.5 (R2020b) 29-Jul-2020, vendor-id=0, behavior=IB_HSER
      code-descriptors:
        code Code
          artifact-descriptors:
            short-label=HSER_ac_c, category=SWSRC
            short-label=look1_iflf_binlca_16a_c, category=SWSRC
            short-label=look2_iflf_binlca_16a_c, category=SWSRC
            short-label=HSER_ac_h, category=SWHDR
            short-label=MemMap_h, category=SWHDR
            short-label=look1_iflf_binlca_16a_h, category=SWHDR
            short-label=look2_iflf_binlca_16a_h, category=SWHDR
            short-label=rtwtypes_h, category=SWHDR
      resource consumption RsrcCons_HSER_ac
    IMP_HSWB: sw-version=1.53.1, used-code-generator=Embedded Coder 7.5 (R2020b) 29-Jul-2020, vendor-id=0, behavior=IB_HSWB
      code-descriptors:
        code Code
          artifact-descriptors:
            short-label=HSWB_ac_c, category=SWSRC
            short-label=look1_iflf_binlca_19a_c, category=SWSRC
            short-label=HSWB_ac_h, category=SWHDR
            short-label=look1_iflf_binlca_19a_h, category=SWHDR
            short-label=rtwtypes_h, category=SWHDR
      resource consumption RsrcCons_HSWB_ac
    IMP_HSWR: sw-version=9.167.1, used-code-generator=Embedded Coder 7.5 (R2020b) 29-Jul-2020, vendor-id=0, behavior=IB_HSWR
      code-descriptors:
        code Code
          artifact-descriptors:
            short-label=HSWR_ac_c, category=SWSRC
            short-label=HSWR_ac_h, category=SWHDR
            short-label=rt_defines_h, category=SWHDR
            short-label=rtwtypes_h, category=SWHDR
      resource consumption RsrcCons_HSWR_ac
    IMP_HTDR: sw-version=9.254.1, used-code-generator=Embedded Coder 7.5 (R2020b) 29-Jul-2020, vendor-id=0, behavior=IB_HTDR
      code-descriptors:
        code Code
          artifact-descriptors:
            short-label=HTDR_ac_c, category=SWSRC
            short-label=look1_iflf_binlcapw_c, category=SWSRC
            short-label=look2_iflf_binlcapw_c, category=SWSRC
            short-label=HTDR_ac_h, category=SWHDR
            short-label=look1_iflf_binlcapw_h, category=SWHDR
            short-label=look2_iflf_binlcapw_h, category=SWHDR
            short-label=rt_defines_h, category=SWHDR
            short-label=rtwtypes_h, category=SWHDR
      resource consumption RsrcCons_HTDR_ac
    IMP_HTIR: sw-version=9.65.1, used-code-generator=Embedded Coder 7.5 (R2020b) 29-Jul-2020, vendor-id=0, behavior=IB_HTIR
      code-descriptors:
        code Code
          artifact-descriptors:
            short-label=HTIR_ac_c, category=SWSRC
            short-label=HTIR_ac_h, category=SWHDR
            short-label=rt_defines_h, category=SWHDR
            short-label=rtwtypes_h, category=SWHDR
      resource consumption RsrcCons_HTIR_ac
    IMP_HTRR: sw-version=9.48.1, used-code-generator=Embedded Coder 7.5 (R2020b) 29-Jul-2020, vendor-id=0, behavior=IB_HTRR
      code-descriptors:
        code Code
          artifact-descriptors:
            short-label=HTRR_ac_c, category=SWSRC
            short-label=look1_iflf_binlcapw_c, category=SWSRC
            short-label=HTRR_ac_h, category=SWHDR
            short-label=look1_iflf_binlcapw_h, category=SWHDR
            short-label=rtwtypes_h, category=SWHDR
      resource consumption RsrcCons_HTRR_ac
    IMP_HVTR: sw-version=9.354.1, used-code-generator=Embedded Coder 7.5 (R2020b) 29-Jul-2020, vendor-id=0, behavior=IB_HVTR
      code-descriptors:
        code Code
          artifact-descriptors:
            short-label=HVTR_ac_c, category=SWSRC
            short-label=HVTR_ac_h, category=SWHDR
            short-label=rtwtypes_h, category=SWHDR
      resource consumption RsrcCons_HVTR_ac
    IMP_HW2B: sw-version=1.89.1, used-code-generator=Embedded Coder 7.5 (R2020b) 29-Jul-2020, vendor-id=0, behavior=IB_HW2B
      code-descriptors:
        code Code
          artifact-descriptors:
            short-label=HW2B_ac_c, category=SWSRC
            short-label=HW2B_ac_h, category=SWHDR
            short-label=rtwtypes_h, category=SWHDR
      resource consumption RsrcCons_HW2B_ac
    IMP_ICSR: sw-version=9.127.1, used-code-generator=Embedded Coder 7.5 (R2020b) 29-Jul-2020, vendor-id=0, behavior=IB_ICSR
      code-descriptors:
        code Code
          artifact-descriptors:
            short-label=ICSR_ac_c, category=SWSRC
            short-label=look1_iflf_binlcapw_c, category=SWSRC
            short-label=look2_iflf_binlcapw_c, category=SWSRC
            short-label=ICSR_ac_h, category=SWHDR
            short-label=look1_iflf_binlcapw_h, category=SWHDR
            short-label=look2_iflf_binlcapw_h, category=SWHDR
            short-label=rtwtypes_h, category=SWHDR
      resource consumption RsrcCons_ICSR_ac
    IMP_IDCR: sw-version=9.533.1, used-code-generator=Embedded Coder 7.5 (R2020b) 29-Jul-2020, vendor-id=0, behavior=IB_IDCR
      code-descriptors:
        code Code
          artifact-descriptors:
            short-label=IDCR_ac_c, category=SWSRC
            short-label=IDCR_ac_h, category=SWHDR
            short-label=rt_defines_h, category=SWHDR
            short-label=rtwtypes_h, category=SWHDR
      resource consumption RsrcCons_IDCR_ac
    IMP_IMOR: sw-version=9.171.1, used-code-generator=Embedded Coder 7.5 (R2020b) 29-Jul-2020, vendor-id=0, behavior=IB_IMOR
      code-descriptors:
        code Code
          artifact-descriptors:
            short-label=IMOR_ac_c, category=SWSRC
            short-label=IMOR_ac_h, category=SWHDR
            short-label=imor_header_h, category=SWHDR
            short-label=rt_defines_h, category=SWHDR
            short-label=rtwtypes_h, category=SWHDR
      resource consumption RsrcCons_IMOR_ac
    IMP_IMPR: sw-version=9.82.1, used-code-generator=Embedded Coder 7.5 (R2020b) 29-Jul-2020, vendor-id=0, behavior=IB_IMPR
      code-descriptors:
        code Code
          artifact-descriptors:
            short-label=IMPR_ac_c, category=SWSRC
            short-label=IMPR_ac_h, category=SWHDR
            short-label=rt_defines_h, category=SWHDR
            short-label=rtwtypes_h, category=SWHDR
      resource consumption RsrcCons_IMPR_ac
    IMP_INVR: sw-version=9.106.1, used-code-generator=Embedded Coder 7.5 (R2020b) 29-Jul-2020, vendor-id=0, behavior=IB_INVR
      code-descriptors:
        code Code
          artifact-descriptors:
            short-label=INVR_ac_c, category=SWSRC
            short-label=look1_iflf_binlca_16a_c, category=SWSRC
            short-label=INVR_ac_h, category=SWHDR
            short-label=look1_iflf_binlca_16a_h, category=SWHDR
            short-label=rt_defines_h, category=SWHDR
            short-label=rtwtypes_h, category=SWHDR
      resource consumption RsrcCons_INVR_ac
    IMP_ITIR: sw-version=1.82.1, used-code-generator=Embedded Coder 7.5 (R2020b) 29-Jul-2020, vendor-id=0, behavior=IB_ITIR
      code-descriptors:
        code Code
          artifact-descriptors:
            short-label=ITIR_ac_c, category=SWSRC
            short-label=ITIR_ac_h, category=SWHDR
            short-label=rtwtypes_h, category=SWHDR
      resource consumption RsrcCons_ITIR_ac
    IMP_LLER: sw-version=9.40.1, used-code-generator=Embedded Coder 7.5 (R2020b) 29-Jul-2020, vendor-id=0, behavior=IB_LLER
      code-descriptors:
        code Code
          artifact-descriptors:
            short-label=LLER_ac_c, category=SWSRC
            short-label=LLER_ac_h, category=SWHDR
            short-label=rtwtypes_h, category=SWHDR
      resource consumption RsrcCons_LLER_ac
    IMP_LQIR: sw-version=9.87.1, used-code-generator=Embedded Coder 7.5 (R2020b) 29-Jul-2020, vendor-id=0, behavior=IB_LQIR
      code-descriptors:
        code Code
          artifact-descriptors:
            short-label=LQIR_ac_c, category=SWSRC
            short-label=look1_iflf_binlcapw_c, category=SWSRC
            short-label=LQIR_ac_h, category=SWHDR
            short-label=look1_iflf_binlcapw_h, category=SWHDR
            short-label=rtwtypes_h, category=SWHDR
      resource consumption RsrcCons_LQIR_ac
    IMP_LR1B_FUNC: sw-version=1.53.1, used-code-generator=Embedded Coder 7.5 (R2020b) 29-Jul-2020, vendor-id=0, behavior=IB_LR1B_FUNC
      code-descriptors:
        code Code
          artifact-descriptors:
            short-label=LR1B_FUNC_ac_c, category=SWSRC
            short-label=LR1B_FUNC_ac_h, category=SWHDR
            short-label=rtwtypes_h, category=SWHDR
      resource consumption RsrcCons_LR1B_FUNC_ac
    IMP_LR2B_FUNC: sw-version=1.57.1, used-code-generator=Embedded Coder 7.5 (R2020b) 29-Jul-2020, vendor-id=0, behavior=IB_LR2B_FUNC
      code-descriptors:
        code Code
          artifact-descriptors:
            short-label=LR2B_FUNC_ac_c, category=SWSRC
            short-label=LR2B_FUNC_ac_h, category=SWHDR
            short-label=rtwtypes_h, category=SWHDR
      resource consumption RsrcCons_LR2B_FUNC_ac
    IMP_LR3B_FUNC: sw-version=1.61.1, used-code-generator=Embedded Coder 7.5 (R2020b) 29-Jul-2020, vendor-id=0, behavior=IB_LR3B_FUNC
      code-descriptors:
        code Code
          artifact-descriptors:
            short-label=LR3B_FUNC_ac_c, category=SWSRC
            short-label=LR3B_FUNC_ac_h, category=SWHDR
            short-label=rtwtypes_h, category=SWHDR
      resource consumption RsrcCons_LR3B_FUNC_ac
    IMP_LT1B_FUNC: sw-version=1.41.1, used-code-generator=Embedded Coder 7.5 (R2020b) 29-Jul-2020, vendor-id=0, behavior=IB_LT1B_FUNC
      code-descriptors:
        code Code
          artifact-descriptors:
            short-label=LT1B_FUNC_ac_c, category=SWSRC
            short-label=LT1B_FUNC_ac_h, category=SWHDR
            short-label=rtwtypes_h, category=SWHDR
      resource consumption RsrcCons_LT1B_FUNC_ac
    IMP_LT2B_FUNC: sw-version=1.47.1, used-code-generator=Embedded Coder 7.5 (R2020b) 29-Jul-2020, vendor-id=0, behavior=IB_LT2B_FUNC
      code-descriptors:
        code Code
          artifact-descriptors:
            short-label=LT2B_FUNC_ac_c, category=SWSRC
            short-label=LT2B_FUNC_ac_h, category=SWHDR
            short-label=rtwtypes_h, category=SWHDR
      resource consumption RsrcCons_LT2B_FUNC_ac
    IMP_LT3B_FUNC: sw-version=1.48.1, used-code-generator=Embedded Coder 7.5 (R2020b) 29-Jul-2020, vendor-id=0, behavior=IB_LT3B_FUNC
      code-descriptors:
        code Code
          artifact-descriptors:
            short-label=LT3B_FUNC_ac_c, category=SWSRC
            short-label=LT3B_FUNC_ac_h, category=SWHDR
            short-label=rtwtypes_h, category=SWHDR
      resource consumption RsrcCons_LT3B_FUNC_ac
    IMP_LTIR: sw-version=9.1079.1, used-code-generator=Embedded Coder 7.5 (R2020b) 29-Jul-2020, vendor-id=0, behavior=IB_LTIR
      code-descriptors:
        code Code
          artifact-descriptors:
            short-label=LTIR_ac_c, category=SWSRC
            short-label=LTIR_ac_h, category=SWHDR
            short-label=rtwtypes_h, category=SWHDR
      resource consumption RsrcCons_LTIR_ac
    IMP_MMMR: sw-version=9.333.1, used-code-generator=Embedded Coder 7.5 (R2020b) 29-Jul-2020, vendor-id=0, behavior=IB_MMMR
      code-descriptors:
        code Code
          artifact-descriptors:
            short-label=MMMR_ac_c, category=SWSRC
            short-label=MMMR_ac_h, category=SWHDR
            short-label=rtwtypes_h, category=SWHDR
      resource consumption RsrcCons_MMMR_ac
    IMP_MSPR: sw-version=9.83.1, used-code-generator=Embedded Coder 7.5 (R2020b) 29-Jul-2020, vendor-id=0, behavior=IB_MSPR
      code-descriptors:
        code Code
          artifact-descriptors:
            short-label=MSPR_ac_c, category=SWSRC
            short-label=MSPR_ac_h, category=SWHDR
            short-label=rt_defines_h, category=SWHDR
            short-label=rtwtypes_h, category=SWHDR
      resource consumption RsrcCons_MSPR_ac
    IMP_MTIR: sw-version=9.31.1, used-code-generator=Embedded Coder 7.5 (R2020b) 29-Jul-2020, vendor-id=0, behavior=IB_MTIR
      code-descriptors:
        code Code
          artifact-descriptors:
            short-label=MTIR_ac_c, category=SWSRC
            short-label=look1_iflf_binlcapw_c, category=SWSRC
            short-label=MTIR_ac_h, category=SWHDR
            short-label=look1_iflf_binlcapw_h, category=SWHDR
            short-label=rt_defines_h, category=SWHDR
            short-label=rtwtypes_h, category=SWHDR
      resource consumption RsrcCons_MTIR_ac
    IMP_MTQR: sw-version=9.240.1, used-code-generator=Embedded Coder 7.5 (R2020b) 29-Jul-2020, vendor-id=0, behavior=IB_MTQR
      code-descriptors:
        code Code
          artifact-descriptors:
            short-label=MTQR_ac_c, category=SWSRC
            short-label=look1_iflf_binlca_16a_c, category=SWSRC
            short-label=MTQR_ac_h, category=SWHDR
            short-label=look1_iflf_binlca_16a_h, category=SWHDR
            short-label=rtwtypes_h, category=SWHDR
      resource consumption RsrcCons_MTQR_ac
    IMP_NVMB: sw-version=1.831.1, used-code-generator=Embedded Coder 7.5 (R2020b) 29-Jul-2020, vendor-id=0, behavior=IB_NVMB
      code-descriptors:
        code Code
          artifact-descriptors:
            short-label=NVMB_ac_c, category=SWSRC
            short-label=NVMB_ac_h, category=SWHDR
            short-label=rtwtypes_h, category=SWHDR
      resource consumption RsrcCons_NVMB_ac
    IMP_OBCR: sw-version=9.571.1, used-code-generator=Embedded Coder 7.5 (R2020b) 29-Jul-2020, vendor-id=0, behavior=IB_OBCR
      code-descriptors:
        code Code
          artifact-descriptors:
            short-label=OBCR_ac_c, category=SWSRC
            short-label=look1_iflf_binlcapw_c, category=SWSRC
            short-label=look2_iflf_binlcapw_c, category=SWSRC
            short-label=OBCR_ac_h, category=SWHDR
            short-label=look1_iflf_binlcapw_h, category=SWHDR
            short-label=look2_iflf_binlcapw_h, category=SWHDR
            short-label=rtwtypes_h, category=SWHDR
      resource consumption RsrcCons_OBCR_ac
    IMP_OEVR: sw-version=9.214.1, used-code-generator=Embedded Coder 7.5 (R2020b) 29-Jul-2020, vendor-id=0, behavior=IB_OEVR
      code-descriptors:
        code Code
          artifact-descriptors:
            short-label=OEVR_ac_c, category=SWSRC
            short-label=look1_iflf_binlca_16a_c, category=SWSRC
            short-label=look2_iflf_binlca_16a_c, category=SWSRC
            short-label=OEVR_ac_h, category=SWHDR
            short-label=look1_iflf_binlca_16a_h, category=SWHDR
            short-label=look2_iflf_binlca_16a_h, category=SWHDR
            short-label=rtwtypes_h, category=SWHDR
      resource consumption RsrcCons_OEVR_ac
    IMP_OFCR: sw-version=9.95.1, used-code-generator=Embedded Coder 7.5 (R2020b) 29-Jul-2020, vendor-id=0, behavior=IB_OFCR
      code-descriptors:
        code Code
          artifact-descriptors:
            short-label=OFCR_ac_c, category=SWSRC
            short-label=OFCR_ac_h, category=SWHDR
            short-label=rtwtypes_h, category=SWHDR
      resource consumption RsrcCons_OFCR_ac
    IMP_OGRR: sw-version=9.224.1, used-code-generator=Embedded Coder 7.5 (R2020b) 29-Jul-2020, vendor-id=0, behavior=IB_OGRR
      code-descriptors:
        code Code
          artifact-descriptors:
            short-label=OGRR_ac_c, category=SWSRC
            short-label=look1_iflf_binlca_16a_c, category=SWSRC
            short-label=OGRR_ac_h, category=SWHDR
            short-label=look1_iflf_binlca_16a_h, category=SWHDR
            short-label=rt_defines_h, category=SWHDR
            short-label=rtwtypes_h, category=SWHDR
      resource consumption RsrcCons_OGRR_ac
    IMP_OHSR: sw-version=9.144.1, used-code-generator=Embedded Coder 7.5 (R2020b) 29-Jul-2020, vendor-id=0, behavior=IB_OHSR
      code-descriptors:
        code Code
          artifact-descriptors:
            short-label=OHSR_ac_c, category=SWSRC
            short-label=binsearch_u32f_16a_c, category=SWSRC
            short-label=intrp2d_fu32fla_16a_c, category=SWSRC
            short-label=look1_iflf_binlca_16a_c, category=SWSRC
            short-label=look2_iflf_binlca_16a_c, category=SWSRC
            short-label=plook_u32ff_binca_16a_c, category=SWSRC
            short-label=OHSR_ac_h, category=SWHDR
            short-label=binsearch_u32f_16a_h, category=SWHDR
            short-label=intrp2d_fu32fla_16a_h, category=SWHDR
            short-label=look1_iflf_binlca_16a_h, category=SWHDR
            short-label=look2_iflf_binlca_16a_h, category=SWHDR
            short-label=plook_u32ff_binca_16a_h, category=SWHDR
            short-label=rtwtypes_h, category=SWHDR
      resource consumption RsrcCons_OHSR_ac
    IMP_OITR: sw-version=9.256.1, used-code-generator=Embedded Coder 7.5 (R2020b) 29-Jul-2020, vendor-id=0, behavior=IB_OITR
      code-descriptors:
        code Code
          artifact-descriptors:
            short-label=OITR_ac_c, category=SWSRC
            short-label=look1_iflf_binlcapw_c, category=SWSRC
            short-label=look2_iflf_binlcapw_c, category=SWSRC
            short-label=OITR_ac_h, category=SWHDR
            short-label=look1_iflf_binlcapw_h, category=SWHDR
            short-label=look2_iflf_binlcapw_h, category=SWHDR
            short-label=rt_defines_h, category=SWHDR
            short-label=rtwtypes_h, category=SWHDR
      resource consumption RsrcCons_OITR_ac
    IMP_OMAR: sw-version=9.207.1, used-code-generator=Embedded Coder 7.5 (R2020b) 29-Jul-2020, vendor-id=0, behavior=IB_OMAR
      code-descriptors:
        code Code
          artifact-descriptors:
            short-label=OMAR_ac_c, category=SWSRC
            short-label=look1_iflf_binlca_16a_c, category=SWSRC
            short-label=look2_iflf_binlca_16a_c, category=SWSRC
            short-label=OMAR_ac_h, category=SWHDR
            short-label=look1_iflf_binlca_16a_h, category=SWHDR
            short-label=look2_iflf_binlca_16a_h, category=SWHDR
            short-label=rt_defines_h, category=SWHDR
            short-label=rtwtypes_h, category=SWHDR
      resource consumption RsrcCons_OMAR_ac
    IMP_OMBR: sw-version=9.215.1, used-code-generator=Embedded Coder 7.5 (R2020b) 29-Jul-2020, vendor-id=0, behavior=IB_OMBR
      code-descriptors:
        code Code
          artifact-descriptors:
            short-label=OMBR_ac_c, category=SWSRC
            short-label=look1_iflf_binlca_16a_c, category=SWSRC
            short-label=look2_iflf_binlca_16a_c, category=SWSRC
            short-label=OMBR_ac_h, category=SWHDR
            short-label=look1_iflf_binlca_16a_h, category=SWHDR
            short-label=look2_iflf_binlca_16a_h, category=SWHDR
            short-label=rt_defines_h, category=SWHDR
            short-label=rtwtypes_h, category=SWHDR
      resource consumption RsrcCons_OMBR_ac
    IMP_OMNR: sw-version=9.192.1, used-code-generator=Embedded Coder 7.5 (R2020b) 29-Jul-2020, vendor-id=0, behavior=IB_OMNR
      code-descriptors:
        code Code
          artifact-descriptors:
            short-label=OMNR_ac_c, category=SWSRC
            short-label=look1_iflf_binlca_16a_c, category=SWSRC
            short-label=look2_iflf_binlca_16a_c, category=SWSRC
            short-label=OMNR_ac_h, category=SWHDR
            short-label=look1_iflf_binlca_16a_h, category=SWHDR
            short-label=look2_iflf_binlca_16a_h, category=SWHDR
            short-label=rt_defines_h, category=SWHDR
            short-label=rtwtypes_h, category=SWHDR
      resource consumption RsrcCons_OMNR_ac
    IMP_OSMR: sw-version=9.297.1, used-code-generator=Embedded Coder 7.5 (R2020b) 29-Jul-2020, vendor-id=0, behavior=IB_OSMR
      code-descriptors:
        code Code
          artifact-descriptors:
            short-label=OSMR_ac_c, category=SWSRC
            short-label=look1_iflf_binlca_16a_c, category=SWSRC
            short-label=look2_iflf_binlca_16a_c, category=SWSRC
            short-label=OSMR_ac_h, category=SWHDR
            short-label=look1_iflf_binlca_16a_h, category=SWHDR
            short-label=look2_iflf_binlca_16a_h, category=SWHDR
            short-label=rtwtypes_h, category=SWHDR
      resource consumption RsrcCons_OSMR_ac
    IMP_PDTR: sw-version=9.153.1, used-code-generator=Embedded Coder 7.5 (R2020b) 29-Jul-2020, vendor-id=0, behavior=IB_PDTR
      code-descriptors:
        code Code
          artifact-descriptors:
            short-label=PDTR_ac_c, category=SWSRC
            short-label=rt_modf_16a_c, category=SWSRC
            short-label=PDTR_ac_h, category=SWHDR
            short-label=rt_modf_16a_h, category=SWHDR
            short-label=rtwtypes_h, category=SWHDR
            short-label=zero_crossing_types_h, category=SWHDR
      resource consumption RsrcCons_PDTR_ac
    IMP_PITR: sw-version=9.30.1, used-code-generator=Embedded Coder 7.5 (R2020b) 29-Jul-2020, vendor-id=0, behavior=IB_PITR
      code-descriptors:
        code Code
          artifact-descriptors:
            short-label=PITR_ac_c, category=SWSRC
            short-label=PITR_ac_h, category=SWHDR
            short-label=rtwtypes_h, category=SWHDR
      resource consumption RsrcCons_PITR_ac
    IMP_PLTR: sw-version=9.416.1, used-code-generator=Embedded Coder 7.5 (R2020b) 29-Jul-2020, vendor-id=0, behavior=IB_PLTR
      code-descriptors:
        code Code
          artifact-descriptors:
            short-label=PLTR_ac_c, category=SWSRC
            short-label=look1_iflf_binlca_16a_c, category=SWSRC
            short-label=look2_iflf_binlca_16a_c, category=SWSRC
            short-label=PLTR_ac_h, category=SWHDR
            short-label=look1_iflf_binlca_16a_h, category=SWHDR
            short-label=look2_iflf_binlca_16a_h, category=SWHDR
            short-label=rt_defines_h, category=SWHDR
            short-label=rtwtypes_h, category=SWHDR
      resource consumption RsrcCons_PLTR_ac
    IMP_PMDB: sw-version=1.212.1, used-code-generator=Embedded Coder 7.5 (R2020b) 29-Jul-2020, vendor-id=0, behavior=IB_PMDB
      code-descriptors:
        code Code
          artifact-descriptors:
            short-label=PMDB_ac_c, category=SWSRC
            short-label=look1_iflf_binlca_19a_c, category=SWSRC
            short-label=PMDB_ac_h, category=SWHDR
            short-label=look1_iflf_binlca_19a_h, category=SWHDR
            short-label=rtwtypes_h, category=SWHDR
      resource consumption RsrcCons_PMDB_ac
    IMP_PMDR: sw-version=9.75.1, used-code-generator=Embedded Coder 7.5 (R2020b) 29-Jul-2020, vendor-id=0, behavior=IB_PMDR
      code-descriptors:
        code Code
          artifact-descriptors:
            short-label=PMDR_ac_c, category=SWSRC
            short-label=PMDR_ac_h, category=SWHDR
            short-label=rt_defines_h, category=SWHDR
            short-label=rtwtypes_h, category=SWHDR
      resource consumption RsrcCons_PMDR_ac
    IMP_PMIB: sw-version=4.374.1, used-code-generator=Embedded Coder 7.5 (R2020b) 29-Jul-2020, vendor-id=0, behavior=IB_PMIB
      code-descriptors:
        code Code
          artifact-descriptors:
            short-label=PMIB_ac_c, category=SWSRC
            short-label=PMIB_ac_h, category=SWHDR
            short-label=rtwtypes_h, category=SWHDR
      resource consumption RsrcCons_PMIB_ac
    IMP_PMIR: sw-version=9.95.1, used-code-generator=Embedded Coder 7.5 (R2020b) 29-Jul-2020, vendor-id=0, behavior=IB_PMIR
      code-descriptors:
        code Code
          artifact-descriptors:
            short-label=PMIR_ac_c, category=SWSRC
            short-label=look1_iflf_binlca_16a_c, category=SWSRC
            short-label=PMIR_ac_h, category=SWHDR
            short-label=look1_iflf_binlca_16a_h, category=SWHDR
            short-label=rtwtypes_h, category=SWHDR
      resource consumption RsrcCons_PMIR_ac
    IMP_PMPR: sw-version=9.468.1, used-code-generator=Embedded Coder 7.5 (R2020b) 29-Jul-2020, vendor-id=0, behavior=IB_PMPR
      code-descriptors:
        code Code
          artifact-descriptors:
            short-label=PMPR_ac_c, category=SWSRC
            short-label=look1_iflf_binlca_16a_c, category=SWSRC
            short-label=look2_iflf_binlca_16a_c, category=SWSRC
            short-label=PMPR_ac_h, category=SWHDR
            short-label=look1_iflf_binlca_16a_h, category=SWHDR
            short-label=look2_iflf_binlca_16a_h, category=SWHDR
            short-label=rtwtypes_h, category=SWHDR
      resource consumption RsrcCons_PMPR_ac
    IMP_PMTR: sw-version=9.66.1, used-code-generator=Embedded Coder 7.5 (R2020b) 29-Jul-2020, vendor-id=0, behavior=IB_PMTR
      code-descriptors:
        code Code
          artifact-descriptors:
            short-label=PMTR_ac_c, category=SWSRC
            short-label=PMTR_ac_h, category=SWHDR
            short-label=rtwtypes_h, category=SWHDR
      resource consumption RsrcCons_PMTR_ac
    IMP_PPCR: sw-version=9.90.1, used-code-generator=Embedded Coder 7.5 (R2020b) 29-Jul-2020, vendor-id=0, behavior=IB_PPCR
      code-descriptors:
        code Code
          artifact-descriptors:
            short-label=PPCR_ac_c, category=SWSRC
            short-label=PPCR_ac_h, category=SWHDR
            short-label=rt_defines_h, category=SWHDR
            short-label=rtwtypes_h, category=SWHDR
      resource consumption RsrcCons_PPCR_ac
    IMP_PRXR: sw-version=1.168.1, used-code-generator=Embedded Coder 7.5 (R2020b) 29-Jul-2020, vendor-id=0, behavior=IB_PRXR
      code-descriptors:
        code Code
          artifact-descriptors:
            short-label=PRXR_ac_c, category=SWSRC
            short-label=PRXR_ac_h, category=SWHDR
            short-label=rtwtypes_h, category=SWHDR
      resource consumption RsrcCons_PRXR_ac
    IMP_PSMR: sw-version=9.149.1, used-code-generator=Embedded Coder 7.5 (R2020b) 29-Jul-2020, vendor-id=0, behavior=IB_PSMR
      code-descriptors:
        code Code
          artifact-descriptors:
            short-label=PSMR_ac_c, category=SWSRC
            short-label=look1_iflf_binlcapw_c, category=SWSRC
            short-label=PSMR_ac_h, category=SWHDR
            short-label=look1_iflf_binlcapw_h, category=SWHDR
            short-label=rtwtypes_h, category=SWHDR
      resource consumption RsrcCons_PSMR_ac
    IMP_PVMR: sw-version=9.18.1, used-code-generator=Embedded Coder 7.5 (R2020b) 29-Jul-2020, vendor-id=0, behavior=IB_PVMR
      code-descriptors:
        code Code
          artifact-descriptors:
            short-label=PVMR_ac_c, category=SWSRC
            short-label=look1_iflf_binlcapw_c, category=SWSRC
            short-label=PVMR_ac_h, category=SWHDR
            short-label=look1_iflf_binlcapw_h, category=SWHDR
            short-label=rtwtypes_h, category=SWHDR
      resource consumption RsrcCons_PVMR_ac
    IMP_PWDR: sw-version=9.120.1, used-code-generator=Embedded Coder 7.5 (R2020b) 29-Jul-2020, vendor-id=0, behavior=IB_PWDR
      code-descriptors:
        code Code
          artifact-descriptors:
            short-label=PWDR_ac_c, category=SWSRC
            short-label=look1_iflf_binlcapw_c, category=SWSRC
            short-label=PWDR_ac_h, category=SWHDR
            short-label=look1_iflf_binlcapw_h, category=SWHDR
            short-label=rtwtypes_h, category=SWHDR
      resource consumption RsrcCons_PWDR_ac
    IMP_RCVR: sw-version=9.126.1, used-code-generator=Embedded Coder 7.5 (R2020b) 29-Jul-2020, vendor-id=0, behavior=IB_RCVR
      code-descriptors:
        code Code
          artifact-descriptors:
            short-label=RCVR_ac_c, category=SWSRC
            short-label=look1_iflf_binlca_16a_c, category=SWSRC
            short-label=look2_iflf_binlca_16a_c, category=SWSRC
            short-label=RCVR_ac_h, category=SWHDR
            short-label=look1_iflf_binlca_16a_h, category=SWHDR
            short-label=look2_iflf_binlca_16a_h, category=SWHDR
            short-label=rtwtypes_h, category=SWHDR
      resource consumption RsrcCons_RCVR_ac
    IMP_RGNR: sw-version=9.184.1, used-code-generator=Embedded Coder 7.5 (R2020b) 29-Jul-2020, vendor-id=0, behavior=IB_RGNR
      code-descriptors:
        code Code
          artifact-descriptors:
            short-label=RGNR_ac_c, category=SWSRC
            short-label=look1_iflf_binlca_16a_c, category=SWSRC
            short-label=look2_iflf_binlca_16a_c, category=SWSRC
            short-label=RGNR_ac_h, category=SWHDR
            short-label=look1_iflf_binlca_16a_h, category=SWHDR
            short-label=look2_iflf_binlca_16a_h, category=SWHDR
            short-label=rtwtypes_h, category=SWHDR
      resource consumption RsrcCons_RGNR_ac
    IMP_RTMR: sw-version=9.170.1, used-code-generator=Embedded Coder 7.5 (R2020b) 29-Jul-2020, vendor-id=0, behavior=IB_RTMR
      code-descriptors:
        code Code
          artifact-descriptors:
            short-label=RTMR_ac_c, category=SWSRC
            short-label=look1_iflf_binlca_16a_c, category=SWSRC
            short-label=RTMR_ac_h, category=SWHDR
            short-label=look1_iflf_binlca_16a_h, category=SWHDR
            short-label=rt_defines_h, category=SWHDR
            short-label=rtwtypes_h, category=SWHDR
      resource consumption RsrcCons_RTMR_ac
    IMP_SCCR: sw-version=9.183.1, used-code-generator=Embedded Coder 7.5 (R2020b) 29-Jul-2020, vendor-id=0, behavior=IB_SCCR
      code-descriptors:
        code Code
          artifact-descriptors:
            short-label=SCCR_ac_c, category=SWSRC
            short-label=look1_iflf_binlca_16a_c, category=SWSRC
            short-label=look2_iflf_binlca_16a_c, category=SWSRC
            short-label=SCCR_ac_h, category=SWHDR
            short-label=look1_iflf_binlca_16a_h, category=SWHDR
            short-label=look2_iflf_binlca_16a_h, category=SWHDR
            short-label=rt_defines_h, category=SWHDR
            short-label=rtwtypes_h, category=SWHDR
      resource consumption RsrcCons_SCCR_ac
    IMP_SCOR: sw-version=9.159.1, used-code-generator=Embedded Coder 7.5 (R2020b) 29-Jul-2020, vendor-id=0, behavior=IB_SCOR
      code-descriptors:
        code Code
          artifact-descriptors:
            short-label=SCOR_ac_c, category=SWSRC
            short-label=look1_iflf_binlcapw_c, category=SWSRC
            short-label=look2_iflf_binlcapw_c, category=SWSRC
            short-label=SCOR_ac_h, category=SWHDR
            short-label=look1_iflf_binlcapw_h, category=SWHDR
            short-label=look2_iflf_binlcapw_h, category=SWHDR
            short-label=rtwtypes_h, category=SWHDR
      resource consumption RsrcCons_SCOR_ac
    IMP_SCPR: sw-version=1.114.1, used-code-generator=Embedded Coder 7.5 (R2020b) 29-Jul-2020, vendor-id=0, behavior=IB_SCPR
      code-descriptors:
        code Code
          artifact-descriptors:
            short-label=SCPR_ac_c, category=SWSRC
            short-label=SCPR_ac_h, category=SWHDR
            short-label=rtwtypes_h, category=SWHDR
      resource consumption RsrcCons_SCPR_ac
    IMP_SR1B_FUNC: sw-version=1.193.1, used-code-generator=Embedded Coder 7.5 (R2020b) 29-Jul-2020, vendor-id=0, behavior=IB_SR1B_FUNC
      code-descriptors:
        code Code
          artifact-descriptors:
            short-label=SR1B_FUNC_ac_c, category=SWSRC
            short-label=SR1B_FUNC_ac_h, category=SWHDR
            short-label=rtwtypes_h, category=SWHDR
      resource consumption RsrcCons_SR1B_FUNC_ac
    IMP_SR2B_COREBEV: sw-version=1.269.1, used-code-generator=Embedded Coder 7.5 (R2020b) 29-Jul-2020, vendor-id=0, behavior=IB_SR2B_COREBEV
      code-descriptors:
        code Code
          artifact-descriptors:
            short-label=SR2B_COREBEV_ac_c, category=SWSRC
            short-label=SR2B_COREBEV_ac_h, category=SWHDR
            short-label=rtwtypes_h, category=SWHDR
      resource consumption RsrcCons_SR2B_COREBEV_ac
    IMP_SRAR: sw-version=9.201.1, used-code-generator=Embedded Coder 7.5 (R2020b) 29-Jul-2020, vendor-id=0, behavior=IB_SRAR
      code-descriptors:
        code Code
          artifact-descriptors:
            short-label=SRAR_ac_c, category=SWSRC
            short-label=look1_iflf_binlcapw_c, category=SWSRC
            short-label=SRAR_ac_h, category=SWHDR
            short-label=look1_iflf_binlcapw_h, category=SWHDR
            short-label=rtwtypes_h, category=SWHDR
            short-label=zero_crossing_types_h, category=SWHDR
      resource consumption RsrcCons_SRAR_ac
    IMP_SRDB_FUNC: sw-version=1.201.1, used-code-generator=Embedded Coder 7.5 (R2020b) 29-Jul-2020, vendor-id=0, behavior=IB_SRDB_FUNC
      code-descriptors:
        code Code
          artifact-descriptors:
            short-label=SRDB_FUNC_ac_c, category=SWSRC
            short-label=SRDB_FUNC_ac_h, category=SWHDR
            short-label=rtwtypes_h, category=SWHDR
      resource consumption RsrcCons_SRDB_FUNC_ac
    IMP_SRMR: sw-version=9.443.1, used-code-generator=Embedded Coder 7.5 (R2020b) 29-Jul-2020, vendor-id=0, behavior=IB_SRMR
      code-descriptors:
        code Code
          artifact-descriptors:
            short-label=SRMR_ac_c, category=SWSRC
            short-label=look1_iflf_binlca_16a_c, category=SWSRC
            short-label=look2_iflf_binlca_16a_c, category=SWSRC
            short-label=SRMR_ac_h, category=SWHDR
            short-label=look1_iflf_binlca_16a_h, category=SWHDR
            short-label=look2_iflf_binlca_16a_h, category=SWHDR
            short-label=rtwtypes_h, category=SWHDR
      resource consumption RsrcCons_SRMR_ac
    IMP_SSDR: sw-version=9.69.1, used-code-generator=Embedded Coder 7.5 (R2020b) 29-Jul-2020, vendor-id=0, behavior=IB_SSDR
      code-descriptors:
        code Code
          artifact-descriptors:
            short-label=SSDR_ac_c, category=SWSRC
            short-label=SSDR_ac_h, category=SWHDR
            short-label=rtwtypes_h, category=SWHDR
      resource consumption RsrcCons_SSDR_ac
    IMP_SSIB: sw-version=1.1030.1, used-code-generator=Embedded Coder 7.5 (R2020b) 29-Jul-2020, vendor-id=0, behavior=IB_SSIB
      code-descriptors:
        code Code
          artifact-descriptors:
            short-label=SSIB_ac_c, category=SWSRC
            short-label=SSIB_ac_h, category=SWHDR
            short-label=rtwtypes_h, category=SWHDR
      resource consumption RsrcCons_SSIB_ac
    IMP_SSMR: sw-version=9.473.1, used-code-generator=Embedded Coder 7.5 (R2020b) 29-Jul-2020, vendor-id=0, behavior=IB_SSMR
      code-descriptors:
        code Code
          artifact-descriptors:
            short-label=SSMR_ac_c, category=SWSRC
            short-label=look1_iflf_binlca_16a_c, category=SWSRC
            short-label=SSMR_ac_h, category=SWHDR
            short-label=look1_iflf_binlca_16a_h, category=SWHDR
            short-label=rtwtypes_h, category=SWHDR
      resource consumption RsrcCons_SSMR_ac
    IMP_ST2B_FUNC: sw-version=1.222.1, used-code-generator=Embedded Coder 7.5 (R2020b) 29-Jul-2020, vendor-id=0, behavior=IB_ST2B_FUNC
      code-descriptors:
        code Code
          artifact-descriptors:
            short-label=ST2B_FUNC_ac_c, category=SWSRC
            short-label=ST2B_FUNC_ac_h, category=SWHDR
            short-label=rtwtypes_h, category=SWHDR
      resource consumption RsrcCons_ST2B_FUNC_ac
    IMP_STAR: sw-version=9.107.1, used-code-generator=Embedded Coder 7.5 (R2020b) 29-Jul-2020, vendor-id=0, behavior=IB_STAR
      code-descriptors:
        code Code
          artifact-descriptors:
            short-label=STAR_ac_c, category=SWSRC
            short-label=look2_iflf_binlcapw_c, category=SWSRC
            short-label=STAR_ac_h, category=SWHDR
            short-label=look2_iflf_binlcapw_h, category=SWHDR
            short-label=rtwtypes_h, category=SWHDR
      resource consumption RsrcCons_STAR_ac
    IMP_STCR: sw-version=9.527.1, used-code-generator=Embedded Coder 7.5 (R2020b) 29-Jul-2020, vendor-id=0, behavior=IB_STCR
      code-descriptors:
        code Code
          artifact-descriptors:
            short-label=STCR_ac_c, category=SWSRC
            short-label=look1_iflf_binlcapw_c, category=SWSRC
            short-label=look2_iflf_binlcapw_c, category=SWSRC
            short-label=STCR_ac_h, category=SWHDR
            short-label=look1_iflf_binlcapw_h, category=SWHDR
            short-label=look2_iflf_binlcapw_h, category=SWHDR
            short-label=rtwtypes_h, category=SWHDR
      resource consumption RsrcCons_STCR_ac
    IMP_STDR: sw-version=9.202.1, used-code-generator=Embedded Coder 7.5 (R2020b) 29-Jul-2020, vendor-id=0, behavior=IB_STDR
      code-descriptors:
        code Code
          artifact-descriptors:
            short-label=STDR_ac_c, category=SWSRC
            short-label=look1_iflf_binlca_16a_c, category=SWSRC
            short-label=look2_iflf_binlca_16a_c, category=SWSRC
            short-label=STDR_ac_h, category=SWHDR
            short-label=look1_iflf_binlca_16a_h, category=SWHDR
            short-label=look2_iflf_binlca_16a_h, category=SWHDR
            short-label=rtwtypes_h, category=SWHDR
      resource consumption RsrcCons_STDR_ac
    IMP_STFR: sw-version=9.157.1, used-code-generator=Embedded Coder 7.5 (R2020b) 29-Jul-2020, vendor-id=0, behavior=IB_STFR
      code-descriptors:
        code Code
          artifact-descriptors:
            short-label=STFR_ac_c, category=SWSRC
            short-label=look1_iflf_binlca_16a_c, category=SWSRC
            short-label=STFR_ac_h, category=SWHDR
            short-label=look1_iflf_binlca_16a_h, category=SWHDR
            short-label=rtwtypes_h, category=SWHDR
      resource consumption RsrcCons_STFR_ac
    IMP_STMR: sw-version=9.2273.1, used-code-generator=Embedded Coder 7.5 (R2020b) 29-Jul-2020, vendor-id=0, behavior=IB_STMR
      code-descriptors:
        code Code
          artifact-descriptors:
            short-label=STMR_ac_c, category=SWSRC
            short-label=look1_iflf_binlca_16a_c, category=SWSRC
            short-label=look2_iflf_binlca_16a_c, category=SWSRC
            short-label=STMR_ac_h, category=SWHDR
            short-label=look1_iflf_binlca_16a_h, category=SWHDR
            short-label=look2_iflf_binlca_16a_h, category=SWHDR
            short-label=rtwtypes_h, category=SWHDR
      resource consumption RsrcCons_STMR_ac
    IMP_STRR: sw-version=9.278.1, used-code-generator=Embedded Coder 7.5 (R2020b) 29-Jul-2020, vendor-id=0, behavior=IB_STRR
      code-descriptors:
        code Code
          artifact-descriptors:
            short-label=STRR_ac_c, category=SWSRC
            short-label=STRR_ac_h, category=SWHDR
            short-label=rtwtypes_h, category=SWHDR
      resource consumption RsrcCons_STRR_ac
    IMP_TAIB: sw-version=4.345.1, used-code-generator=Embedded Coder 7.5 (R2020b) 29-Jul-2020, vendor-id=0, behavior=IB_TAIB
      code-descriptors:
        code Code
          artifact-descriptors:
            short-label=TAIB_ac_c, category=SWSRC
            short-label=look1_iflf_binlca_19a_c, category=SWSRC
            short-label=TAIB_ac_h, category=SWHDR
            short-label=look1_iflf_binlca_19a_h, category=SWHDR
            short-label=rtwtypes_h, category=SWHDR
      resource consumption RsrcCons_TAIB_ac
    IMP_TAIR: sw-version=9.179.1, used-code-generator=Embedded Coder 7.5 (R2020b) 29-Jul-2020, vendor-id=0, behavior=IB_TAIR
      code-descriptors:
        code Code
          artifact-descriptors:
            short-label=TAIR_ac_c, category=SWSRC
            short-label=TAIR_ac_h, category=SWHDR
            short-label=rt_defines_h, category=SWHDR
            short-label=rtwtypes_h, category=SWHDR
      resource consumption RsrcCons_TAIR_ac
    IMP_TAPR: sw-version=9.87.1, used-code-generator=Embedded Coder 7.5 (R2020b) 29-Jul-2020, vendor-id=0, behavior=IB_TAPR
      code-descriptors:
        code Code
          artifact-descriptors:
            short-label=TAPR_ac_c, category=SWSRC
            short-label=look1_iflf_binlca_16a_c, category=SWSRC
            short-label=look2_iflf_binlca_16a_c, category=SWSRC
            short-label=TAPR_ac_h, category=SWHDR
            short-label=look1_iflf_binlca_16a_h, category=SWHDR
            short-label=look2_iflf_binlca_16a_h, category=SWHDR
            short-label=rtwtypes_h, category=SWHDR
      resource consumption RsrcCons_TAPR_ac
    IMP_TCCR: sw-version=9.193.1, used-code-generator=Embedded Coder 7.5 (R2020b) 29-Jul-2020, vendor-id=0, behavior=IB_TCCR
      code-descriptors:
        code Code
          artifact-descriptors:
            short-label=TCCR_ac_c, category=SWSRC
            short-label=look1_iflf_binlca_16a_c, category=SWSRC
            short-label=look2_iflf_binlca_16a_c, category=SWSRC
            short-label=TCCR_ac_h, category=SWHDR
            short-label=look1_iflf_binlca_16a_h, category=SWHDR
            short-label=look2_iflf_binlca_16a_h, category=SWHDR
            short-label=rtwtypes_h, category=SWHDR
      resource consumption RsrcCons_TCCR_ac
    IMP_TCPR: sw-version=9.54.1, used-code-generator=Embedded Coder 7.5 (R2020b) 29-Jul-2020, vendor-id=0, behavior=IB_TCPR
      code-descriptors:
        code Code
          artifact-descriptors:
            short-label=TCPR_ac_c, category=SWSRC
            short-label=look2_iflf_binlca_16a_c, category=SWSRC
            short-label=TCPR_ac_h, category=SWHDR
            short-label=look2_iflf_binlca_16a_h, category=SWHDR
            short-label=rtwtypes_h, category=SWHDR
      resource consumption RsrcCons_TCPR_ac
    IMP_TFTR: sw-version=9.84.1, used-code-generator=Embedded Coder 7.5 (R2020b) 29-Jul-2020, vendor-id=0, behavior=IB_TFTR
      code-descriptors:
        code Code
          artifact-descriptors:
            short-label=TFTR_ac_c, category=SWSRC
            short-label=look1_iflf_binlca_16a_c, category=SWSRC
            short-label=look2_iflf_binlca_16a_c, category=SWSRC
            short-label=TFTR_ac_h, category=SWHDR
            short-label=look1_iflf_binlca_16a_h, category=SWHDR
            short-label=look2_iflf_binlca_16a_h, category=SWHDR
            short-label=rtwtypes_h, category=SWHDR
      resource consumption RsrcCons_TFTR_ac
    IMP_THDR: sw-version=9.673.1, used-code-generator=Embedded Coder 7.5 (R2020b) 29-Jul-2020, vendor-id=0, behavior=IB_THDR
      code-descriptors:
        code Code
          artifact-descriptors:
            short-label=THDR_ac_c, category=SWSRC
            short-label=THDR_ac_h, category=SWHDR
            short-label=rtwtypes_h, category=SWHDR
      resource consumption RsrcCons_THDR_ac
    IMP_THMR: sw-version=9.965.1, used-code-generator=Embedded Coder 7.5 (R2020b) 29-Jul-2020, vendor-id=0, behavior=IB_THMR
      code-descriptors:
        code Code
          artifact-descriptors:
            short-label=THMR_ac_c, category=SWSRC
            short-label=look1_iflf_binlcapw_c, category=SWSRC
            short-label=look2_iflf_binlcapw_c, category=SWSRC
            short-label=THMR_ac_h, category=SWHDR
            short-label=look1_iflf_binlcapw_h, category=SWHDR
            short-label=look2_iflf_binlcapw_h, category=SWHDR
            short-label=rtwtypes_h, category=SWHDR
      resource consumption RsrcCons_THMR_ac
    IMP_TIDR: sw-version=9.21.1, used-code-generator=Embedded Coder 7.5 (R2020b) 29-Jul-2020, vendor-id=0, behavior=IB_TIDR
      code-descriptors:
        code Code
          artifact-descriptors:
            short-label=TIDR_ac_c, category=SWSRC
            short-label=look1_iflf_binlca_16a_c, category=SWSRC
            short-label=look2_iflf_binlca_16a_c, category=SWSRC
            short-label=TIDR_ac_h, category=SWHDR
            short-label=look1_iflf_binlca_16a_h, category=SWHDR
            short-label=look2_iflf_binlca_16a_h, category=SWHDR
            short-label=rtwtypes_h, category=SWHDR
      resource consumption RsrcCons_TIDR_ac
    IMP_TIMR: sw-version=9.651.1, used-code-generator=Embedded Coder 7.5 (R2020b) 29-Jul-2020, vendor-id=0, behavior=IB_TIMR
      code-descriptors:
        code Code
          artifact-descriptors:
            short-label=TIMR_ac_c, category=SWSRC
            short-label=TIMR_ac_h, category=SWHDR
            short-label=rt_defines_h, category=SWHDR
            short-label=rtwtypes_h, category=SWHDR
      resource consumption RsrcCons_TIMR_ac
    IMP_TINR: sw-version=9.88.1, used-code-generator=Embedded Coder 7.5 (R2020b) 29-Jul-2020, vendor-id=0, behavior=IB_TINR
      code-descriptors:
        code Code
          artifact-descriptors:
            short-label=TINR_ac_c, category=SWSRC
            short-label=look2_iflf_binlca_16a_c, category=SWSRC
            short-label=TINR_ac_h, category=SWHDR
            short-label=look2_iflf_binlca_16a_h, category=SWHDR
            short-label=rt_defines_h, category=SWHDR
            short-label=rtwtypes_h, category=SWHDR
      resource consumption RsrcCons_TINR_ac
    IMP_TISR: sw-version=9.82.1, used-code-generator=Embedded Coder 7.5 (R2020b) 29-Jul-2020, vendor-id=0, behavior=IB_TISR
      code-descriptors:
        code Code
          artifact-descriptors:
            short-label=TISR_ac_c, category=SWSRC
            short-label=TISR_ac_h, category=SWHDR
            short-label=rtwtypes_h, category=SWHDR
      resource consumption RsrcCons_TISR_ac
    IMP_TITR: sw-version=9.75.1, used-code-generator=Embedded Coder 7.5 (R2020b) 29-Jul-2020, vendor-id=0, behavior=IB_TITR
      code-descriptors:
        code Code
          artifact-descriptors:
            short-label=TITR_ac_c, category=SWSRC
            short-label=look1_iflf_binlca_16a_c, category=SWSRC
            short-label=look2_iflf_binlca_16a_c, category=SWSRC
            short-label=TITR_ac_h, category=SWHDR
            short-label=look1_iflf_binlca_16a_h, category=SWHDR
            short-label=look2_iflf_binlca_16a_h, category=SWHDR
            short-label=rtwtypes_h, category=SWHDR
      resource consumption RsrcCons_TITR_ac
    IMP_TMDR: sw-version=9.427.1, used-code-generator=Embedded Coder 7.5 (R2020b) 29-Jul-2020, vendor-id=0, behavior=IB_TMDR
      code-descriptors:
        code Code
          artifact-descriptors:
            short-label=TMDR_ac_c, category=SWSRC
            short-label=look1_iflf_binlca_16a_c, category=SWSRC
            short-label=look2_iflf_binlca_16a_c, category=SWSRC
            short-label=TMDR_ac_h, category=SWHDR
            short-label=look1_iflf_binlca_16a_h, category=SWHDR
            short-label=look2_iflf_binlca_16a_h, category=SWHDR
            short-label=rtwtypes_h, category=SWHDR
      resource consumption RsrcCons_TMDR_ac
    IMP_TMIB: sw-version=1.114.1, used-code-generator=Embedded Coder 7.5 (R2020b) 29-Jul-2020, vendor-id=0, behavior=IB_TMIB
      code-descriptors:
        code Code
          artifact-descriptors:
            short-label=TMIB_ac_c, category=SWSRC
            short-label=look1_iflf_binlca_19a_c, category=SWSRC
            short-label=TMIB_ac_h, category=SWHDR
            short-label=look1_iflf_binlca_19a_h, category=SWHDR
            short-label=rtwtypes_h, category=SWHDR
      resource consumption RsrcCons_TMIB_ac
    IMP_TMIR: sw-version=9.78.1, used-code-generator=Embedded Coder 7.5 (R2020b) 29-Jul-2020, vendor-id=0, behavior=IB_TMIR
      code-descriptors:
        code Code
          artifact-descriptors:
            short-label=TMIR_ac_c, category=SWSRC
            short-label=TMIR_ac_h, category=SWHDR
            short-label=rt_defines_h, category=SWHDR
            short-label=rtwtypes_h, category=SWHDR
      resource consumption RsrcCons_TMIR_ac
    IMP_TMMR: sw-version=9.255.1, used-code-generator=Embedded Coder 7.5 (R2020b) 29-Jul-2020, vendor-id=0, behavior=IB_TMMR
      code-descriptors:
        code Code
          artifact-descriptors:
            short-label=TMMR_ac_c, category=SWSRC
            short-label=look1_iflf_binlca_16a_c, category=SWSRC
            short-label=look2_iflf_binlca_16a_c, category=SWSRC
            short-label=TMMR_ac_h, category=SWHDR
            short-label=look1_iflf_binlca_16a_h, category=SWHDR
            short-label=look2_iflf_binlca_16a_h, category=SWHDR
            short-label=rtwtypes_h, category=SWHDR
      resource consumption RsrcCons_TMMR_ac
    IMP_TPCR: sw-version=9.502.1, used-code-generator=Embedded Coder 7.5 (R2020b) 29-Jul-2020, vendor-id=0, behavior=IB_TPCR
      code-descriptors:
        code Code
          artifact-descriptors:
            short-label=TPCR_ac_c, category=SWSRC
            short-label=look1_iflf_binlcapw_c, category=SWSRC
            short-label=look2_iflf_binlcapw_c, category=SWSRC
            short-label=TPCR_ac_h, category=SWHDR
            short-label=look1_iflf_binlcapw_h, category=SWHDR
            short-label=look2_iflf_binlcapw_h, category=SWHDR
            short-label=rtwtypes_h, category=SWHDR
      resource consumption RsrcCons_TPCR_ac
    IMP_TPDR: sw-version=9.18.1, used-code-generator=Embedded Coder 7.5 (R2020b) 29-Jul-2020, vendor-id=0, behavior=IB_TPDR
      code-descriptors:
        code Code
          artifact-descriptors:
            short-label=TPDR_ac_c, category=SWSRC
            short-label=look2_iflf_binlca_16a_c, category=SWSRC
            short-label=TPDR_ac_h, category=SWHDR
            short-label=look2_iflf_binlca_16a_h, category=SWHDR
            short-label=rtwtypes_h, category=SWHDR
      resource consumption RsrcCons_TPDR_ac
    IMP_TRAR: sw-version=9.179.1, used-code-generator=Embedded Coder 7.5 (R2020b) 29-Jul-2020, vendor-id=0, behavior=IB_TRAR
      code-descriptors:
        code Code
          artifact-descriptors:
            short-label=TRAR_ac_c, category=SWSRC
            short-label=look1_iflf_binlca_16a_c, category=SWSRC
            short-label=TRAR_ac_h, category=SWHDR
            short-label=look1_iflf_binlca_16a_h, category=SWHDR
            short-label=rtwtypes_h, category=SWHDR
      resource consumption RsrcCons_TRAR_ac
    IMP_TRGR: sw-version=9.523.1, used-code-generator=Embedded Coder 7.5 (R2020b) 29-Jul-2020, vendor-id=0, behavior=IB_TRGR
      code-descriptors:
        code Code
          artifact-descriptors:
            short-label=TRGR_ac_c, category=SWSRC
            short-label=TRGR_ac_h, category=SWHDR
            short-label=rtwtypes_h, category=SWHDR
      resource consumption RsrcCons_TRGR_ac
    IMP_TRIB: sw-version=1.160.1, used-code-generator=Embedded Coder 7.5 (R2020b) 29-Jul-2020, vendor-id=0, behavior=IB_TRIB
      code-descriptors:
        code Code
          artifact-descriptors:
            short-label=TRIB_ac_c, category=SWSRC
            short-label=look1_iflf_binlca_19a_c, category=SWSRC
            short-label=TRIB_ac_h, category=SWHDR
            short-label=look1_iflf_binlca_19a_h, category=SWHDR
            short-label=rtwtypes_h, category=SWHDR
      resource consumption RsrcCons_TRIB_ac
    IMP_TRIR: sw-version=9.161.1, used-code-generator=Embedded Coder 7.5 (R2020b) 29-Jul-2020, vendor-id=0, behavior=IB_TRIR
      code-descriptors:
        code Code
          artifact-descriptors:
            short-label=TRIR_ac_c, category=SWSRC
            short-label=TRIR_ac_h, category=SWHDR
            short-label=rt_defines_h, category=SWHDR
            short-label=rtwtypes_h, category=SWHDR
      resource consumption RsrcCons_TRIR_ac
    IMP_TRNR: sw-version=9.59.1, used-code-generator=Embedded Coder 7.5 (R2020b) 29-Jul-2020, vendor-id=0, behavior=IB_TRNR
      code-descriptors:
        code Code
          artifact-descriptors:
            short-label=TRNR_ac_c, category=SWSRC
            short-label=TRNR_ac_h, category=SWHDR
            short-label=rtwtypes_h, category=SWHDR
            short-label=zero_crossing_types_h, category=SWHDR
      resource consumption RsrcCons_TRNR_ac
    IMP_TSXR: sw-version=9.305.1, used-code-generator=Embedded Coder 7.5 (R2020b) 29-Jul-2020, vendor-id=0, behavior=IB_TSXR
      code-descriptors:
        code Code
          artifact-descriptors:
            short-label=TSXR_ac_c, category=SWSRC
            short-label=MatlabCppSharedLib_hpp, category=SWHDR
            short-label=MatlabDataArray_hpp, category=SWHDR
            short-label=MatlabEngine_hpp, category=SWHDR
            short-label=MatlabExecutionInterface_hpp, category=SWHDR
            short-label=MatlabTypesInterface_hpp, category=SWHDR
            short-label=TSXR_ac_h, category=SWHDR
            short-label=bio_sig_h, category=SWHDR
            short-label=blas_h, category=SWHDR
            short-label=blascompat32_h, category=SWHDR
            short-label=cg_matrx_h, category=SWHDR
            short-label=cg_sfun_h, category=SWHDR
            short-label=cgxert_h, category=SWHDR
            short-label=covrt_h, category=SWHDR
            short-label=dt_info_h, category=SWHDR
            short-label=emlrt_h, category=SWHDR
            short-label=engine_h, category=SWHDR
            short-label=ext_share_h, category=SWHDR
            short-label=ext_svr_h, category=SWHDR
            short-label=ext_svr_transport_h, category=SWHDR
            short-label=ext_test_h, category=SWHDR
            short-label=ext_types_h, category=SWHDR
            short-label=ext_work_h, category=SWHDR
            short-label=fintrf_h, category=SWHDR
            short-label=fixedpoint_h, category=SWHDR
            short-label=fixpoint_spec_h, category=SWHDR
            short-label=i18n_c_api_h, category=SWHDR
            short-label=io64_h, category=SWHDR
            short-label=lapack_h, category=SWHDR
            short-label=lapacke_h, category=SWHDR
            short-label=lapacke_config_h, category=SWHDR
            short-label=libmwjpegreader_h, category=SWHDR
            short-label=libmwrgb2gray_tbb_h, category=SWHDR
            short-label=libmwrgb2hsv_tbb_h, category=SWHDR
            short-label=libmwslsa_sim_h, category=SWHDR
            short-label=mat_h, category=SWHDR
            short-label=matrix_h, category=SWHDR
            short-label=mclbase_h, category=SWHDR
            short-label=mclcom_h, category=SWHDR
            short-label=mclcomclass_h, category=SWHDR
            short-label=mclcommain_h, category=SWHDR
            short-label=mclcppclass_h, category=SWHDR
            short-label=mclmcr_h, category=SWHDR
            short-label=mclmcrrt_h, category=SWHDR
            short-label=mclxlmain_h, category=SWHDR
            short-label=mcr_h, category=SWHDR
            short-label=mdl_info_h, category=SWHDR
            short-label=mem_mgr_h, category=SWHDR
            short-label=mex_h, category=SWHDR
            short-label=mex_hpp, category=SWHDR
            short-label=mexAdapter_hpp, category=SWHDR
            short-label=mwmathutil_h, category=SWHDR
            short-label=mwservices_h, category=SWHDR
            short-label=mwstringutil_h, category=SWHDR
            short-label=odesup_h, category=SWHDR
            short-label=polygonBoolean_h, category=SWHDR
            short-label=pt_info_h, category=SWHDR
            short-label=rt_defines_h, category=SWHDR
            short-label=rt_logging_h, category=SWHDR
            short-label=rt_logging_mmi_h, category=SWHDR
            short-label=rt_math_h, category=SWHDR
            short-label=rt_matrx_h, category=SWHDR
            short-label=rt_mxclassid_h, category=SWHDR
            short-label=rt_sim_h, category=SWHDR
            short-label=rtmcmacros_h, category=SWHDR
            short-label=rtmmacros_h, category=SWHDR
            short-label=rtsplntypes_h, category=SWHDR
            short-label=rtw_capi_h, category=SWHDR
            short-label=rtw_capi_examples_h, category=SWHDR
            short-label=rtw_continuous_h, category=SWHDR
            short-label=rtw_extmode_h, category=SWHDR
            short-label=rtw_linux_h, category=SWHDR
            short-label=rtw_linux_mac_h, category=SWHDR
            short-label=rtw_matlogging_h, category=SWHDR
            short-label=rtw_modelmap_h, category=SWHDR
            short-label=rtw_modelmap_logging_h, category=SWHDR
            short-label=rtw_msvc_lshift_h, category=SWHDR
            short-label=rtw_solver_h, category=SWHDR
            short-label=rtw_storage_h, category=SWHDR
            short-label=rtw_windows_h, category=SWHDR
            short-label=rtwtypes_h, category=SWHDR
            short-label=sfcn_bridge_h, category=SWHDR
            short-label=sfcn_loader_c_api_h, category=SWHDR
            short-label=sfun_rtwcg_hpp, category=SWHDR
            short-label=sigmapdef_sfcn_h, category=SWHDR
            short-label=sigregdef_h, category=SWHDR
            short-label=sigstream_rtw_h, category=SWHDR
            short-label=simlogCIntrf_h, category=SWHDR
            short-label=simstruc_h, category=SWHDR
            short-label=simstruc_compcond_h, category=SWHDR
            short-label=simstruc_debug_h, category=SWHDR
            short-label=simstruc_def_h, category=SWHDR
            short-label=simstruc_implement_h, category=SWHDR
            short-label=simstruc_internal_h, category=SWHDR
            short-label=simstruc_internal_types_h, category=SWHDR
            short-label=simstruc_types_h, category=SWHDR
            short-label=simulink_h, category=SWHDR
            short-label=simulink2_h, category=SWHDR
            short-label=simulink_solver_api_h, category=SWHDR
            short-label=slImageTypes_h, category=SWHDR
            short-label=sl_common_types_def_h, category=SWHDR
            short-label=sl_datatype_access_h, category=SWHDR
            short-label=sl_fileio_rtw_h, category=SWHDR
            short-label=sl_fixpt_h, category=SWHDR
            short-label=sl_prodhwdevicetype_h, category=SWHDR
            short-label=sl_report_types_h, category=SWHDR
            short-label=sl_sample_time_defs_h, category=SWHDR
            short-label=sl_sfcn_st_api_h, category=SWHDR
            short-label=sl_solver_rtw_h, category=SWHDR
            short-label=sl_types_def_h, category=SWHDR
            short-label=slccrt_h, category=SWHDR
            short-label=slexec_block_runtime_service_h, category=SWHDR
            short-label=slexec_parallel_h, category=SWHDR
            short-label=slexec_simbridge_h, category=SWHDR
            short-label=slexec_simstruct_bridge_h, category=SWHDR
            short-label=slexec_ssExecutionInfo_h, category=SWHDR
            short-label=slexec_vm_lookup_functions_h, category=SWHDR
            short-label=slexec_vm_rt_functions_h, category=SWHDR
            short-label=slexec_vm_simstruct_bridge_h, category=SWHDR
            short-label=slexec_vm_zc_functions_h, category=SWHDR
            short-label=slsa_sim_engine_h, category=SWHDR
            short-label=slsv_diagnostic_codegen_c_api_h, category=SWHDR
            short-label=slsv_diagnostic_deployment_c_api_h, category=SWHDR
            short-label=slsv_diagnostic_logger_type_h, category=SWHDR
            short-label=slsv_mexhelper_h, category=SWHDR
            short-label=solver_zc_h, category=SWHDR
            short-label=sysran_types_h, category=SWHDR
            short-label=tmwtypes_h, category=SWHDR
            short-label=updown_h, category=SWHDR
            short-label=updown_util_h, category=SWHDR
            short-label=upsup_public_h, category=SWHDR
      resource consumption RsrcCons_TSXR_ac
    IMP_TTIR: sw-version=9.120.1, used-code-generator=Embedded Coder 7.5 (R2020b) 29-Jul-2020, vendor-id=0, behavior=IB_TTIR
      code-descriptors:
        code Code
          artifact-descriptors:
            short-label=TTIR_ac_c, category=SWSRC
            short-label=TTIR_ac_h, category=SWHDR
            short-label=rtwtypes_h, category=SWHDR
      resource consumption RsrcCons_TTIR_ac
    IMP_TTQR: sw-version=9.58.1, used-code-generator=Embedded Coder 7.5 (R2020b) 29-Jul-2020, vendor-id=0, behavior=IB_TTQR
      code-descriptors:
        code Code
          artifact-descriptors:
            short-label=TTQR_ac_c, category=SWSRC
            short-label=look1_iflf_binlcapw_c, category=SWSRC
            short-label=look2_iflf_binlcapw_c, category=SWSRC
            short-label=TTQR_ac_h, category=SWHDR
            short-label=look1_iflf_binlcapw_h, category=SWHDR
            short-label=look2_iflf_binlcapw_h, category=SWHDR
            short-label=rtwtypes_h, category=SWHDR
      resource consumption RsrcCons_TTQR_ac
    IMP_UBTR: sw-version=9.107.1, used-code-generator=Embedded Coder 7.5 (R2020b) 29-Jul-2020, vendor-id=0, behavior=IB_UBTR
      code-descriptors:
        code Code
          artifact-descriptors:
            short-label=UBTR_ac_c, category=SWSRC
            short-label=look1_iflf_binlca_16a_c, category=SWSRC
            short-label=look2_iflf_binlca_16a_c, category=SWSRC
            short-label=UBTR_ac_h, category=SWHDR
            short-label=look1_iflf_binlca_16a_h, category=SWHDR
            short-label=look2_iflf_binlca_16a_h, category=SWHDR
            short-label=rtwtypes_h, category=SWHDR
      resource consumption RsrcCons_UBTR_ac
    IMP_VCPR: sw-version=9.20.1, used-code-generator=Embedded Coder 7.5 (R2020b) 29-Jul-2020, vendor-id=0, behavior=IB_VCPR
      code-descriptors:
        code Code
          artifact-descriptors:
            short-label=VCPR_ac_c, category=SWSRC
            short-label=VCPR_ac_h, category=SWHDR
            short-label=rtwtypes_h, category=SWHDR
      resource consumption RsrcCons_VCPR_ac
    IMP_VDDR: sw-version=1.382.1, used-code-generator=Embedded Coder 7.5 (R2020b) 29-Jul-2020, vendor-id=0, behavior=IB_VDDR
      code-descriptors:
        code Code
          artifact-descriptors:
            short-label=VDDR_ac_c, category=SWSRC
            short-label=look1_iflf_binlcapw_c, category=SWSRC
            short-label=VDDR_ac_h, category=SWHDR
            short-label=look1_iflf_binlcapw_h, category=SWHDR
            short-label=rtwtypes_h, category=SWHDR
      resource consumption RsrcCons_VDDR_ac
    IMP_VDVR: sw-version=9.1186.1, used-code-generator=Embedded Coder 7.5 (R2020b) 29-Jul-2020, vendor-id=0, behavior=IB_VDVR
      code-descriptors:
        code Code
          artifact-descriptors:
            short-label=VDVR_ac_c, category=SWSRC
            short-label=VDVR_ac_h, category=SWHDR
            short-label=rtwtypes_h, category=SWHDR
      resource consumption RsrcCons_VDVR_ac
    IMP_VLDR: sw-version=9.219.1, used-code-generator=Embedded Coder 7.5 (R2020b) 29-Jul-2020, vendor-id=0, behavior=IB_VLDR
      code-descriptors:
        code Code
          artifact-descriptors:
            short-label=VLDR_ac_c, category=SWSRC
            short-label=look1_iflf_binlcapw_c, category=SWSRC
            short-label=VLDR_ac_h, category=SWHDR
            short-label=look1_iflf_binlcapw_h, category=SWHDR
            short-label=rtwtypes_h, category=SWHDR
      resource consumption RsrcCons_VLDR_ac
    IMP_VSDR: sw-version=9.51.1, used-code-generator=Embedded Coder 7.5 (R2020b) 29-Jul-2020, vendor-id=0, behavior=IB_VSDR
      code-descriptors:
        code Code
          artifact-descriptors:
            short-label=VSDR_ac_c, category=SWSRC
            short-label=look1_iflf_binlcapw_c, category=SWSRC
            short-label=look2_iflf_binlcapw_c, category=SWSRC
            short-label=VSDR_ac_h, category=SWHDR
            short-label=look1_iflf_binlcapw_h, category=SWHDR
            short-label=look2_iflf_binlcapw_h, category=SWHDR
            short-label=rtwtypes_h, category=SWHDR
      resource consumption RsrcCons_VSDR_ac
    IMP_VSMR: sw-version=9.311.1, used-code-generator=Embedded Coder 7.5 (R2020b) 29-Jul-2020, vendor-id=0, behavior=IB_VSMR
      code-descriptors:
        code Code
          artifact-descriptors:
            short-label=VSMR_ac_c, category=SWSRC
            short-label=VSMR_ac_h, category=SWHDR
            short-label=rtwtypes_h, category=SWHDR
      resource consumption RsrcCons_VSMR_ac
    IMP_VTHR: sw-version=9.1252.1, used-code-generator=Embedded Coder 7.5 (R2020b) 29-Jul-2020, vendor-id=0, behavior=IB_VTHR
      code-descriptors:
        code Code
          artifact-descriptors:
            short-label=VTHR_ac_c, category=SWSRC
            short-label=VTHR_ac_h, category=SWHDR
            short-label=rtwtypes_h, category=SWHDR
      resource consumption RsrcCons_VTHR_ac
    IMP_VTLR: sw-version=9.374.1, used-code-generator=Embedded Coder 7.5 (R2020b) 29-Jul-2020, vendor-id=0, behavior=IB_VTLR
      code-descriptors:
        code Code
          artifact-descriptors:
            short-label=VTLR_ac_c, category=SWSRC
            short-label=VTLR_ac_h, category=SWHDR
            short-label=rtwtypes_h, category=SWHDR
      resource consumption RsrcCons_VTLR_ac
    IMP_VTVR: sw-version=9.215.1, used-code-generator=Embedded Coder 7.5 (R2020b) 29-Jul-2020, vendor-id=0, behavior=IB_VTVR
      code-descriptors:
        code Code
          artifact-descriptors:
            short-label=VTVR_ac_c, category=SWSRC
            short-label=look1_iflf_binlcapw_c, category=SWSRC
            short-label=look2_iflf_binlcapw_c, category=SWSRC
            short-label=VTVR_ac_h, category=SWHDR
            short-label=look1_iflf_binlcapw_h, category=SWHDR
            short-label=look2_iflf_binlcapw_h, category=SWHDR
            short-label=rtwtypes_h, category=SWHDR
      resource consumption RsrcCons_VTVR_ac
    IMP_VTXR: sw-version=9.228.1, used-code-generator=Embedded Coder 7.5 (R2020b) 29-Jul-2020, vendor-id=0, behavior=IB_VTXR
      code-descriptors:
        code Code
          artifact-descriptors:
            short-label=VTXR_ac_c, category=SWSRC
            short-label=VTXR_ac_h, category=SWHDR
            short-label=rtwtypes_h, category=SWHDR
      resource consumption RsrcCons_VTXR_ac
    IMP_WTAR: sw-version=9.323.1, used-code-generator=Embedded Coder 7.5 (R2020b) 29-Jul-2020, vendor-id=0, behavior=IB_WTAR
      code-descriptors:
        code Code
          artifact-descriptors:
            short-label=WTAR_ac_c, category=SWSRC
            short-label=look1_iflf_binlcapw_c, category=SWSRC
            short-label=look2_iflf_binlcapw_c, category=SWSRC
            short-label=look2_iu8flftf_binlcapw_c, category=SWSRC
            short-label=WTAR_ac_h, category=SWHDR
            short-label=look1_iflf_binlcapw_h, category=SWHDR
            short-label=look2_iflf_binlcapw_h, category=SWHDR
            short-label=look2_iu8flftf_binlcapw_h, category=SWHDR
            short-label=rtwtypes_h, category=SWHDR
      resource consumption RsrcCons_WTAR_ac
