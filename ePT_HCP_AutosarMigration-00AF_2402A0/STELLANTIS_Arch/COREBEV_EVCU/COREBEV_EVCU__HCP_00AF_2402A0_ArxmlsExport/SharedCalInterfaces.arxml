AUTOSAR XML (schema 4-2-2)
package /STELLANTIS/EPT/SharedCalInterfaces/PRSWCs
  863 x parameter interface:
    CaOPTR_r_TimpMaxArray
      parameter data prototype CaOPTR_r_TimpMaxArray: category=ARRAY, sw-calibration-access=READ-WRITE, type=rt_Array_Float_16  # Description_Tag_Not_Defined
    CaOPTR_r_ZeroArray
      parameter data prototype CaOPTR_r_ZeroArray: category=ARRAY, sw-calibration-access=READ-WRITE, type=rt_Array_Float_9  # Description_Tag_Not_Defined
    CeTMMR_Cnt_MaxNumClch
      parameter data prototype CeTMMR_Cnt_MaxNumClch: category=VALUE, sw-calibration-access=READ-WRITE, type=SInt16  # Description_Tag_Not_Defined
    HaOPTR_b_OptBatPwrBrk_EVM_Enbl
      parameter data prototype HaOPTR_b_OptBatPwrBrk_EVM_Enbl: category=ARRAY, sw-calibration-access=READ-WRITE, type=rt_Array_Boolean_9  # Description_Tag_Not_Defined
    HaOPTR_b_OptBatPwrBrk_EVN_Enbl
      parameter data prototype HaOPTR_b_OptBatPwrBrk_EVN_Enbl: category=ARRAY, sw-calibration-access=READ-WRITE, type=rt_Array_Boolean_9  # Description_Tag_Not_Defined
    HaOPTR_b_OptBatPwrBrk_Gr_Enbl
      parameter data prototype HaOPTR_b_OptBatPwrBrk_Gr_Enbl: category=ARRAY, sw-calibration-access=READ-WRITE, type=rt_Array_Boolean_9  # Description_Tag_Not_Defined
    HaOPTR_b_OptBatPwrBrk_MA_Enbl
      parameter data prototype HaOPTR_b_OptBatPwrBrk_MA_Enbl: category=ARRAY, sw-calibration-access=READ-WRITE, type=rt_Array_Boolean_9  # Description_Tag_Not_Defined
    HaOPTR_b_OptBatPwrBrk_MB_Enbl
      parameter data prototype HaOPTR_b_OptBatPwrBrk_MB_Enbl: category=ARRAY, sw-calibration-access=READ-WRITE, type=rt_Array_Boolean_9  # Description_Tag_Not_Defined
    HaOPTR_b_OptBatPwrBrk_N_Enbl
      parameter data prototype HaOPTR_b_OptBatPwrBrk_N_Enbl: category=ARRAY, sw-calibration-access=READ-WRITE, type=rt_Array_Boolean_9  # Description_Tag_Not_Defined
    HaOPTR_b_RngStForBltCapParallel
      parameter data prototype HaOPTR_b_RngStForBltCapParallel: category=ARRAY, sw-calibration-access=READ-WRITE, type=rt_Array_Boolean_6  # Description_Tag_Not_Defined
    HaOPTR_b_WEDOpenRngSt
      parameter data prototype HaOPTR_b_WEDOpenRngSt: category=ARRAY, sw-calibration-access=READ-WRITE, type=rt_Array_Boolean_6  # Applies WED power reserve to PbattMax limit for WED open range states determined by this configuration. [N MA MB Gr EVM EVN]
    HaOPTR_n_InitInputSpdDsrdMA
      parameter data prototype HaOPTR_n_InitInputSpdDsrdMA: category=ARRAY, sw-calibration-access=READ-WRITE, type=rt_Array_Float_9  # Description_Tag_Not_Defined
    HaOPTR_n_InitInputSpdDsrdMB
      parameter data prototype HaOPTR_n_InitInputSpdDsrdMB: category=ARRAY, sw-calibration-access=READ-WRITE, type=rt_Array_Float_9  # Description_Tag_Not_Defined
    HaOPTR_n_InitInputSpdDsrdN
      parameter data prototype HaOPTR_n_InitInputSpdDsrdN: category=ARRAY, sw-calibration-access=READ-WRITE, type=rt_Array_Float_9  # Description_Tag_Not_Defined
    HaOPTR_r_NimpCalcEqnMtrx
      parameter data prototype HaOPTR_r_NimpCalcEqnMtrx: category=ARRAY, sw-calibration-access=READ-WRITE, type=rt_Array_Float_3  # Description not Available
    HaOPTR_r_NturbCalcEqnMtrx
      parameter data prototype HaOPTR_r_NturbCalcEqnMtrx: category=ARRAY, sw-calibration-access=READ-WRITE, type=rt_Array_Float_3  # Description not Available
    HaTSXR_b_EVM_NoEqn1Mtrx
      parameter data prototype HaTSXR_b_EVM_NoEqn1Mtrx: category=ARRAY, sw-calibration-access=READ-WRITE, type=rt_Array_Boolean_9  # Description_Tag_Not_Defined
    HaTSXR_b_EVM_NoEqn2Mtrx
      parameter data prototype HaTSXR_b_EVM_NoEqn2Mtrx: category=ARRAY, sw-calibration-access=READ-WRITE, type=rt_Array_Boolean_9  # Description_Tag_Not_Defined
    HaTSXR_b_EVM_NtiEqn1Mtrx
      parameter data prototype HaTSXR_b_EVM_NtiEqn1Mtrx: category=ARRAY, sw-calibration-access=READ-WRITE, type=rt_Array_Boolean_9  # Description_Tag_Not_Defined
    HaTSXR_b_EVM_NtiEqn2Mtrx
      parameter data prototype HaTSXR_b_EVM_NtiEqn2Mtrx: category=ARRAY, sw-calibration-access=READ-WRITE, type=rt_Array_Boolean_9  # Description_Tag_Not_Defined
    HaTSXR_b_EVN_Nc1Eqn2Mtrx
      parameter data prototype HaTSXR_b_EVN_Nc1Eqn2Mtrx: category=ARRAY, sw-calibration-access=READ-WRITE, type=rt_Array_Boolean_9  # Description_Tag_Not_Defined
    HaTSXR_b_EVN_NoEqn1Mtrx
      parameter data prototype HaTSXR_b_EVN_NoEqn1Mtrx: category=ARRAY, sw-calibration-access=READ-WRITE, type=rt_Array_Boolean_9  # Description_Tag_Not_Defined
    HaTSXR_b_EVN_NoEqn2Mtrx
      parameter data prototype HaTSXR_b_EVN_NoEqn2Mtrx: category=ARRAY, sw-calibration-access=READ-WRITE, type=rt_Array_Boolean_9  # Description_Tag_Not_Defined
    HaTSXR_b_EVN_NtiEqn1Mtrx
      parameter data prototype HaTSXR_b_EVN_NtiEqn1Mtrx: category=ARRAY, sw-calibration-access=READ-WRITE, type=rt_Array_Boolean_9  # Description_Tag_Not_Defined
    HaTSXR_b_EVN_NtiEqn2Mtrx
      parameter data prototype HaTSXR_b_EVN_NtiEqn2Mtrx: category=ARRAY, sw-calibration-access=READ-WRITE, type=rt_Array_Boolean_9  # Description_Tag_Not_Defined
    HaTSXR_b_GA_NoEqn1Mtrx
      parameter data prototype HaTSXR_b_GA_NoEqn1Mtrx: category=ARRAY, sw-calibration-access=READ-WRITE, type=rt_Array_Boolean_9  # Description_Tag_Not_Defined
    HaTSXR_b_GA_NoEqn2Mtrx
      parameter data prototype HaTSXR_b_GA_NoEqn2Mtrx: category=ARRAY, sw-calibration-access=READ-WRITE, type=rt_Array_Boolean_9  # Description_Tag_Not_Defined
    HaTSXR_b_GA_NtiEqn1Mtrx
      parameter data prototype HaTSXR_b_GA_NtiEqn1Mtrx: category=ARRAY, sw-calibration-access=READ-WRITE, type=rt_Array_Boolean_9  # Description_Tag_Not_Defined
    HaTSXR_b_GA_NtiEqn2Mtrx
      parameter data prototype HaTSXR_b_GA_NtiEqn2Mtrx: category=ARRAY, sw-calibration-access=READ-WRITE, type=rt_Array_Boolean_9  # Description_Tag_Not_Defined
    HaTSXR_b_G_NiEqn1Mtrx
      parameter data prototype HaTSXR_b_G_NiEqn1Mtrx: category=ARRAY, sw-calibration-access=READ-WRITE, type=rt_Array_Boolean_9  # Description_Tag_Not_Defined
    HaTSXR_b_G_NiEqn2Mtrx
      parameter data prototype HaTSXR_b_G_NiEqn2Mtrx: category=ARRAY, sw-calibration-access=READ-WRITE, type=rt_Array_Boolean_9  # Description_Tag_Not_Defined
    HaTSXR_b_G_NoEqn1Mtrx
      parameter data prototype HaTSXR_b_G_NoEqn1Mtrx: category=ARRAY, sw-calibration-access=READ-WRITE, type=rt_Array_Boolean_9  # Description_Tag_Not_Defined
    HaTSXR_b_G_NoEqn2Mtrx
      parameter data prototype HaTSXR_b_G_NoEqn2Mtrx: category=ARRAY, sw-calibration-access=READ-WRITE, type=rt_Array_Boolean_9  # Description_Tag_Not_Defined
    HaTSXR_b_G_NtiEqn1Mtrx
      parameter data prototype HaTSXR_b_G_NtiEqn1Mtrx: category=ARRAY, sw-calibration-access=READ-WRITE, type=rt_Array_Boolean_9  # Description_Tag_Not_Defined
    HaTSXR_b_G_NtiEqn2Mtrx
      parameter data prototype HaTSXR_b_G_NtiEqn2Mtrx: category=ARRAY, sw-calibration-access=READ-WRITE, type=rt_Array_Boolean_9  # Description_Tag_Not_Defined
    HaTSXR_b_MA_NiEqn2Mtrx
      parameter data prototype HaTSXR_b_MA_NiEqn2Mtrx: category=ARRAY, sw-calibration-access=READ-WRITE, type=rt_Array_Boolean_9  # Description_Tag_Not_Defined
    HaTSXR_b_MA_NoEqn1Mtrx
      parameter data prototype HaTSXR_b_MA_NoEqn1Mtrx: category=ARRAY, sw-calibration-access=READ-WRITE, type=rt_Array_Boolean_9  # Description_Tag_Not_Defined
    HaTSXR_b_MA_NoEqn2Mtrx
      parameter data prototype HaTSXR_b_MA_NoEqn2Mtrx: category=ARRAY, sw-calibration-access=READ-WRITE, type=rt_Array_Boolean_9  # Description_Tag_Not_Defined
    HaTSXR_b_MA_NtiEqn1Mtrx
      parameter data prototype HaTSXR_b_MA_NtiEqn1Mtrx: category=ARRAY, sw-calibration-access=READ-WRITE, type=rt_Array_Boolean_9  # Description_Tag_Not_Defined
    HaTSXR_b_MA_NtiEqn2Mtrx
      parameter data prototype HaTSXR_b_MA_NtiEqn2Mtrx: category=ARRAY, sw-calibration-access=READ-WRITE, type=rt_Array_Boolean_9  # Description_Tag_Not_Defined
    HaTSXR_b_MB_NiEqn1Mtrx
      parameter data prototype HaTSXR_b_MB_NiEqn1Mtrx: category=ARRAY, sw-calibration-access=READ-WRITE, type=rt_Array_Boolean_9  # Description_Tag_Not_Defined
    HaTSXR_b_MB_NiEqn2Mtrx
      parameter data prototype HaTSXR_b_MB_NiEqn2Mtrx: category=ARRAY, sw-calibration-access=READ-WRITE, type=rt_Array_Boolean_9  # Description_Tag_Not_Defined
    HaTSXR_b_MB_NoEqn1Mtrx
      parameter data prototype HaTSXR_b_MB_NoEqn1Mtrx: category=ARRAY, sw-calibration-access=READ-WRITE, type=rt_Array_Boolean_9  # Description_Tag_Not_Defined
    HaTSXR_b_MB_NoEqn2Mtrx
      parameter data prototype HaTSXR_b_MB_NoEqn2Mtrx: category=ARRAY, sw-calibration-access=READ-WRITE, type=rt_Array_Boolean_9  # Description_Tag_Not_Defined
    HaTSXR_b_MB_NtiEqn1Mtrx
      parameter data prototype HaTSXR_b_MB_NtiEqn1Mtrx: category=ARRAY, sw-calibration-access=READ-WRITE, type=rt_Array_Boolean_9  # Description_Tag_Not_Defined
    HaTSXR_b_MB_NtiEqn2Mtrx
      parameter data prototype HaTSXR_b_MB_NtiEqn2Mtrx: category=ARRAY, sw-calibration-access=READ-WRITE, type=rt_Array_Boolean_9  # Description_Tag_Not_Defined
    HaTSXR_b_N_Nc1Eqn2Mtrx
      parameter data prototype HaTSXR_b_N_Nc1Eqn2Mtrx: category=ARRAY, sw-calibration-access=READ-WRITE, type=rt_Array_Boolean_9  # Description_Tag_Not_Defined
    HaTSXR_b_N_NiEqn2Mtrx
      parameter data prototype HaTSXR_b_N_NiEqn2Mtrx: category=ARRAY, sw-calibration-access=READ-WRITE, type=rt_Array_Boolean_9  # Description_Tag_Not_Defined
    HaTSXR_b_N_NoEqn1Mtrx
      parameter data prototype HaTSXR_b_N_NoEqn1Mtrx: category=ARRAY, sw-calibration-access=READ-WRITE, type=rt_Array_Boolean_9  # Description_Tag_Not_Defined
    HaTSXR_b_N_NoEqn2Mtrx
      parameter data prototype HaTSXR_b_N_NoEqn2Mtrx: category=ARRAY, sw-calibration-access=READ-WRITE, type=rt_Array_Boolean_9  # Description_Tag_Not_Defined
    HaTSXR_b_N_NtiEqn1Mtrx
      parameter data prototype HaTSXR_b_N_NtiEqn1Mtrx: category=ARRAY, sw-calibration-access=READ-WRITE, type=rt_Array_Boolean_9  # Description_Tag_Not_Defined
    HaTSXR_b_N_NtiEqn2Mtrx
      parameter data prototype HaTSXR_b_N_NtiEqn2Mtrx: category=ARRAY, sw-calibration-access=READ-WRITE, type=rt_Array_Boolean_9  # Description_Tag_Not_Defined
    HaTSXR_b_N_STRRToConstrnChk
      parameter data prototype HaTSXR_b_N_STRRToConstrnChk: category=ARRAY, sw-calibration-access=READ-WRITE, type=rt_Array_Boolean_6  # Description_Tag_Not_Defined
    HaTSXR_e_EVM_ConstrntType
      parameter data prototype HaTSXR_e_EVM_ConstrntType: category=ARRAY, sw-calibration-access=READ-WRITE, type=rt_Array_SInt16_9  # Description_Tag_Not_Defined
    HaTSXR_e_EVM_DtrmnOptTmsDepVars
      parameter data prototype HaTSXR_e_EVM_DtrmnOptTmsDepVars: category=ARRAY, sw-calibration-access=READ-WRITE, type=rt_Array_SInt16_36  # Description_Tag_Not_Defined
    HaTSXR_e_EVM_ToConstrnStratPrfrdComb
      parameter data prototype HaTSXR_e_EVM_ToConstrnStratPrfrdComb: category=ARRAY, sw-calibration-access=READ-WRITE, type=rt_Array_TeTSXR_e_PrfrdComb_7  # Description_Tag_Not_Defined
    HaTSXR_e_EVN_ConstrntType
      parameter data prototype HaTSXR_e_EVN_ConstrntType: category=ARRAY, sw-calibration-access=READ-WRITE, type=rt_Array_SInt16_9  # Description_Tag_Not_Defined
    HaTSXR_e_EVN_DtrmnOptTmsDepVars
      parameter data prototype HaTSXR_e_EVN_DtrmnOptTmsDepVars: category=ARRAY, sw-calibration-access=READ-WRITE, type=rt_Array_SInt16_36  # Description_Tag_Not_Defined
    HaTSXR_e_EVN_ToConstrnStratPrfrdComb
      parameter data prototype HaTSXR_e_EVN_ToConstrnStratPrfrdComb: category=ARRAY, sw-calibration-access=READ-WRITE, type=rt_Array_TeTSXR_e_PrfrdComb_7  # Description_Tag_Not_Defined
    HaTSXR_e_GA_ConstrntType
      parameter data prototype HaTSXR_e_GA_ConstrntType: category=ARRAY, sw-calibration-access=READ-WRITE, type=rt_Array_SInt16_9  # Description_Tag_Not_Defined
    HaTSXR_e_GA_DtrmnOptTmsDepVars
      parameter data prototype HaTSXR_e_GA_DtrmnOptTmsDepVars: category=ARRAY, sw-calibration-access=READ-WRITE, type=rt_Array_SInt16_36  # Description_Tag_Not_Defined
    HaTSXR_e_GA_TiConstrnStratPrfrdComb
      parameter data prototype HaTSXR_e_GA_TiConstrnStratPrfrdComb: category=ARRAY, sw-calibration-access=READ-WRITE, type=rt_Array_TeTSXR_e_PrfrdComb_7  # Description_Tag_Not_Defined
    HaTSXR_e_GA_ToConstrnStratPrfrdComb
      parameter data prototype HaTSXR_e_GA_ToConstrnStratPrfrdComb: category=ARRAY, sw-calibration-access=READ-WRITE, type=rt_Array_TeTSXR_e_PrfrdComb_7  # Description_Tag_Not_Defined
    HaTSXR_e_G_ConstrntType
      parameter data prototype HaTSXR_e_G_ConstrntType: category=ARRAY, sw-calibration-access=READ-WRITE, type=rt_Array_SInt16_9  # Description_Tag_Not_Defined
    HaTSXR_e_G_DtrmnOptTmsDepVars
      parameter data prototype HaTSXR_e_G_DtrmnOptTmsDepVars: category=ARRAY, sw-calibration-access=READ-WRITE, type=rt_Array_SInt16_36  # Description_Tag_Not_Defined
    HaTSXR_e_G_TiConstrnStratPrfrdComb
      parameter data prototype HaTSXR_e_G_TiConstrnStratPrfrdComb: category=ARRAY, sw-calibration-access=READ-WRITE, type=rt_Array_TeTSXR_e_PrfrdComb_7  # Description_Tag_Not_Defined
    HaTSXR_e_G_ToConstrnStratPrfrdComb
      parameter data prototype HaTSXR_e_G_ToConstrnStratPrfrdComb: category=ARRAY, sw-calibration-access=READ-WRITE, type=rt_Array_TeTSXR_e_PrfrdComb_7  # Description_Tag_Not_Defined
    HaTSXR_e_MA_ConstrntType
      parameter data prototype HaTSXR_e_MA_ConstrntType: category=ARRAY, sw-calibration-access=READ-WRITE, type=rt_Array_SInt16_9  # Description_Tag_Not_Defined
    HaTSXR_e_MA_DtrmnOptTmsDepVars
      parameter data prototype HaTSXR_e_MA_DtrmnOptTmsDepVars: category=ARRAY, sw-calibration-access=READ-WRITE, type=rt_Array_SInt16_36  # Description_Tag_Not_Defined
    HaTSXR_e_MA_TiConstrnStratPrfrdComb
      parameter data prototype HaTSXR_e_MA_TiConstrnStratPrfrdComb: category=ARRAY, sw-calibration-access=READ-WRITE, type=rt_Array_TeTSXR_e_PrfrdComb_7  # Description_Tag_Not_Defined
    HaTSXR_e_MA_ToConstrnStratPrfrdComb
      parameter data prototype HaTSXR_e_MA_ToConstrnStratPrfrdComb: category=ARRAY, sw-calibration-access=READ-WRITE, type=rt_Array_TeTSXR_e_PrfrdComb_7  # Description_Tag_Not_Defined
    HaTSXR_e_MB_ConstrntType
      parameter data prototype HaTSXR_e_MB_ConstrntType: category=ARRAY, sw-calibration-access=READ-WRITE, type=rt_Array_SInt16_9  # Description_Tag_Not_Defined
    HaTSXR_e_MB_DtrmnOptTmsDepVars
      parameter data prototype HaTSXR_e_MB_DtrmnOptTmsDepVars: category=ARRAY, sw-calibration-access=READ-WRITE, type=rt_Array_SInt16_36  # Description_Tag_Not_Defined
    HaTSXR_e_MB_TiConstrnStratPrfrdComb
      parameter data prototype HaTSXR_e_MB_TiConstrnStratPrfrdComb: category=ARRAY, sw-calibration-access=READ-WRITE, type=rt_Array_TeTSXR_e_PrfrdComb_7  # Description_Tag_Not_Defined
    HaTSXR_e_MB_ToConstrnStratPrfrdComb
      parameter data prototype HaTSXR_e_MB_ToConstrnStratPrfrdComb: category=ARRAY, sw-calibration-access=READ-WRITE, type=rt_Array_TeTSXR_e_PrfrdComb_7  # Description_Tag_Not_Defined
    HaTSXR_e_N_ConstrntType
      parameter data prototype HaTSXR_e_N_ConstrntType: category=ARRAY, sw-calibration-access=READ-WRITE, type=rt_Array_SInt16_9  # Description_Tag_Not_Defined
    HaTSXR_e_N_DtrmnOptTmsDepVars
      parameter data prototype HaTSXR_e_N_DtrmnOptTmsDepVars: category=ARRAY, sw-calibration-access=READ-WRITE, type=rt_Array_SInt16_36  # Description_Tag_Not_Defined
    HaTSXR_e_N_STRRToConstrnDepVars
      parameter data prototype HaTSXR_e_N_STRRToConstrnDepVars: category=ARRAY, sw-calibration-access=READ-WRITE, type=rt_Array_TeTSXR_e_TorqMatrixVars_6  # Description_Tag_Not_Defined
    HaTSXR_e_N_TiConstrnStratPrfrdComb
      parameter data prototype HaTSXR_e_N_TiConstrnStratPrfrdComb: category=ARRAY, sw-calibration-access=READ-WRITE, type=rt_Array_TeTSXR_e_PrfrdComb_7  # Description_Tag_Not_Defined
    HaTSXR_e_N_ToConstrnStratPrfrdComb
      parameter data prototype HaTSXR_e_N_ToConstrnStratPrfrdComb: category=ARRAY, sw-calibration-access=READ-WRITE, type=rt_Array_TeTSXR_e_PrfrdComb_7  # Description_Tag_Not_Defined
    HeATRR_b_BSGConvByps
      parameter data prototype HeATRR_b_BSGConvByps: category=VALUE, sw-calibration-access=READ-WRITE, type=Boolean  # Cal to bypass wheel torque conversion for BSG systems
    HeATRR_b_RTC_Enbl
      parameter data prototype HeATRR_b_RTC_Enbl: category=VALUE, sw-calibration-access=READ-WRITE, type=Boolean  # Cal to enable use of the driver calculated torque converter\nratio instead of the current torque conveter ratio
    HeHSCR_M_CombMdOvrd
      parameter data prototype HeHSCR_M_CombMdOvrd: category=VALUE, sw-calibration-access=READ-WRITE, type=UInt8  # Overide calibration to override the method used to find M\nand N when an equality constraint is not used. A value of uint8(1)\noverrides to always using the opt line based M and N and uint8(2)\noverrides to M and N fit through the corners of the cuboid. A
    HeHSCR_b_DisableManufMNStrat
      parameter data prototype HeHSCR_b_DisableManufMNStrat: category=VALUE, sw-calibration-access=READ-WRITE, type=Boolean  # Boolean to disable the corner of cuboid and opt. line based M and N calculation since SCOR always uses equality constraints.
    HeHSCR_b_DsblCalcMinToMinMax_Md
      parameter data prototype HeHSCR_b_DsblCalcMinToMinMax_Md: category=VALUE, sw-calibration-access=READ-WRITE, type=Boolean  # Description_Tag_Not_Defined
    HeHSCR_b_EnblCnstChkBool
      parameter data prototype HeHSCR_b_EnblCnstChkBool: category=VALUE, sw-calibration-access=READ-WRITE, type=Boolean  # Boolean to enable using the modified TSXR boolean array\ndownstream in 2D HSCL.
    HeHSCR_b_EnblCnstMtrLims
      parameter data prototype HeHSCR_b_EnblCnstMtrLims: category=VALUE, sw-calibration-access=READ-WRITE, type=Boolean  # Boolean to enable using the constrained torque limit cuboid\nfor downstream analysis in 2D HSCL.
    HeHSCR_b_EnblOptBsdCalc
      parameter data prototype HeHSCR_b_EnblOptBsdCalc: category=VALUE, sw-calibration-access=READ-WRITE, type=Boolean  # Boolean to enable using the 3D opt. line roots for finding\nthe opt line based M and N plane.
    HeHSCR_b_ForceDrive
      parameter data prototype HeHSCR_b_ForceDrive: category=VALUE, sw-calibration-access=READ-WRITE, type=Boolean  # P1P2.5 P2 is before reverse gear, for torque floor, only use drive for P2.5
    HeHSCR_b_MNCnstCalcOvrd
      parameter data prototype HeHSCR_b_MNCnstCalcOvrd: category=VALUE, sw-calibration-access=READ-WRITE, type=Boolean  # Boolean override calibration to overide the constraint \nlocated inside the HSCL M and N calculator. Boolean(1) overrides to raw\nmotor torque constraints and boolean(0) allows motor torque limits\ninclusive of TSXR constraints to be used.
    HeHSCR_b_ToMaxMinArbtBEV
      parameter data prototype HeHSCR_b_ToMaxMinArbtBEV: category=VALUE, sw-calibration-access=READ-WRITE, type=Boolean  # Use for HSCL ToMaxMinTrqSplt for BEV arbitration
    HeOBCR_t_FnctRate
      parameter data prototype HeOBCR_t_FnctRate: category=VALUE, sw-calibration-access=READ-WRITE, type=Float  # Function Call Rate of OBCR
    HeOBCR_t_dT
      parameter data prototype HeOBCR_t_dT: category=VALUE, sw-calibration-access=READ-WRITE, type=Float  # Rate at which OBCR runs
    HeOPTR_b_AltMd_Ovrd
      parameter data prototype HeOPTR_b_AltMd_Ovrd: category=VALUE, sw-calibration-access=READ-WRITE, type=Boolean  # Description_Tag_Not_Defined
    HeOPTR_b_DsblEPtsArb
      parameter data prototype HeOPTR_b_DsblEPtsArb: category=VALUE, sw-calibration-access=READ-WRITE, type=Boolean  # Override to disable battery power voilation check for OPTL final motor torque determination.
    HeOPTR_b_EnblNiCostScrimFiltforAllRng
      parameter data prototype HeOPTR_b_EnblNiCostScrimFiltforAllRng: category=VALUE, sw-calibration-access=READ-WRITE, type=Boolean  # Description_Tag_Not_Defined
    HeOPTR_b_EnblOptTrqSplitFact
      parameter data prototype HeOPTR_b_EnblOptTrqSplitFact: category=VALUE, sw-calibration-access=READ-WRITE, type=Boolean  # Enable Optimum Torque Split factor
    HeOPTR_b_EnblOptTrqSplitFilt
      parameter data prototype HeOPTR_b_EnblOptTrqSplitFilt: category=VALUE, sw-calibration-access=READ-WRITE, type=Boolean  # Enable Optimum Torque Split Filter
    HeOPTR_b_EnblSWALims
      parameter data prototype HeOPTR_b_EnblSWALims: category=VALUE, sw-calibration-access=READ-WRITE, type=Boolean  # Cal to enable or disable steering wheel angle based Mtr A torque limits
    HeOPTR_b_EnblTCC_Calc
      parameter data prototype HeOPTR_b_EnblTCC_Calc: category=VALUE, sw-calibration-access=READ-WRITE, type=Boolean  # Description_Tag_Not_Defined
    HeOPTR_b_EnblZMtrBAct
      parameter data prototype HeOPTR_b_EnblZMtrBAct: category=VALUE, sw-calibration-access=READ-WRITE, type=Boolean  # Enable zero motor B torque actuation
    HeOPTR_b_EvalNiLimGldSrch
      parameter data prototype HeOPTR_b_EvalNiLimGldSrch: category=VALUE, sw-calibration-access=READ-WRITE, type=Boolean  # Description_Tag_Not_Defined
    HeOPTR_b_FixedGrDpndntRngSt_EVM
      parameter data prototype HeOPTR_b_FixedGrDpndntRngSt_EVM: category=VALUE, sw-calibration-access=READ-WRITE, type=Boolean  # Indicates whether the indexes of the EVM range state are fixed step gears (1) or have a different meaning (0)
    HeOPTR_b_FixedGrDpndntRngSt_EVN
      parameter data prototype HeOPTR_b_FixedGrDpndntRngSt_EVN: category=VALUE, sw-calibration-access=READ-WRITE, type=Boolean  # Indicates whether the indexes of the EVN range state are fixed step gears (1) or have a different meaning (0)
    HeOPTR_b_FixedGrDpndntRngSt_Gr
      parameter data prototype HeOPTR_b_FixedGrDpndntRngSt_Gr: category=VALUE, sw-calibration-access=READ-WRITE, type=Boolean  # Indicates whether the indexes of the Gear B range state are fixed step gears (1) or have a different meaning (0)
    HeOPTR_b_FixedGrDpndntRngSt_MA
      parameter data prototype HeOPTR_b_FixedGrDpndntRngSt_MA: category=VALUE, sw-calibration-access=READ-WRITE, type=Boolean  # Indicates whether the indexes of the Mode A range state are fixed step gears (1) or have a different meaning (0)
    HeOPTR_b_FixedGrDpndntRngSt_MB
      parameter data prototype HeOPTR_b_FixedGrDpndntRngSt_MB: category=VALUE, sw-calibration-access=READ-WRITE, type=Boolean  # Indicates whether the indexes of the Mode B range state are fixed step gears (1) or have a different meaning (0)
    HeOPTR_b_FixedGrDpndntRngSt_N_GA
      parameter data prototype HeOPTR_b_FixedGrDpndntRngSt_N_GA: category=VALUE, sw-calibration-access=READ-WRITE, type=Boolean  # Indicates whether the indexes of the Mode N / Gear A range state are fixed step gears (1) or have a different meaning (0)
    HeOPTR_b_IncSEMFltDsble
      parameter data prototype HeOPTR_b_IncSEMFltDsble: category=VALUE, sw-calibration-access=READ-WRITE, type=Boolean  # Date: 09/09/19 (22A_2010A) This cal allows for the \ndisabling of OPTL Mtr. A filtering for inc shifts. This cal is to\nbe set to boolean(1) for P1P4 systems and set to boolean(0) for all other\nsystems
    HeOPTR_b_InclPiCold_NiIndpndt
      parameter data prototype HeOPTR_b_InclPiCold_NiIndpndt: category=VALUE, sw-calibration-access=READ-WRITE, type=Boolean  # Description_Tag_Not_Defined
    HeOPTR_b_NC2TrgtSel
      parameter data prototype HeOPTR_b_NC2TrgtSel: category=VALUE, sw-calibration-access=READ-WRITE, type=Boolean  # Description not Available
    HeOPTR_b_TransLoss_UseTturb
      parameter data prototype HeOPTR_b_TransLoss_UseTturb: category=VALUE, sw-calibration-access=READ-WRITE, type=Boolean  # Description_Tag_Not_Defined
    HeOPTR_b_UsePshiftForPwrTerm
      parameter data prototype HeOPTR_b_UsePshiftForPwrTerm: category=VALUE, sw-calibration-access=READ-WRITE, type=Boolean
    HeTSXR_b_NxNMtrIndDepChk
      parameter data prototype HeTSXR_b_NxNMtrIndDepChk: category=VALUE, sw-calibration-access=READ-WRITE, type=Boolean  # Description Not yet Available
    HeTSXR_b_OITRTacTiMnNActiv
      parameter data prototype HeTSXR_b_OITRTacTiMnNActiv: category=VALUE, sw-calibration-access=READ-WRITE, type=Boolean  # Description_Tag_Not_Defined
    HeTSXR_b_OITRTacTiRadModActiv
      parameter data prototype HeTSXR_b_OITRTacTiRadModActiv: category=VALUE, sw-calibration-access=READ-WRITE, type=Boolean  # Description_Tag_Not_Defined
    HeTSXR_b_OITRTacToMnNActiv
      parameter data prototype HeTSXR_b_OITRTacToMnNActiv: category=VALUE, sw-calibration-access=READ-WRITE, type=Boolean  # Description_Tag_Not_Defined
    HeTSXR_b_OITRTacToRadModActiv
      parameter data prototype HeTSXR_b_OITRTacToRadModActiv: category=VALUE, sw-calibration-access=READ-WRITE, type=Boolean  # Description_Tag_Not_Defined
    HeTSXR_b_VTVRTacToMnNActiv
      parameter data prototype HeTSXR_b_VTVRTacToMnNActiv: category=VALUE, sw-calibration-access=READ-WRITE, type=Boolean  # Description_Tag_Not_Defined
    HeTSXR_b_VTVRTacToRadModActiv
      parameter data prototype HeTSXR_b_VTVRTacToRadModActiv: category=VALUE, sw-calibration-access=READ-WRITE, type=Boolean  # Description_Tag_Not_Defined
    HeTSXR_e_All_StratToDomain
      parameter data prototype HeTSXR_e_All_StratToDomain: category=VALUE, sw-calibration-access=READ-WRITE, type=TeTSXR_e_TSXRTorqDomain  # Description_Tag_Not_Defined
    HeTSXR_e_All_TactToDomain
      parameter data prototype HeTSXR_e_All_TactToDomain: category=VALUE, sw-calibration-access=READ-WRITE, type=TeTSXR_e_TSXRTorqDomain  # Description_Tag_Not_Defined
    HeTSXR_e_DrivabilityEqnWEDClsd
      parameter data prototype HeTSXR_e_DrivabilityEqnWEDClsd: category=VALUE, sw-calibration-access=READ-WRITE, type=TeHSER_e_SteadyStates  # Description_Tag_Not_Defined
    HeTSXR_e_DrivabilityRngEqnSel
      parameter data prototype HeTSXR_e_DrivabilityRngEqnSel: category=VALUE, sw-calibration-access=READ-WRITE, type=TeHSER_e_SteadyStates  # Description_Tag_Not_Defined
    HeTSXR_e_EVM_StrtgcToEqltyEqn
      parameter data prototype HeTSXR_e_EVM_StrtgcToEqltyEqn: category=VALUE, sw-calibration-access=READ-WRITE, type=TeTSXR_e_Number  # Description_Tag_Not_Defined
    HeTSXR_e_EVN_StrtgcToEqltyEqn
      parameter data prototype HeTSXR_e_EVN_StrtgcToEqltyEqn: category=VALUE, sw-calibration-access=READ-WRITE, type=TeTSXR_e_Number  # Description_Tag_Not_Defined
    HeTSXR_e_GA_StrtgcTiEqltyEqn
      parameter data prototype HeTSXR_e_GA_StrtgcTiEqltyEqn: category=VALUE, sw-calibration-access=READ-WRITE, type=TeTSXR_e_Number  # Description_Tag_Not_Defined
    HeTSXR_e_GA_StrtgcToEqltyEqn
      parameter data prototype HeTSXR_e_GA_StrtgcToEqltyEqn: category=VALUE, sw-calibration-access=READ-WRITE, type=TeTSXR_e_Number  # Description_Tag_Not_Defined
    HeTSXR_e_G_StrtgcTiEqltyEqn
      parameter data prototype HeTSXR_e_G_StrtgcTiEqltyEqn: category=VALUE, sw-calibration-access=READ-WRITE, type=TeTSXR_e_Number  # Description_Tag_Not_Defined
    HeTSXR_e_G_StrtgcToEqltyEqn
      parameter data prototype HeTSXR_e_G_StrtgcToEqltyEqn: category=VALUE, sw-calibration-access=READ-WRITE, type=TeTSXR_e_Number  # Description_Tag_Not_Defined
    HeTSXR_e_MA_StrtgcTiEqltyEqn
      parameter data prototype HeTSXR_e_MA_StrtgcTiEqltyEqn: category=VALUE, sw-calibration-access=READ-WRITE, type=TeTSXR_e_Number  # Description_Tag_Not_Defined
    HeTSXR_e_MA_StrtgcToEqltyEqn
      parameter data prototype HeTSXR_e_MA_StrtgcToEqltyEqn: category=VALUE, sw-calibration-access=READ-WRITE, type=TeTSXR_e_Number  # Description_Tag_Not_Defined
    HeTSXR_e_MB_StrtgcTiEqltyEqn
      parameter data prototype HeTSXR_e_MB_StrtgcTiEqltyEqn: category=VALUE, sw-calibration-access=READ-WRITE, type=TeTSXR_e_Number  # Description_Tag_Not_Defined
    HeTSXR_e_MB_StrtgcToEqltyEqn
      parameter data prototype HeTSXR_e_MB_StrtgcToEqltyEqn: category=VALUE, sw-calibration-access=READ-WRITE, type=TeTSXR_e_Number  # Description_Tag_Not_Defined
    HeTSXR_e_N_StrtgcTiEqltyEqn
      parameter data prototype HeTSXR_e_N_StrtgcTiEqltyEqn: category=VALUE, sw-calibration-access=READ-WRITE, type=TeTSXR_e_Number  # Description_Tag_Not_Defined
    HeTSXR_e_N_StrtgcToEqltyEqn
      parameter data prototype HeTSXR_e_N_StrtgcToEqltyEqn: category=VALUE, sw-calibration-access=READ-WRITE, type=TeTSXR_e_Number  # Description_Tag_Not_Defined
    HeTSXR_e_NxDomain
      parameter data prototype HeTSXR_e_NxDomain: category=VALUE, sw-calibration-access=READ-WRITE, type=TeTSXR_e_NxDomain  # Description_Tag_Not_Defined
    HeTSXR_e_NxMtr4LmtCalc
      parameter data prototype HeTSXR_e_NxMtr4LmtCalc: category=VALUE, sw-calibration-access=READ-WRITE, type=TeTSXR_e_TorqMatrixVars  # Description_Tag_Not_Defined
    KaHSCR_k_Donut_Space_Coefs_A1
      parameter data prototype KaHSCR_k_Donut_Space_Coefs_A1: category=ARRAY, sw-calibration-access=READ-WRITE, type=rt_Array_Float_34  # Coefficient A1 in the Motor A torque vs electrical power equation.
    KaHSCR_k_Donut_Space_Coefs_A2
      parameter data prototype KaHSCR_k_Donut_Space_Coefs_A2: category=ARRAY, sw-calibration-access=READ-WRITE, type=rt_Array_Float_34  # Coefficient A2 in the Motor A torque vs electrical power equation.
    KaHSCR_k_Donut_Space_Coefs_B1
      parameter data prototype KaHSCR_k_Donut_Space_Coefs_B1: category=ARRAY, sw-calibration-access=READ-WRITE, type=rt_Array_Float_34  # Coefficient B1 in the Motor B torque vs electrical power equation.
    KaHSCR_k_Donut_Space_Coefs_B2
      parameter data prototype KaHSCR_k_Donut_Space_Coefs_B2: category=ARRAY, sw-calibration-access=READ-WRITE, type=rt_Array_Float_34  # Coefficient B2 in the Motor B torque vs electrical power equation.
    KaHSCR_k_Donut_Space_Coefs_C
      parameter data prototype KaHSCR_k_Donut_Space_Coefs_C: category=ARRAY, sw-calibration-access=READ-WRITE, type=rt_Array_Float_34  # Coefficient C in the Motor A torque vs electrical power equation.
    KaHSCR_k_Donut_Space_Coefs_C1
      parameter data prototype KaHSCR_k_Donut_Space_Coefs_C1: category=ARRAY, sw-calibration-access=READ-WRITE, type=rt_Array_Float_34  # Coefficient C1 in the Motor C torque vs electrical power equation.
    KaHSCR_k_Donut_Space_Coefs_C2
      parameter data prototype KaHSCR_k_Donut_Space_Coefs_C2: category=ARRAY, sw-calibration-access=READ-WRITE, type=rt_Array_Float_34  # Coefficient C2 in the Motor C torque vs electrical power equation.
    KaHSCR_k_Donut_Space_Coefs_D
      parameter data prototype KaHSCR_k_Donut_Space_Coefs_D: category=ARRAY, sw-calibration-access=READ-WRITE, type=rt_Array_Float_34  # Coefficient B2 in the Motor B torque vs electrical power equation.
    KaHSCR_k_Donut_Space_Coefs_E
      parameter data prototype KaHSCR_k_Donut_Space_Coefs_E: category=ARRAY, sw-calibration-access=READ-WRITE, type=rt_Array_Float_34  # Coefficient X2 in the Motor C torque vs electrical power equation.
    KaHSCR_n_DonutSpaceCoeffs_AxisA
      parameter data prototype KaHSCR_n_DonutSpaceCoeffs_AxisA: category=ARRAY, sw-calibration-access=READ-WRITE, type=rt_Array_Float_34  # Motor A speed as axis for donut coefficients.
    KaHSCR_n_DonutSpaceCoeffs_AxisB
      parameter data prototype KaHSCR_n_DonutSpaceCoeffs_AxisB: category=ARRAY, sw-calibration-access=READ-WRITE, type=rt_Array_Float_34  # Motor B speed as axis for donut coefficients.
    KaHSCR_n_DonutSpaceCoeffs_AxisC
      parameter data prototype KaHSCR_n_DonutSpaceCoeffs_AxisC: category=ARRAY, sw-calibration-access=READ-WRITE, type=rt_Array_Float_34  # Motor C speed as axis for donut coefficients.
    KaHSCR_n_Eng_Speed
      parameter data prototype KaHSCR_n_Eng_Speed: category=ARRAY, sw-calibration-access=READ-WRITE, type=rt_Array_Float_34  # Engine Speed Break points
    KaHSCR_n_FEADLoss_CoeffA
      parameter data prototype KaHSCR_n_FEADLoss_CoeffA: category=ARRAY, sw-calibration-access=READ-WRITE, type=rt_Array_Float_34  # FEAD loss coeff A Correlated with Engine Speed Break points
    KaHSCR_n_FEADLoss_CoeffB
      parameter data prototype KaHSCR_n_FEADLoss_CoeffB: category=ARRAY, sw-calibration-access=READ-WRITE, type=rt_Array_Float_34  # FEAD loss coeff B Correlated with Engine Speed Break points
    KaHSCR_n_FEADLoss_CoeffC
      parameter data prototype KaHSCR_n_FEADLoss_CoeffC: category=ARRAY, sw-calibration-access=READ-WRITE, type=rt_Array_Float_34  # FEAD loss coeff C Correlated with Engine Speed Break points
    KaOPTR_M_FuelFlowTrqAxis
      parameter data prototype KaOPTR_M_FuelFlowTrqAxis: category=ARRAY, sw-calibration-access=READ-WRITE, type=rt_Array_Float_31  # Engine torque axis for fuel flow rate during all cylinder operation.
    KaOPTR_M_FuelFlowTrqAxis_DOD
      parameter data prototype KaOPTR_M_FuelFlowTrqAxis_DOD: category=ARRAY, sw-calibration-access=READ-WRITE, type=rt_Array_Float_31  # Engine torque axis for fuel flow rate during DOD operation.
    KaOPTR_b_ABOCaseMapNeg
      parameter data prototype KaOPTR_b_ABOCaseMapNeg: category=ARRAY, sw-calibration-access=READ-WRITE, type=rt_Array_Boolean_9  # This cal is used to enable or disable ABO case switching when SWA is extreme, there is not a zero crossing & when output torque is negative
    KaOPTR_b_ABOCaseMapPos
      parameter data prototype KaOPTR_b_ABOCaseMapPos: category=ARRAY, sw-calibration-access=READ-WRITE, type=rt_Array_Boolean_9  # Cal to enable or disable ABO case switching when SWA is extreme & there no zero crossing in output torque. This Cal is used when output Torque is +ve or 0.
    KaOPTR_b_LockLowSt_LwrdCreepEna
      parameter data prototype KaOPTR_b_LockLowSt_LwrdCreepEna: category=ARRAY, sw-calibration-access=READ-WRITE, type=rt_Array_Boolean_3  # Enable calibratrion as a function of Lock Low State to allow the Lowered Creep feature to be active
    KaOPTR_b_RGS_Gears_Sel
      parameter data prototype KaOPTR_b_RGS_Gears_Sel: category=ARRAY, sw-calibration-access=READ-WRITE, type=rt_Array_Boolean_13  # Description_Tag_Not_Defined
    KaOPTR_b_SteadySt_LwrdCreepEna
      parameter data prototype KaOPTR_b_SteadySt_LwrdCreepEna: category=ARRAY, sw-calibration-access=READ-WRITE, type=rt_Array_Boolean_8  # Enable calibratrion as a function of the current steady state Range State to allow the Lowered Creep feature to be active
    KaOPTR_b_ZeroRPMAllowPRNDL
      parameter data prototype KaOPTR_b_ZeroRPMAllowPRNDL: category=ARRAY, sw-calibration-access=READ-WRITE, type=rt_Array_Boolean_4  # Description_Tag_Not_Defined
    KaOPTR_b_ZeroRPMAllowTCase
      parameter data prototype KaOPTR_b_ZeroRPMAllowTCase: category=ARRAY, sw-calibration-access=READ-WRITE, type=rt_Array_Boolean_8  # Description_Tag_Not_Defined
    KaOPTR_dm_FuelFlowAllCyl
      parameter data prototype KaOPTR_dm_FuelFlowAllCyl: category=ARRAY, sw-calibration-access=READ-WRITE, type=rt_Array_Float_961  # Engine fuel flow rate (g/sec) for all cylinder operation.
    KaOPTR_dm_FuelFlowAllCylStgc
      parameter data prototype KaOPTR_dm_FuelFlowAllCylStgc: category=ARRAY, sw-calibration-access=READ-WRITE, type=rt_Array_Float_961  # Strategic engine fuel flow rate (g/sec) for all cylinder operation.
    KaOPTR_dm_FuelFlowDOD
      parameter data prototype KaOPTR_dm_FuelFlowDOD: category=ARRAY, sw-calibration-access=READ-WRITE, type=rt_Array_Float_465  # Engine fuel flow rate (g/sec) during DOD operation.
    KaOPTR_e_LashWiggleArb
      parameter data prototype KaOPTR_e_LashWiggleArb: category=ARRAY, sw-calibration-access=READ-WRITE, type=rt_Array_TeOPTR_e_LashWiggleActv_6  # cal to set to follow Motr A or Motr B or To when in lash or wiggle
    KaOPTR_i_GearRemap
      parameter data prototype KaOPTR_i_GearRemap: category=ARRAY, sw-calibration-access=READ-WRITE, type=rt_Array_UInt16_13  # This calibration is used in the branching logic to select\nwhich set of A,B, and O tables will be used.
    KaOPTR_n_FuelFlowSpdAxis
      parameter data prototype KaOPTR_n_FuelFlowSpdAxis: category=ARRAY, sw-calibration-access=READ-WRITE, type=rt_Array_Float_31  # Engine speed axis for fuel flow rate during all cylinder operation.
    KaOPTR_n_FuelFlowSpdAxis_DOD
      parameter data prototype KaOPTR_n_FuelFlowSpdAxis_DOD: category=ARRAY, sw-calibration-access=READ-WRITE, type=rt_Array_Float_15  # Engine speed axis for fuel flow rate during DOD operation.
    KaTMMR_r_CoeffGrRatClchOffgPostShftType
      parameter data prototype KaTMMR_r_CoeffGrRatClchOffgPostShftType: category=ARRAY, sw-calibration-access=READ-WRITE, type=rt_Array_Float_89  # Coefficient Gear ratio off-going clutch post value for TSXR calculation
    KaTMMR_r_CoeffGrRatClchOffgPreShftType
      parameter data prototype KaTMMR_r_CoeffGrRatClchOffgPreShftType: category=ARRAY, sw-calibration-access=READ-WRITE, type=rt_Array_Float_89  # Coefficient Gear ratio off-going clutch pre value for TSXR calculation
    KaTMMR_r_CoeffGrRatClchOncPostShftType
      parameter data prototype KaTMMR_r_CoeffGrRatClchOncPostShftType: category=ARRAY, sw-calibration-access=READ-WRITE, type=rt_Array_Float_89  # Coefficient Gear ratio on-coming clutch post value for TSXR calculation
    KaTMMR_r_CoeffGrRatClchOncPreShftType
      parameter data prototype KaTMMR_r_CoeffGrRatClchOncPreShftType: category=ARRAY, sw-calibration-access=READ-WRITE, type=rt_Array_Float_89  # Coefficient Gear ratio on-coming clutch pre value for TSXR calculation
    KaTSXR_r_All_Nt2StratNoRatio
      parameter data prototype KaTSXR_r_All_Nt2StratNoRatio: category=ARRAY, sw-calibration-access=READ-WRITE, type=rt_Array_Float_9  # Description_Tag_Not_Defined
    KaTSXR_r_EVM_CalcStrtgcTlfEqn
      parameter data prototype KaTSXR_r_EVM_CalcStrtgcTlfEqn: category=ARRAY, sw-calibration-access=READ-WRITE, type=rt_Array_Float_126  # Description_Tag_Not_Defined
    KaTSXR_r_EVM_CalcTc1Eqn
      parameter data prototype KaTSXR_r_EVM_CalcTc1Eqn: category=ARRAY, sw-calibration-access=READ-WRITE, type=rt_Array_Float_126  # Description_Tag_Not_Defined
    KaTSXR_r_EVM_CalcTc2Eqn
      parameter data prototype KaTSXR_r_EVM_CalcTc2Eqn: category=ARRAY, sw-calibration-access=READ-WRITE, type=rt_Array_Float_126  # Description_Tag_Not_Defined
    KaTSXR_r_EVM_CalcTc3Eqn
      parameter data prototype KaTSXR_r_EVM_CalcTc3Eqn: category=ARRAY, sw-calibration-access=READ-WRITE, type=rt_Array_Float_126  # Description_Tag_Not_Defined
    KaTSXR_r_EVM_CalcTc4Eqn
      parameter data prototype KaTSXR_r_EVM_CalcTc4Eqn: category=ARRAY, sw-calibration-access=READ-WRITE, type=rt_Array_Float_126  # Description_Tag_Not_Defined
    KaTSXR_r_EVM_CalcTofEqn
      parameter data prototype KaTSXR_r_EVM_CalcTofEqn: category=ARRAY, sw-calibration-access=READ-WRITE, type=rt_Array_Float_126  # Description_Tag_Not_Defined
    KaTSXR_r_EVM_CalcTorEqn
      parameter data prototype KaTSXR_r_EVM_CalcTorEqn: category=ARRAY, sw-calibration-access=READ-WRITE, type=rt_Array_Float_126  # Description_Tag_Not_Defined
    KaTSXR_r_EVM_NaCalcEqnMtrx
      parameter data prototype KaTSXR_r_EVM_NaCalcEqnMtrx: category=ARRAY, sw-calibration-access=READ-WRITE, type=rt_Array_Float_27  # Description_Tag_Not_Defined
    KaTSXR_r_EVM_NbCalcEqnMtrx
      parameter data prototype KaTSXR_r_EVM_NbCalcEqnMtrx: category=ARRAY, sw-calibration-access=READ-WRITE, type=rt_Array_Float_27  # Description_Tag_Not_Defined
    KaTSXR_r_EVM_Nc1CalcEqnMtrx
      parameter data prototype KaTSXR_r_EVM_Nc1CalcEqnMtrx: category=ARRAY, sw-calibration-access=READ-WRITE, type=rt_Array_Float_27  # Description_Tag_Not_Defined
    KaTSXR_r_EVM_Nc2CalcEqnMtrx
      parameter data prototype KaTSXR_r_EVM_Nc2CalcEqnMtrx: category=ARRAY, sw-calibration-access=READ-WRITE, type=rt_Array_Float_27  # Description_Tag_Not_Defined
    KaTSXR_r_EVM_NcCalcEqnMtrx
      parameter data prototype KaTSXR_r_EVM_NcCalcEqnMtrx: category=ARRAY, sw-calibration-access=READ-WRITE, type=rt_Array_Float_27  # Description_Tag_Not_Defined
    KaTSXR_r_EVM_NiCalcEqnMtrx
      parameter data prototype KaTSXR_r_EVM_NiCalcEqnMtrx: category=ARRAY, sw-calibration-access=READ-WRITE, type=rt_Array_Float_27  # Description_Tag_Not_Defined
    KaTSXR_r_EVM_NoEqn1Mtrx
      parameter data prototype KaTSXR_r_EVM_NoEqn1Mtrx: category=ARRAY, sw-calibration-access=READ-WRITE, type=rt_Array_Float_54  # Description_Tag_Not_Defined
    KaTSXR_r_EVM_NoEqn2Mtrx
      parameter data prototype KaTSXR_r_EVM_NoEqn2Mtrx: category=ARRAY, sw-calibration-access=READ-WRITE, type=rt_Array_Float_54  # Description_Tag_Not_Defined
    KaTSXR_r_EVM_NtiEqn1Mtrx
      parameter data prototype KaTSXR_r_EVM_NtiEqn1Mtrx: category=ARRAY, sw-calibration-access=READ-WRITE, type=rt_Array_Float_54  # Description_Tag_Not_Defined
    KaTSXR_r_EVM_NtiEqn2Mtrx
      parameter data prototype KaTSXR_r_EVM_NtiEqn2Mtrx: category=ARRAY, sw-calibration-access=READ-WRITE, type=rt_Array_Float_54  # Description_Tag_Not_Defined
    KaTSXR_r_EVM_TM1_DtrmnOptTms
      parameter data prototype KaTSXR_r_EVM_TM1_DtrmnOptTms: category=ARRAY, sw-calibration-access=READ-WRITE, type=rt_Array_Float_126  # Description_Tag_Not_Defined
    KaTSXR_r_EVM_TM1_TiConstrn
      parameter data prototype KaTSXR_r_EVM_TM1_TiConstrn: category=ARRAY, sw-calibration-access=READ-WRITE, type=rt_Array_Float_126  # Description_Tag_Not_Defined
    KaTSXR_r_EVM_TM1_ToConstrn
      parameter data prototype KaTSXR_r_EVM_TM1_ToConstrn: category=ARRAY, sw-calibration-access=READ-WRITE, type=rt_Array_Float_126  # Description_Tag_Not_Defined
    KaTSXR_r_EVM_TM2_DtrmnOptTms
      parameter data prototype KaTSXR_r_EVM_TM2_DtrmnOptTms: category=ARRAY, sw-calibration-access=READ-WRITE, type=rt_Array_Float_126  # Description_Tag_Not_Defined
    KaTSXR_r_EVM_TM2_TiConstrn
      parameter data prototype KaTSXR_r_EVM_TM2_TiConstrn: category=ARRAY, sw-calibration-access=READ-WRITE, type=rt_Array_Float_126  # Description_Tag_Not_Defined
    KaTSXR_r_EVM_TM2_ToConstrn
      parameter data prototype KaTSXR_r_EVM_TM2_ToConstrn: category=ARRAY, sw-calibration-access=READ-WRITE, type=rt_Array_Float_126  # Description_Tag_Not_Defined
    KaTSXR_r_EVM_TM3_DtrmnOptTms
      parameter data prototype KaTSXR_r_EVM_TM3_DtrmnOptTms: category=ARRAY, sw-calibration-access=READ-WRITE, type=rt_Array_Float_126  # Description_Tag_Not_Defined
    KaTSXR_r_EVM_TM3_TiConstrn
      parameter data prototype KaTSXR_r_EVM_TM3_TiConstrn: category=ARRAY, sw-calibration-access=READ-WRITE, type=rt_Array_Float_126  # Description_Tag_Not_Defined
    KaTSXR_r_EVM_TM3_ToConstrn
      parameter data prototype KaTSXR_r_EVM_TM3_ToConstrn: category=ARRAY, sw-calibration-access=READ-WRITE, type=rt_Array_Float_126  # Description_Tag_Not_Defined
    KaTSXR_r_EVM_TM4_DtrmnOptTms
      parameter data prototype KaTSXR_r_EVM_TM4_DtrmnOptTms: category=ARRAY, sw-calibration-access=READ-WRITE, type=rt_Array_Float_126  # Description_Tag_Not_Defined
    KaTSXR_r_EVM_ToFromTcrs
      parameter data prototype KaTSXR_r_EVM_ToFromTcrs: category=ARRAY, sw-calibration-access=READ-WRITE, type=rt_Array_Float_126  # Description_Tag_Not_Defined
    KaTSXR_r_EVN_CalcStrtgcTlfEqn
      parameter data prototype KaTSXR_r_EVN_CalcStrtgcTlfEqn: category=ARRAY, sw-calibration-access=READ-WRITE, type=rt_Array_Float_126  # Description_Tag_Not_Defined
    KaTSXR_r_EVN_CalcTc1Eqn
      parameter data prototype KaTSXR_r_EVN_CalcTc1Eqn: category=ARRAY, sw-calibration-access=READ-WRITE, type=rt_Array_Float_126  # Description_Tag_Not_Defined
    KaTSXR_r_EVN_CalcTc2Eqn
      parameter data prototype KaTSXR_r_EVN_CalcTc2Eqn: category=ARRAY, sw-calibration-access=READ-WRITE, type=rt_Array_Float_126  # Description_Tag_Not_Defined
    KaTSXR_r_EVN_CalcTc3Eqn
      parameter data prototype KaTSXR_r_EVN_CalcTc3Eqn: category=ARRAY, sw-calibration-access=READ-WRITE, type=rt_Array_Float_126  # Description_Tag_Not_Defined
    KaTSXR_r_EVN_CalcTc4Eqn
      parameter data prototype KaTSXR_r_EVN_CalcTc4Eqn: category=ARRAY, sw-calibration-access=READ-WRITE, type=rt_Array_Float_126  # Description_Tag_Not_Defined
    KaTSXR_r_EVN_CalcTofEqn
      parameter data prototype KaTSXR_r_EVN_CalcTofEqn: category=ARRAY, sw-calibration-access=READ-WRITE, type=rt_Array_Float_126  # Description_Tag_Not_Defined
    KaTSXR_r_EVN_CalcTorEqn
      parameter data prototype KaTSXR_r_EVN_CalcTorEqn: category=ARRAY, sw-calibration-access=READ-WRITE, type=rt_Array_Float_126  # Description_Tag_Not_Defined
    KaTSXR_r_EVN_NaCalcEqnMtrx
      parameter data prototype KaTSXR_r_EVN_NaCalcEqnMtrx: category=ARRAY, sw-calibration-access=READ-WRITE, type=rt_Array_Float_27  # Description_Tag_Not_Defined
    KaTSXR_r_EVN_NbCalcEqnMtrx
      parameter data prototype KaTSXR_r_EVN_NbCalcEqnMtrx: category=ARRAY, sw-calibration-access=READ-WRITE, type=rt_Array_Float_27  # Description_Tag_Not_Defined
    KaTSXR_r_EVN_Nc1CalcEqnMtrx
      parameter data prototype KaTSXR_r_EVN_Nc1CalcEqnMtrx: category=ARRAY, sw-calibration-access=READ-WRITE, type=rt_Array_Float_27  # Description_Tag_Not_Defined
    KaTSXR_r_EVN_Nc1Eqn1Mtrx
      parameter data prototype KaTSXR_r_EVN_Nc1Eqn1Mtrx: category=ARRAY, sw-calibration-access=READ-WRITE, type=rt_Array_Float_54  # Description_Tag_Not_Defined
    KaTSXR_r_EVN_Nc1Eqn2Mtrx
      parameter data prototype KaTSXR_r_EVN_Nc1Eqn2Mtrx: category=ARRAY, sw-calibration-access=READ-WRITE, type=rt_Array_Float_54  # Description_Tag_Not_Defined
    KaTSXR_r_EVN_Nc1TargetEqnMtrx
      parameter data prototype KaTSXR_r_EVN_Nc1TargetEqnMtrx: category=ARRAY, sw-calibration-access=READ-WRITE, type=rt_Array_Float_27  # Description_Tag_Not_Defined
    KaTSXR_r_EVN_Nc2CalcEqnMtrx
      parameter data prototype KaTSXR_r_EVN_Nc2CalcEqnMtrx: category=ARRAY, sw-calibration-access=READ-WRITE, type=rt_Array_Float_27  # Description_Tag_Not_Defined
    KaTSXR_r_EVN_NcCalcEqnMtrx
      parameter data prototype KaTSXR_r_EVN_NcCalcEqnMtrx: category=ARRAY, sw-calibration-access=READ-WRITE, type=rt_Array_Float_27  # Description_Tag_Not_Defined
    KaTSXR_r_EVN_NoEqn1Mtrx
      parameter data prototype KaTSXR_r_EVN_NoEqn1Mtrx: category=ARRAY, sw-calibration-access=READ-WRITE, type=rt_Array_Float_54  # Description_Tag_Not_Defined
    KaTSXR_r_EVN_NoEqn2Mtrx
      parameter data prototype KaTSXR_r_EVN_NoEqn2Mtrx: category=ARRAY, sw-calibration-access=READ-WRITE, type=rt_Array_Float_54  # Description_Tag_Not_Defined
    KaTSXR_r_EVN_NtiEqn1Mtrx
      parameter data prototype KaTSXR_r_EVN_NtiEqn1Mtrx: category=ARRAY, sw-calibration-access=READ-WRITE, type=rt_Array_Float_54  # Description_Tag_Not_Defined
    KaTSXR_r_EVN_NtiEqn2Mtrx
      parameter data prototype KaTSXR_r_EVN_NtiEqn2Mtrx: category=ARRAY, sw-calibration-access=READ-WRITE, type=rt_Array_Float_54  # Description_Tag_Not_Defined
    KaTSXR_r_EVN_TM1_DtrmnOptTms
      parameter data prototype KaTSXR_r_EVN_TM1_DtrmnOptTms: category=ARRAY, sw-calibration-access=READ-WRITE, type=rt_Array_Float_126  # Description_Tag_Not_Defined
    KaTSXR_r_EVN_TM1_TiConstrn
      parameter data prototype KaTSXR_r_EVN_TM1_TiConstrn: category=ARRAY, sw-calibration-access=READ-WRITE, type=rt_Array_Float_126  # Description_Tag_Not_Defined
    KaTSXR_r_EVN_TM1_ToConstrn
      parameter data prototype KaTSXR_r_EVN_TM1_ToConstrn: category=ARRAY, sw-calibration-access=READ-WRITE, type=rt_Array_Float_126  # Description_Tag_Not_Defined
    KaTSXR_r_EVN_TM2_DtrmnOptTms
      parameter data prototype KaTSXR_r_EVN_TM2_DtrmnOptTms: category=ARRAY, sw-calibration-access=READ-WRITE, type=rt_Array_Float_126  # Description_Tag_Not_Defined
    KaTSXR_r_EVN_TM2_ToConstrn
      parameter data prototype KaTSXR_r_EVN_TM2_ToConstrn: category=ARRAY, sw-calibration-access=READ-WRITE, type=rt_Array_Float_126  # Description_Tag_Not_Defined
    KaTSXR_r_EVN_TM3_DtrmnOptTms
      parameter data prototype KaTSXR_r_EVN_TM3_DtrmnOptTms: category=ARRAY, sw-calibration-access=READ-WRITE, type=rt_Array_Float_126  # Description_Tag_Not_Defined
    KaTSXR_r_EVN_TM3_ToConstrn
      parameter data prototype KaTSXR_r_EVN_TM3_ToConstrn: category=ARRAY, sw-calibration-access=READ-WRITE, type=rt_Array_Float_126  # Description_Tag_Not_Defined
    KaTSXR_r_EVN_TM4_DtrmnOptTms
      parameter data prototype KaTSXR_r_EVN_TM4_DtrmnOptTms: category=ARRAY, sw-calibration-access=READ-WRITE, type=rt_Array_Float_126  # Description_Tag_Not_Defined
    KaTSXR_r_EVN_ToFromTcrs
      parameter data prototype KaTSXR_r_EVN_ToFromTcrs: category=ARRAY, sw-calibration-access=READ-WRITE, type=rt_Array_Float_126  # Description_Tag_Not_Defined
    KaTSXR_r_GA_CalcStrtgcTlfEqn
      parameter data prototype KaTSXR_r_GA_CalcStrtgcTlfEqn: category=ARRAY, sw-calibration-access=READ-WRITE, type=rt_Array_Float_126  # Description_Tag_Not_Defined
    KaTSXR_r_GA_CalcTc1Eqn
      parameter data prototype KaTSXR_r_GA_CalcTc1Eqn: category=ARRAY, sw-calibration-access=READ-WRITE, type=rt_Array_Float_126  # Description_Tag_Not_Defined
    KaTSXR_r_GA_CalcTc2Eqn
      parameter data prototype KaTSXR_r_GA_CalcTc2Eqn: category=ARRAY, sw-calibration-access=READ-WRITE, type=rt_Array_Float_126  # Description_Tag_Not_Defined
    KaTSXR_r_GA_CalcTc3Eqn
      parameter data prototype KaTSXR_r_GA_CalcTc3Eqn: category=ARRAY, sw-calibration-access=READ-WRITE, type=rt_Array_Float_126  # Description_Tag_Not_Defined
    KaTSXR_r_GA_CalcTc4Eqn
      parameter data prototype KaTSXR_r_GA_CalcTc4Eqn: category=ARRAY, sw-calibration-access=READ-WRITE, type=rt_Array_Float_126  # Description_Tag_Not_Defined
    KaTSXR_r_GA_CalcTofEqn
      parameter data prototype KaTSXR_r_GA_CalcTofEqn: category=ARRAY, sw-calibration-access=READ-WRITE, type=rt_Array_Float_126  # Description_Tag_Not_Defined
    KaTSXR_r_GA_CalcTorEqn
      parameter data prototype KaTSXR_r_GA_CalcTorEqn: category=ARRAY, sw-calibration-access=READ-WRITE, type=rt_Array_Float_126  # Description_Tag_Not_Defined
    KaTSXR_r_GA_NaCalcEqnMtrx
      parameter data prototype KaTSXR_r_GA_NaCalcEqnMtrx: category=ARRAY, sw-calibration-access=READ-WRITE, type=rt_Array_Float_27  # Description_Tag_Not_Defined
    KaTSXR_r_GA_NbCalcEqnMtrx
      parameter data prototype KaTSXR_r_GA_NbCalcEqnMtrx: category=ARRAY, sw-calibration-access=READ-WRITE, type=rt_Array_Float_27  # Description_Tag_Not_Defined
    KaTSXR_r_GA_Nc1CalcEqnMtrx
      parameter data prototype KaTSXR_r_GA_Nc1CalcEqnMtrx: category=ARRAY, sw-calibration-access=READ-WRITE, type=rt_Array_Float_27  # Description_Tag_Not_Defined
    KaTSXR_r_GA_Nc2CalcEqnMtrx
      parameter data prototype KaTSXR_r_GA_Nc2CalcEqnMtrx: category=ARRAY, sw-calibration-access=READ-WRITE, type=rt_Array_Float_27  # Description_Tag_Not_Defined
    KaTSXR_r_GA_NcCalcEqnMtrx
      parameter data prototype KaTSXR_r_GA_NcCalcEqnMtrx: category=ARRAY, sw-calibration-access=READ-WRITE, type=rt_Array_Float_27  # Description_Tag_Not_Defined
    KaTSXR_r_GA_NiCalcEqnMtrx
      parameter data prototype KaTSXR_r_GA_NiCalcEqnMtrx: category=ARRAY, sw-calibration-access=READ-WRITE, type=rt_Array_Float_27  # Description_Tag_Not_Defined
    KaTSXR_r_GA_NoEqn1Mtrx
      parameter data prototype KaTSXR_r_GA_NoEqn1Mtrx: category=ARRAY, sw-calibration-access=READ-WRITE, type=rt_Array_Float_54  # Description_Tag_Not_Defined
    KaTSXR_r_GA_NoEqn2Mtrx
      parameter data prototype KaTSXR_r_GA_NoEqn2Mtrx: category=ARRAY, sw-calibration-access=READ-WRITE, type=rt_Array_Float_54  # Description_Tag_Not_Defined
    KaTSXR_r_GA_NtiEqn1Mtrx
      parameter data prototype KaTSXR_r_GA_NtiEqn1Mtrx: category=ARRAY, sw-calibration-access=READ-WRITE, type=rt_Array_Float_54  # Description_Tag_Not_Defined
    KaTSXR_r_GA_NtiEqn2Mtrx
      parameter data prototype KaTSXR_r_GA_NtiEqn2Mtrx: category=ARRAY, sw-calibration-access=READ-WRITE, type=rt_Array_Float_54  # Description_Tag_Not_Defined
    KaTSXR_r_GA_TM1_DtrmnOptTms
      parameter data prototype KaTSXR_r_GA_TM1_DtrmnOptTms: category=ARRAY, sw-calibration-access=READ-WRITE, type=rt_Array_Float_126  # Description_Tag_Not_Defined
    KaTSXR_r_GA_TM1_TiConstrn
      parameter data prototype KaTSXR_r_GA_TM1_TiConstrn: category=ARRAY, sw-calibration-access=READ-WRITE, type=rt_Array_Float_126  # Description_Tag_Not_Defined
    KaTSXR_r_GA_TM1_ToConstrn
      parameter data prototype KaTSXR_r_GA_TM1_ToConstrn: category=ARRAY, sw-calibration-access=READ-WRITE, type=rt_Array_Float_126  # Description_Tag_Not_Defined
    KaTSXR_r_GA_TM2_DtrmnOptTms
      parameter data prototype KaTSXR_r_GA_TM2_DtrmnOptTms: category=ARRAY, sw-calibration-access=READ-WRITE, type=rt_Array_Float_126  # Description_Tag_Not_Defined
    KaTSXR_r_GA_TM2_TiConstrn
      parameter data prototype KaTSXR_r_GA_TM2_TiConstrn: category=ARRAY, sw-calibration-access=READ-WRITE, type=rt_Array_Float_126  # Description_Tag_Not_Defined
    KaTSXR_r_GA_TM2_ToConstrn
      parameter data prototype KaTSXR_r_GA_TM2_ToConstrn: category=ARRAY, sw-calibration-access=READ-WRITE, type=rt_Array_Float_126  # Description_Tag_Not_Defined
    KaTSXR_r_GA_TM3_DtrmnOptTms
      parameter data prototype KaTSXR_r_GA_TM3_DtrmnOptTms: category=ARRAY, sw-calibration-access=READ-WRITE, type=rt_Array_Float_126  # Description_Tag_Not_Defined
    KaTSXR_r_GA_TM3_TiConstrn
      parameter data prototype KaTSXR_r_GA_TM3_TiConstrn: category=ARRAY, sw-calibration-access=READ-WRITE, type=rt_Array_Float_126  # Description_Tag_Not_Defined
    KaTSXR_r_GA_TM3_ToConstrn
      parameter data prototype KaTSXR_r_GA_TM3_ToConstrn: category=ARRAY, sw-calibration-access=READ-WRITE, type=rt_Array_Float_126  # Description_Tag_Not_Defined
    KaTSXR_r_GA_TM4_DtrmnOptTms
      parameter data prototype KaTSXR_r_GA_TM4_DtrmnOptTms: category=ARRAY, sw-calibration-access=READ-WRITE, type=rt_Array_Float_126  # Description_Tag_Not_Defined
    KaTSXR_r_GA_ToFromTcrs
      parameter data prototype KaTSXR_r_GA_ToFromTcrs: category=ARRAY, sw-calibration-access=READ-WRITE, type=rt_Array_Float_126  # Description_Tag_Not_Defined
    KaTSXR_r_G_CalcStrtgcTlfEqn
      parameter data prototype KaTSXR_r_G_CalcStrtgcTlfEqn: category=ARRAY, sw-calibration-access=READ-WRITE, type=rt_Array_Float_126  # Description_Tag_Not_Defined
    KaTSXR_r_G_CalcTc1Eqn
      parameter data prototype KaTSXR_r_G_CalcTc1Eqn: category=ARRAY, sw-calibration-access=READ-WRITE, type=rt_Array_Float_126  # Description_Tag_Not_Defined
    KaTSXR_r_G_CalcTc2Eqn
      parameter data prototype KaTSXR_r_G_CalcTc2Eqn: category=ARRAY, sw-calibration-access=READ-WRITE, type=rt_Array_Float_126  # Description_Tag_Not_Defined
    KaTSXR_r_G_CalcTc3Eqn
      parameter data prototype KaTSXR_r_G_CalcTc3Eqn: category=ARRAY, sw-calibration-access=READ-WRITE, type=rt_Array_Float_126  # Description_Tag_Not_Defined
    KaTSXR_r_G_CalcTc4Eqn
      parameter data prototype KaTSXR_r_G_CalcTc4Eqn: category=ARRAY, sw-calibration-access=READ-WRITE, type=rt_Array_Float_126  # Description_Tag_Not_Defined
    KaTSXR_r_G_CalcTofEqn
      parameter data prototype KaTSXR_r_G_CalcTofEqn: category=ARRAY, sw-calibration-access=READ-WRITE, type=rt_Array_Float_126  # Description_Tag_Not_Defined
    KaTSXR_r_G_CalcTorEqn
      parameter data prototype KaTSXR_r_G_CalcTorEqn: category=ARRAY, sw-calibration-access=READ-WRITE, type=rt_Array_Float_126  # Description_Tag_Not_Defined
    KaTSXR_r_G_NaCalcEqnMtrx
      parameter data prototype KaTSXR_r_G_NaCalcEqnMtrx: category=ARRAY, sw-calibration-access=READ-WRITE, type=rt_Array_Float_27  # Description_Tag_Not_Defined
    KaTSXR_r_G_NbCalcEqnMtrx
      parameter data prototype KaTSXR_r_G_NbCalcEqnMtrx: category=ARRAY, sw-calibration-access=READ-WRITE, type=rt_Array_Float_27  # Description_Tag_Not_Defined
    KaTSXR_r_G_Nc1CalcEqnMtrx
      parameter data prototype KaTSXR_r_G_Nc1CalcEqnMtrx: category=ARRAY, sw-calibration-access=READ-WRITE, type=rt_Array_Float_27  # Description_Tag_Not_Defined
    KaTSXR_r_G_Nc2CalcEqnMtrx
      parameter data prototype KaTSXR_r_G_Nc2CalcEqnMtrx: category=ARRAY, sw-calibration-access=READ-WRITE, type=rt_Array_Float_27  # Description_Tag_Not_Defined
    KaTSXR_r_G_NcCalcEqnMtrx
      parameter data prototype KaTSXR_r_G_NcCalcEqnMtrx: category=ARRAY, sw-calibration-access=READ-WRITE, type=rt_Array_Float_27  # Description_Tag_Not_Defined
    KaTSXR_r_G_NiCalcEqnMtrx
      parameter data prototype KaTSXR_r_G_NiCalcEqnMtrx: category=ARRAY, sw-calibration-access=READ-WRITE, type=rt_Array_Float_27  # Description_Tag_Not_Defined
    KaTSXR_r_G_NiEqn1Mtrx
      parameter data prototype KaTSXR_r_G_NiEqn1Mtrx: category=ARRAY, sw-calibration-access=READ-WRITE, type=rt_Array_Float_54  # Description_Tag_Not_Defined
    KaTSXR_r_G_NiEqn2Mtrx
      parameter data prototype KaTSXR_r_G_NiEqn2Mtrx: category=ARRAY, sw-calibration-access=READ-WRITE, type=rt_Array_Float_54  # Description_Tag_Not_Defined
    KaTSXR_r_G_NoEqn1Mtrx
      parameter data prototype KaTSXR_r_G_NoEqn1Mtrx: category=ARRAY, sw-calibration-access=READ-WRITE, type=rt_Array_Float_54  # Description_Tag_Not_Defined
    KaTSXR_r_G_NoEqn2Mtrx
      parameter data prototype KaTSXR_r_G_NoEqn2Mtrx: category=ARRAY, sw-calibration-access=READ-WRITE, type=rt_Array_Float_54  # Description_Tag_Not_Defined
    KaTSXR_r_G_NtiEqn1Mtrx
      parameter data prototype KaTSXR_r_G_NtiEqn1Mtrx: category=ARRAY, sw-calibration-access=READ-WRITE, type=rt_Array_Float_54  # Description_Tag_Not_Defined
    KaTSXR_r_G_NtiEqn2Mtrx
      parameter data prototype KaTSXR_r_G_NtiEqn2Mtrx: category=ARRAY, sw-calibration-access=READ-WRITE, type=rt_Array_Float_54  # Description_Tag_Not_Defined
    KaTSXR_r_G_TM1_DtrmnOptTms
      parameter data prototype KaTSXR_r_G_TM1_DtrmnOptTms: category=ARRAY, sw-calibration-access=READ-WRITE, type=rt_Array_Float_126  # Description_Tag_Not_Defined
    KaTSXR_r_G_TM1_TiConstrn
      parameter data prototype KaTSXR_r_G_TM1_TiConstrn: category=ARRAY, sw-calibration-access=READ-WRITE, type=rt_Array_Float_126  # Description_Tag_Not_Defined
    KaTSXR_r_G_TM1_ToConstrn
      parameter data prototype KaTSXR_r_G_TM1_ToConstrn: category=ARRAY, sw-calibration-access=READ-WRITE, type=rt_Array_Float_126  # Description_Tag_Not_Defined
    KaTSXR_r_G_TM2_DtrmnOptTms
      parameter data prototype KaTSXR_r_G_TM2_DtrmnOptTms: category=ARRAY, sw-calibration-access=READ-WRITE, type=rt_Array_Float_126  # Description_Tag_Not_Defined
    KaTSXR_r_G_TM2_TiConstrn
      parameter data prototype KaTSXR_r_G_TM2_TiConstrn: category=ARRAY, sw-calibration-access=READ-WRITE, type=rt_Array_Float_126  # Description_Tag_Not_Defined
    KaTSXR_r_G_TM2_ToConstrn
      parameter data prototype KaTSXR_r_G_TM2_ToConstrn: category=ARRAY, sw-calibration-access=READ-WRITE, type=rt_Array_Float_126  # Description_Tag_Not_Defined
    KaTSXR_r_G_TM3_DtrmnOptTms
      parameter data prototype KaTSXR_r_G_TM3_DtrmnOptTms: category=ARRAY, sw-calibration-access=READ-WRITE, type=rt_Array_Float_126  # Description_Tag_Not_Defined
    KaTSXR_r_G_TM3_TiConstrn
      parameter data prototype KaTSXR_r_G_TM3_TiConstrn: category=ARRAY, sw-calibration-access=READ-WRITE, type=rt_Array_Float_126  # Description_Tag_Not_Defined
    KaTSXR_r_G_TM3_ToConstrn
      parameter data prototype KaTSXR_r_G_TM3_ToConstrn: category=ARRAY, sw-calibration-access=READ-WRITE, type=rt_Array_Float_126  # Description_Tag_Not_Defined
    KaTSXR_r_G_TM4_DtrmnOptTms
      parameter data prototype KaTSXR_r_G_TM4_DtrmnOptTms: category=ARRAY, sw-calibration-access=READ-WRITE, type=rt_Array_Float_126  # Description_Tag_Not_Defined
    KaTSXR_r_G_ToFromTcrs
      parameter data prototype KaTSXR_r_G_ToFromTcrs: category=ARRAY, sw-calibration-access=READ-WRITE, type=rt_Array_Float_126  # Description_Tag_Not_Defined
    KaTSXR_r_MA_CalcStrtgcTlfEqn
      parameter data prototype KaTSXR_r_MA_CalcStrtgcTlfEqn: category=ARRAY, sw-calibration-access=READ-WRITE, type=rt_Array_Float_126  # Description_Tag_Not_Defined
    KaTSXR_r_MA_CalcTc1Eqn
      parameter data prototype KaTSXR_r_MA_CalcTc1Eqn: category=ARRAY, sw-calibration-access=READ-WRITE, type=rt_Array_Float_126  # Description_Tag_Not_Defined
    KaTSXR_r_MA_CalcTc2Eqn
      parameter data prototype KaTSXR_r_MA_CalcTc2Eqn: category=ARRAY, sw-calibration-access=READ-WRITE, type=rt_Array_Float_126  # Description_Tag_Not_Defined
    KaTSXR_r_MA_CalcTc3Eqn
      parameter data prototype KaTSXR_r_MA_CalcTc3Eqn: category=ARRAY, sw-calibration-access=READ-WRITE, type=rt_Array_Float_126  # Description_Tag_Not_Defined
    KaTSXR_r_MA_CalcTc4Eqn
      parameter data prototype KaTSXR_r_MA_CalcTc4Eqn: category=ARRAY, sw-calibration-access=READ-WRITE, type=rt_Array_Float_126  # Description_Tag_Not_Defined
    KaTSXR_r_MA_CalcTofEqn
      parameter data prototype KaTSXR_r_MA_CalcTofEqn: category=ARRAY, sw-calibration-access=READ-WRITE, type=rt_Array_Float_126  # Description_Tag_Not_Defined
    KaTSXR_r_MA_CalcTorEqn
      parameter data prototype KaTSXR_r_MA_CalcTorEqn: category=ARRAY, sw-calibration-access=READ-WRITE, type=rt_Array_Float_126  # Description_Tag_Not_Defined
    KaTSXR_r_MA_NaCalcEqnMtrx
      parameter data prototype KaTSXR_r_MA_NaCalcEqnMtrx: category=ARRAY, sw-calibration-access=READ-WRITE, type=rt_Array_Float_27  # Description_Tag_Not_Defined
    KaTSXR_r_MA_NbCalcEqnMtrx
      parameter data prototype KaTSXR_r_MA_NbCalcEqnMtrx: category=ARRAY, sw-calibration-access=READ-WRITE, type=rt_Array_Float_27  # Description_Tag_Not_Defined
    KaTSXR_r_MA_Nc1CalcEqnMtrx
      parameter data prototype KaTSXR_r_MA_Nc1CalcEqnMtrx: category=ARRAY, sw-calibration-access=READ-WRITE, type=rt_Array_Float_27  # Description_Tag_Not_Defined
    KaTSXR_r_MA_Nc2CalcEqnMtrx
      parameter data prototype KaTSXR_r_MA_Nc2CalcEqnMtrx: category=ARRAY, sw-calibration-access=READ-WRITE, type=rt_Array_Float_27  # Description_Tag_Not_Defined
    KaTSXR_r_MA_NcCalcEqnMtrx
      parameter data prototype KaTSXR_r_MA_NcCalcEqnMtrx: category=ARRAY, sw-calibration-access=READ-WRITE, type=rt_Array_Float_27  # Description_Tag_Not_Defined
    KaTSXR_r_MA_NiCalcEqnMtrx
      parameter data prototype KaTSXR_r_MA_NiCalcEqnMtrx: category=ARRAY, sw-calibration-access=READ-WRITE, type=rt_Array_Float_27  # Description_Tag_Not_Defined
    KaTSXR_r_MA_NiEqn1Mtrx
      parameter data prototype KaTSXR_r_MA_NiEqn1Mtrx: category=ARRAY, sw-calibration-access=READ-WRITE, type=rt_Array_Float_54  # Description_Tag_Not_Defined
    KaTSXR_r_MA_NiEqn2Mtrx
      parameter data prototype KaTSXR_r_MA_NiEqn2Mtrx: category=ARRAY, sw-calibration-access=READ-WRITE, type=rt_Array_Float_54  # Description_Tag_Not_Defined
    KaTSXR_r_MA_NoEqn1Mtrx
      parameter data prototype KaTSXR_r_MA_NoEqn1Mtrx: category=ARRAY, sw-calibration-access=READ-WRITE, type=rt_Array_Float_54  # Description_Tag_Not_Defined
    KaTSXR_r_MA_NoEqn2Mtrx
      parameter data prototype KaTSXR_r_MA_NoEqn2Mtrx: category=ARRAY, sw-calibration-access=READ-WRITE, type=rt_Array_Float_54  # Description_Tag_Not_Defined
    KaTSXR_r_MA_NtiEqn1Mtrx
      parameter data prototype KaTSXR_r_MA_NtiEqn1Mtrx: category=ARRAY, sw-calibration-access=READ-WRITE, type=rt_Array_Float_54  # Description_Tag_Not_Defined
    KaTSXR_r_MA_NtiEqn2Mtrx
      parameter data prototype KaTSXR_r_MA_NtiEqn2Mtrx: category=ARRAY, sw-calibration-access=READ-WRITE, type=rt_Array_Float_54  # Description_Tag_Not_Defined
    KaTSXR_r_MA_TM1_DtrmnOptTms
      parameter data prototype KaTSXR_r_MA_TM1_DtrmnOptTms: category=ARRAY, sw-calibration-access=READ-WRITE, type=rt_Array_Float_126  # Description_Tag_Not_Defined
    KaTSXR_r_MA_TM1_TiConstrn
      parameter data prototype KaTSXR_r_MA_TM1_TiConstrn: category=ARRAY, sw-calibration-access=READ-WRITE, type=rt_Array_Float_126  # Description_Tag_Not_Defined
    KaTSXR_r_MA_TM1_ToConstrn
      parameter data prototype KaTSXR_r_MA_TM1_ToConstrn: category=ARRAY, sw-calibration-access=READ-WRITE, type=rt_Array_Float_126  # Description_Tag_Not_Defined
    KaTSXR_r_MA_TM2_DtrmnOptTms
      parameter data prototype KaTSXR_r_MA_TM2_DtrmnOptTms: category=ARRAY, sw-calibration-access=READ-WRITE, type=rt_Array_Float_126  # Description_Tag_Not_Defined
    KaTSXR_r_MA_TM2_TiConstrn
      parameter data prototype KaTSXR_r_MA_TM2_TiConstrn: category=ARRAY, sw-calibration-access=READ-WRITE, type=rt_Array_Float_126  # Description_Tag_Not_Defined
    KaTSXR_r_MA_TM2_ToConstrn
      parameter data prototype KaTSXR_r_MA_TM2_ToConstrn: category=ARRAY, sw-calibration-access=READ-WRITE, type=rt_Array_Float_126  # Description_Tag_Not_Defined
    KaTSXR_r_MA_TM3_DtrmnOptTms
      parameter data prototype KaTSXR_r_MA_TM3_DtrmnOptTms: category=ARRAY, sw-calibration-access=READ-WRITE, type=rt_Array_Float_126  # Description_Tag_Not_Defined
    KaTSXR_r_MA_TM3_TiConstrn
      parameter data prototype KaTSXR_r_MA_TM3_TiConstrn: category=ARRAY, sw-calibration-access=READ-WRITE, type=rt_Array_Float_126  # Description_Tag_Not_Defined
    KaTSXR_r_MA_TM3_ToConstrn
      parameter data prototype KaTSXR_r_MA_TM3_ToConstrn: category=ARRAY, sw-calibration-access=READ-WRITE, type=rt_Array_Float_126  # Description_Tag_Not_Defined
    KaTSXR_r_MA_TM4_DtrmnOptTms
      parameter data prototype KaTSXR_r_MA_TM4_DtrmnOptTms: category=ARRAY, sw-calibration-access=READ-WRITE, type=rt_Array_Float_126  # Description_Tag_Not_Defined
    KaTSXR_r_MA_ToFromTcrs
      parameter data prototype KaTSXR_r_MA_ToFromTcrs: category=ARRAY, sw-calibration-access=READ-WRITE, type=rt_Array_Float_126  # Description_Tag_Not_Defined
    KaTSXR_r_MB_CalcStrtgcTlfEqn
      parameter data prototype KaTSXR_r_MB_CalcStrtgcTlfEqn: category=ARRAY, sw-calibration-access=READ-WRITE, type=rt_Array_Float_126  # Description_Tag_Not_Defined
    KaTSXR_r_MB_CalcTc1Eqn
      parameter data prototype KaTSXR_r_MB_CalcTc1Eqn: category=ARRAY, sw-calibration-access=READ-WRITE, type=rt_Array_Float_126  # Description_Tag_Not_Defined
    KaTSXR_r_MB_CalcTc2Eqn
      parameter data prototype KaTSXR_r_MB_CalcTc2Eqn: category=ARRAY, sw-calibration-access=READ-WRITE, type=rt_Array_Float_126  # Description_Tag_Not_Defined
    KaTSXR_r_MB_CalcTc3Eqn
      parameter data prototype KaTSXR_r_MB_CalcTc3Eqn: category=ARRAY, sw-calibration-access=READ-WRITE, type=rt_Array_Float_126  # Description_Tag_Not_Defined
    KaTSXR_r_MB_CalcTc4Eqn
      parameter data prototype KaTSXR_r_MB_CalcTc4Eqn: category=ARRAY, sw-calibration-access=READ-WRITE, type=rt_Array_Float_126  # Description_Tag_Not_Defined
    KaTSXR_r_MB_CalcTofEqn
      parameter data prototype KaTSXR_r_MB_CalcTofEqn: category=ARRAY, sw-calibration-access=READ-WRITE, type=rt_Array_Float_126  # Description_Tag_Not_Defined
    KaTSXR_r_MB_CalcTorEqn
      parameter data prototype KaTSXR_r_MB_CalcTorEqn: category=ARRAY, sw-calibration-access=READ-WRITE, type=rt_Array_Float_126  # Description_Tag_Not_Defined
    KaTSXR_r_MB_NaCalcEqnMtrx
      parameter data prototype KaTSXR_r_MB_NaCalcEqnMtrx: category=ARRAY, sw-calibration-access=READ-WRITE, type=rt_Array_Float_27  # Description_Tag_Not_Defined
    KaTSXR_r_MB_NbCalcEqnMtrx
      parameter data prototype KaTSXR_r_MB_NbCalcEqnMtrx: category=ARRAY, sw-calibration-access=READ-WRITE, type=rt_Array_Float_27  # Description_Tag_Not_Defined
    KaTSXR_r_MB_Nc1CalcEqnMtrx
      parameter data prototype KaTSXR_r_MB_Nc1CalcEqnMtrx: category=ARRAY, sw-calibration-access=READ-WRITE, type=rt_Array_Float_27  # Description_Tag_Not_Defined
    KaTSXR_r_MB_Nc2CalcEqnMtrx
      parameter data prototype KaTSXR_r_MB_Nc2CalcEqnMtrx: category=ARRAY, sw-calibration-access=READ-WRITE, type=rt_Array_Float_27  # Description_Tag_Not_Defined
    KaTSXR_r_MB_NcCalcEqnMtrx
      parameter data prototype KaTSXR_r_MB_NcCalcEqnMtrx: category=ARRAY, sw-calibration-access=READ-WRITE, type=rt_Array_Float_27  # Description_Tag_Not_Defined
    KaTSXR_r_MB_NiCalcEqnMtrx
      parameter data prototype KaTSXR_r_MB_NiCalcEqnMtrx: category=ARRAY, sw-calibration-access=READ-WRITE, type=rt_Array_Float_27  # Description_Tag_Not_Defined
    KaTSXR_r_MB_NiEqn1Mtrx
      parameter data prototype KaTSXR_r_MB_NiEqn1Mtrx: category=ARRAY, sw-calibration-access=READ-WRITE, type=rt_Array_Float_54  # Description_Tag_Not_Defined
    KaTSXR_r_MB_NiEqn2Mtrx
      parameter data prototype KaTSXR_r_MB_NiEqn2Mtrx: category=ARRAY, sw-calibration-access=READ-WRITE, type=rt_Array_Float_54  # Description_Tag_Not_Defined
    KaTSXR_r_MB_NoEqn1Mtrx
      parameter data prototype KaTSXR_r_MB_NoEqn1Mtrx: category=ARRAY, sw-calibration-access=READ-WRITE, type=rt_Array_Float_54  # Description_Tag_Not_Defined
    KaTSXR_r_MB_NoEqn2Mtrx
      parameter data prototype KaTSXR_r_MB_NoEqn2Mtrx: category=ARRAY, sw-calibration-access=READ-WRITE, type=rt_Array_Float_54  # Description_Tag_Not_Defined
    KaTSXR_r_MB_NtiEqn1Mtrx
      parameter data prototype KaTSXR_r_MB_NtiEqn1Mtrx: category=ARRAY, sw-calibration-access=READ-WRITE, type=rt_Array_Float_54  # Description_Tag_Not_Defined
    KaTSXR_r_MB_NtiEqn2Mtrx
      parameter data prototype KaTSXR_r_MB_NtiEqn2Mtrx: category=ARRAY, sw-calibration-access=READ-WRITE, type=rt_Array_Float_54  # Description_Tag_Not_Defined
    KaTSXR_r_MB_TM1_DtrmnOptTms
      parameter data prototype KaTSXR_r_MB_TM1_DtrmnOptTms: category=ARRAY, sw-calibration-access=READ-WRITE, type=rt_Array_Float_126  # Description_Tag_Not_Defined
    KaTSXR_r_MB_TM1_TiConstrn
      parameter data prototype KaTSXR_r_MB_TM1_TiConstrn: category=ARRAY, sw-calibration-access=READ-WRITE, type=rt_Array_Float_126  # Description_Tag_Not_Defined
    KaTSXR_r_MB_TM1_ToConstrn
      parameter data prototype KaTSXR_r_MB_TM1_ToConstrn: category=ARRAY, sw-calibration-access=READ-WRITE, type=rt_Array_Float_126  # Description_Tag_Not_Defined
    KaTSXR_r_MB_TM2_DtrmnOptTms
      parameter data prototype KaTSXR_r_MB_TM2_DtrmnOptTms: category=ARRAY, sw-calibration-access=READ-WRITE, type=rt_Array_Float_126  # Description_Tag_Not_Defined
    KaTSXR_r_MB_TM2_TiConstrn
      parameter data prototype KaTSXR_r_MB_TM2_TiConstrn: category=ARRAY, sw-calibration-access=READ-WRITE, type=rt_Array_Float_126  # Description_Tag_Not_Defined
    KaTSXR_r_MB_TM2_ToConstrn
      parameter data prototype KaTSXR_r_MB_TM2_ToConstrn: category=ARRAY, sw-calibration-access=READ-WRITE, type=rt_Array_Float_126  # Description_Tag_Not_Defined
    KaTSXR_r_MB_TM3_DtrmnOptTms
      parameter data prototype KaTSXR_r_MB_TM3_DtrmnOptTms: category=ARRAY, sw-calibration-access=READ-WRITE, type=rt_Array_Float_126  # Description_Tag_Not_Defined
    KaTSXR_r_MB_TM3_TiConstrn
      parameter data prototype KaTSXR_r_MB_TM3_TiConstrn: category=ARRAY, sw-calibration-access=READ-WRITE, type=rt_Array_Float_126  # Description_Tag_Not_Defined
    KaTSXR_r_MB_TM3_ToConstrn
      parameter data prototype KaTSXR_r_MB_TM3_ToConstrn: category=ARRAY, sw-calibration-access=READ-WRITE, type=rt_Array_Float_126  # Description_Tag_Not_Defined
    KaTSXR_r_MB_TM4_DtrmnOptTms
      parameter data prototype KaTSXR_r_MB_TM4_DtrmnOptTms: category=ARRAY, sw-calibration-access=READ-WRITE, type=rt_Array_Float_126  # Description_Tag_Not_Defined
    KaTSXR_r_MB_ToFromTcrs
      parameter data prototype KaTSXR_r_MB_ToFromTcrs: category=ARRAY, sw-calibration-access=READ-WRITE, type=rt_Array_Float_126  # Description_Tag_Not_Defined
    KaTSXR_r_N_CalcStrtgcTlfEqn
      parameter data prototype KaTSXR_r_N_CalcStrtgcTlfEqn: category=ARRAY, sw-calibration-access=READ-WRITE, type=rt_Array_Float_126  # Description_Tag_Not_Defined
    KaTSXR_r_N_CalcTc1Eqn
      parameter data prototype KaTSXR_r_N_CalcTc1Eqn: category=ARRAY, sw-calibration-access=READ-WRITE, type=rt_Array_Float_126  # Description_Tag_Not_Defined
    KaTSXR_r_N_CalcTc2Eqn
      parameter data prototype KaTSXR_r_N_CalcTc2Eqn: category=ARRAY, sw-calibration-access=READ-WRITE, type=rt_Array_Float_126  # Description_Tag_Not_Defined
    KaTSXR_r_N_CalcTc3Eqn
      parameter data prototype KaTSXR_r_N_CalcTc3Eqn: category=ARRAY, sw-calibration-access=READ-WRITE, type=rt_Array_Float_126  # Description_Tag_Not_Defined
    KaTSXR_r_N_CalcTc4Eqn
      parameter data prototype KaTSXR_r_N_CalcTc4Eqn: category=ARRAY, sw-calibration-access=READ-WRITE, type=rt_Array_Float_126  # Description_Tag_Not_Defined
    KaTSXR_r_N_CalcTofEqn
      parameter data prototype KaTSXR_r_N_CalcTofEqn: category=ARRAY, sw-calibration-access=READ-WRITE, type=rt_Array_Float_126  # Description_Tag_Not_Defined
    KaTSXR_r_N_CalcTorEqn
      parameter data prototype KaTSXR_r_N_CalcTorEqn: category=ARRAY, sw-calibration-access=READ-WRITE, type=rt_Array_Float_126  # Description_Tag_Not_Defined
    KaTSXR_r_N_NaCalcEqnMtrx
      parameter data prototype KaTSXR_r_N_NaCalcEqnMtrx: category=ARRAY, sw-calibration-access=READ-WRITE, type=rt_Array_Float_27  # Description_Tag_Not_Defined
    KaTSXR_r_N_NbCalcEqnMtrx
      parameter data prototype KaTSXR_r_N_NbCalcEqnMtrx: category=ARRAY, sw-calibration-access=READ-WRITE, type=rt_Array_Float_27  # Description_Tag_Not_Defined
    KaTSXR_r_N_Nc1CalcEqnMtrx
      parameter data prototype KaTSXR_r_N_Nc1CalcEqnMtrx: category=ARRAY, sw-calibration-access=READ-WRITE, type=rt_Array_Float_27  # Description_Tag_Not_Defined
    KaTSXR_r_N_Nc1Eqn1Mtrx
      parameter data prototype KaTSXR_r_N_Nc1Eqn1Mtrx: category=ARRAY, sw-calibration-access=READ-WRITE, type=rt_Array_Float_54  # Description_Tag_Not_Defined
    KaTSXR_r_N_Nc1Eqn2Mtrx
      parameter data prototype KaTSXR_r_N_Nc1Eqn2Mtrx: category=ARRAY, sw-calibration-access=READ-WRITE, type=rt_Array_Float_54  # Description_Tag_Not_Defined
    KaTSXR_r_N_Nc1TargetEqnMtrx
      parameter data prototype KaTSXR_r_N_Nc1TargetEqnMtrx: category=ARRAY, sw-calibration-access=READ-WRITE, type=rt_Array_Float_27  # Description_Tag_Not_Defined
    KaTSXR_r_N_Nc2CalcEqnMtrx
      parameter data prototype KaTSXR_r_N_Nc2CalcEqnMtrx: category=ARRAY, sw-calibration-access=READ-WRITE, type=rt_Array_Float_27  # Description_Tag_Not_Defined
    KaTSXR_r_N_NcCalcEqnMtrx
      parameter data prototype KaTSXR_r_N_NcCalcEqnMtrx: category=ARRAY, sw-calibration-access=READ-WRITE, type=rt_Array_Float_27  # Description_Tag_Not_Defined
    KaTSXR_r_N_NiEqn1Mtrx
      parameter data prototype KaTSXR_r_N_NiEqn1Mtrx: category=ARRAY, sw-calibration-access=READ-WRITE, type=rt_Array_Float_54  # Description_Tag_Not_Defined
    KaTSXR_r_N_NiEqn2Mtrx
      parameter data prototype KaTSXR_r_N_NiEqn2Mtrx: category=ARRAY, sw-calibration-access=READ-WRITE, type=rt_Array_Float_54  # Description_Tag_Not_Defined
    KaTSXR_r_N_NoEqn1Mtrx
      parameter data prototype KaTSXR_r_N_NoEqn1Mtrx: category=ARRAY, sw-calibration-access=READ-WRITE, type=rt_Array_Float_54  # Description_Tag_Not_Defined
    KaTSXR_r_N_NoEqn2Mtrx
      parameter data prototype KaTSXR_r_N_NoEqn2Mtrx: category=ARRAY, sw-calibration-access=READ-WRITE, type=rt_Array_Float_54  # Description_Tag_Not_Defined
    KaTSXR_r_N_NtiEqn1Mtrx
      parameter data prototype KaTSXR_r_N_NtiEqn1Mtrx: category=ARRAY, sw-calibration-access=READ-WRITE, type=rt_Array_Float_54  # Description_Tag_Not_Defined
    KaTSXR_r_N_NtiEqn2Mtrx
      parameter data prototype KaTSXR_r_N_NtiEqn2Mtrx: category=ARRAY, sw-calibration-access=READ-WRITE, type=rt_Array_Float_54  # Description_Tag_Not_Defined
    KaTSXR_r_N_STRRToConstrn
      parameter data prototype KaTSXR_r_N_STRRToConstrn: category=ARRAY, sw-calibration-access=READ-WRITE, type=rt_Array_Float_114  # Description_Tag_Not_Defined
    KaTSXR_r_N_TM1_DtrmnOptTms
      parameter data prototype KaTSXR_r_N_TM1_DtrmnOptTms: category=ARRAY, sw-calibration-access=READ-WRITE, type=rt_Array_Float_126  # Description_Tag_Not_Defined
    KaTSXR_r_N_TM1_TiConstrn
      parameter data prototype KaTSXR_r_N_TM1_TiConstrn: category=ARRAY, sw-calibration-access=READ-WRITE, type=rt_Array_Float_126  # Description_Tag_Not_Defined
    KaTSXR_r_N_TM1_ToConstrn
      parameter data prototype KaTSXR_r_N_TM1_ToConstrn: category=ARRAY, sw-calibration-access=READ-WRITE, type=rt_Array_Float_126  # Description_Tag_Not_Defined
    KaTSXR_r_N_TM2_DtrmnOptTms
      parameter data prototype KaTSXR_r_N_TM2_DtrmnOptTms: category=ARRAY, sw-calibration-access=READ-WRITE, type=rt_Array_Float_126  # Description_Tag_Not_Defined
    KaTSXR_r_N_TM2_ToConstrn
      parameter data prototype KaTSXR_r_N_TM2_ToConstrn: category=ARRAY, sw-calibration-access=READ-WRITE, type=rt_Array_Float_126  # Description_Tag_Not_Defined
    KaTSXR_r_N_TM3_DtrmnOptTms
      parameter data prototype KaTSXR_r_N_TM3_DtrmnOptTms: category=ARRAY, sw-calibration-access=READ-WRITE, type=rt_Array_Float_126  # Description_Tag_Not_Defined
    KaTSXR_r_N_TM3_ToConstrn
      parameter data prototype KaTSXR_r_N_TM3_ToConstrn: category=ARRAY, sw-calibration-access=READ-WRITE, type=rt_Array_Float_126  # Description_Tag_Not_Defined
    KaTSXR_r_N_TM4_DtrmnOptTms
      parameter data prototype KaTSXR_r_N_TM4_DtrmnOptTms: category=ARRAY, sw-calibration-access=READ-WRITE, type=rt_Array_Float_126  # Description_Tag_Not_Defined
    KaTSXR_r_N_ToFromTcrs
      parameter data prototype KaTSXR_r_N_ToFromTcrs: category=ARRAY, sw-calibration-access=READ-WRITE, type=rt_Array_Float_126  # Description_Tag_Not_Defined
    KaTSXR_r_TCMGearRatios
      parameter data prototype KaTSXR_r_TCMGearRatios: category=ARRAY, sw-calibration-access=READ-WRITE, type=rt_Array_Float_13  # Description_Tag_Not_Defined
    KeASLR_b_ASLInstantActivationEnable
      parameter data prototype KeASLR_b_ASLInstantActivationEnable: category=VALUE, sw-calibration-access=READ-WRITE, type=Boolean  # ASL Instant activation enable parameter (1 = instant activation,\nsingle press 0 = double press activation)
    KeESMR_k_BatModNo
      parameter data prototype KeESMR_k_BatModNo: category=VALUE, sw-calibration-access=READ-WRITE, type=Float  # Not used in ESMR / in ESMC_Initialize Controller
    KeHPMR_t_BSWTimeout_SPT
      parameter data prototype KeHPMR_t_BSWTimeout_SPT: category=VALUE, sw-calibration-access=READ-WRITE, type=Float  # amount of time before shutting down, given to SPT Pending\nstate from BSW
    KeHSCR_K_Min_Incr_4_2Pts
      parameter data prototype KeHSCR_K_Min_Incr_4_2Pts: category=VALUE, sw-calibration-access=READ-WRITE, type=Float  # Minimum increment between two points that are close by. \nThis cal adjusts the minimum distance in Tx and in Ty direction.\nThis is the minimum distance that must be measured in Tx and/or Ty direction between\ntwo points in order for them to be treated a
    KeHSCR_K_Min_dist
      parameter data prototype KeHSCR_K_Min_dist: category=VALUE, sw-calibration-access=READ-WRITE, type=Float  # Minimum distance used in geometric calculations in the HSCL_CalcDonutSpaceLmtHorizLine library block.
    KeHSCR_M_Adher_Limiting
      parameter data prototype KeHSCR_M_Adher_Limiting: category=VALUE, sw-calibration-access=READ-WRITE, type=Float  # Adherence trigger for change in limit arb
    KeHSCR_M_Adherence_LSP
      parameter data prototype KeHSCR_M_Adherence_LSP: category=VALUE, sw-calibration-access=READ-WRITE, type=Float  # Adherence LSP for filtering
    KeHSCR_M_Adherence_RSP
      parameter data prototype KeHSCR_M_Adherence_RSP: category=VALUE, sw-calibration-access=READ-WRITE, type=Float  # Adherence RSP for filtering
    KeHSCR_M_LowMuRmpEndLmt
      parameter data prototype KeHSCR_M_LowMuRmpEndLmt: category=VALUE, sw-calibration-access=READ-WRITE, type=UInt16  # ramp out end limit for LowMu end. the default value is: 150Nm
    KeHSCR_M_MaxTrqReserve_MtrA
      parameter data prototype KeHSCR_M_MaxTrqReserve_MtrA: category=VALUE, sw-calibration-access=READ-WRITE, type=Float  # This positive value is subtracted from the Ta_max output of the motor torque limit calibration tables. The result is sent out as Ta_Max. The idea is to leave a safety margin between the actual torque capability of the motors and the value the software works with. Example location: SCOR_FUNC_PxPy_ac/SCOR_FUNC_PxPy_MedTED/SCOC_Main_Control_Ring/SCOC_EVM/Enable/SCOC_EV_Mode/SCOL_Optimization_EV_Mode/SCOC_Opt_EVM/SCOL_StrategicOptimization_EngOff/SCOL_PreOptToTaTb
    KeHSCR_M_MaxTrqReserve_MtrB
      parameter data prototype KeHSCR_M_MaxTrqReserve_MtrB: category=VALUE, sw-calibration-access=READ-WRITE, type=Float  # This positive value is subtracted from the Tb_max output of the motor torque limit calibration tables. The result is sent out as Tb_Max. The idea is to leave a safety margin between the actual torque capability of the motors and the value the software works with. Example location: SCOR_FUNC_PxPy_ac/SCOR_FUNC_PxPy_MedTED/SCOC_Main_Control_Ring/SCOC_EVM/Enable/SCOC_EV_Mode/SCOL_Optimization_EV_Mode/SCOC_Opt_EVM/SCOL_StrategicOptimization_EngOff/SCOL_PreOptToTaTb
    KeHSCR_M_MaxTrqReserve_MtrC
      parameter data prototype KeHSCR_M_MaxTrqReserve_MtrC: category=VALUE, sw-calibration-access=READ-WRITE, type=Float  # This positive value is subtracted from the Tc_max output of the motor torque limit calibration tables. The result is sent out as Tc_Max. The idea is to leave a safety margin between the actual torque capability of the motors and the value the software works with. Example location: SCOR_FUNC_PxPy_ac/SCOR_FUNC_PxPy_MedTED/SCOC_Main_Control_Ring/SCOC_EVM/Enable/SCOC_EV_Mode/SCOL_Optimization_EV_Mode/SCOC_Opt_EVM/SCOL_StrategicOptimization_EngOff/SCOL_PreOptToTaTb
    KeHSCR_M_MinTrqReserve_MtrA
      parameter data prototype KeHSCR_M_MinTrqReserve_MtrA: category=VALUE, sw-calibration-access=READ-WRITE, type=Float  # This positive value is subtracted from the Ta_min output of the motor torque limit calibration tables. The result is sent out as Ta_Min. The idea is to leave a safety margin between the actual torque capability of the motors and the value the software works with. Example location: SCOR_FUNC_PxPy_ac/SCOR_FUNC_PxPy_MedTED/SCOC_Main_Control_Ring/SCOC_EVM/Enable/SCOC_EV_Mode/SCOL_Optimization_EV_Mode/SCOC_Opt_EVM/SCOL_StrategicOptimization_EngOff/SCOL_PreOptToTaTb
    KeHSCR_M_MinTrqReserve_MtrB
      parameter data prototype KeHSCR_M_MinTrqReserve_MtrB: category=VALUE, sw-calibration-access=READ-WRITE, type=Float  # This positive value is subtracted from the Tb_min output of the motor torque limit calibration tables. The result is sent out as Tb_Min. The idea is to leave a safety margin between the actual torque capability of the motors and the value the software works with. Example location: SCOR_FUNC_PxPy_ac/SCOR_FUNC_PxPy_MedTED/SCOC_Main_Control_Ring/SCOC_EVM/Enable/SCOC_EV_Mode/SCOL_Optimization_EV_Mode/SCOC_Opt_EVM/SCOL_StrategicOptimization_EngOff/SCOL_PreOptToTaTb
    KeHSCR_M_MinTrqReserve_MtrC
      parameter data prototype KeHSCR_M_MinTrqReserve_MtrC: category=VALUE, sw-calibration-access=READ-WRITE, type=Float  # This positive value is subtracted from the Tc_min output of the motor torque limit calibration tables. The result is sent out as Tc_Min. The idea is to leave a safety margin between the actual torque capability of the motors and the value the software works with. Example location: SCOR_FUNC_PxPy_ac/SCOR_FUNC_PxPy_MedTED/SCOC_Main_Control_Ring/SCOC_EVM/Enable/SCOC_EV_Mode/SCOL_Optimization_EV_Mode/SCOC_Opt_EVM/SCOL_StrategicOptimization_EngOff/SCOL_PreOptToTaTb
    KeHSCR_M_SWA_Lash_LSP
      parameter data prototype KeHSCR_M_SWA_Lash_LSP: category=VALUE, sw-calibration-access=READ-WRITE, type=Float
    KeHSCR_M_SWA_Lash_RSP
      parameter data prototype KeHSCR_M_SWA_Lash_RSP: category=VALUE, sw-calibration-access=READ-WRITE, type=Float
    KeHSCR_M_TLFMax_SRAR
      parameter data prototype KeHSCR_M_TLFMax_SRAR: category=VALUE, sw-calibration-access=READ-WRITE, type=Float  # Maximum TLF limit during SRAR sum torque limiting.
    KeHSCR_P_ChrgPwrLimMM
      parameter data prototype KeHSCR_P_ChrgPwrLimMM: category=VALUE, sw-calibration-access=READ-WRITE, type=Float  # Charge power limit override when there is a power limit\nvalue mismatch
    KeHSCR_P_DschrgPwrLimMM
      parameter data prototype KeHSCR_P_DschrgPwrLimMM: category=VALUE, sw-calibration-access=READ-WRITE, type=Float  # Discharge power limit override when there is a power limit\nvalue mismatch
    KeHSCR_P_MaxLim_Override
      parameter data prototype KeHSCR_P_MaxLim_Override: category=VALUE, sw-calibration-access=READ-WRITE, type=Float  # HSCL OVUV controller eval power limit mismatch override hooks
    KeHSCR_P_MinLim_Override
      parameter data prototype KeHSCR_P_MinLim_Override: category=VALUE, sw-calibration-access=READ-WRITE, type=Float  # HSCL OVUV controller eval power limit mismatch override hooks
    KeHSCR_b_CollapseXsXltoXs
      parameter data prototype KeHSCR_b_CollapseXsXltoXs: category=VALUE, sw-calibration-access=READ-WRITE, type=Boolean  # Set this to 1 to use XS value instead of the XL value. This is deep inside the HSCL main library. The library was\nvalidated with this being set to boolean(1). Dont switch it to zero\nunless you plan to revalidate the entire library.
    KeHSCR_b_DrvrTrqReqAlwaysWithinLimits
      parameter data prototype KeHSCR_b_DrvrTrqReqAlwaysWithinLimits: category=VALUE, sw-calibration-access=READ-WRITE, type=Boolean  # Location: OITR/OITR/Tactical_Optimization_OITC/OITC_TSC_TacticalSysConstrnt/DtrmnToPredLmts/OutputTorqueConstraining_Pred/HSCL_ToDirectionCheck2/Limited Set this to 1 to keep the To_Request signal within the minimum and maximum limits. Set this to 0 to let another, milder limiting scheme work on the To_Request signal. This other scheme still runs the limiting algorithm, but does not send its results out as an output. Instead, when the results and the To_Request signal have opposite signs, then this scheme sends out zero. One subsystem-level up from here there is another calibration: KeHSCR_b_DrvrTrqReqNotLimited. See that description also.
    KeHSCR_b_DrvrTrqReqNotLimited
      parameter data prototype KeHSCR_b_DrvrTrqReqNotLimited: category=VALUE, sw-calibration-access=READ-WRITE, type=Boolean  # Example location: OITR/OITR/Tactical_Optimization_OITC/OITC_TSC_TacticalSysConstrnt/DtrmnToPredLmts/OutputTorqueConstraining_Pred/HSCL_ToDirectionCheck2 Set this to 1 to let the To_Request signal pass through and become To_Cmnd. Set this to 0 to make it enter a min/max limiting routine that uses KeHSCR_b_DrvrTrqReqAlwaysWithinLimits to make further decisions. See the description of that calibration also.
    KeHSCR_b_EnblPbattRateLmtHighPrrty
      parameter data prototype KeHSCR_b_EnblPbattRateLmtHighPrrty: category=VALUE, sw-calibration-access=READ-WRITE, type=Boolean  # Calibration to enable battery power rate limit having\nhighest priority
    KeHSCR_b_FEADadj
      parameter data prototype KeHSCR_b_FEADadj: category=VALUE, sw-calibration-access=READ-WRITE, type=Boolean
    KeHSCR_b_UseAvgBlock
      parameter data prototype KeHSCR_b_UseAvgBlock: category=VALUE, sw-calibration-access=READ-WRITE, type=Boolean  # This is a part of the OV/UV library: HSER/HSER/HSEC/HSEC_PowerLimits/Calculate_Local_Power_Limits/HSCL_OV_UV_PowerLimits/HSCL_Dtrmn_PD_OV/HSCL_PwrLimits_ProcBattVoltage/KeHSCR_b_UseAvgBlock When set to 1, the Battery_Module_Voltage will be calculated
    KeHSCR_b_UseCalcPbatLim
      parameter data prototype KeHSCR_b_UseCalcPbatLim: category=VALUE, sw-calibration-access=READ-WRITE, type=Boolean  # OVUV controller - this cal needs to be enabled to initialize to\ncurrent opt calc bat power of the ring when there is an OV/UV event\ninstead of initiliazing to extreme discharge/charge limits
    KeHSCR_b_UseESC_DtctTrqSplt
      parameter data prototype KeHSCR_b_UseESC_DtctTrqSplt: category=VALUE, sw-calibration-access=READ-WRITE, type=Boolean  # Use for HSCL ToMaxMinTrqSplt ESC detection
    KeHSCR_b_UseFiltFrntLowMu
      parameter data prototype KeHSCR_b_UseFiltFrntLowMu: category=VALUE, sw-calibration-access=READ-WRITE, type=Boolean  # Use a filtering of front axle speed for Low Mu subsystem\nt8445M0: Three Motor Update KeHSCR_b_UseFiltMtrALowMu -> KeHSCR_b_UseFiltFrntLowMu\n
    KeHSCR_b_UseFiltRearLowMu
      parameter data prototype KeHSCR_b_UseFiltRearLowMu: category=VALUE, sw-calibration-access=READ-WRITE, type=Boolean  # Use a filtering of rear Axle speed for Low Mu subsystem\nt8445M0: Three Motor Update KeHSCR_b_UseFiltMtrBLowMu -> KeHSCR_b_UseFiltRearLowMu\n
    KeHSCR_b_UseLowMuLmtArbt
      parameter data prototype KeHSCR_b_UseLowMuLmtArbt: category=VALUE, sw-calibration-access=READ-WRITE, type=Boolean  # Use for HSCL ToMaxMinTrqSplt Low mu arbitration. Default value = 1
    KeHSCR_dM_LowMuFact_LD
      parameter data prototype KeHSCR_dM_LowMuFact_LD: category=VALUE, sw-calibration-access=READ-WRITE, type=SInt16  # ramp out each raster with this value from 1 to 0. The\ndefault value is -50Nm/s. Please note that KeHSCR_dK_LowMuFact_LD was in Sep 2021 changed to KeHSCR_dM_LowMuFact_LD
    KeHSCR_dM_LowMuRmpOutFrnt
      parameter data prototype KeHSCR_dM_LowMuRmpOutFrnt: category=VALUE, sw-calibration-access=READ-WRITE, type=SInt16  # ramp out each raster with this value for LowMu end\ndefault -50Nm/s This should normally only have negative values but for testing the algo use positive 100
    KeHSCR_dM_LowMuRmpOutRr
      parameter data prototype KeHSCR_dM_LowMuRmpOutRr: category=VALUE, sw-calibration-access=READ-WRITE, type=SInt16  # ramp out each raster with this value for LowMu end\ndefault value = -50Nm/s This should normally only have negative values but for testing the algo, use positive 100
    KeHSCR_dP_ChrgPwrRateNegLim
      parameter data prototype KeHSCR_dP_ChrgPwrRateNegLim: category=VALUE, sw-calibration-access=READ-WRITE, type=Float  # OVUV controller rate limit charge power limit decrements. This is a part of the OV UV libraries. This is a lower limit on the rate of change d_Pbatt_Charge / dt of battery charge power. The battery charge power calculated this way is a part of dete
    KeHSCR_dP_ChrgPwrRatePosLim
      parameter data prototype KeHSCR_dP_ChrgPwrRatePosLim: category=VALUE, sw-calibration-access=READ-WRITE, type=Float  # OVUV controller rate limit charge power limit increments. This is a part of the OV UV libraries. This is an upper limit on the rate of change d_Pbatt_Charge / dt of battery charge power. The battery charge power calculated this way is a part of det
    KeHSCR_dP_DschrgPwrRateNegLim
      parameter data prototype KeHSCR_dP_DschrgPwrRateNegLim: category=VALUE, sw-calibration-access=READ-WRITE, type=Float  # OVUV controller rate limit discharge power limit decrements. This is a part of the OV UV libraries. This is a lower limit on the rate of change d_Pbatt_Discharge / dt of battery discharge power. The battery discharge power calculated this way is a
    KeHSCR_dP_DschrgPwrRatePosLim
      parameter data prototype KeHSCR_dP_DschrgPwrRatePosLim: category=VALUE, sw-calibration-access=READ-WRITE, type=Float  # OVUV controller rate limit discharge power limit increments. This is a part of the OV UV libraries. This is an upper limit on the rate of change d_Pbatt_Discharge / dt of battery discharge power. The battery discharge power calculated this way is a
    KeHSCR_dU_OV_WT_RateLimLD
      parameter data prototype KeHSCR_dU_OV_WT_RateLimLD: category=VALUE, sw-calibration-access=READ-WRITE, type=Float  # OVUV controller - Over voltage limit gradient limit down. OVUV controller - Over voltage limit gradient limit down. WT probably means With Threshold.
    KeHSCR_dU_OV_WT_RateLimLU
      parameter data prototype KeHSCR_dU_OV_WT_RateLimLU: category=VALUE, sw-calibration-access=READ-WRITE, type=Float  # OVUV controller - Over voltage limit gradient limit up. OVUV controller - Over voltage limit gradient limit up. WT probably means With Threshold.
    KeHSCR_dU_UV_WT_RateLimLD
      parameter data prototype KeHSCR_dU_UV_WT_RateLimLD: category=VALUE, sw-calibration-access=READ-WRITE, type=Float  # OVUV controller - Under voltage limit gradient limit down. OVUV controller - Under voltage limit gradient limit down. WT probably means With Threshold.
    KeHSCR_dU_UV_WT_RateLimLU
      parameter data prototype KeHSCR_dU_UV_WT_RateLimLU: category=VALUE, sw-calibration-access=READ-WRITE, type=Float  # OVUV controller - Under voltage limit gradient limit up. OVUV controller - Under voltage limit gradient limit up. WT probably means With Threshold.
    KeHSCR_k_AdherenceFilt
      parameter data prototype KeHSCR_k_AdherenceFilt: category=VALUE, sw-calibration-access=READ-WRITE, type=Float  # Adherence limit filter coeff (for REEV)
    KeHSCR_k_FiltCoeffFrnt_LowMu
      parameter data prototype KeHSCR_k_FiltCoeffFrnt_LowMu: category=VALUE, sw-calibration-access=READ-WRITE, type=Float  # Filter coefficient for front axle in the Low Mu function of\nToMaxMin_trqFloor library\nt8445M0: Three Motor Update KeHSCR_k_FiltCoeffMtrA_LowMu -> KeHSCR_k_FiltCoeffFrnt_LowMu\n
    KeHSCR_k_FiltCoeffRear_LowMu
      parameter data prototype KeHSCR_k_FiltCoeffRear_LowMu: category=VALUE, sw-calibration-access=READ-WRITE, type=Float  # Filter coefficient for rear axle in the Low Mu function of\nToMaxMin_trqFloor library\nt8445M0: Three Motor Update KeHSCR_k_FiltCoeffMtrB_LowMu -> KeHSCR_k_FiltCoeffRear_LowMu\n
    KeHSCR_n_LowMuEndFrntTrq
      parameter data prototype KeHSCR_n_LowMuEndFrntTrq: category=VALUE, sw-calibration-access=READ-WRITE, type=UInt16  # Front Axle speed at which LowMu limitation shall end calc back to\nnormal limit. Default value = 730. A shaftspeed of 730rpm is equivalent to a vehicle velocity of alsmost 8kph based on: Tire_Speed_velocity.xlsx under the HSCR folder\nt8445M0: Th
    KeHSCR_n_LowMuEndRearTrq
      parameter data prototype KeHSCR_n_LowMuEndRearTrq: category=VALUE, sw-calibration-access=READ-WRITE, type=UInt16  # Rear Axle speed at which LowMu limitation shall end calc back to\nnormal limit vehspeed 730 is almost 8kph. Default value = 730 rpm,\nthis is equivalent to about 8kph based on\nTire_Speed_velocity.xlsx under HSCR folder.\nt8445M0: Three Motor Update Ke
    KeHSCR_n_Nc1Max
      parameter data prototype KeHSCR_n_Nc1Max: category=VALUE, sw-calibration-access=READ-WRITE, type=Float  # Soft Nc1Max limit for Ni and Nx Profile
    KeHSCR_n_Nc1Min
      parameter data prototype KeHSCR_n_Nc1Min: category=VALUE, sw-calibration-access=READ-WRITE, type=Float  # Soft Nc1Min limit for Ni and Nx Profile
    KeHSCR_n_Nc2Max
      parameter data prototype KeHSCR_n_Nc2Max: category=VALUE, sw-calibration-access=READ-WRITE, type=Float  # Soft Nc2Max limit for Ni and Nx Profile
    KeHSCR_n_Nc2Min
      parameter data prototype KeHSCR_n_Nc2Min: category=VALUE, sw-calibration-access=READ-WRITE, type=Float  # Soft Nc2Min limit for Ni and Nx Profile
    KeHSCR_n_Nc3Max
      parameter data prototype KeHSCR_n_Nc3Max: category=VALUE, sw-calibration-access=READ-WRITE, type=Float  # Soft Nc3Max limit for Ni and Nx Profile
    KeHSCR_n_Nc3Min
      parameter data prototype KeHSCR_n_Nc3Min: category=VALUE, sw-calibration-access=READ-WRITE, type=Float  # Soft Nc3Min limit for Ni and Nx Profile
    KeHSCR_n_Nc4Max
      parameter data prototype KeHSCR_n_Nc4Max: category=VALUE, sw-calibration-access=READ-WRITE, type=Float  # Soft Nc4Max limit for Ni and Nx Profile
    KeHSCR_n_Nc4Min
      parameter data prototype KeHSCR_n_Nc4Min: category=VALUE, sw-calibration-access=READ-WRITE, type=Float  # Soft Nc4Min limit for Ni and Nx Profile
    KeHSCR_t_ExpireLatchCnd
      parameter data prototype KeHSCR_t_ExpireLatchCnd: category=VALUE, sw-calibration-access=READ-WRITE, type=Float  # expire timer for latch condition in HSCL_ToMaxMin_TrqFloor
    KeOBCR_Cnt_LatchUnplugInterupCnt
      parameter data prototype KeOBCR_Cnt_LatchUnplugInterupCnt: category=VALUE, sw-calibration-access=READ-WRITE, type=Float  # Charging System Sts debounce time for charge interrupted display
    KeOBCR_I_MinJ1772ICA
      parameter data prototype KeOBCR_I_MinJ1772ICA: category=VALUE, sw-calibration-access=READ-WRITE, type=Float  # The minimum ICA current needed to allow the secure connection\n+ established to be true
    KeOBCR_I_MinJ1772ICA1
      parameter data prototype KeOBCR_I_MinJ1772ICA1: category=VALUE, sw-calibration-access=READ-WRITE, type=Float  # The maximum ICA value that is allowed before an override to \n+ park is forced
    KeOBCR_P_ThermalHys_Cal1
      parameter data prototype KeOBCR_P_ThermalHys_Cal1: category=VALUE, sw-calibration-access=READ-WRITE, type=Float  # Difference between P_avail and P_out before lowering budget
    KeOBCR_P_ThermalHys_Cal2
      parameter data prototype KeOBCR_P_ThermalHys_Cal2: category=VALUE, sw-calibration-access=READ-WRITE, type=Float  # Difference between P_avail and P_out before increasing\nbudget
    KeOBCR_P_ThermalHys_Cal3
      parameter data prototype KeOBCR_P_ThermalHys_Cal3: category=VALUE, sw-calibration-access=READ-WRITE, type=Float  # Budget offset from what is available
    KeOBCR_U_MinValue2TrgrPPI
      parameter data prototype KeOBCR_U_MinValue2TrgrPPI: category=VALUE, sw-calibration-access=READ-WRITE, type=Float  # Minimum voltage needed to declare a good connection vs partial plug in.
    KeOBCR_k_ChargingSts
      parameter data prototype KeOBCR_k_ChargingSts: category=VALUE, sw-calibration-access=READ-WRITE, type=SInt16  # Override cal to change the ChargingSystemsts Sig Value
    KeOBCR_k_ThermHysFactor
      parameter data prototype KeOBCR_k_ThermHysFactor: category=VALUE, sw-calibration-access=READ-WRITE, type=Float  # P_avail- P_out > % of P_available before increasing budget
    KeOBCR_t_BPCM_Ready
      parameter data prototype KeOBCR_t_BPCM_Ready: category=VALUE, sw-calibration-access=READ-WRITE, type=Float  # Timeout from the check for BPCM ready to EStop in the\ncharging sequence
    KeOBCR_t_BPCM_ReadyDelay
      parameter data prototype KeOBCR_t_BPCM_ReadyDelay: category=VALUE, sw-calibration-access=READ-WRITE, type=Float  # Minimum time between BPCM Ready to the CHarge Type State
    KeOBCR_t_ChargeCompleteDelay
      parameter data prototype KeOBCR_t_ChargeCompleteDelay: category=VALUE, sw-calibration-access=READ-WRITE, type=Float  # Minimum time requred to be in Charging before moving to\ncharge complete
    KeOBCR_t_ChargePause
      parameter data prototype KeOBCR_t_ChargePause: category=VALUE, sw-calibration-access=READ-WRITE, type=Float  # Cal for how many seconds charging pauses
    KeOBCR_t_CloseS2
      parameter data prototype KeOBCR_t_CloseS2: category=VALUE, sw-calibration-access=READ-WRITE, type=Float  # Maximum time allowed to be in CloseS2 before moving to\nchecking the OBCM Mode as Charge
    KeOBCR_t_CloseS2Delay
      parameter data prototype KeOBCR_t_CloseS2Delay: category=VALUE, sw-calibration-access=READ-WRITE, type=Float  # Minimum time required to move between closing S2 and\nchecking OBCM mode is Charge
    KeOBCR_t_DCGBTInitWait
      parameter data prototype KeOBCR_t_DCGBTInitWait: category=VALUE, sw-calibration-access=READ-WRITE, type=Float  # Maximum time to remain in DCGBTinit state after receiving\nBMS_Not_Recognized from EVSE
    KeOBCR_t_DCInitWait
      parameter data prototype KeOBCR_t_DCInitWait: category=VALUE, sw-calibration-access=READ-WRITE, type=Float  # Maximum amount of time to wait in the DCInit state in the\nMain SF without passing SLAC. Default calue of 20 chosen because 20s is\nthe maximum amount of time allowed by the DIN Spec to reach SessionSetUp.\nThere is no specific timer to establish SLAC but
    KeOBCR_t_DCMaxTime
      parameter data prototype KeOBCR_t_DCMaxTime: category=VALUE, sw-calibration-access=READ-WRITE, type=Float  # maximum time allowed to be in DCWait before moving through\nthe DC Charging sequence
    KeOBCR_t_DbncTmPPI
      parameter data prototype KeOBCR_t_DbncTmPPI: category=VALUE, sw-calibration-access=READ-WRITE, type=Float  # Debounce Time in seconds before a PPI is established
    KeOBCR_t_EnableChargeDelay
      parameter data prototype KeOBCR_t_EnableChargeDelay: category=VALUE, sw-calibration-access=READ-WRITE, type=Float  # minimum time required for power up when initiating charging
    KeOBCR_t_OBCM_Charge
      parameter data prototype KeOBCR_t_OBCM_Charge: category=VALUE, sw-calibration-access=READ-WRITE, type=Float  # Maximum time allowed between receiving S2 as closed and\nseeing OBCM Mode change to Charge
    KeOBCR_t_OBCM_ChargeDelay
      parameter data prototype KeOBCR_t_OBCM_ChargeDelay: category=VALUE, sw-calibration-access=READ-WRITE, type=Float  # Minimum time required to move between checking OBCM mode is \nCharge and enabling OBCM charge
    KeOBCR_t_OBCM_EnblCharge
      parameter data prototype KeOBCR_t_OBCM_EnblCharge: category=VALUE, sw-calibration-access=READ-WRITE, type=Float  # Maximum time between receiving the OBCM mode as Charge and\nreceiving the OBCM Charge Enable Status as true
    KeOBCR_t_OBCM_EnblChargeDelay
      parameter data prototype KeOBCR_t_OBCM_EnblChargeDelay: category=VALUE, sw-calibration-access=READ-WRITE, type=Float  # Minimum time required between OCBM enable charge and\ncharging for AC Charging
    KeOBCR_t_OBCM_Idle
      parameter data prototype KeOBCR_t_OBCM_Idle: category=VALUE, sw-calibration-access=READ-WRITE, type=Float  # Maximum time allowed to be in OBCM Idle before moving to\nclosing S2
    KeOBCR_t_OBCM_IdleDelay
      parameter data prototype KeOBCR_t_OBCM_IdleDelay: category=VALUE, sw-calibration-access=READ-WRITE, type=Float  # Minimum time requred to go between OBCM Idle and closing S2
    KeOBCR_t_PowerUp
      parameter data prototype KeOBCR_t_PowerUp: category=VALUE, sw-calibration-access=READ-WRITE, type=Float  # Timeout from power up to emergency stop in the charging\nsequence
    KeOBCR_t_RetryDelay
      parameter data prototype KeOBCR_t_RetryDelay: category=VALUE, sw-calibration-access=READ-WRITE, type=Float  # Minimum time between Estop and Power Up if charging is not\ngiving up
    KeOBCR_t_StateDbnc
      parameter data prototype KeOBCR_t_StateDbnc: category=VALUE, sw-calibration-access=READ-WRITE, type=Float  # Debounce time in seconds that is used when debouncing Charging\n+ Level Determination States
    KeOBCR_t_StateShutDown
      parameter data prototype KeOBCR_t_StateShutDown: category=VALUE, sw-calibration-access=READ-WRITE, type=Float  # Timeout between Charge Complete and Shutdown if charge type\nis AC Charging
    KeOBCR_t_StateTransTimer
      parameter data prototype KeOBCR_t_StateTransTimer: category=VALUE, sw-calibration-access=READ-WRITE, type=Float  # Debounce Time to move between states
    KeOBCR_t_ThermHysDbnc
      parameter data prototype KeOBCR_t_ThermHysDbnc: category=VALUE, sw-calibration-access=READ-WRITE, type=Float  # Time to hold budget before increasing it, if cond are met.
    KeOBCR_t_UnplugDbnctime
      parameter data prototype KeOBCR_t_UnplugDbnctime: category=VALUE, sw-calibration-access=READ-WRITE, type=Float  # Debounce time to determine a full unplug before doing the \n+determination
    KeOPTR_Cf_MaxEngPwrPerFuelFlow
      parameter data prototype KeOPTR_Cf_MaxEngPwrPerFuelFlow: category=VALUE, sw-calibration-access=READ-WRITE, type=Float  # Coefficient of Fuel Flow vs Engine Power
    KeOPTR_Cf_Tc1GammaFact
      parameter data prototype KeOPTR_Cf_Tc1GammaFact: category=VALUE, sw-calibration-access=READ-WRITE, type=Float  # This calibration is used in OPTL_TmCoefs_Mngr as a\nconversion factor in Tc1 Gamma Calculation.\nTc1Gamma=TmxFromTa*Nc1*KeOPTR_Cf_Tc1GammaFact
    KeOPTR_Cf_Tc2GammaFact
      parameter data prototype KeOPTR_Cf_Tc2GammaFact: category=VALUE, sw-calibration-access=READ-WRITE, type=Float  # This calibration is used in OPTL_TmCoefs_Mngr as a\nconversion factor in Tc2 Gamma Calculation.\nTc2Gamma=TmxFromTa*Nc2*KeOPTR_Cf_Tc2GammaFact
    KeOPTR_Cf_Tc3GammaFact
      parameter data prototype KeOPTR_Cf_Tc3GammaFact: category=VALUE, sw-calibration-access=READ-WRITE, type=Float  # This calibration is used in OPTL_TmCoefs_Mngr as a\nconversion factor in Tc3 Gamma Calculation.\nTc3Gamma=TmxFromTa*Nc3*KeOPTR_Cf_Tc3GammaFact
    KeOPTR_Cf_Tc4GammaFact
      parameter data prototype KeOPTR_Cf_Tc4GammaFact: category=VALUE, sw-calibration-access=READ-WRITE, type=Float  # This calibration is used in OPTL_TmCoefs_Mngr as a\nconversion factor in Tc4 Gamma Calculation.\nTc4Gamma=TmxFromTa*Nc4*KeOPTR_Cf_Tc4GammaFact
    KeOPTR_M_BrkOutTrqDelta
      parameter data prototype KeOPTR_M_BrkOutTrqDelta: category=VALUE, sw-calibration-access=READ-WRITE, type=Float  # Minimum break torque to invoke 1-D optimization
    KeOPTR_M_DfltIrrelevantClutchTrq
      parameter data prototype KeOPTR_M_DfltIrrelevantClutchTrq: category=VALUE, sw-calibration-access=READ-WRITE, type=Float  # This calibration is used within OPTL_ClchTrqT. \nThis calibration becomes the output when the ELSE case is selected inside\nOPTL_Dtrmn_TC1, OPTL_Dtrmn_TC2, OPTL_Dtrmn_TC3, OPTL_Dtrmn_TC4.
    KeOPTR_M_EqualTcCmdThresh
      parameter data prototype KeOPTR_M_EqualTcCmdThresh: category=VALUE, sw-calibration-access=READ-WRITE, type=Float  # Threshold for clutch torque command
    KeOPTR_M_ExtremeMaxTorque
      parameter data prototype KeOPTR_M_ExtremeMaxTorque: category=VALUE, sw-calibration-access=READ-WRITE, type=Float  # Within torque limit arbitrations this calibration is used as\na max extreme value that will not impact the result of an arbitration. Ex:\nWithin an output torque arbitration ToMax from TmX will become\nKeOPTR_M_ExtremeMaxTorque if TmX does not depend on T
    KeOPTR_M_ExtremeMinTorque
      parameter data prototype KeOPTR_M_ExtremeMinTorque: category=VALUE, sw-calibration-access=READ-WRITE, type=Float  # Within torque limit arbitrations this calibration is used as\na min extreme value that will not impact the result of an arbitration. Ex:\nWithin an output torque arbitration ToMin from TmX will become\nKeOPTR_M_ExtremeMinTorque if TmX does not depend on T
    KeOPTR_M_FLDCTD_MaxLim
      parameter data prototype KeOPTR_M_FLDCTD_MaxLim: category=VALUE, sw-calibration-access=READ-WRITE, type=Float  # Description_Tag_Not_Defined
    KeOPTR_M_FLDCTD_MinLim
      parameter data prototype KeOPTR_M_FLDCTD_MinLim: category=VALUE, sw-calibration-access=READ-WRITE, type=Float  # Description_Tag_Not_Defined
    KeOPTR_M_LashInit
      parameter data prototype KeOPTR_M_LashInit: category=VALUE, sw-calibration-access=READ-WRITE, type=Float  # OPTL lash control initial value calibration
    KeOPTR_M_MtrARateLimInput
      parameter data prototype KeOPTR_M_MtrARateLimInput: category=VALUE, sw-calibration-access=READ-WRITE, type=Float
    KeOPTR_M_MtrASmallTrq
      parameter data prototype KeOPTR_M_MtrASmallTrq: category=VALUE, sw-calibration-access=READ-WRITE, type=Float
    KeOPTR_M_MtrASmallTrq_NEQ0
      parameter data prototype KeOPTR_M_MtrASmallTrq_NEQ0: category=VALUE, sw-calibration-access=READ-WRITE, type=Float
    KeOPTR_M_MtrBRateLimInput
      parameter data prototype KeOPTR_M_MtrBRateLimInput: category=VALUE, sw-calibration-access=READ-WRITE, type=Float
    KeOPTR_M_MtrBSmallTrq
      parameter data prototype KeOPTR_M_MtrBSmallTrq: category=VALUE, sw-calibration-access=READ-WRITE, type=Float
    KeOPTR_M_MtrBSmallTrq_NEQ0
      parameter data prototype KeOPTR_M_MtrBSmallTrq_NEQ0: category=VALUE, sw-calibration-access=READ-WRITE, type=Float
    KeOPTR_M_NiMinNVH_EngCpbltyReserve
      parameter data prototype KeOPTR_M_NiMinNVH_EngCpbltyReserve: category=VALUE, sw-calibration-access=READ-WRITE, type=Float  # Description_Tag_Not_Defined
    KeOPTR_M_OptToEqZeroThresh
      parameter data prototype KeOPTR_M_OptToEqZeroThresh: category=VALUE, sw-calibration-access=READ-WRITE, type=Float  # This is a threshold calibration used to determine if OptTo
    KeOPTR_M_P2ZeroIdle_2Pdl_BrkTrq_LSP
      parameter data prototype KeOPTR_M_P2ZeroIdle_2Pdl_BrkTrq_LSP: category=VALUE, sw-calibration-access=READ-WRITE, type=Float  # Description_Tag_Not_Defined
    KeOPTR_M_P2ZeroIdle_2Pdl_BrkTrq_RSP
      parameter data prototype KeOPTR_M_P2ZeroIdle_2Pdl_BrkTrq_RSP: category=VALUE, sw-calibration-access=READ-WRITE, type=Float  # Description_Tag_Not_Defined
    KeOPTR_M_P2ZeroIdle_BrkTrqMin_RSP_OS
      parameter data prototype KeOPTR_M_P2ZeroIdle_BrkTrqMin_RSP_OS: category=VALUE, sw-calibration-access=READ-WRITE, type=Float  # Description_Tag_Not_Defined
    KeOPTR_M_TLFMin_Dflt
      parameter data prototype KeOPTR_M_TLFMin_Dflt: category=VALUE, sw-calibration-access=READ-WRITE, type=Float  # Minimum TLF limit for determining TLF penalty.
    KeOPTR_M_TempFacFltTC
      parameter data prototype KeOPTR_M_TempFacFltTC: category=VALUE, sw-calibration-access=READ-WRITE, type=Float  # This cal is used as a time constant for the filtering of\nOPTL temperature factors.
    KeOPTR_P_2DSrchRngDeltaPi
      parameter data prototype KeOPTR_P_2DSrchRngDeltaPi: category=VALUE, sw-calibration-access=READ-WRITE, type=Float  # Minimum engine power(nm-rpm) range for 2D search during collapsed search limits.
    KeOPTR_P_A_Const
      parameter data prototype KeOPTR_P_A_Const: category=VALUE, sw-calibration-access=READ-WRITE, type=Float  # The 1D A calibration for A, B, and O points.
    KeOPTR_P_A_D7
      parameter data prototype KeOPTR_P_A_D7: category=VALUE, sw-calibration-access=READ-WRITE, type=Float  # This calibration defines the A point for OPTL_DtrmnOptToTaTb\ngear type library as a function of motor A shaft speed and output shaft\nspeed in D7.
    KeOPTR_P_A_D8
      parameter data prototype KeOPTR_P_A_D8: category=VALUE, sw-calibration-access=READ-WRITE, type=Float  # This calibration defines the A point for OPTL_DtrmnOptToTaTb\ngear type library as a function of motor A shaft speed and output shaft\nspeed in D8.
    KeOPTR_P_A_D9
      parameter data prototype KeOPTR_P_A_D9: category=VALUE, sw-calibration-access=READ-WRITE, type=Float  # This calibration defines the A point for OPTL_DtrmnOptToTaTb\ngear type library as a function of motor A shaft speed and output shaft\nspeed in D9.
    KeOPTR_P_A_N
      parameter data prototype KeOPTR_P_A_N: category=VALUE, sw-calibration-access=READ-WRITE, type=Float  # This calibration defines the A point for OPTL_DtrmnOptToTaTb\ngear type library as a function of motor A shaft speed and output shaft\nspeed in N.
    KeOPTR_P_A_R
      parameter data prototype KeOPTR_P_A_R: category=VALUE, sw-calibration-access=READ-WRITE, type=Float  # This calibration defines the A point for OPTL_DtrmnOptToTaTb\ngear type library as a function of motor A shaft speed and output shaft\nspeed in R.
    KeOPTR_P_A_R2
      parameter data prototype KeOPTR_P_A_R2: category=VALUE, sw-calibration-access=READ-WRITE, type=Float  # This calibration defines the A point for OPTL_DtrmnOptToTaTb\ngear type library as a function of motor A shaft speed and output shaft\nspeed in R2.
    KeOPTR_P_B_Const
      parameter data prototype KeOPTR_P_B_Const: category=VALUE, sw-calibration-access=READ-WRITE, type=Float  # The 1D B calibration for A, B, and O points.
    KeOPTR_P_B_D7
      parameter data prototype KeOPTR_P_B_D7: category=VALUE, sw-calibration-access=READ-WRITE, type=Float  # This calibration defines the B point for OPTL_DtrmnOptToTaTb\ngear type library as a function of motor A shaft speed and output shaft\nspeed in D7.
    KeOPTR_P_B_D8
      parameter data prototype KeOPTR_P_B_D8: category=VALUE, sw-calibration-access=READ-WRITE, type=Float  # This calibration defines the B point for OPTL_DtrmnOptToTaTb\ngear type library as a function of motor A shaft speed and output shaft\nspeed in D8.
    KeOPTR_P_B_D9
      parameter data prototype KeOPTR_P_B_D9: category=VALUE, sw-calibration-access=READ-WRITE, type=Float  # This calibration defines the B point for OPTL_DtrmnOptToTaTb\ngear type library as a function of motor A shaft speed and output shaft\nspeed in D9.
    KeOPTR_P_B_N
      parameter data prototype KeOPTR_P_B_N: category=VALUE, sw-calibration-access=READ-WRITE, type=Float  # This calibration defines the B point for OPTL_DtrmnOptToTaTb\ngear type library as a function of motor A shaft speed and output shaft\nspeed in N.
    KeOPTR_P_B_P
      parameter data prototype KeOPTR_P_B_P: category=VALUE, sw-calibration-access=READ-WRITE, type=Float  # This calibration defines the A point for OPTL_DtrmnOptToTaTb\ngear type library as a function of motor A shaft speed and output shaft\nspeed in N.
    KeOPTR_P_B_R
      parameter data prototype KeOPTR_P_B_R: category=VALUE, sw-calibration-access=READ-WRITE, type=Float  # This calibration defines the B point for OPTL_DtrmnOptToTaTb\ngear type library as a function of motor A shaft speed and output shaft\nspeed in R.
    KeOPTR_P_B_R2
      parameter data prototype KeOPTR_P_B_R2: category=VALUE, sw-calibration-access=READ-WRITE, type=Float  # This calibration defines the B point for OPTL_DtrmnOptToTaTb\ngear type library as a function of motor A shaft speed and output shaft\nspeed in R2.
    KeOPTR_P_DfltOptCost
      parameter data prototype KeOPTR_P_DfltOptCost: category=VALUE, sw-calibration-access=READ-WRITE, type=Float  # Default power loss when optimiation is not enabled.
    KeOPTR_P_FLDBattUseCost_MinLim
      parameter data prototype KeOPTR_P_FLDBattUseCost_MinLim: category=VALUE, sw-calibration-access=READ-WRITE, type=Float  # Description_Tag_Not_Defined
    KeOPTR_P_FLDEngUseCost_MinLim
      parameter data prototype KeOPTR_P_FLDEngUseCost_MinLim: category=VALUE, sw-calibration-access=READ-WRITE, type=Float  # Description_Tag_Not_Defined
    KeOPTR_P_HysA_Const
      parameter data prototype KeOPTR_P_HysA_Const: category=VALUE, sw-calibration-access=READ-WRITE, type=Float  # This calibration defines the O point for OPTL_DtrmnOptToTaTb\ngear type library as a function of motor A shaft speed and output shaft\nspeed in R2.
    KeOPTR_P_HysA_D7
      parameter data prototype KeOPTR_P_HysA_D7: category=VALUE, sw-calibration-access=READ-WRITE, type=Float  # This calibration defines the O point for OPTL_DtrmnOptToTaTb\ngear type library as a function of motor A shaft speed and output shaft\nspeed in R2.
    KeOPTR_P_HysA_D8
      parameter data prototype KeOPTR_P_HysA_D8: category=VALUE, sw-calibration-access=READ-WRITE, type=Float  # This calibration defines the O point for OPTL_DtrmnOptToTaTb\ngear type library as a function of motor A shaft speed and output shaft\nspeed in R2.
    KeOPTR_P_HysA_D9
      parameter data prototype KeOPTR_P_HysA_D9: category=VALUE, sw-calibration-access=READ-WRITE, type=Float  # This calibration defines the O point for OPTL_DtrmnOptToTaTb\ngear type library as a function of motor A shaft speed and output shaft\nspeed in R2.
    KeOPTR_P_HysA_N
      parameter data prototype KeOPTR_P_HysA_N: category=VALUE, sw-calibration-access=READ-WRITE, type=Float  # This calibration defines the O point for OPTL_DtrmnOptToTaTb\ngear type library as a function of motor A shaft speed and output shaft\nspeed in R2.
    KeOPTR_P_HysA_N1
      parameter data prototype KeOPTR_P_HysA_N1: category=VALUE, sw-calibration-access=READ-WRITE, type=Float  # This calibration defines the O point for OPTL_DtrmnOptToTaTb\ngear type library as a function of motor A shaft speed and output shaft\nspeed in R2.
    KeOPTR_P_HysA_N2
      parameter data prototype KeOPTR_P_HysA_N2: category=VALUE, sw-calibration-access=READ-WRITE, type=Float  # This calibration defines the O point for OPTL_DtrmnOptToTaTb\ngear type library as a function of motor A shaft speed and output shaft\nspeed in R2.
    KeOPTR_P_HysA_N3
      parameter data prototype KeOPTR_P_HysA_N3: category=VALUE, sw-calibration-access=READ-WRITE, type=Float  # This calibration defines the O point for OPTL_DtrmnOptToTaTb\ngear type library as a function of motor A shaft speed and output shaft\nspeed in R2.
    KeOPTR_P_HysB_Const
      parameter data prototype KeOPTR_P_HysB_Const: category=VALUE, sw-calibration-access=READ-WRITE, type=Float  # This calibration defines the O point for OPTL_DtrmnOptToTaTb\ngear type library as a function of motor A shaft speed and output shaft\nspeed in R2.
    KeOPTR_P_HysB_D7
      parameter data prototype KeOPTR_P_HysB_D7: category=VALUE, sw-calibration-access=READ-WRITE, type=Float  # This calibration defines the O point for OPTL_DtrmnOptToTaTb\ngear type library as a function of motor A shaft speed and output shaft\nspeed in R2.
    KeOPTR_P_HysB_D8
      parameter data prototype KeOPTR_P_HysB_D8: category=VALUE, sw-calibration-access=READ-WRITE, type=Float  # This calibration defines the O point for OPTL_DtrmnOptToTaTb\ngear type library as a function of motor A shaft speed and output shaft\nspeed in R2.
    KeOPTR_P_HysB_D9
      parameter data prototype KeOPTR_P_HysB_D9: category=VALUE, sw-calibration-access=READ-WRITE, type=Float  # This calibration defines the O point for OPTL_DtrmnOptToTaTb\ngear type library as a function of motor A shaft speed and output shaft\nspeed in R2.
    KeOPTR_P_HysB_N
      parameter data prototype KeOPTR_P_HysB_N: category=VALUE, sw-calibration-access=READ-WRITE, type=Float  # This calibration defines the O point for OPTL_DtrmnOptToTaTb\ngear type library as a function of motor A shaft speed and output shaft\nspeed in R2.
    KeOPTR_P_HysB_N1
      parameter data prototype KeOPTR_P_HysB_N1: category=VALUE, sw-calibration-access=READ-WRITE, type=Float  # This calibration defines the O point for OPTL_DtrmnOptToTaTb\ngear type library as a function of motor A shaft speed and output shaft\nspeed in R2.
    KeOPTR_P_HysB_N2
      parameter data prototype KeOPTR_P_HysB_N2: category=VALUE, sw-calibration-access=READ-WRITE, type=Float  # This calibration defines the O point for OPTL_DtrmnOptToTaTb\ngear type library as a function of motor A shaft speed and output shaft\nspeed in R2.
    KeOPTR_P_HysB_N3
      parameter data prototype KeOPTR_P_HysB_N3: category=VALUE, sw-calibration-access=READ-WRITE, type=Float  # This calibration defines the O point for OPTL_DtrmnOptToTaTb\ngear type library as a function of motor A shaft speed and output shaft\nspeed in R2.
    KeOPTR_P_NiMax2NiMinNFZCost
      parameter data prototype KeOPTR_P_NiMax2NiMinNFZCost: category=VALUE, sw-calibration-access=READ-WRITE, type=Float  # Penalty for Idle speed to cross NiMax to NiMin no fly zone.
    KeOPTR_P_NiMin2NiMaxNFZCost
      parameter data prototype KeOPTR_P_NiMin2NiMaxNFZCost: category=VALUE, sw-calibration-access=READ-WRITE, type=Float  # Penalty for Idle speed to cross NiMin to NiMax no fly zone.
    KeOPTR_P_O_Const
      parameter data prototype KeOPTR_P_O_Const: category=VALUE, sw-calibration-access=READ-WRITE, type=Float  # The 1D O calibration for A, B, and O points.
    KeOPTR_P_O_D7
      parameter data prototype KeOPTR_P_O_D7: category=VALUE, sw-calibration-access=READ-WRITE, type=Float  # This calibration defines the O point for OPTL_DtrmnOptToTaTb\ngear type library as a function of motor A shaft speed and output shaft\nspeed in D7.
    KeOPTR_P_O_D8
      parameter data prototype KeOPTR_P_O_D8: category=VALUE, sw-calibration-access=READ-WRITE, type=Float  # This calibration defines the O point for OPTL_DtrmnOptToTaTb\ngear type library as a function of motor A shaft speed and output shaft\nspeed in D8.
    KeOPTR_P_O_D9
      parameter data prototype KeOPTR_P_O_D9: category=VALUE, sw-calibration-access=READ-WRITE, type=Float  # This calibration defines the O point for OPTL_DtrmnOptToTaTb\ngear type library as a function of motor A shaft speed and output shaft\nspeed in D9.
    KeOPTR_P_O_N
      parameter data prototype KeOPTR_P_O_N: category=VALUE, sw-calibration-access=READ-WRITE, type=Float  # This calibration defines the O point for OPTL_DtrmnOptToTaTb\ngear type library as a function of motor A shaft speed and output shaft\nspeed in N.
    KeOPTR_P_O_P
      parameter data prototype KeOPTR_P_O_P: category=VALUE, sw-calibration-access=READ-WRITE, type=Float  # This calibration defines the A point for OPTL_DtrmnOptToTaTb\ngear type library as a function of motor A shaft speed and output shaft\nspeed in N.
    KeOPTR_P_O_R
      parameter data prototype KeOPTR_P_O_R: category=VALUE, sw-calibration-access=READ-WRITE, type=Float  # This calibration defines the O point for OPTL_DtrmnOptToTaTb\ngear type library as a function of motor A shaft speed and output shaft\nspeed in R.
    KeOPTR_P_O_R2
      parameter data prototype KeOPTR_P_O_R2: category=VALUE, sw-calibration-access=READ-WRITE, type=Float  # This calibration defines the O point for OPTL_DtrmnOptToTaTb\ngear type library as a function of motor A shaft speed and output shaft\nspeed in R2.
    KeOPTR_Pct_P2ZeroIdle_2Pdl_Acl_LSP
      parameter data prototype KeOPTR_Pct_P2ZeroIdle_2Pdl_Acl_LSP: category=VALUE, sw-calibration-access=READ-WRITE, type=Float  # Description_Tag_Not_Defined
    KeOPTR_Pct_P2ZeroIdle_2Pdl_Acl_RSP
      parameter data prototype KeOPTR_Pct_P2ZeroIdle_2Pdl_Acl_RSP: category=VALUE, sw-calibration-access=READ-WRITE, type=Float  # Description_Tag_Not_Defined
    KeOPTR_T_MtrALshEnblTmr
      parameter data prototype KeOPTR_T_MtrALshEnblTmr: category=VALUE, sw-calibration-access=READ-WRITE, type=Float
    KeOPTR_T_MtrBLshEnblTmr
      parameter data prototype KeOPTR_T_MtrBLshEnblTmr: category=VALUE, sw-calibration-access=READ-WRITE, type=Float
    KeOPTR_T_ResetTimer
      parameter data prototype KeOPTR_T_ResetTimer: category=VALUE, sw-calibration-access=READ-WRITE, type=Float  # This calibration is used initialize a timer that is used in\na filtering scheme for opt. Ta/Tb in OPTL_DtrmnOptToTaTb.
    KeOPTR_b_1dCostArbEnbl
      parameter data prototype KeOPTR_b_1dCostArbEnbl: category=VALUE, sw-calibration-access=READ-WRITE, type=Boolean  # Use ToMax with start reserve for To penalty calculation in EV range states.
    KeOPTR_b_CntrntTypOvrwrt_En
      parameter data prototype KeOPTR_b_CntrntTypOvrwrt_En: category=VALUE, sw-calibration-access=READ-WRITE, type=Boolean  # Allows an override of the constraint type condition in \nOPTL_ToArbitration_Quadratic_Mode (root selection library)
    KeOPTR_b_ContraintType
      parameter data prototype KeOPTR_b_ContraintType: category=VALUE, sw-calibration-access=READ-WRITE, type=Boolean  # If KeOPTR_b_CntrntTypOvrwrt_En=boolean(1) this calibration\nselects if the gear type condition is boolean(1) or boolean(0) in\nOPTL_ToArbitration_Quadratic_Mode
    KeOPTR_b_EnblEqlMtrPwrSign
      parameter data prototype KeOPTR_b_EnblEqlMtrPwrSign: category=VALUE, sw-calibration-access=READ-WRITE, type=Boolean  # This calibration is used to enable the protected opt. split\nwith A,B, and O calibrations. Both electric motor torques will have the\nsame sign.
    KeOPTR_b_EnblPbattLim4Timpmax
      parameter data prototype KeOPTR_b_EnblPbattLim4Timpmax: category=VALUE, sw-calibration-access=READ-WRITE, type=Boolean  # Enabling battey power limits for Timp_max calculation
    KeOPTR_b_EnblTrqRsrv4CrsActv
      parameter data prototype KeOPTR_b_EnblTrqRsrv4CrsActv: category=VALUE, sw-calibration-access=READ-WRITE, type=Boolean  # Description_Tag_Not_Defined
    KeOPTR_b_ForceDualAxleLash
      parameter data prototype KeOPTR_b_ForceDualAxleLash: category=VALUE, sw-calibration-access=READ-WRITE, type=Boolean
    KeOPTR_b_MtrALatchSEM
      parameter data prototype KeOPTR_b_MtrALatchSEM: category=VALUE, sw-calibration-access=READ-WRITE, type=Boolean  # This calibration is used to enable the feature of freezing\nmtr A torque during SEM events
    KeOPTR_b_OptFiltEnbl
      parameter data prototype KeOPTR_b_OptFiltEnbl: category=VALUE, sw-calibration-access=READ-WRITE, type=Boolean  # This calibration is used to enable an initialization of the\nslope of the opt. line.
    KeOPTR_b_PurgeAdjst_Enbl
      parameter data prototype KeOPTR_b_PurgeAdjst_Enbl: category=VALUE, sw-calibration-access=READ-WRITE, type=Boolean  # Enable Purge Adjustment in Engine Power Loss
    KeOPTR_b_QuadrLimit_Ovr
      parameter data prototype KeOPTR_b_QuadrLimit_Ovr: category=VALUE, sw-calibration-access=READ-WRITE, type=Boolean  # This calibration is used as a condition for open roots\n(case 5) in OPTL_ToArbitration_Quadratic_Mode
    KeOPTR_b_RGS_Threshold_Disable
      parameter data prototype KeOPTR_b_RGS_Threshold_Disable: category=VALUE, sw-calibration-access=READ-WRITE, type=Boolean  # Description_Tag_Not_Defined
    KeOPTR_b_StgcFuelFlowIdlLib
      parameter data prototype KeOPTR_b_StgcFuelFlowIdlLib: category=VALUE, sw-calibration-access=READ-WRITE, type=Boolean  # Use KaOPTR_dm_FuelFlowAllCylStgc fuel flow map for Idle libraries.(MAIdle MBIdle)
    KeOPTR_b_UseG2asMB
      parameter data prototype KeOPTR_b_UseG2asMB: category=VALUE, sw-calibration-access=READ-WRITE, type=Boolean  # This calibration is used as part of the branching strategy \nin OPTL_DtrmnOptToTaTb to utilize the OPTL MB libary for gear type\nTSXR equations.
    KeOPTR_b_UseNewOPTL
      parameter data prototype KeOPTR_b_UseNewOPTL: category=VALUE, sw-calibration-access=READ-WRITE, type=Boolean  # Enables full branching within OPTL_ToArbitration_Quadratic_Mode\nfor root selection.
    KeOPTR_b_UseOrignlOptSplit
      parameter data prototype KeOPTR_b_UseOrignlOptSplit: category=VALUE, sw-calibration-access=READ-WRITE, type=Boolean  # This calibration is used to select the raw opt solution.
    KeOPTR_b_UseStgcFuelFlow
      parameter data prototype KeOPTR_b_UseStgcFuelFlow: category=VALUE, sw-calibration-access=READ-WRITE, type=Boolean  # Use KaOPTR_dm_FuelFlowAllCylStgc fuel flow map for optimization libraries
    KeOPTR_b_UseToNet4ToCost1d
      parameter data prototype KeOPTR_b_UseToNet4ToCost1d: category=VALUE, sw-calibration-access=READ-WRITE, type=Boolean  # Description_Tag_Not_Defined
    KeOPTR_b_ZrPdlToMinAtTeMin
      parameter data prototype KeOPTR_b_ZrPdlToMinAtTeMin: category=VALUE, sw-calibration-access=READ-WRITE, type=Boolean  # Enables use of ToMin calculated at TiMin for zero pedal torque penalty in N/MA/MB range states.
    KeOPTR_dM_DsblLshALULD
      parameter data prototype KeOPTR_dM_DsblLshALULD: category=VALUE, sw-calibration-access=READ-WRITE, type=Float
    KeOPTR_dM_DsblLshBLULD
      parameter data prototype KeOPTR_dM_DsblLshBLULD: category=VALUE, sw-calibration-access=READ-WRITE, type=Float
    KeOPTR_k_NonZeroCoeffThrshld_Neg
      parameter data prototype KeOPTR_k_NonZeroCoeffThrshld_Neg: category=VALUE, sw-calibration-access=READ-WRITE, type=Float  # This calibration is used as a small
    KeOPTR_k_NonZeroCoeffThrshld_Pos
      parameter data prototype KeOPTR_k_NonZeroCoeffThrshld_Pos: category=VALUE, sw-calibration-access=READ-WRITE, type=Float  # This calibration is used as a small (near zero) positive \nnumber within OPTL. This calibration is used for robust comparisons to 0.
    KeOPTR_n_2DSrchRngDeltaNi
      parameter data prototype KeOPTR_n_2DSrchRngDeltaNi: category=VALUE, sw-calibration-access=READ-WRITE, type=Float  # Minimum engine speed range for 2D search during collapsed search limits.
    KeOPTR_n_AltMd_IdleSpd_LD
      parameter data prototype KeOPTR_n_AltMd_IdleSpd_LD: category=VALUE, sw-calibration-access=READ-WRITE, type=Float  # Description_Tag_Not_Defined
    KeOPTR_n_AltMd_IdleSpd_LU
      parameter data prototype KeOPTR_n_AltMd_IdleSpd_LU: category=VALUE, sw-calibration-access=READ-WRITE, type=Float  # Description_Tag_Not_Defined
    KeOPTR_n_AltMd_MinIdleSpd
      parameter data prototype KeOPTR_n_AltMd_MinIdleSpd: category=VALUE, sw-calibration-access=READ-WRITE, type=Float  # Description_Tag_Not_Defined
    KeOPTR_n_NaOffset
      parameter data prototype KeOPTR_n_NaOffset: category=VALUE, sw-calibration-access=READ-WRITE, type=Float  # This calibration is used as in the calculation of a ratio of\nNa to No. This is applied as an offset to Na. This calibration is located\nin the D1 A,B, and O subsystem.
    KeOPTR_n_NegLrgNoThrsh
      parameter data prototype KeOPTR_n_NegLrgNoThrsh: category=VALUE, sw-calibration-access=READ-WRITE, type=Float  # This calibration is used within OPTL_DtrmnOptToTaTb to\ndeclare neg switching (output shaft speed is less than\nKeOPTR_n_NegLrgNoThrsh). This is used as a factor for selecting roots.
    KeOPTR_n_NiMinThrsh_ToOpenSrch
      parameter data prototype KeOPTR_n_NiMinThrsh_ToOpenSrch: category=VALUE, sw-calibration-access=READ-WRITE, type=Float  # Engine speed threshold below which the\nKeSCOR_n_2DSrchRngDeltaNi is added to maximum engine speed limit when constraints and search limit conflict.
    KeOPTR_n_P2Idle_ZeroRPM
      parameter data prototype KeOPTR_n_P2Idle_ZeroRPM: category=VALUE, sw-calibration-access=READ-WRITE, type=Float  # Description_Tag_Not_Defined
    KeOPTR_n_P2MinIdle_TransMinSpd_LSP
      parameter data prototype KeOPTR_n_P2MinIdle_TransMinSpd_LSP: category=VALUE, sw-calibration-access=READ-WRITE, type=Float  # Offset to P2MinIdleSpd for Trans Min Input Speed LSP threshold
    KeOPTR_n_P2MinIdle_TransMinSpd_RSP
      parameter data prototype KeOPTR_n_P2MinIdle_TransMinSpd_RSP: category=VALUE, sw-calibration-access=READ-WRITE, type=Float  # Offset to P2MinIdleSpd for Trans Min Input Speed RSP threshold
    KeOPTR_n_P2ZeroIdle_NoMax_LSP
      parameter data prototype KeOPTR_n_P2ZeroIdle_NoMax_LSP: category=VALUE, sw-calibration-access=READ-WRITE, type=Float  # Description_Tag_Not_Defined
    KeOPTR_n_P2ZeroIdle_NoMax_RSP
      parameter data prototype KeOPTR_n_P2ZeroIdle_NoMax_RSP: category=VALUE, sw-calibration-access=READ-WRITE, type=Float  # Description_Tag_Not_Defined
    KeOPTR_n_PosLrgNoThrsh
      parameter data prototype KeOPTR_n_PosLrgNoThrsh: category=VALUE, sw-calibration-access=READ-WRITE, type=Float  # Description_Tag_Not_Defined
    KeOPTR_n_PwrPnlCapNi
      parameter data prototype KeOPTR_n_PwrPnlCapNi: category=VALUE, sw-calibration-access=READ-WRITE, type=Float  # Description_Tag_Not_Defined
    KeOPTR_n_RGS_ActivationThreshold
      parameter data prototype KeOPTR_n_RGS_ActivationThreshold: category=VALUE, sw-calibration-access=READ-WRITE, type=Float  # Description_Tag_Not_Defined
    KeOPTR_n_RGS_IdleSpd
      parameter data prototype KeOPTR_n_RGS_IdleSpd: category=VALUE, sw-calibration-access=READ-WRITE, type=Float  # Description_Tag_Not_Defined
    KeOPTR_phi_SWAThresh
      parameter data prototype KeOPTR_phi_SWAThresh: category=VALUE, sw-calibration-access=READ-WRITE, type=Float  # SWA Threshold in degrees
    KeOPTR_r_2DSrch_NiTiFctrMin
      parameter data prototype KeOPTR_r_2DSrch_NiTiFctrMin: category=VALUE, sw-calibration-access=READ-WRITE, type=Float  # Minimum NiTi Factor to invoke 2D search of NiTi points.
    KeOPTR_r_BatPwrLossCost
      parameter data prototype KeOPTR_r_BatPwrLossCost: category=VALUE, sw-calibration-access=READ-WRITE, type=Float  # Battery Power Loss Cost Factor
    KeOPTR_r_BatPwrLossCost_Subj
      parameter data prototype KeOPTR_r_BatPwrLossCost_Subj: category=VALUE, sw-calibration-access=READ-WRITE, type=Float  # Subjective Battery Power Loss Cost Factor
    KeOPTR_r_CTMPenaltyFactFF
      parameter data prototype KeOPTR_r_CTMPenaltyFactFF: category=VALUE, sw-calibration-access=READ-WRITE, type=Float  # CTM penalty factor for Full Fuel optimization libraries (keep on for P1P2)
    KeOPTR_r_CTMPenaltyFactZF
      parameter data prototype KeOPTR_r_CTMPenaltyFactZF: category=VALUE, sw-calibration-access=READ-WRITE, type=Float  # CTM penalty factor for Zero Fuel optimization libraries (keep on for P1P2)
    KeOPTR_r_ClutchLossCostFactor
      parameter data prototype KeOPTR_r_ClutchLossCostFactor: category=VALUE, sw-calibration-access=READ-WRITE, type=Float  # Cost factor for physical clutch power losses
    KeOPTR_r_EngPwrLossCostFactor
      parameter data prototype KeOPTR_r_EngPwrLossCostFactor: category=VALUE, sw-calibration-access=READ-WRITE, type=Float  # Cost factor for physical engine power losses
    KeOPTR_r_FLDBattUseCost_Fact
      parameter data prototype KeOPTR_r_FLDBattUseCost_Fact: category=VALUE, sw-calibration-access=READ-WRITE, type=Float  # Description_Tag_Not_Defined
    KeOPTR_r_FLDCCW_Fact
      parameter data prototype KeOPTR_r_FLDCCW_Fact: category=VALUE, sw-calibration-access=READ-WRITE, type=Float  # Description_Tag_Not_Defined
    KeOPTR_r_FLDCTD_Fact
      parameter data prototype KeOPTR_r_FLDCTD_Fact: category=VALUE, sw-calibration-access=READ-WRITE, type=Float  # Description_Tag_Not_Defined
    KeOPTR_r_FLDEngUseCost_Fact
      parameter data prototype KeOPTR_r_FLDEngUseCost_Fact: category=VALUE, sw-calibration-access=READ-WRITE, type=Float  # Description_Tag_Not_Defined
    KeOPTR_r_FLDTiVld_Fact
      parameter data prototype KeOPTR_r_FLDTiVld_Fact: category=VALUE, sw-calibration-access=READ-WRITE, type=Float  # Description_Tag_Not_Defined
    KeOPTR_r_LSPforGamma
      parameter data prototype KeOPTR_r_LSPforGamma: category=VALUE, sw-calibration-access=READ-WRITE, type=Float  # Used as LSP for Gamma hysteresis block
    KeOPTR_r_MtrTrqMaxPenaltyFact
      parameter data prototype KeOPTR_r_MtrTrqMaxPenaltyFact: category=VALUE, sw-calibration-access=READ-WRITE, type=Float  # Maximum motor torque voilation penalty factor.
    KeOPTR_r_MtrTrqMinPenaltyFact
      parameter data prototype KeOPTR_r_MtrTrqMinPenaltyFact: category=VALUE, sw-calibration-access=READ-WRITE, type=Float  # Minimum motor torque voilation penalty factor.
    KeOPTR_r_NatoNo_D1
      parameter data prototype KeOPTR_r_NatoNo_D1: category=VALUE, sw-calibration-access=READ-WRITE, type=Float  # This calibration is used as a comparison to the actual Na to\nNo speed ratio in the D1 A,B, and O subsystem
    KeOPTR_r_NiColdPnlty_Fact
      parameter data prototype KeOPTR_r_NiColdPnlty_Fact: category=VALUE, sw-calibration-access=READ-WRITE, type=Float  # Engine speed penalty factor during catalyst warmup
    KeOPTR_r_NiMaxPenaltyFact
      parameter data prototype KeOPTR_r_NiMaxPenaltyFact: category=VALUE, sw-calibration-access=READ-WRITE, type=Float  # Input speed penalty gain for maximum input speed soft limit voilation.
    KeOPTR_r_NiMinPenaltyFact
      parameter data prototype KeOPTR_r_NiMinPenaltyFact: category=VALUE, sw-calibration-access=READ-WRITE, type=Float  # Input speed penalty gain for minimum input speed soft limit voilation.
    KeOPTR_r_NiTiFctrMin
      parameter data prototype KeOPTR_r_NiTiFctrMin: category=VALUE, sw-calibration-access=READ-WRITE, type=Float  # Minimum threshold for NiTi factors to be active.
    KeOPTR_r_NoMaxPenaltyFact
      parameter data prototype KeOPTR_r_NoMaxPenaltyFact: category=VALUE, sw-calibration-access=READ-WRITE, type=Float  # Output speed penalty gain for maximum output speed soft limit voilation.
    KeOPTR_r_NoMinPenaltyFact
      parameter data prototype KeOPTR_r_NoMinPenaltyFact: category=VALUE, sw-calibration-access=READ-WRITE, type=Float  # Output speed penalty gain for minimum output speed soft limit voilation.
    KeOPTR_r_OptTrqSpltFiltT
      parameter data prototype KeOPTR_r_OptTrqSpltFiltT: category=VALUE, sw-calibration-access=READ-WRITE, type=Float  # This cal is used as the filter\ntime constant for the U, V, and V_Raw LPF
    KeOPTR_r_PenaltyFact
      parameter data prototype KeOPTR_r_PenaltyFact: category=VALUE, sw-calibration-access=READ-WRITE, type=Float  # Generic penalty factor
    KeOPTR_r_PreSelZeroPedCost
      parameter data prototype KeOPTR_r_PreSelZeroPedCost: category=VALUE, sw-calibration-access=READ-WRITE, type=Float  # Zero pedal cost gain.
    KeOPTR_r_PwrConvFctr_V2L
      parameter data prototype KeOPTR_r_PwrConvFctr_V2L: category=VALUE, sw-calibration-access=READ-WRITE, type=Float  # Description_Tag_Not_Defined
    KeOPTR_r_RSPforGamma
      parameter data prototype KeOPTR_r_RSPforGamma: category=VALUE, sw-calibration-access=READ-WRITE, type=Float  # Used as LSP for Gamma hysteresis block
    KeOPTR_r_TLFMaxCostFactor
      parameter data prototype KeOPTR_r_TLFMaxCostFactor: category=VALUE, sw-calibration-access=READ-WRITE, type=Float  # TLF penalty cost factor for maximum TLF voilation.
    KeOPTR_r_TLFMinCostFactor
      parameter data prototype KeOPTR_r_TLFMinCostFactor: category=VALUE, sw-calibration-access=READ-WRITE, type=Float  # TLF penalty cost factor for minimum TLF voilation.
    KeOPTR_r_TLF_Reserve
      parameter data prototype KeOPTR_r_TLF_Reserve: category=VALUE, sw-calibration-access=READ-WRITE, type=Float  # Torque reserve for TLF max penalty.
    KeOPTR_r_TiColdPnlty_Fact
      parameter data prototype KeOPTR_r_TiColdPnlty_Fact: category=VALUE, sw-calibration-access=READ-WRITE, type=Float  # Engine torque penalty factor during catalyst warmup
    KeOPTR_r_TiMaxPenaltyFact
      parameter data prototype KeOPTR_r_TiMaxPenaltyFact: category=VALUE, sw-calibration-access=READ-WRITE, type=Float  # Penalty factor for maximum engine torque limit voilation.
    KeOPTR_r_TiMinPenaltyFact
      parameter data prototype KeOPTR_r_TiMinPenaltyFact: category=VALUE, sw-calibration-access=READ-WRITE, type=Float  # Penalty factor for minimum engine torque limit voilation.
    KeOPTR_r_ToFMaxCostFactor
      parameter data prototype KeOPTR_r_ToFMaxCostFactor: category=VALUE, sw-calibration-access=READ-WRITE, type=Float  # ToF penalty cost factor for maximum ToF voilation.
    KeOPTR_r_ToFMinCostFactor
      parameter data prototype KeOPTR_r_ToFMinCostFactor: category=VALUE, sw-calibration-access=READ-WRITE, type=Float  # ToF penalty cost factor for minimum ToF voilation.
    KeOPTR_r_ToF_Reserve
      parameter data prototype KeOPTR_r_ToF_Reserve: category=VALUE, sw-calibration-access=READ-WRITE, type=Float  # Torque reserve for ToF max penalty.
    KeOPTR_r_ToMaxCostFactor
      parameter data prototype KeOPTR_r_ToMaxCostFactor: category=VALUE, sw-calibration-access=READ-WRITE, type=Float  # Cost factor for subjective quadrative ToMax violation costs
    KeOPTR_r_ToMaxIdleRsrvCostFactor
      parameter data prototype KeOPTR_r_ToMaxIdleRsrvCostFactor: category=VALUE, sw-calibration-access=READ-WRITE, type=Float  # Cost factor for physical transmission power losses
    KeOPTR_r_ToMinCostFactor
      parameter data prototype KeOPTR_r_ToMinCostFactor: category=VALUE, sw-calibration-access=READ-WRITE, type=Float  # Cost factor for subjective quadrative ToMin violation costs
    KeOPTR_r_ToRMaxCostFactor
      parameter data prototype KeOPTR_r_ToRMaxCostFactor: category=VALUE, sw-calibration-access=READ-WRITE, type=Float  # ToR penalty cost factor for maximum ToR voilation.
    KeOPTR_r_ToRMinCostFactor
      parameter data prototype KeOPTR_r_ToRMinCostFactor: category=VALUE, sw-calibration-access=READ-WRITE, type=Float  # ToR penalty cost factor for minimum ToR voilation.
    KeOPTR_r_ToR_Reserve
      parameter data prototype KeOPTR_r_ToR_Reserve: category=VALUE, sw-calibration-access=READ-WRITE, type=Float  # Torque reserve for ToR max penalty.
    KeOPTR_r_TransPwrLossCostFactor
      parameter data prototype KeOPTR_r_TransPwrLossCostFactor: category=VALUE, sw-calibration-access=READ-WRITE, type=Float  # Cost factor for physical transmission power losses
    KeOPTR_r_ZeroPedalCostFactor
      parameter data prototype KeOPTR_r_ZeroPedalCostFactor: category=VALUE, sw-calibration-access=READ-WRITE, type=Float  # Cost factor for ToMin penalty in EVM EVN.
    KeOPTR_t_BrkTrq_TstDer_CutOffT
      parameter data prototype KeOPTR_t_BrkTrq_TstDer_CutOffT: category=VALUE, sw-calibration-access=READ-WRITE, type=Float  # Description_Tag_Not_Defined
    KeOPTR_t_DelayTimeToggle
      parameter data prototype KeOPTR_t_DelayTimeToggle: category=VALUE, sw-calibration-access=READ-WRITE, type=Float  # Description_Tag_Not_Defined
    KeOPTR_t_NidotDeltaTime
      parameter data prototype KeOPTR_t_NidotDeltaTime: category=VALUE, sw-calibration-access=READ-WRITE, type=Float  # Delta time gain for Nidot to offset Niold.
    KeOPTR_t_QuadJumpRampTime
      parameter data prototype KeOPTR_t_QuadJumpRampTime: category=VALUE, sw-calibration-access=READ-WRITE, type=Float  # This calibration is used as part of an iterpolation scheme\nin OPTL_DtrmnOptToTaTb within the ToMin/Max calculation in the MB\nlibrary. It is used for scenarios when the root
    KeOPTR_t_RGS_Delay
      parameter data prototype KeOPTR_t_RGS_Delay: category=VALUE, sw-calibration-access=READ-WRITE, type=Float  # Description_Tag_Not_Defined
    KeOPTR_t_RGS_DelayTimeNTurb
      parameter data prototype KeOPTR_t_RGS_DelayTimeNTurb: category=VALUE, sw-calibration-access=READ-WRITE, type=Float  # Description_Tag_Not_Defined
    KeOPTR_t_ToMaxRampTime
      parameter data prototype KeOPTR_t_ToMaxRampTime: category=VALUE, sw-calibration-access=READ-WRITE, type=Float  # This is used within the OPTL root selection library (OPTL_ToArbitration_Quadratic_Mode) as part of an interpolation scheme. This calibration is used as the IV for the timer that is used to interpolate ToMax when the system switches root cases.
    KeOPTR_t_ToMinRampTime
      parameter data prototype KeOPTR_t_ToMinRampTime: category=VALUE, sw-calibration-access=READ-WRITE, type=Float  # This is used within the OPTL root selection library (OPTL_ToArbitration_Quadratic_Mode) as part of an interpolation scheme. This calibration is used as the IV for the timer that is used to interpolate ToMin when the system switches root cases.
    KeTHMR_b_TurtleMd_SelDial
      parameter data prototype KeTHMR_b_TurtleMd_SelDial: category=VALUE, sw-calibration-access=READ-WRITE, type=Boolean  # This cal is to override the signal turtle mode for testing\npurpose
    KeTHMR_e_TurtleMd_Dial
      parameter data prototype KeTHMR_e_TurtleMd_Dial: category=VALUE, sw-calibration-access=READ-WRITE, type=TeDMDR_e_TurtleMdSts  # Description_Tag_Not_Defined
    KeTISR_r_M2_NiFromNa_NCnDep
      parameter data prototype KeTISR_r_M2_NiFromNa_NCnDep: category=VALUE, sw-calibration-access=READ-WRITE, type=Float  # Ratio of the mean of connection (belt, gear..) between Motor A and the Engine in M2 case
    KeTSXR_D_Ba
      parameter data prototype KeTSXR_D_Ba: category=VALUE, sw-calibration-access=READ-WRITE, type=Float  # Description_Tag_Not_Defined
    KeTSXR_D_Bb
      parameter data prototype KeTSXR_D_Bb: category=VALUE, sw-calibration-access=READ-WRITE, type=Float  # Description_Tag_Not_Defined
    KeTSXR_D_Be
      parameter data prototype KeTSXR_D_Be: category=VALUE, sw-calibration-access=READ-WRITE, type=Float  # Description_Tag_Not_Defined
    KeTSXR_D_ExternWEDMtrDmpng
      parameter data prototype KeTSXR_D_ExternWEDMtrDmpng: category=VALUE, sw-calibration-access=READ-WRITE, type=Float  # WED motor damping
    KeTSXR_J_ExternWEDMtrInertia
      parameter data prototype KeTSXR_J_ExternWEDMtrInertia: category=VALUE, sw-calibration-access=READ-WRITE, type=Float  # WED Motor inertia
    KeTSXR_J_Ia
      parameter data prototype KeTSXR_J_Ia: category=VALUE, sw-calibration-access=READ-WRITE, type=Float  # Description_Tag_Not_Defined
    KeTSXR_J_Ib
      parameter data prototype KeTSXR_J_Ib: category=VALUE, sw-calibration-access=READ-WRITE, type=Float  # Motor B intertia within TSXR plant
    KeTSXR_J_Ie
      parameter data prototype KeTSXR_J_Ie: category=VALUE, sw-calibration-access=READ-WRITE, type=Float  # Description_Tag_Not_Defined
    KeTSXR_r_All_FDRratio
      parameter data prototype KeTSXR_r_All_FDRratio: category=VALUE, sw-calibration-access=READ-WRITE, type=Float  # Description_Tag_Not_Defined
    KeTSXR_r_FDRf
      parameter data prototype KeTSXR_r_FDRf: category=VALUE, sw-calibration-access=READ-WRITE, type=Float  # Description_Tag_Not_Defined
    KeTSXR_r_FDRr
      parameter data prototype KeTSXR_r_FDRr: category=VALUE, sw-calibration-access=READ-WRITE, type=Float  # Description_Tag_Not_Defined
    KeTSXR_r_NaFixRatioNi
      parameter data prototype KeTSXR_r_NaFixRatioNi: category=VALUE, sw-calibration-access=READ-WRITE, type=Float  # Description_Tag_Not_Defined
    KeTSXR_r_NbFixRatioNi
      parameter data prototype KeTSXR_r_NbFixRatioNi: category=VALUE, sw-calibration-access=READ-WRITE, type=Float  # Description_Tag_Not_Defined
    KeTSXR_r_NcFixRatioNi
      parameter data prototype KeTSXR_r_NcFixRatioNi: category=VALUE, sw-calibration-access=READ-WRITE, type=Float  # Description_Tag_Not_Defined
    KeTSXR_r_P1f
      parameter data prototype KeTSXR_r_P1f: category=VALUE, sw-calibration-access=READ-WRITE, type=Float  # Description_Tag_Not_Defined
    KeTSXR_r_P2p5
      parameter data prototype KeTSXR_r_P2p5: category=VALUE, sw-calibration-access=READ-WRITE, type=Float  # Description_Tag_Not_Defined
    KtCTCR_k_CreepCancelBlend
      parameter data prototype KtCTCR_k_CreepCancelBlend: category=MAP, sw-calibration-access=READ-WRITE, type=Appl_KtCTCR_k_CreepCancelBlend  # Min Creep blend factor based on vehicle Speed and\nDrvrIntndTotBrkOutTrq
    KtHSCR_K_LowSpdDnyRgnFrntMinTrq
      parameter data prototype KtHSCR_K_LowSpdDnyRgnFrntMinTrq: category=CURVE, sw-calibration-access=READ-WRITE, type=Appl_KtHSCR_K_LowSpdDnyRgnFrntMinTrq  # based on front axle speed deny regen at low speed at 5kph,\nstart limitation at 8kph , as gain factor K for RearMin\nThis cal is not used on any vehicle program on Jun 25, 2021.\nt8445M0: Three Motor Update KtHSCR_K_LowSpdDnyRgnRrMinTrq_MtrA -> KtHSCR_K_L
    KtHSCR_K_LowSpdDnyRgnRrMinTrq
      parameter data prototype KtHSCR_K_LowSpdDnyRgnRrMinTrq: category=CURVE, sw-calibration-access=READ-WRITE, type=Appl_KtHSCR_K_LowSpdDnyRgnRrMinTrq  # based on rear axle speed, deny regen at low speed at 5kph,\nstart limitation at 8kph , as gain factor K for RearMin\nt8445M0: Three Motor Update KtHSCR_K_LowSpdDnyRgnRrMinTrq_MtrB -> KtHSCR_K_LowSpdDnyRgnRrMinTrq\n
    KtHSCR_M_Motor_Torque_Max_MtrA
      parameter data prototype KtHSCR_M_Motor_Torque_Max_MtrA: category=CURVE, sw-calibration-access=READ-WRITE, type=Appl_KtHSCR_M_Motor_Torque_Max_MtrA  # Cal table to show the maximum motor A torque [Nm] as a function of shaftspeed [rpm].
    KtHSCR_M_Motor_Torque_Max_MtrB
      parameter data prototype KtHSCR_M_Motor_Torque_Max_MtrB: category=CURVE, sw-calibration-access=READ-WRITE, type=Appl_KtHSCR_M_Motor_Torque_Max_MtrB  # Description_Tag_Not_Defined
    KtHSCR_M_Motor_Torque_Max_MtrC
      parameter data prototype KtHSCR_M_Motor_Torque_Max_MtrC: category=CURVE, sw-calibration-access=READ-WRITE, type=Appl_KtHSCR_M_Motor_Torque_Max_MtrC  # Description_Tag_Not_Defined
    KtHSCR_M_Motor_Torque_Min_MtrA
      parameter data prototype KtHSCR_M_Motor_Torque_Min_MtrA: category=CURVE, sw-calibration-access=READ-WRITE, type=Appl_KtHSCR_M_Motor_Torque_Min_MtrA  # Cal table to show the minimum motor A torque [Nm] as a function of shaftspeed [rpm].
    KtHSCR_M_Motor_Torque_Min_MtrB
      parameter data prototype KtHSCR_M_Motor_Torque_Min_MtrB: category=CURVE, sw-calibration-access=READ-WRITE, type=Appl_KtHSCR_M_Motor_Torque_Min_MtrB  # Cal table to show the minimum motor B torque [Nm] as a function of shaftspeed [rpm].
    KtHSCR_M_Motor_Torque_Min_MtrC
      parameter data prototype KtHSCR_M_Motor_Torque_Min_MtrC: category=CURVE, sw-calibration-access=READ-WRITE, type=Appl_KtHSCR_M_Motor_Torque_Min_MtrC  # Description_Tag_Not_Defined
    KtHSCR_M_TCC_TorqImp
      parameter data prototype KtHSCR_M_TCC_TorqImp: category=MAP, sw-calibration-access=READ-WRITE, type=Appl_KtHSCR_M_TCC_TorqImp  # TCC impeller torque based on impeller speed and\nspeed ratio.
    KtHSCR_M_ToRrMaxCstRvrs
      parameter data prototype KtHSCR_M_ToRrMaxCstRvrs: category=CURVE, sw-calibration-access=READ-WRITE, type=Appl_KtHSCR_M_ToRrMaxCstRvrs  # for coast open limit for torque output rear maximum
    KtHSCR_M_ToRrMinCst
      parameter data prototype KtHSCR_M_ToRrMinCst: category=CURVE, sw-calibration-access=READ-WRITE, type=Appl_KtHSCR_M_ToRrMinCst  # for coast open limit for torque output rear minimum
    KtHSCR_r_TCC_Nc2FromTturb_CoeffsA
      parameter data prototype KtHSCR_r_TCC_Nc2FromTturb_CoeffsA: category=CURVE, sw-calibration-access=READ-WRITE, type=Appl_KtHSCR_r_TCC_Nc2FromTturb_CoeffsA  # Table of A Coeffienct of the Coast FTC
    KtHSCR_r_TCC_Nc2FromTturb_CoeffsB
      parameter data prototype KtHSCR_r_TCC_Nc2FromTturb_CoeffsB: category=CURVE, sw-calibration-access=READ-WRITE, type=Appl_KtHSCR_r_TCC_Nc2FromTturb_CoeffsB  # Table for B Coeffienct of the Coast FTC
    KtHSCR_r_TCC_Nc2FromTturb_CoeffsC
      parameter data prototype KtHSCR_r_TCC_Nc2FromTturb_CoeffsC: category=CURVE, sw-calibration-access=READ-WRITE, type=Appl_KtHSCR_r_TCC_Nc2FromTturb_CoeffsC  # Table for C Coeffienct of the Coast FTC
    KtHSCR_r_TCC_TorqRatio
      parameter data prototype KtHSCR_r_TCC_TorqRatio: category=CURVE, sw-calibration-access=READ-WRITE, type=Appl_KtHSCR_r_TCC_TorqRatio  # TCC torque ratio based on speed ratio.
    KtHSCR_r_TCC_TturbFromNC2_CoeffsA
      parameter data prototype KtHSCR_r_TCC_TturbFromNC2_CoeffsA: category=CURVE, sw-calibration-access=READ-WRITE, type=Appl_KtHSCR_r_TCC_TturbFromNC2_CoeffsA  # Emperical TCC model (Tturb=A*NC2^2+B*NC2+C) coefficient A function Nturb. Needs to\nchange with KtHSCR_r_TCC_TorqRatio.
    KtHSCR_r_TCC_TturbFromNC2_CoeffsB
      parameter data prototype KtHSCR_r_TCC_TturbFromNC2_CoeffsB: category=CURVE, sw-calibration-access=READ-WRITE, type=Appl_KtHSCR_r_TCC_TturbFromNC2_CoeffsB  # Emperical TCC model (Tturb=A*NC2^2+B*NC2+C) coefficient B function Nturb. Needs to\nchange with KtSCOR_r_TCC_TorqRatio.
    KtHSCR_r_TCC_TturbFromNC2_CoeffsC
      parameter data prototype KtHSCR_r_TCC_TturbFromNC2_CoeffsC: category=CURVE, sw-calibration-access=READ-WRITE, type=Appl_KtHSCR_r_TCC_TturbFromNC2_CoeffsC  # Emperical TCC model (Tturb=A*NC2^2+B*NC2+C) coefficient C function Nturb. Needs to\nchange with KtHSCR_r_TCC_TorqRatio.
    KtHSER_dn_NiRtLim
      parameter data prototype KtHSER_dn_NiRtLim: category=CURVE, sw-calibration-access=READ-WRITE, type=Appl_KtHSER_dn_NiRtLim  # Input speed rate limit
    KtOPTR_M_DOD_AllCyl_Threshld
      parameter data prototype KtOPTR_M_DOD_AllCyl_Threshld: category=CURVE, sw-calibration-access=READ-WRITE, type=Appl_KtOPTR_M_DOD_AllCyl_Threshld  # Input speed based maximum engine torque threshold for\nallowing DOD.
    KtOPTR_M_P2ZeroIdle_BrkTrqThres
      parameter data prototype KtOPTR_M_P2ZeroIdle_BrkTrqThres: category=CURVE, sw-calibration-access=READ-WRITE, type=Appl_KtOPTR_M_P2ZeroIdle_BrkTrqThres  # Description_Tag_Not_Defined
    KtOPTR_M_Ti4Start
      parameter data prototype KtOPTR_M_Ti4Start: category=MAP, sw-calibration-access=READ-WRITE, type=Appl_KtOPTR_M_Ti4Start  # Description_Tag_Not_Defined
    KtOPTR_M_Ti4StartEVMd
      parameter data prototype KtOPTR_M_Ti4StartEVMd: category=MAP, sw-calibration-access=READ-WRITE, type=Appl_KtOPTR_M_Ti4StartEVMd  # Description_Tag_Not_Defined
    KtOPTR_P_A_BEV
      parameter data prototype KtOPTR_P_A_BEV: category=CURVE, sw-calibration-access=READ-WRITE, type=Appl_KtOPTR_P_A_BEV  # The A calibration table that is a function of output shaft\nspeed and motor A shaft speed for A, B, and O points.
    KtOPTR_P_B_BEV
      parameter data prototype KtOPTR_P_B_BEV: category=CURVE, sw-calibration-access=READ-WRITE, type=Appl_KtOPTR_P_B_BEV  # The B calibration table that is a function of output shaft\nspeed and motor A shaft speed for A, B, and O points.
    KtOPTR_P_HysA_BEV
      parameter data prototype KtOPTR_P_HysA_BEV: category=CURVE, sw-calibration-access=READ-WRITE, type=Appl_KtOPTR_P_HysA_BEV  # This calibration defines the B point for OPTL_DtrmnOptToTaTb\ngear type library as a function of motor A shaft speed and output shaft\nspeed in D6.
    KtOPTR_P_HysA_D1
      parameter data prototype KtOPTR_P_HysA_D1: category=CURVE, sw-calibration-access=READ-WRITE, type=Appl_KtOPTR_P_HysA_D1  # This calibration defines the B point for OPTL_DtrmnOptToTaTb\ngear type library as a function of motor A shaft speed and output shaft\nspeed in D6.
    KtOPTR_P_HysA_D2
      parameter data prototype KtOPTR_P_HysA_D2: category=CURVE, sw-calibration-access=READ-WRITE, type=Appl_KtOPTR_P_HysA_D2  # This calibration defines the B point for OPTL_DtrmnOptToTaTb\ngear type library as a function of motor A shaft speed and output shaft\nspeed in D6.
    KtOPTR_P_HysA_D3
      parameter data prototype KtOPTR_P_HysA_D3: category=CURVE, sw-calibration-access=READ-WRITE, type=Appl_KtOPTR_P_HysA_D3  # This calibration defines the B point for OPTL_DtrmnOptToTaTb\ngear type library as a function of motor A shaft speed and output shaft\nspeed in D6.
    KtOPTR_P_HysA_D4
      parameter data prototype KtOPTR_P_HysA_D4: category=CURVE, sw-calibration-access=READ-WRITE, type=Appl_KtOPTR_P_HysA_D4  # This calibration defines the B point for OPTL_DtrmnOptToTaTb\ngear type library as a function of motor A shaft speed and output shaft\nspeed in D6.
    KtOPTR_P_HysA_D5
      parameter data prototype KtOPTR_P_HysA_D5: category=CURVE, sw-calibration-access=READ-WRITE, type=Appl_KtOPTR_P_HysA_D5  # This calibration defines the B point for OPTL_DtrmnOptToTaTb\ngear type library as a function of motor A shaft speed and output shaft\nspeed in D6.
    KtOPTR_P_HysA_D6
      parameter data prototype KtOPTR_P_HysA_D6: category=CURVE, sw-calibration-access=READ-WRITE, type=Appl_KtOPTR_P_HysA_D6  # This calibration defines the B point for OPTL_DtrmnOptToTaTb\ngear type library as a function of motor A shaft speed and output shaft\nspeed in D6.
    KtOPTR_P_HysB_BEV
      parameter data prototype KtOPTR_P_HysB_BEV: category=CURVE, sw-calibration-access=READ-WRITE, type=Appl_KtOPTR_P_HysB_BEV  # This calibration defines the B point for OPTL_DtrmnOptToTaTb\ngear type library as a function of motor A shaft speed and output shaft\nspeed in D6.
    KtOPTR_P_HysB_D1
      parameter data prototype KtOPTR_P_HysB_D1: category=CURVE, sw-calibration-access=READ-WRITE, type=Appl_KtOPTR_P_HysB_D1  # This calibration defines the B point for OPTL_DtrmnOptToTaTb\ngear type library as a function of motor A shaft speed and output shaft\nspeed in D6.
    KtOPTR_P_HysB_D2
      parameter data prototype KtOPTR_P_HysB_D2: category=CURVE, sw-calibration-access=READ-WRITE, type=Appl_KtOPTR_P_HysB_D2  # This calibration defines the B point for OPTL_DtrmnOptToTaTb\ngear type library as a function of motor A shaft speed and output shaft\nspeed in D6.
    KtOPTR_P_HysB_D3
      parameter data prototype KtOPTR_P_HysB_D3: category=CURVE, sw-calibration-access=READ-WRITE, type=Appl_KtOPTR_P_HysB_D3  # This calibration defines the B point for OPTL_DtrmnOptToTaTb\ngear type library as a function of motor A shaft speed and output shaft\nspeed in D6.
    KtOPTR_P_HysB_D4
      parameter data prototype KtOPTR_P_HysB_D4: category=CURVE, sw-calibration-access=READ-WRITE, type=Appl_KtOPTR_P_HysB_D4  # This calibration defines the B point for OPTL_DtrmnOptToTaTb\ngear type library as a function of motor A shaft speed and output shaft\nspeed in D6.
    KtOPTR_P_HysB_D5
      parameter data prototype KtOPTR_P_HysB_D5: category=CURVE, sw-calibration-access=READ-WRITE, type=Appl_KtOPTR_P_HysB_D5  # This calibration defines the B point for OPTL_DtrmnOptToTaTb\ngear type library as a function of motor A shaft speed and output shaft\nspeed in D6.
    KtOPTR_P_HysB_D6
      parameter data prototype KtOPTR_P_HysB_D6: category=CURVE, sw-calibration-access=READ-WRITE, type=Appl_KtOPTR_P_HysB_D6  # This calibration defines the B point for OPTL_DtrmnOptToTaTb\ngear type library as a function of motor A shaft speed and output shaft\nspeed in D6.
    KtOPTR_P_O_BEV
      parameter data prototype KtOPTR_P_O_BEV: category=CURVE, sw-calibration-access=READ-WRITE, type=Appl_KtOPTR_P_O_BEV  # The O calibration table that is a function of output shaft\nspeed and motor A shaft speed for A, B, and O points.
    KtOPTR_P_OptTa_A_D1
      parameter data prototype KtOPTR_P_OptTa_A_D1: category=MAP, sw-calibration-access=READ-WRITE, type=Appl_KtOPTR_P_OptTa_A_D1  # This calibration defines the A point for OPTL_DtrmnOptToTaTb\ngear type library as a function of motor A shaft speed and output shaft\nspeed in D1.
    KtOPTR_P_OptTa_A_D2
      parameter data prototype KtOPTR_P_OptTa_A_D2: category=MAP, sw-calibration-access=READ-WRITE, type=Appl_KtOPTR_P_OptTa_A_D2  # This calibration defines the A point for OPTL_DtrmnOptToTaTb\ngear type library as a function of motor A shaft speed and output shaft\nspeed in D2.
    KtOPTR_P_OptTa_A_D4
      parameter data prototype KtOPTR_P_OptTa_A_D4: category=MAP, sw-calibration-access=READ-WRITE, type=Appl_KtOPTR_P_OptTa_A_D4  # This calibration defines the A point for OPTL_DtrmnOptToTaTb\ngear type library as a function of motor A shaft speed and output shaft\nspeed in D4.
    KtOPTR_P_OptTa_A_D5
      parameter data prototype KtOPTR_P_OptTa_A_D5: category=MAP, sw-calibration-access=READ-WRITE, type=Appl_KtOPTR_P_OptTa_A_D5  # This calibration defines the A point for OPTL_DtrmnOptToTaTb\ngear type library as a function of motor A shaft speed and output shaft\nspeed in D5.
    KtOPTR_P_OptTa_A_D6
      parameter data prototype KtOPTR_P_OptTa_A_D6: category=MAP, sw-calibration-access=READ-WRITE, type=Appl_KtOPTR_P_OptTa_A_D6  # This calibration defines the A point for OPTL_DtrmnOptToTaTb\ngear type library as a function of motor A shaft speed and output shaft\nspeed in D6.
    KtOPTR_P_OptTa_B_D1
      parameter data prototype KtOPTR_P_OptTa_B_D1: category=MAP, sw-calibration-access=READ-WRITE, type=Appl_KtOPTR_P_OptTa_B_D1  # This calibration defines the B point for OPTL_DtrmnOptToTaTb\ngear type library as a function of motor A shaft speed and output shaft\nspeed in D1.
    KtOPTR_P_OptTa_B_D4
      parameter data prototype KtOPTR_P_OptTa_B_D4: category=MAP, sw-calibration-access=READ-WRITE, type=Appl_KtOPTR_P_OptTa_B_D4  # This calibration defines the B point for OPTL_DtrmnOptToTaTb\ngear type library as a function of motor A shaft speed and output shaft\nspeed in D4.
    KtOPTR_P_OptTa_B_D5
      parameter data prototype KtOPTR_P_OptTa_B_D5: category=MAP, sw-calibration-access=READ-WRITE, type=Appl_KtOPTR_P_OptTa_B_D5  # This calibration defines the B point for OPTL_DtrmnOptToTaTb\ngear type library as a function of motor A shaft speed and output shaft\nspeed in D5.
    KtOPTR_P_OptTa_B_D6
      parameter data prototype KtOPTR_P_OptTa_B_D6: category=MAP, sw-calibration-access=READ-WRITE, type=Appl_KtOPTR_P_OptTa_B_D6  # This calibration defines the B point for OPTL_DtrmnOptToTaTb\ngear type library as a function of motor A shaft speed and output shaft\nspeed in D6.
    KtOPTR_P_OptTa_O_D1
      parameter data prototype KtOPTR_P_OptTa_O_D1: category=MAP, sw-calibration-access=READ-WRITE, type=Appl_KtOPTR_P_OptTa_O_D1  # This calibration defines the O point for OPTL_DtrmnOptToTaTb\ngear type library as a function of motor A shaft speed and output shaft\nspeed in D1.
    KtOPTR_P_OptTa_O_D2
      parameter data prototype KtOPTR_P_OptTa_O_D2: category=MAP, sw-calibration-access=READ-WRITE, type=Appl_KtOPTR_P_OptTa_O_D2  # This calibration defines the O point for OPTL_DtrmnOptToTaTb\ngear type library as a function of motor A shaft speed and output shaft\nspeed in D2.
    KtOPTR_P_OptTa_O_D3
      parameter data prototype KtOPTR_P_OptTa_O_D3: category=MAP, sw-calibration-access=READ-WRITE, type=Appl_KtOPTR_P_OptTa_O_D3  # This calibration defines the O point for OPTL_DtrmnOptToTaTb\ngear type library as a function of motor A shaft speed and output shaft\nspeed in D3.
    KtOPTR_P_OptTa_O_D4
      parameter data prototype KtOPTR_P_OptTa_O_D4: category=MAP, sw-calibration-access=READ-WRITE, type=Appl_KtOPTR_P_OptTa_O_D4  # This calibration defines the O point for OPTL_DtrmnOptToTaTb\ngear type library as a function of motor A shaft speed and output shaft\nspeed in D4.
    KtOPTR_P_OptTa_O_D6
      parameter data prototype KtOPTR_P_OptTa_O_D6: category=MAP, sw-calibration-access=READ-WRITE, type=Appl_KtOPTR_P_OptTa_O_D6  # This calibration defines the O point for OPTL_DtrmnOptToTaTb\ngear type library as a function of motor A shaft speed and output shaft\nspeed in D6.
    KtOPTR_dM_MtrARLLULD
      parameter data prototype KtOPTR_dM_MtrARLLULD: category=MAP, sw-calibration-access=READ-WRITE, type=Appl_KtOPTR_dM_MtrARLLULD
    KtOPTR_dM_MtrBRLLULD
      parameter data prototype KtOPTR_dM_MtrBRLLULD: category=MAP, sw-calibration-access=READ-WRITE, type=Appl_KtOPTR_dM_MtrBRLLULD
    KtOPTR_dn_Nidot4Start
      parameter data prototype KtOPTR_dn_Nidot4Start: category=MAP, sw-calibration-access=READ-WRITE, type=Appl_KtOPTR_dn_Nidot4Start  # Description_Tag_Not_Defined
    KtOPTR_dn_Nidot4StartEVMd
      parameter data prototype KtOPTR_dn_Nidot4StartEVMd: category=MAP, sw-calibration-access=READ-WRITE, type=Appl_KtOPTR_dn_Nidot4StartEVMd  # Description_Tag_Not_Defined
    KtOPTR_n_Ni4Start
      parameter data prototype KtOPTR_n_Ni4Start: category=MAP, sw-calibration-access=READ-WRITE, type=Appl_KtOPTR_n_Ni4Start  # Description_Tag_Not_Defined
    KtOPTR_n_Ni4StartEVMd
      parameter data prototype KtOPTR_n_Ni4StartEVMd: category=MAP, sw-calibration-access=READ-WRITE, type=Appl_KtOPTR_n_Ni4StartEVMd  # Description_Tag_Not_Defined
    KtOPTR_n_P2IdleSpd
      parameter data prototype KtOPTR_n_P2IdleSpd: category=CURVE, sw-calibration-access=READ-WRITE, type=Appl_KtOPTR_n_P2IdleSpd  # Description_Tag_Not_Defined
    KtOPTR_r_BattTmpThermalCntrl
      parameter data prototype KtOPTR_r_BattTmpThermalCntrl: category=CURVE, sw-calibration-access=READ-WRITE, type=Appl_KtOPTR_r_BattTmpThermalCntrl  # Description_Tag_Not_Defined
    KtOPTR_r_INVR_A_ThermalCntrl
      parameter data prototype KtOPTR_r_INVR_A_ThermalCntrl: category=CURVE, sw-calibration-access=READ-WRITE, type=Appl_KtOPTR_r_INVR_A_ThermalCntrl  # Cost factor as a function of Inverter A Temperature for electrical losses of Motor A
    KtOPTR_r_INVR_B_ThermalCntrl
      parameter data prototype KtOPTR_r_INVR_B_ThermalCntrl: category=CURVE, sw-calibration-access=READ-WRITE, type=Appl_KtOPTR_r_INVR_B_ThermalCntrl  # Cost factor as a function of Inverter B Temperature for electrical losses of Motor B
    KtOPTR_r_INVR_C_ThermalCntrl
      parameter data prototype KtOPTR_r_INVR_C_ThermalCntrl: category=CURVE, sw-calibration-access=READ-WRITE, type=Appl_KtOPTR_r_INVR_C_ThermalCntrl  # Cost factor as a function of Inverter C Temperature for\nelectrical losses of Motor C
    KtOPTR_r_Mtr_A_ThermalCntrl
      parameter data prototype KtOPTR_r_Mtr_A_ThermalCntrl: category=CURVE, sw-calibration-access=READ-WRITE, type=Appl_KtOPTR_r_Mtr_A_ThermalCntrl  # Cost factor as a function of Motor A Temperature for electrical losses of Motor A
    KtOPTR_r_Mtr_B_ThermalCntrl
      parameter data prototype KtOPTR_r_Mtr_B_ThermalCntrl: category=CURVE, sw-calibration-access=READ-WRITE, type=Appl_KtOPTR_r_Mtr_B_ThermalCntrl  # Cost factor as a function of Motor B Temperature for electrical losses of Motor B
    KtOPTR_r_Mtr_C_ThermalCntrl
      parameter data prototype KtOPTR_r_Mtr_C_ThermalCntrl: category=CURVE, sw-calibration-access=READ-WRITE, type=Appl_KtOPTR_r_Mtr_C_ThermalCntrl  # Cost factor as a function of Motor C Temperature for\nelectrical losses of Motor C
    KtOPTR_r_OptMtrTrqSplit_Fact
      parameter data prototype KtOPTR_r_OptMtrTrqSplit_Fact: category=MAP, sw-calibration-access=READ-WRITE, type=Appl_KtOPTR_r_OptMtrTrqSplit_Fact  # This calibration is used to alter the slope of the opt. line\nas function of electrical torque and output shaft speed. In certain\nscenarios this calibration will allow the system to utilize six switch\nopen.
    KtOPTR_r_TmpBsd_MtrA_OptToFctr
      parameter data prototype KtOPTR_r_TmpBsd_MtrA_OptToFctr: category=CURVE, sw-calibration-access=READ-WRITE, type=Appl_KtOPTR_r_TmpBsd_MtrA_OptToFctr  # This calibration is used to derate the opt. motor A torque\nsolution as a function of motor As temperature.
    KtOPTR_r_TmpBsd_MtrB_OptToFctr
      parameter data prototype KtOPTR_r_TmpBsd_MtrB_OptToFctr: category=CURVE, sw-calibration-access=READ-WRITE, type=Appl_KtOPTR_r_TmpBsd_MtrB_OptToFctr  # This calibration is used to derate the opt. motor B torque\nsolution as a function of motor Bs temperature.
    KtOPTR_r_TmpBsd_MtrC_OptToFctr
      parameter data prototype KtOPTR_r_TmpBsd_MtrC_OptToFctr: category=CURVE, sw-calibration-access=READ-WRITE, type=Appl_KtOPTR_r_TmpBsd_MtrC_OptToFctr  # This calibration is used to derate the opt. motor C torque\nsolution as a function of motor Bs temperature.
    KtOPTR_r_TmpBsd_MtrInvrtrA_OptToFctr
      parameter data prototype KtOPTR_r_TmpBsd_MtrInvrtrA_OptToFctr: category=CURVE, sw-calibration-access=READ-WRITE, type=Appl_KtOPTR_r_TmpBsd_MtrInvrtrA_OptToFctr  # This calibration is used to derate the opt. motor A torque\nsolution as a function of inverter A (motor As inverter) temperature.
    KtOPTR_r_TmpBsd_MtrInvrtrB_OptToFctr
      parameter data prototype KtOPTR_r_TmpBsd_MtrInvrtrB_OptToFctr: category=CURVE, sw-calibration-access=READ-WRITE, type=Appl_KtOPTR_r_TmpBsd_MtrInvrtrB_OptToFctr  # This calibration is used to derate the opt. motor B torque\nsolution as a function of inverter B (motor Bs inverter) temperature.
    KtOPTR_r_TmpBsd_MtrInvrtrC_OptToFctr
      parameter data prototype KtOPTR_r_TmpBsd_MtrInvrtrC_OptToFctr: category=CURVE, sw-calibration-access=READ-WRITE, type=Appl_KtOPTR_r_TmpBsd_MtrInvrtrC_OptToFctr  # This calibration is used to derate the opt. motor C torque\nsolution as a function of inverter B (motor Bs inverter) temperature.
    KtOPTR_t_OptMtrTrqSplit_SolnFilt
      parameter data prototype KtOPTR_t_OptMtrTrqSplit_SolnFilt: category=MAP, sw-calibration-access=READ-WRITE, type=Appl_KtOPTR_t_OptMtrTrqSplit_SolnFilt  # This calibration determines the time constant for the\nfilters for TaFromTo, TbFromTo, and their respective misc. terms in the\nOPTL_DtrmnOptToTaTb MB library .
    KtTSXR_P_TransLoss_G2
      parameter data prototype KtTSXR_P_TransLoss_G2: category=CURVE, sw-calibration-access=READ-WRITE, type=Appl_KtTSXR_P_TransLoss_G2  # Description_Tag_Not_Defined
    KtTSXR_P_TransLoss_M1EngOff
      parameter data prototype KtTSXR_P_TransLoss_M1EngOff: category=CURVE, sw-calibration-access=READ-WRITE, type=Appl_KtTSXR_P_TransLoss_M1EngOff  # Description_Tag_Not_Defined
    KtTSXR_P_TransLoss_M2EngOff
      parameter data prototype KtTSXR_P_TransLoss_M2EngOff: category=CURVE, sw-calibration-access=READ-WRITE, type=Appl_KtTSXR_P_TransLoss_M2EngOff  # Description_Tag_Not_Defined
    KtTSXR_k_TransLoss1stOrdCf_M1
      parameter data prototype KtTSXR_k_TransLoss1stOrdCf_M1: category=CURVE, sw-calibration-access=READ-WRITE, type=Appl_KtTSXR_k_TransLoss1stOrdCf_M1  # Description_Tag_Not_Defined
    KtTSXR_k_TransLoss1stOrdCf_M2
      parameter data prototype KtTSXR_k_TransLoss1stOrdCf_M2: category=CURVE, sw-calibration-access=READ-WRITE, type=Appl_KtTSXR_k_TransLoss1stOrdCf_M2  # Description_Tag_Not_Defined
    KtTSXR_k_TransLoss1stOrdCf_N
      parameter data prototype KtTSXR_k_TransLoss1stOrdCf_N: category=CURVE, sw-calibration-access=READ-WRITE, type=Appl_KtTSXR_k_TransLoss1stOrdCf_N  # Description_Tag_Not_Defined
    KtTSXR_k_TransLoss2ndOrdCf_M1
      parameter data prototype KtTSXR_k_TransLoss2ndOrdCf_M1: category=CURVE, sw-calibration-access=READ-WRITE, type=Appl_KtTSXR_k_TransLoss2ndOrdCf_M1  # Description_Tag_Not_Defined
    KtTSXR_k_TransLoss2ndOrdCf_M2
      parameter data prototype KtTSXR_k_TransLoss2ndOrdCf_M2: category=CURVE, sw-calibration-access=READ-WRITE, type=Appl_KtTSXR_k_TransLoss2ndOrdCf_M2  # Description_Tag_Not_Defined
    KtTSXR_k_TransLoss2ndOrdCf_N
      parameter data prototype KtTSXR_k_TransLoss2ndOrdCf_N: category=CURVE, sw-calibration-access=READ-WRITE, type=Appl_KtTSXR_k_TransLoss2ndOrdCf_N  # Description_Tag_Not_Defined
    KtTSXR_k_TransLossZeroOrdCf_M1
      parameter data prototype KtTSXR_k_TransLossZeroOrdCf_M1: category=CURVE, sw-calibration-access=READ-WRITE, type=Appl_KtTSXR_k_TransLossZeroOrdCf_M1  # Description_Tag_Not_Defined
    KtTSXR_k_TransLossZeroOrdCf_M2
      parameter data prototype KtTSXR_k_TransLossZeroOrdCf_M2: category=CURVE, sw-calibration-access=READ-WRITE, type=Appl_KtTSXR_k_TransLossZeroOrdCf_M2  # Description_Tag_Not_Defined
    KtTSXR_k_TransLossZeroOrdCf_N
      parameter data prototype KtTSXR_k_TransLossZeroOrdCf_N: category=CURVE, sw-calibration-access=READ-WRITE, type=Appl_KtTSXR_k_TransLossZeroOrdCf_N  # Description_Tag_Not_Defined
    KxCTCR_k_CreepCancelBlend
      parameter data prototype KxCTCR_k_CreepCancelBlend: category=COM_AXIS, sw-calibration-access=READ-WRITE, type=Appl_KxCTCR_k_CreepCancelBlend  # Description_Tag_Not_Defined
    KxHSCR_K_LowSpdDnyRgnFrntMinTrq
      parameter data prototype KxHSCR_K_LowSpdDnyRgnFrntMinTrq: category=COM_AXIS, sw-calibration-access=READ-WRITE, type=Appl_KxHSCR_K_LowSpdDnyRgnFrntMinTrq  # Description_Tag_Not_Defined
    KxHSCR_K_LowSpdDnyRgnRrMinTrq
      parameter data prototype KxHSCR_K_LowSpdDnyRgnRrMinTrq: category=COM_AXIS, sw-calibration-access=READ-WRITE, type=Appl_KxHSCR_K_LowSpdDnyRgnRrMinTrq  # Description_Tag_Not_Defined
    KxHSCR_M_Motor_Torque_Max_MtrA
      parameter data prototype KxHSCR_M_Motor_Torque_Max_MtrA: category=COM_AXIS, sw-calibration-access=READ-WRITE, type=Appl_KxHSCR_M_Motor_Torque_Max_MtrA  # Description_Tag_Not_Defined
    KxHSCR_M_Motor_Torque_Max_MtrB
      parameter data prototype KxHSCR_M_Motor_Torque_Max_MtrB: category=COM_AXIS, sw-calibration-access=READ-WRITE, type=Appl_KxHSCR_M_Motor_Torque_Max_MtrB  # Description_Tag_Not_Defined
    KxHSCR_M_Motor_Torque_Max_MtrC
      parameter data prototype KxHSCR_M_Motor_Torque_Max_MtrC: category=COM_AXIS, sw-calibration-access=READ-WRITE, type=Appl_KxHSCR_M_Motor_Torque_Max_MtrC  # Description_Tag_Not_Defined
    KxHSCR_M_Motor_Torque_Min_MtrA
      parameter data prototype KxHSCR_M_Motor_Torque_Min_MtrA: category=COM_AXIS, sw-calibration-access=READ-WRITE, type=Appl_KxHSCR_M_Motor_Torque_Min_MtrA  # Description_Tag_Not_Defined
    KxHSCR_M_Motor_Torque_Min_MtrB
      parameter data prototype KxHSCR_M_Motor_Torque_Min_MtrB: category=COM_AXIS, sw-calibration-access=READ-WRITE, type=Appl_KxHSCR_M_Motor_Torque_Min_MtrB  # Description_Tag_Not_Defined
    KxHSCR_M_Motor_Torque_Min_MtrC
      parameter data prototype KxHSCR_M_Motor_Torque_Min_MtrC: category=COM_AXIS, sw-calibration-access=READ-WRITE, type=Appl_KxHSCR_M_Motor_Torque_Min_MtrC  # Description_Tag_Not_Defined
    KxHSCR_M_TCC_TorqImp
      parameter data prototype KxHSCR_M_TCC_TorqImp: category=COM_AXIS, sw-calibration-access=READ-WRITE, type=Appl_KxHSCR_M_TCC_TorqImp  # Description_Tag_Not_Defined
    KxHSCR_M_ToRrMaxCstRvrs
      parameter data prototype KxHSCR_M_ToRrMaxCstRvrs: category=COM_AXIS, sw-calibration-access=READ-WRITE, type=Appl_KxHSCR_M_ToRrMaxCstRvrs  # Description_Tag_Not_Defined
    KxHSCR_M_ToRrMinCst
      parameter data prototype KxHSCR_M_ToRrMinCst: category=COM_AXIS, sw-calibration-access=READ-WRITE, type=Appl_KxHSCR_M_ToRrMinCst  # Description_Tag_Not_Defined
    KxHSCR_r_TCC_Nc2FromTturb_CoeffsA
      parameter data prototype KxHSCR_r_TCC_Nc2FromTturb_CoeffsA: category=COM_AXIS, sw-calibration-access=READ-WRITE, type=Appl_KxHSCR_r_TCC_Nc2FromTturb_CoeffsA  # A coefficent in Coast FTC
    KxHSCR_r_TCC_Nc2FromTturb_CoeffsB
      parameter data prototype KxHSCR_r_TCC_Nc2FromTturb_CoeffsB: category=COM_AXIS, sw-calibration-access=READ-WRITE, type=Appl_KxHSCR_r_TCC_Nc2FromTturb_CoeffsB  # B coeffienct of the Coast FTC
    KxHSCR_r_TCC_Nc2FromTturb_CoeffsC
      parameter data prototype KxHSCR_r_TCC_Nc2FromTturb_CoeffsC: category=COM_AXIS, sw-calibration-access=READ-WRITE, type=Appl_KxHSCR_r_TCC_Nc2FromTturb_CoeffsC  # C coefficient for Coast FTC
    KxHSCR_r_TCC_TorqRatio
      parameter data prototype KxHSCR_r_TCC_TorqRatio: category=COM_AXIS, sw-calibration-access=READ-WRITE, type=Appl_KxHSCR_r_TCC_TorqRatio  # Description_Tag_Not_Defined
    KxHSCR_r_TCC_TturbFromNC2_CoeffsA
      parameter data prototype KxHSCR_r_TCC_TturbFromNC2_CoeffsA: category=COM_AXIS, sw-calibration-access=READ-WRITE, type=Appl_KxHSCR_r_TCC_TturbFromNC2_CoeffsA  # Description_Tag_Not_Defined
    KxHSCR_r_TCC_TturbFromNC2_CoeffsB
      parameter data prototype KxHSCR_r_TCC_TturbFromNC2_CoeffsB: category=COM_AXIS, sw-calibration-access=READ-WRITE, type=Appl_KxHSCR_r_TCC_TturbFromNC2_CoeffsB  # Description_Tag_Not_Defined
    KxHSCR_r_TCC_TturbFromNC2_CoeffsC
      parameter data prototype KxHSCR_r_TCC_TturbFromNC2_CoeffsC: category=COM_AXIS, sw-calibration-access=READ-WRITE, type=Appl_KxHSCR_r_TCC_TturbFromNC2_CoeffsC  # Description_Tag_Not_Defined
    KxHSER_dn_NiRtLim
      parameter data prototype KxHSER_dn_NiRtLim: category=COM_AXIS, sw-calibration-access=READ-WRITE, type=Appl_KxHSER_dn_NiRtLim  # Description_Tag_Not_Defined
    KxOPTR_M_DOD_AllCyl_Threshld
      parameter data prototype KxOPTR_M_DOD_AllCyl_Threshld: category=COM_AXIS, sw-calibration-access=READ-WRITE, type=Appl_KxOPTR_M_DOD_AllCyl_Threshld  # Description_Tag_Not_Defined
    KxOPTR_M_P2ZeroIdle_BrkTrqThres
      parameter data prototype KxOPTR_M_P2ZeroIdle_BrkTrqThres: category=COM_AXIS, sw-calibration-access=READ-WRITE, type=Appl_KxOPTR_M_P2ZeroIdle_BrkTrqThres  # Description_Tag_Not_Defined
    KxOPTR_M_Ti4Start
      parameter data prototype KxOPTR_M_Ti4Start: category=COM_AXIS, sw-calibration-access=READ-WRITE, type=Appl_KxOPTR_M_Ti4Start  # Description_Tag_Not_Defined
    KxOPTR_M_Ti4StartEVMd
      parameter data prototype KxOPTR_M_Ti4StartEVMd: category=COM_AXIS, sw-calibration-access=READ-WRITE, type=Appl_KxOPTR_M_Ti4StartEVMd  # Description_Tag_Not_Defined
    KxOPTR_P_A_BEV
      parameter data prototype KxOPTR_P_A_BEV: category=COM_AXIS, sw-calibration-access=READ-WRITE, type=Appl_KxOPTR_P_A_BEV  # Description_Tag_Not_Defined
    KxOPTR_P_B_BEV
      parameter data prototype KxOPTR_P_B_BEV: category=COM_AXIS, sw-calibration-access=READ-WRITE, type=Appl_KxOPTR_P_B_BEV  # Description_Tag_Not_Defined
    KxOPTR_P_HysA_BEV
      parameter data prototype KxOPTR_P_HysA_BEV: category=COM_AXIS, sw-calibration-access=READ-WRITE, type=Appl_KxOPTR_P_HysA_BEV  # Description_Tag_Not_Defined
    KxOPTR_P_HysA_D1
      parameter data prototype KxOPTR_P_HysA_D1: category=COM_AXIS, sw-calibration-access=READ-WRITE, type=Appl_KxOPTR_P_HysA_D1  # Description_Tag_Not_Defined
    KxOPTR_P_HysA_D2
      parameter data prototype KxOPTR_P_HysA_D2: category=COM_AXIS, sw-calibration-access=READ-WRITE, type=Appl_KxOPTR_P_HysA_D2  # Description_Tag_Not_Defined
    KxOPTR_P_HysA_D3
      parameter data prototype KxOPTR_P_HysA_D3: category=COM_AXIS, sw-calibration-access=READ-WRITE, type=Appl_KxOPTR_P_HysA_D3  # Description_Tag_Not_Defined
    KxOPTR_P_HysA_D4
      parameter data prototype KxOPTR_P_HysA_D4: category=COM_AXIS, sw-calibration-access=READ-WRITE, type=Appl_KxOPTR_P_HysA_D4  # Description_Tag_Not_Defined
    KxOPTR_P_HysA_D5
      parameter data prototype KxOPTR_P_HysA_D5: category=COM_AXIS, sw-calibration-access=READ-WRITE, type=Appl_KxOPTR_P_HysA_D5  # Description_Tag_Not_Defined
    KxOPTR_P_HysA_D6
      parameter data prototype KxOPTR_P_HysA_D6: category=COM_AXIS, sw-calibration-access=READ-WRITE, type=Appl_KxOPTR_P_HysA_D6  # Description_Tag_Not_Defined
    KxOPTR_P_HysB_BEV
      parameter data prototype KxOPTR_P_HysB_BEV: category=COM_AXIS, sw-calibration-access=READ-WRITE, type=Appl_KxOPTR_P_HysB_BEV  # Description_Tag_Not_Defined
    KxOPTR_P_HysB_D1
      parameter data prototype KxOPTR_P_HysB_D1: category=COM_AXIS, sw-calibration-access=READ-WRITE, type=Appl_KxOPTR_P_HysB_D1  # Description_Tag_Not_Defined
    KxOPTR_P_HysB_D2
      parameter data prototype KxOPTR_P_HysB_D2: category=COM_AXIS, sw-calibration-access=READ-WRITE, type=Appl_KxOPTR_P_HysB_D2  # Description_Tag_Not_Defined
    KxOPTR_P_HysB_D3
      parameter data prototype KxOPTR_P_HysB_D3: category=COM_AXIS, sw-calibration-access=READ-WRITE, type=Appl_KxOPTR_P_HysB_D3  # Description_Tag_Not_Defined
    KxOPTR_P_HysB_D4
      parameter data prototype KxOPTR_P_HysB_D4: category=COM_AXIS, sw-calibration-access=READ-WRITE, type=Appl_KxOPTR_P_HysB_D4  # Description_Tag_Not_Defined
    KxOPTR_P_HysB_D5
      parameter data prototype KxOPTR_P_HysB_D5: category=COM_AXIS, sw-calibration-access=READ-WRITE, type=Appl_KxOPTR_P_HysB_D5  # Description_Tag_Not_Defined
    KxOPTR_P_HysB_D6
      parameter data prototype KxOPTR_P_HysB_D6: category=COM_AXIS, sw-calibration-access=READ-WRITE, type=Appl_KxOPTR_P_HysB_D6  # Description_Tag_Not_Defined
    KxOPTR_P_O_BEV
      parameter data prototype KxOPTR_P_O_BEV: category=COM_AXIS, sw-calibration-access=READ-WRITE, type=Appl_KxOPTR_P_O_BEV  # Description_Tag_Not_Defined
    KxOPTR_P_OptTa_A_D1
      parameter data prototype KxOPTR_P_OptTa_A_D1: category=COM_AXIS, sw-calibration-access=READ-WRITE, type=Appl_KxOPTR_P_OptTa_A_D1  # Description_Tag_Not_Defined
    KxOPTR_P_OptTa_A_D2
      parameter data prototype KxOPTR_P_OptTa_A_D2: category=COM_AXIS, sw-calibration-access=READ-WRITE, type=Appl_KxOPTR_P_OptTa_A_D2  # Description_Tag_Not_Defined
    KxOPTR_P_OptTa_A_D4
      parameter data prototype KxOPTR_P_OptTa_A_D4: category=COM_AXIS, sw-calibration-access=READ-WRITE, type=Appl_KxOPTR_P_OptTa_A_D4  # Description_Tag_Not_Defined
    KxOPTR_P_OptTa_A_D5
      parameter data prototype KxOPTR_P_OptTa_A_D5: category=COM_AXIS, sw-calibration-access=READ-WRITE, type=Appl_KxOPTR_P_OptTa_A_D5  # Description_Tag_Not_Defined
    KxOPTR_P_OptTa_A_D6
      parameter data prototype KxOPTR_P_OptTa_A_D6: category=COM_AXIS, sw-calibration-access=READ-WRITE, type=Appl_KxOPTR_P_OptTa_A_D6  # Description_Tag_Not_Defined
    KxOPTR_P_OptTa_B_D1
      parameter data prototype KxOPTR_P_OptTa_B_D1: category=COM_AXIS, sw-calibration-access=READ-WRITE, type=Appl_KxOPTR_P_OptTa_B_D1  # Description_Tag_Not_Defined
    KxOPTR_P_OptTa_B_D4
      parameter data prototype KxOPTR_P_OptTa_B_D4: category=COM_AXIS, sw-calibration-access=READ-WRITE, type=Appl_KxOPTR_P_OptTa_B_D4  # Description_Tag_Not_Defined
    KxOPTR_P_OptTa_B_D5
      parameter data prototype KxOPTR_P_OptTa_B_D5: category=COM_AXIS, sw-calibration-access=READ-WRITE, type=Appl_KxOPTR_P_OptTa_B_D5  # Description_Tag_Not_Defined
    KxOPTR_P_OptTa_B_D6
      parameter data prototype KxOPTR_P_OptTa_B_D6: category=COM_AXIS, sw-calibration-access=READ-WRITE, type=Appl_KxOPTR_P_OptTa_B_D6  # Description_Tag_Not_Defined
    KxOPTR_P_OptTa_O_D1
      parameter data prototype KxOPTR_P_OptTa_O_D1: category=COM_AXIS, sw-calibration-access=READ-WRITE, type=Appl_KxOPTR_P_OptTa_O_D1  # x axis of KtOPTR_P_OptTa_O_D1
    KxOPTR_P_OptTa_O_D2
      parameter data prototype KxOPTR_P_OptTa_O_D2: category=COM_AXIS, sw-calibration-access=READ-WRITE, type=Appl_KxOPTR_P_OptTa_O_D2  # x axis of KtOPTR_P_OptTa_O_D2
    KxOPTR_P_OptTa_O_D3
      parameter data prototype KxOPTR_P_OptTa_O_D3: category=COM_AXIS, sw-calibration-access=READ-WRITE, type=Appl_KxOPTR_P_OptTa_O_D3  # x axis of KtOPTR_P_OptTa_O_D3
    KxOPTR_P_OptTa_O_D4
      parameter data prototype KxOPTR_P_OptTa_O_D4: category=COM_AXIS, sw-calibration-access=READ-WRITE, type=Appl_KxOPTR_P_OptTa_O_D4  # x axis of KtOPTR_P_OptTa_O_D4
    KxOPTR_P_OptTa_O_D6
      parameter data prototype KxOPTR_P_OptTa_O_D6: category=COM_AXIS, sw-calibration-access=READ-WRITE, type=Appl_KxOPTR_P_OptTa_O_D6  # x axis of KtOPTR_P_OptTa_O_D6
    KxOPTR_dM_MtrARLLULD
      parameter data prototype KxOPTR_dM_MtrARLLULD: category=COM_AXIS, sw-calibration-access=READ-WRITE, type=Appl_KxOPTR_dM_MtrARLLULD
    KxOPTR_dM_MtrBRLLULD
      parameter data prototype KxOPTR_dM_MtrBRLLULD: category=COM_AXIS, sw-calibration-access=READ-WRITE, type=Appl_KxOPTR_dM_MtrBRLLULD
    KxOPTR_dn_Nidot4Start
      parameter data prototype KxOPTR_dn_Nidot4Start: category=COM_AXIS, sw-calibration-access=READ-WRITE, type=Appl_KxOPTR_dn_Nidot4Start  # Description_Tag_Not_Defined
    KxOPTR_dn_Nidot4StartEVMd
      parameter data prototype KxOPTR_dn_Nidot4StartEVMd: category=COM_AXIS, sw-calibration-access=READ-WRITE, type=Appl_KxOPTR_dn_Nidot4StartEVMd  # Description_Tag_Not_Defined
    KxOPTR_n_Ni4Start
      parameter data prototype KxOPTR_n_Ni4Start: category=COM_AXIS, sw-calibration-access=READ-WRITE, type=Appl_KxOPTR_n_Ni4Start  # Description_Tag_Not_Defined
    KxOPTR_n_Ni4StartEVMd
      parameter data prototype KxOPTR_n_Ni4StartEVMd: category=COM_AXIS, sw-calibration-access=READ-WRITE, type=Appl_KxOPTR_n_Ni4StartEVMd  # Description_Tag_Not_Defined
    KxOPTR_n_P2IdleSpd
      parameter data prototype KxOPTR_n_P2IdleSpd: category=COM_AXIS, sw-calibration-access=READ-WRITE, type=Appl_KxOPTR_n_P2IdleSpd  # Description_Tag_Not_Defined
    KxOPTR_r_BattTmpThermalCntrl
      parameter data prototype KxOPTR_r_BattTmpThermalCntrl: category=COM_AXIS, sw-calibration-access=READ-WRITE, type=Appl_KxOPTR_r_BattTmpThermalCntrl  # Description_Tag_Not_Defined
    KxOPTR_r_INVR_A_ThermalCntrl
      parameter data prototype KxOPTR_r_INVR_A_ThermalCntrl: category=COM_AXIS, sw-calibration-access=READ-WRITE, type=Appl_KxOPTR_r_INVR_A_ThermalCntrl  # Description_Tag_Not_Defined
    KxOPTR_r_INVR_B_ThermalCntrl
      parameter data prototype KxOPTR_r_INVR_B_ThermalCntrl: category=COM_AXIS, sw-calibration-access=READ-WRITE, type=Appl_KxOPTR_r_INVR_B_ThermalCntrl  # Description_Tag_Not_Defined
    KxOPTR_r_INVR_C_ThermalCntrl
      parameter data prototype KxOPTR_r_INVR_C_ThermalCntrl: category=COM_AXIS, sw-calibration-access=READ-WRITE, type=Appl_KxOPTR_r_INVR_C_ThermalCntrl  # Description_Tag_Not_Defined
    KxOPTR_r_Mtr_A_ThermalCntrl
      parameter data prototype KxOPTR_r_Mtr_A_ThermalCntrl: category=COM_AXIS, sw-calibration-access=READ-WRITE, type=Appl_KxOPTR_r_Mtr_A_ThermalCntrl  # Description_Tag_Not_Defined
    KxOPTR_r_Mtr_B_ThermalCntrl
      parameter data prototype KxOPTR_r_Mtr_B_ThermalCntrl: category=COM_AXIS, sw-calibration-access=READ-WRITE, type=Appl_KxOPTR_r_Mtr_B_ThermalCntrl  # Description_Tag_Not_Defined
    KxOPTR_r_Mtr_C_ThermalCntrl
      parameter data prototype KxOPTR_r_Mtr_C_ThermalCntrl: category=COM_AXIS, sw-calibration-access=READ-WRITE, type=Appl_KxOPTR_r_Mtr_C_ThermalCntrl  # Description_Tag_Not_Defined
    KxOPTR_r_OptMtrTrqSplit_Fact
      parameter data prototype KxOPTR_r_OptMtrTrqSplit_Fact: category=COM_AXIS, sw-calibration-access=READ-WRITE, type=Appl_KxOPTR_r_OptMtrTrqSplit_Fact  # Description_Tag_Not_Defined
    KxOPTR_r_TmpBsd_MtrA_OptToFctr
      parameter data prototype KxOPTR_r_TmpBsd_MtrA_OptToFctr: category=COM_AXIS, sw-calibration-access=READ-WRITE, type=Appl_KxOPTR_r_TmpBsd_MtrA_OptToFctr  # Description_Tag_Not_Defined
    KxOPTR_r_TmpBsd_MtrB_OptToFctr
      parameter data prototype KxOPTR_r_TmpBsd_MtrB_OptToFctr: category=COM_AXIS, sw-calibration-access=READ-WRITE, type=Appl_KxOPTR_r_TmpBsd_MtrB_OptToFctr  # Description_Tag_Not_Defined
    KxOPTR_r_TmpBsd_MtrC_OptToFctr
      parameter data prototype KxOPTR_r_TmpBsd_MtrC_OptToFctr: category=COM_AXIS, sw-calibration-access=READ-WRITE, type=Appl_KxOPTR_r_TmpBsd_MtrC_OptToFctr  # Description_Tag_Not_Defined
    KxOPTR_r_TmpBsd_MtrInvrtrA_OptToFctr
      parameter data prototype KxOPTR_r_TmpBsd_MtrInvrtrA_OptToFctr: category=COM_AXIS, sw-calibration-access=READ-WRITE, type=Appl_KxOPTR_r_TmpBsd_MtrInvrtrA_OptToFctr  # Description_Tag_Not_Defined
    KxOPTR_r_TmpBsd_MtrInvrtrB_OptToFctr
      parameter data prototype KxOPTR_r_TmpBsd_MtrInvrtrB_OptToFctr: category=COM_AXIS, sw-calibration-access=READ-WRITE, type=Appl_KxOPTR_r_TmpBsd_MtrInvrtrB_OptToFctr  # Description_Tag_Not_Defined
    KxOPTR_r_TmpBsd_MtrInvrtrC_OptToFctr
      parameter data prototype KxOPTR_r_TmpBsd_MtrInvrtrC_OptToFctr: category=COM_AXIS, sw-calibration-access=READ-WRITE, type=Appl_KxOPTR_r_TmpBsd_MtrInvrtrC_OptToFctr  # Description_Tag_Not_Defined
    KxOPTR_t_OptMtrTrqSplit_SolnFilt
      parameter data prototype KxOPTR_t_OptMtrTrqSplit_SolnFilt: category=COM_AXIS, sw-calibration-access=READ-WRITE, type=Appl_KxOPTR_t_OptMtrTrqSplit_SolnFilt  # Description_Tag_Not_Defined
    KxTSXR_P_TransLoss_G2
      parameter data prototype KxTSXR_P_TransLoss_G2: category=COM_AXIS, sw-calibration-access=READ-WRITE, type=Appl_KxTSXR_P_TransLoss_G2  # Description_Tag_Not_Defined
    KxTSXR_P_TransLoss_M1EngOff
      parameter data prototype KxTSXR_P_TransLoss_M1EngOff: category=COM_AXIS, sw-calibration-access=READ-WRITE, type=Appl_KxTSXR_P_TransLoss_M1EngOff  # Description_Tag_Not_Defined
    KxTSXR_P_TransLoss_M2EngOff
      parameter data prototype KxTSXR_P_TransLoss_M2EngOff: category=COM_AXIS, sw-calibration-access=READ-WRITE, type=Appl_KxTSXR_P_TransLoss_M2EngOff  # Description_Tag_Not_Defined
    KxTSXR_k_TransLoss1stOrdCf_M1
      parameter data prototype KxTSXR_k_TransLoss1stOrdCf_M1: category=COM_AXIS, sw-calibration-access=READ-WRITE, type=Appl_KxTSXR_k_TransLoss1stOrdCf_M1  # Description_Tag_Not_Defined
    KxTSXR_k_TransLoss1stOrdCf_M2
      parameter data prototype KxTSXR_k_TransLoss1stOrdCf_M2: category=COM_AXIS, sw-calibration-access=READ-WRITE, type=Appl_KxTSXR_k_TransLoss1stOrdCf_M2  # Description_Tag_Not_Defined
    KxTSXR_k_TransLoss1stOrdCf_N
      parameter data prototype KxTSXR_k_TransLoss1stOrdCf_N: category=COM_AXIS, sw-calibration-access=READ-WRITE, type=Appl_KxTSXR_k_TransLoss1stOrdCf_N  # Description_Tag_Not_Defined
    KxTSXR_k_TransLoss2ndOrdCf_M1
      parameter data prototype KxTSXR_k_TransLoss2ndOrdCf_M1: category=COM_AXIS, sw-calibration-access=READ-WRITE, type=Appl_KxTSXR_k_TransLoss2ndOrdCf_M1  # Description_Tag_Not_Defined
    KxTSXR_k_TransLoss2ndOrdCf_M2
      parameter data prototype KxTSXR_k_TransLoss2ndOrdCf_M2: category=COM_AXIS, sw-calibration-access=READ-WRITE, type=Appl_KxTSXR_k_TransLoss2ndOrdCf_M2  # Description_Tag_Not_Defined
    KxTSXR_k_TransLoss2ndOrdCf_N
      parameter data prototype KxTSXR_k_TransLoss2ndOrdCf_N: category=COM_AXIS, sw-calibration-access=READ-WRITE, type=Appl_KxTSXR_k_TransLoss2ndOrdCf_N  # Description_Tag_Not_Defined
    KxTSXR_k_TransLossZeroOrdCf_M1
      parameter data prototype KxTSXR_k_TransLossZeroOrdCf_M1: category=COM_AXIS, sw-calibration-access=READ-WRITE, type=Appl_KxTSXR_k_TransLossZeroOrdCf_M1  # Description_Tag_Not_Defined
    KxTSXR_k_TransLossZeroOrdCf_M2
      parameter data prototype KxTSXR_k_TransLossZeroOrdCf_M2: category=COM_AXIS, sw-calibration-access=READ-WRITE, type=Appl_KxTSXR_k_TransLossZeroOrdCf_M2  # Description_Tag_Not_Defined
    KxTSXR_k_TransLossZeroOrdCf_N
      parameter data prototype KxTSXR_k_TransLossZeroOrdCf_N: category=COM_AXIS, sw-calibration-access=READ-WRITE, type=Appl_KxTSXR_k_TransLossZeroOrdCf_N  # Description_Tag_Not_Defined
    KyCTCR_k_CreepCancelBlend
      parameter data prototype KyCTCR_k_CreepCancelBlend: category=COM_AXIS, sw-calibration-access=READ-WRITE, type=Appl_KyCTCR_k_CreepCancelBlend  # Description_Tag_Not_Defined
    KyHSCR_M_TCC_TorqImp
      parameter data prototype KyHSCR_M_TCC_TorqImp: category=COM_AXIS, sw-calibration-access=READ-WRITE, type=Appl_KyHSCR_M_TCC_TorqImp  # Description_Tag_Not_Defined
    KyOPTR_M_Ti4Start
      parameter data prototype KyOPTR_M_Ti4Start: category=COM_AXIS, sw-calibration-access=READ-WRITE, type=Appl_KyOPTR_M_Ti4Start  # Description_Tag_Not_Defined
    KyOPTR_M_Ti4StartEVMd
      parameter data prototype KyOPTR_M_Ti4StartEVMd: category=COM_AXIS, sw-calibration-access=READ-WRITE, type=Appl_KyOPTR_M_Ti4StartEVMd  # Description_Tag_Not_Defined
    KyOPTR_P_OptTa_A_D1
      parameter data prototype KyOPTR_P_OptTa_A_D1: category=COM_AXIS, sw-calibration-access=READ-WRITE, type=Appl_KyOPTR_P_OptTa_A_D1  # Description_Tag_Not_Defined
    KyOPTR_P_OptTa_A_D2
      parameter data prototype KyOPTR_P_OptTa_A_D2: category=COM_AXIS, sw-calibration-access=READ-WRITE, type=Appl_KyOPTR_P_OptTa_A_D2  # Description_Tag_Not_Defined
    KyOPTR_P_OptTa_A_D4
      parameter data prototype KyOPTR_P_OptTa_A_D4: category=COM_AXIS, sw-calibration-access=READ-WRITE, type=Appl_KyOPTR_P_OptTa_A_D4  # Description_Tag_Not_Defined
    KyOPTR_P_OptTa_A_D5
      parameter data prototype KyOPTR_P_OptTa_A_D5: category=COM_AXIS, sw-calibration-access=READ-WRITE, type=Appl_KyOPTR_P_OptTa_A_D5  # Description_Tag_Not_Defined
    KyOPTR_P_OptTa_A_D6
      parameter data prototype KyOPTR_P_OptTa_A_D6: category=COM_AXIS, sw-calibration-access=READ-WRITE, type=Appl_KyOPTR_P_OptTa_A_D6  # Description_Tag_Not_Defined
    KyOPTR_P_OptTa_B_D1
      parameter data prototype KyOPTR_P_OptTa_B_D1: category=COM_AXIS, sw-calibration-access=READ-WRITE, type=Appl_KyOPTR_P_OptTa_B_D1  # Description_Tag_Not_Defined
    KyOPTR_P_OptTa_B_D4
      parameter data prototype KyOPTR_P_OptTa_B_D4: category=COM_AXIS, sw-calibration-access=READ-WRITE, type=Appl_KyOPTR_P_OptTa_B_D4  # Description_Tag_Not_Defined
    KyOPTR_P_OptTa_B_D5
      parameter data prototype KyOPTR_P_OptTa_B_D5: category=COM_AXIS, sw-calibration-access=READ-WRITE, type=Appl_KyOPTR_P_OptTa_B_D5  # Description_Tag_Not_Defined
    KyOPTR_P_OptTa_B_D6
      parameter data prototype KyOPTR_P_OptTa_B_D6: category=COM_AXIS, sw-calibration-access=READ-WRITE, type=Appl_KyOPTR_P_OptTa_B_D6  # Description_Tag_Not_Defined
    KyOPTR_P_OptTa_O_D1
      parameter data prototype KyOPTR_P_OptTa_O_D1: category=COM_AXIS, sw-calibration-access=READ-WRITE, type=Appl_KyOPTR_P_OptTa_O_D1  # y axis of KtOPTR_P_OptTa_O_D1
    KyOPTR_P_OptTa_O_D2
      parameter data prototype KyOPTR_P_OptTa_O_D2: category=COM_AXIS, sw-calibration-access=READ-WRITE, type=Appl_KyOPTR_P_OptTa_O_D2  # y axis of KtOPTR_P_OptTa_O_D2
    KyOPTR_P_OptTa_O_D3
      parameter data prototype KyOPTR_P_OptTa_O_D3: category=COM_AXIS, sw-calibration-access=READ-WRITE, type=Appl_KyOPTR_P_OptTa_O_D3  # y axis of KtOPTR_P_OptTa_O_D3
    KyOPTR_P_OptTa_O_D4
      parameter data prototype KyOPTR_P_OptTa_O_D4: category=COM_AXIS, sw-calibration-access=READ-WRITE, type=Appl_KyOPTR_P_OptTa_O_D4  # y axis of KtOPTR_P_OptTa_O_D4
    KyOPTR_P_OptTa_O_D6
      parameter data prototype KyOPTR_P_OptTa_O_D6: category=COM_AXIS, sw-calibration-access=READ-WRITE, type=Appl_KyOPTR_P_OptTa_O_D6  # y axis of KtOPTR_P_OptTa_O_D6
    KyOPTR_dM_MtrARLLULD
      parameter data prototype KyOPTR_dM_MtrARLLULD: category=COM_AXIS, sw-calibration-access=READ-WRITE, type=Appl_KyOPTR_dM_MtrARLLULD
    KyOPTR_dM_MtrBRLLULD
      parameter data prototype KyOPTR_dM_MtrBRLLULD: category=COM_AXIS, sw-calibration-access=READ-WRITE, type=Appl_KyOPTR_dM_MtrBRLLULD
    KyOPTR_dn_Nidot4Start
      parameter data prototype KyOPTR_dn_Nidot4Start: category=COM_AXIS, sw-calibration-access=READ-WRITE, type=Appl_KyOPTR_dn_Nidot4Start  # Description_Tag_Not_Defined
    KyOPTR_dn_Nidot4StartEVMd
      parameter data prototype KyOPTR_dn_Nidot4StartEVMd: category=COM_AXIS, sw-calibration-access=READ-WRITE, type=Appl_KyOPTR_dn_Nidot4StartEVMd  # Description_Tag_Not_Defined
    KyOPTR_n_Ni4Start
      parameter data prototype KyOPTR_n_Ni4Start: category=COM_AXIS, sw-calibration-access=READ-WRITE, type=Appl_KyOPTR_n_Ni4Start  # Description_Tag_Not_Defined
    KyOPTR_n_Ni4StartEVMd
      parameter data prototype KyOPTR_n_Ni4StartEVMd: category=COM_AXIS, sw-calibration-access=READ-WRITE, type=Appl_KyOPTR_n_Ni4StartEVMd  # Description_Tag_Not_Defined
    KyOPTR_r_OptMtrTrqSplit_Fact
      parameter data prototype KyOPTR_r_OptMtrTrqSplit_Fact: category=COM_AXIS, sw-calibration-access=READ-WRITE, type=Appl_KyOPTR_r_OptMtrTrqSplit_Fact  # Description_Tag_Not_Defined
    KyOPTR_t_OptMtrTrqSplit_SolnFilt
      parameter data prototype KyOPTR_t_OptMtrTrqSplit_SolnFilt: category=COM_AXIS, sw-calibration-access=READ-WRITE, type=Appl_KyOPTR_t_OptMtrTrqSplit_SolnFilt  # Description_Tag_Not_Defined
