AUTOSAR XML (schema 4-2-2)
standard types defined: dtRef_VOID, dtRef_const_VOID, boolean_CompuMethod, boolean_DataConstr, sint16_DataConstr, sint32_DataConstr, sint8_DataConstr, uint32_DataConstr, uint64_DataConstr, uint8_DataConstr
package /AUTOSAR_Platform/BaseTypes
  base type boolean_2: category=FIXED_LENGTH, base-type-size=8, base-type-encoding=BOOLEAN, native-declaration=boolean_2
package /AUTOSAR_Platform/ImplementationDataTypes
  8 x impl type, all with category=VALUE, type-emitter=Platform_Type:
    float64_2: base-type=float64, range raw >-INF..<INF  # The float64 datatype corresponds to IEEE float64-precision 64-bit floating point type [IEEE 754-1985]. The basic value space of float64 consists of the values m * 2^e, where m is an integer whose absolute value is less than 2^53, and e is an integer between -1075 and 970, inclusive. In addition to the basic value space described above, the value space of float64 also contains the following special values: positive and negative zero, positive and negative infinity and not-a-number. The order-relation on float64 is: x < y if y - x is positive. Positive zero is greater than negative zero. Not-a-number equals itself and is greater than all float64 values including positive infinity. float64 values have a lexical representation consisting of a mantissa followed, optionally, by the character "E" or "e", followed by an exponent. The exponent must be an integer. The mantissa must be a decimal number. The representations for exponent and mantissa must follow the lexical rules for integer and decimal. If the "E" or "e" and the following exponent are omitted, an exponent value of 0 is assumed. The special values positive and negative zero, positive and negative infinity and not-a-number have lexical representations 0, -0, INF, -INF and NaN, respectively. For example, -1E4, 1267.43233E12, 12.78e-2, 12 and INF are all legal literals for float64.
    sint16_least_2: base-type=sint16_least, range raw -32768..32767  # sint16_least represents a signed integer with values defined by at least 16 bit.
    sint32_least_2: base-type=sint32_least, range raw -2147483648..2147483647  # sint32_least represents a signed integer with values defined by at least 32 bit.
    sint64_2: base-type=sint64, range raw -9223372036854775808..9223372036854775807  # sint64 represents integers with a minimum value of -9223372036854775808 and a maximum value of 9223372036854775807. The order-relation on sint64 is: x < y if y - x is positive. sint64 has a lexical representation consisting of an optional sign allowed by a finite-length sequence of decimal digits (#x30-#x39). If the sign is omitted, "+" is assumed. For example: -1, 0, -12688778, +10000, 250098675.
    sint8_least_1: base-type=sint8_least, range raw -128..127  # sint8_least represents a signed integer with values defined by at least 8 bit.
    uint16_least_2: base-type=uint16_least, range raw 0..65535  # uint16_least represents an unsigned integer with values defined by at least 16 bit.
    uint32_least_1: base-type=uint32_least, range raw 0..4294967295  # uint32_least represents an unsigned integer with values defined by at least 32 bit.
    uint8_least_1: base-type=uint8_least, range raw 0..255  # uint8_least represents an unsigned integer with values defined by at least 8 bit.
