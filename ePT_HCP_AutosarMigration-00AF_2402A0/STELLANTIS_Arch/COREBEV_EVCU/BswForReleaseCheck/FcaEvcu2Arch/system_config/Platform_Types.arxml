AUTOSAR XML (schema 4-2-2)
standard types defined: boolean, float32, float64, sint16, sint16_least, sint32, sint32_least, sint64, sint8, sint8_least, uint16, uint16_least, uint32, uint32_least, uint64, uint8, uint8_least
package /AUTOSAR_Platform/ImplementationDataTypes  # AUTOSAR Platform types
