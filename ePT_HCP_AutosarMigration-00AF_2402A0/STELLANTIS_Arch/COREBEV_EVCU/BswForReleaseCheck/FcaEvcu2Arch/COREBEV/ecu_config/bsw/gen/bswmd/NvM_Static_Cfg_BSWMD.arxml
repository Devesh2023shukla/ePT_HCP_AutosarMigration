AUTOSAR XML (schema 4-2-2)
package /AUTOSAR_NvM/SwcBswMappings
  swc bsw mapping NvM: bsw-behavior=BswInternalBehavior, swc-behavior=NVRAMManager
    runnable-mappings:
      bsw-entity=CE_EraseNvBlock, swc-runnable=EraseNvBlock
      bsw-entity=CE_GetDataIndex, swc-runnable=GetDataIndex
      bsw-entity=CE_GetErrorStatus, swc-runnable=GetErrorStatus
      bsw-entity=CE_InvalidateNvBlock, swc-runnable=InvalidateNvBlock
      bsw-entity=CE_ReadBlock, swc-runnable=ReadBlock
      bsw-entity=CE_ReadPRAMBlock, swc-runnable=ReadPRAMBlock
      bsw-entity=CE_RestoreBlockDefaults, swc-runnable=RestoreBlockDefaults
      bsw-entity=CE_RestorePRAMBlockDefaults, swc-runnable=RestorePRAMBlockDefaults
      bsw-entity=CE_SetBlockProtection, swc-runnable=SetBlockProtection
      bsw-entity=CE_SetDataIndex, swc-runnable=SetDataIndex
      bsw-entity=CE_SetRamBlockStatus, swc-runnable=SetRamBlockStatus
      bsw-entity=CE_WriteBlock, swc-runnable=WriteBlock
      bsw-entity=CE_WritePRAMBlock, swc-runnable=WritePRAMBlock
      bsw-entity=SE_MainFunction, swc-runnable=MainFunction
package /AUTOSAR_NvM/BswModuleDescriptions
  bsw module description NvM: category=BSW_MODULE, module-id=20  # NVRAM Manager
    provided-entrys:
      NvM_CancelWriteAll
      NvM_EraseNvBlock
      NvM_GetDataIndex
      NvM_GetErrorStatus
      NvM_GetVersionInfo
      NvM_Init
      NvM_InvalidateNvBlock
      NvM_MainFunction
      NvM_Rb_AuxGetDataIndex
      NvM_Rb_AuxGetErrorInfoDetail
      NvM_Rb_AuxGetErrorStatus
      NvM_Rb_AuxGetMigrationResult
      NvM_Rb_AuxInvalidateNvBlock
      NvM_Rb_AuxReadBlock
      NvM_Rb_AuxSetDataIndex
      NvM_Rb_AuxWriteBlock
      NvM_Rb_ClrWriteMonCntrs
      NvM_Rb_FirstInitAll
      NvM_Rb_GetActiveService
      NvM_Rb_GetBlockId
      NvM_Rb_GetBlockIdCausingLastDetError
      NvM_Rb_GetErrorInfoDetail
      NvM_Rb_GetMigrationResult
      NvM_Rb_GetNvBlockLength
      NvM_Rb_GetRequestType
      NvM_Rb_GetStatus
      NvM_Rb_GetWriteCounter
      NvM_Rb_MainFunctionAndDependency
      NvM_Rb_SetWriteAllTrigger
      NvM_ReadAll
      NvM_ReadBlock
      NvM_ReadPRAMBlock
      NvM_RestoreBlockDefaults
      NvM_RestorePRAMBlockDefaults
      NvM_SetBlockLockStatus
      NvM_SetBlockProtection
      NvM_SetDataIndex
      NvM_SetRamBlockStatus
      NvM_ValidateAll
      NvM_WriteAll
      NvM_WriteBlock
      NvM_WritePRAMBlock
    outgoing-callbacks:
      NvM_InitBlockCallbackFunction
      NvM_MultiBlockCallbackFunction
      NvM_Rb_MultiBlockStartCallbackFunction
      NvM_Rb_ObserverCallbackFunction
      NvM_ReadRamBlockFromNvm
      NvM_SingleBlockCallbackFunction
      NvM_Rb_SingleBlockStartCallbackFunction
      NvM_WriteRamBlockToNvm
    4 x bsw module dependency:
      Det: target-module-id=15
      MemIf: target-module-id=22
      Rte: target-module-id=2
      SchM: target-module-id=130
package /AUTOSAR_NvM/BswModuleEntrys
  50 x bsw module entry, all with sw-service-impl-policy=STANDARD:
    NvM_CancelWriteAll: service-id=10, is-reentrant=true, is-synchronous=false, call-type=REGULAR, execution-context=UNSPECIFIED  # Service to cancel a running NvM_WriteAll request | This service stops an ongoning multi-block write operation in a non-destructive way. Non-destructive means that the currently ongoing single-block write operation is finished as usual before the loop over all blocks to be written is leaved prematurely. If no multi-block write operation is currently ongoing, invoking NvM_CancelWriteAll is without any effect. The request result of all blocks which are not written as part of the multi-block write operation, due to the invocation of NvM_CancelWriteAll, is set to NVM_REQ_CANCELED except for those blocks which are pending due to a previously queued single block request. | NvM_CancelWriteAll sets the request result of block #0 to NVM_REQ_CANCELED if the writing of at least one block has been cancelled. A configured multiblock callback is invoked even if the WriteAll operation is canceled due to the invocation of NvM_CancelWriteAll.
    NvM_EraseNvBlock: service-id=9, is-reentrant=true, is-synchronous=false, call-type=REGULAR, execution-context=UNSPECIFIED  # Service to erase an NV block | This service allows the NvM user to erase a block in persistent storage. After successful execution of this service, reading this block will fail due to missing NV block data (NVM_REQ_INTEGRITY_FAILED). The request for erasing a block is only put into an NvM-internal queue and the actual erase operation is then carried out asynchronously. The NvM user can poll the request result of this operation via NvM_GetErrorStatus or can be informed by a callback function upon completion (see NvM_SingleBlockCallbackFunction). | Erasing is only possible for blocks configured to have immediate priority (see also NvMBlockJobPriority). If enhanced dynamic configuration is enabled and the current block is selected for ReadAll and is not resistant to changed software then the request NvM_EraseNvBlock will be not accepted by NvM as long as NvM_ReadAll has not been initiated. The following request results (not return values!) from NvM_EraseNvBlock (retrieved by a subsequent call of NvM_GetErrorStatus) are possible: NVM_REQ_OK: Indicates that the erase operation was successful. NVM_REQ_PENDING: Indicates that the erase operation is still ongoing. NVM_REQ_NOT_OK: Indicates that the erase operation failed due to an unexpected event. This is typically (but not always) due to integration errors.
      return type ReturnValue: direction=OUT, implementation-data-type=Std_ReturnType  # E_OK is returned if the erase operation has been successfully triggered. Otherwise, E_NOT_OK is returned. | Possible reasons for NvM_EraseNvBlock returning E_NOT_OK are: NvM is not yet initialized. The BlockId parameter is out of range. The NvM block selected by the BlockId parameter is not configured to have immediate job priority (as defined by configuration parameter NvMBlockJobPriority). The NvM block selected by the BlockId parameter is write protected. The NvM block selected by the BlockId parameter is of type NVM_BLOCK_DATASET and its dataset index points to a ROM block instead of an NV block. There is currently a single-block or multi-block operation in progress on the selected block. The queue for single-block requests is full.
      sw service arg BlockId: direction=IN, implementation-data-type=NvM_BlockIdType  # This parameter selects the block which shall be erased on the persistent storage.
    NvM_GetDataIndex: service-id=2, is-reentrant=true, is-synchronous=true, call-type=REGULAR, execution-context=UNSPECIFIED  # Service for getting the current dataset index of an NvM block of type NVM_BLOCK_DATASET | This service allows the NvM user to retrieve which NV block is currently used for the given NvM block. It is only useful for NvM blocks of type NVM_BLOCK_DATASET.
      return type ReturnValue: direction=OUT, implementation-data-type=Std_ReturnType  # E_OK is returned if the dataset index has been successfully retrieved. Otherwise, E_NOT_OK is returned. | Possible reasons for NvM_GetDataIndex returning E_NOT_OK are: NvM is not yet initialized. The BlockId parameter is out of range. The DataIndexPtr parameter is a NULL pointer.
      sw service arg BlockId: direction=IN, implementation-data-type=NvM_BlockIdType  # This parameter selects the block for which the dataset index shall be retrieved.
      sw service arg DataIndexPtr: category=DATA_REFERENCE, direction=OUT, sw-pointer-target-props={target-category=VALUE, implementation-data-type=uint8}  # This parameter points to the user variable which shall receive the current dataset index for the block selected by the BlockId parameter.
    NvM_GetErrorStatus: service-id=4, is-reentrant=true, is-synchronous=true, call-type=REGULAR, execution-context=UNSPECIFIED  # Service for reading block dependent error/status information | This service allows the NvM user to retrieve the result of the latest asynchronous block operation. If there is a block operation currently ongoing, NVM_REQ_PENDING is reported.
      return type ReturnValue: direction=OUT, implementation-data-type=Std_ReturnType  # E_OK is returned if the error/status information has been successfully retrieved. Otherwise, E_NOT_OK is returned. | Possible reasons for NvM_GetErrorStatus returning E_NOT_OK are: NvM is not yet initialized. The BlockId parameter is out of range. The RequestResultPtr parameter is a NULL pointer. If you are absolutely sure that you always provide a valid BlockId and a non-NULL request result pointer when calling this service, you may decide to not check this service's return value.
      sw service arg BlockId: direction=IN, implementation-data-type=NvM_BlockIdType  # This parameter selects the block for which error/status information shall be retrieved. In addition to the IDs of single blocks configured by the NvM user, NvM_GetErrorStatus also allows the BlockId to be set to zero. In this case, the error/status information of the latest multi-block operation is retrieved.
      sw service arg RequestResultPtr: category=DATA_REFERENCE, direction=OUT, sw-pointer-target-props={target-category=VALUE, implementation-data-type=NvM_RequestResultType}  # This parameter points to the user variable which shall receive the current error/status information for the block selected by the BlockId parameter. Please refer to the description of the NvM_RequestResultType for a list of all possible request results and their meaning.
    NvM_GetVersionInfo: service-id=15, is-reentrant=false, is-synchronous=true, call-type=REGULAR, execution-context=UNSPECIFIED  # Service for getting version information of the NvM module | This service allows the NvM user to retrieve version information of the NvM module at runtime. The existence of this service is pre-compile time configurable by the configuration parameter NvMVersionInfoApi.
      sw service arg VersionInfoPtr: category=DATA_REFERENCE, direction=OUT, sw-pointer-target-props={target-category=STRUCTURE, implementation-data-type=Std_VersionInfoType}  # This parameter points to the user variable which shall receive the version information of this module (vendor ID, module ID and software version). Please refer to the description of the Std_VersionInfoType for details.
    NvM_Init: service-id=0, is-reentrant=false, is-synchronous=true, call-type=REGULAR, execution-context=UNSPECIFIED  # Service for resetting internal variables | This service resets internal NvM variables. This also includes the clearing of all queues. In case the corresponding saved zone is lost (e.g. after a reset), invoking this service sets all request results to NVM_REQ_OK and the corresponding RAM block states to unchanged and invalid. Additionally, the write protection states of all blocks are reset to their configured value and their dataset index is reset to zero. In case the saved zone is not lost, invoking this service resets neither RAM block states nor write protection states. | In contrast to many non-AUTOSAR implementations of persistent storage drivers, this initialization service does not also read selected blocks from persistent storage. In NvM, this initial reading of blocks is the task of the NvM_ReadAll service, not of NvM_Init. NvM_Init shall not be called by any regular NvM user. This is the task of system control only (in particular EcuM).
    NvM_InitBlockCallbackFunction: is-reentrant=false, is-synchronous=true, call-type=CALLBACK, execution-context=UNSPECIFIED  # Per block callback routine to notify the NvM user that default data is required for a block | A callback routine with this signature (but typically not with the same name) is called by NvM if a RAM block shall be initialized by the NvM user. The actual name of the callback routine is configured by the NvM user via the NvMInitBlockCallback configuration parameter. Inside this callback routine, the NvM user shall fill the corresponding RAM block with initialization data. It is not allowed to call any NvM or DEM functions from within this callback function!
      return type ReturnValue: direction=OUT, implementation-data-type=Std_ReturnType  # The NvM user shall always return E_OK as the return value of the initialization callback. NvM does not evaluate this return value at all.
    NvM_InvalidateNvBlock: service-id=11, is-reentrant=true, is-synchronous=false, call-type=REGULAR, execution-context=UNSPECIFIED  # Service to invalidate an NV block | This service allows the NvM user to invalidate a block in persistent storage. After successful execution of this service, reading this block will fail due to invalidated NV block data (NVM_REQ_NV_INVALIDATED). The request for invalidating a block is only put into an NvM-internal queue and the actual invalidation operation is then carried out asynchronously. The NvM user can poll the request result of this operation via NvM_GetErrorStatus or can be informed by a callback function upon completion (see NvM_SingleBlockCallbackFunction). | If enhanced dynamic configuration is enabled and the current block is selected for ReadAll and is not resistant to changed software then the request NvM_InvalidateNvBlock will be not accepted by NvM as long as NvM_ReadAll has not been initiated. The following request results (not return values!) from NvM_InvalidateNvBlock (retrieved by a subsequent call of NvM_GetErrorStatus) are possible: NVM_REQ_OK: Indicates that the invalidation operation was successful. NVM_REQ_PENDING: Indicates that the invalidation operation is still ongoing. NVM_REQ_NOT_OK: Indicates that the invalidation operation failed due to an unexpected event. This is typically (but not always) due to integration errors.
      return type ReturnValue: direction=OUT, implementation-data-type=Std_ReturnType  # E_OK is returned if the invalidation operation has been successfully triggered. Otherwise, E_NOT_OK is returned. | Possible reasons for NvM_InvalidateNvBlock returning E_NOT_OK are: NvM is not yet initialized. The BlockId parameter is out of range. The NvM block selected by the BlockId parameter is write protected. The NvM block selected by the BlockId parameter is of type NVM_BLOCK_DATASET and its dataset index points to a ROM block instead of an NV block. There is currently a single-block or multi-block operation in progress on the selected block. The queue for single-block requests is full.
      sw service arg BlockId: direction=IN, implementation-data-type=NvM_BlockIdType  # This parameter selects the block which shall be invalidated in persistent storage.
    NvM_MainFunction: service-id=14, is-reentrant=false, is-synchronous=true, call-type=SCHEDULED, execution-context=TASK  # Service for performing the processing of NvM jobs | This service does the actual processing of all asynchronous tasks given to NvM such as reading or writing single or multiple NvM blocks. | This service shall not be called by any regular NvM user. This is the task of the BSW scheduler.
    NvM_MultiBlockCallbackFunction: is-reentrant=false, is-synchronous=true, call-type=CALLBACK, execution-context=UNSPECIFIED  # Callback routine to notify the NvM user that an asynchronous multi-block request has been finished | A callback routine with this signature (but typically not with the same name) is called by NvM once a multi-block operation has finished. The actual name of the callback routine is configured by the NvM user via the NvMMultiBlockCallback configuration parameter. It is not allowed to call any NvM or DEM functions from within this callback function!
      sw service arg ServiceId: direction=IN, implementation-data-type=uint8  # The request type (read, write, ... etc.) of the previous processed multi block job.
      sw service arg JobResult: direction=IN, implementation-data-type=NvM_RequestResultType  # The job result parameter informs the NvM user about the result of the just finished multi-block service. This is the same value which would also be reported by the NvM_GetErrorStatus API.
    NvM_Rb_MultiBlockStartCallbackFunction: is-reentrant=false, is-synchronous=true, call-type=CALLBACK, execution-context=UNSPECIFIED  # Callback routine to notify the NvM user that an asynchronous multi-block request is starting | A callback routine with this signature (but typically not with the same name) is called by NvM once a multi-block operation is starting. The actual name of the callback routine is configured by the NvM user via the NvMRbMultiBlockStartCallback configuration parameter. It is not allowed to call any NvM or DEM functions from within this callback function!
      sw service arg ServiceId: direction=IN, implementation-data-type=uint8  # The request type (read, write, ... etc.) of the previous processed multi block job.
    NvM_Rb_AuxGetDataIndex: service-id=243, is-reentrant=true, is-synchronous=true, call-type=REGULAR, execution-context=UNSPECIFIED  # Service for getting the current dataset index of an NvM block of type NVM_BLOCK_DATASET | This service allows the NvM user to retrieve which NV block is currently used for accesses to NvM blocks of type NVM_BLOCK_DATASET carried out by an auxiliary user.
      return type ReturnValue: direction=OUT, implementation-data-type=Std_ReturnType  # E_OK is returned if the dataset index has been successfully retrieved. Otherwise, E_NOT_OK is returned. | Possible reasons for NvM_Rb_AuxGetDataIndex returning E_NOT_OK are: NvM is not yet initialized. The DataIndexPtr parameter is a NULL pointer.
      sw service arg DataIndexPtr: category=DATA_REFERENCE, direction=OUT, sw-pointer-target-props={target-category=VALUE, implementation-data-type=uint8}  # This parameter points to the user variable which shall receive the current dataset index.
    NvM_Rb_AuxGetErrorInfoDetail: service-id=228, is-reentrant=false, is-synchronous=true, call-type=REGULAR, execution-context=UNSPECIFIED  # Service to read more detailed error information | This service allows the NvM user to read detailed error information carried out by an auxiliary user. It is defined only in case a read job finished with NVM_REQ_INTEGRITY_FAILED or NVM_REQ_RESTORED_FROM_ROM.
      return type ReturnValue: direction=OUT, implementation-data-type=Std_ReturnType  # E_OK is returned if the detailed error information has been successfully read. Otherwise, E_NOT_OK is returned. | Possible reasons for NvM_Rb_GetErrorInfoDetail returning E_NOT_OK are: NvM is not yet initialized. The result_pen parameter is a NULL pointer.
      sw service arg result_pen: category=DATA_REFERENCE, direction=OUT, sw-pointer-target-props={target-category=VALUE, implementation-data-type=NvM_Rb_ErrorInfoDetail_ten}  # This parameter points to the auxiliary user variable which shall receive the detailed error information for the block. Please refer to the description of the NvM_Rb_ErrorInfoDetail_ten for a list of all possible detailed error information and their meaning.
    NvM_Rb_AuxGetErrorStatus: service-id=244, is-reentrant=true, is-synchronous=true, call-type=REGULAR, execution-context=UNSPECIFIED  # Service for reading block dependent error/status information | This service allows the NvM user to retrieve the result of the latest asynchronous block operation carried out by an auxiliary user. If there is a block operation currently ongoing, NVM_REQ_PENDING is reported.
      return type ReturnValue: direction=OUT, implementation-data-type=Std_ReturnType  # E_OK is returned if the error/status information has been successfully retrieved. Otherwise, E_NOT_OK is returned. | Possible reasons for NvM_Rb_AuxGetErrorStatus returning E_NOT_OK are: NvM is not yet initialized. The RequestResultPtr parameter is a NULL pointer. If you are absolutely sure that you always provide a non-NULL request result pointer when calling this service, you may decide to not check this service's return value.
      sw service arg RequestResultPtr: category=DATA_REFERENCE, direction=OUT, sw-pointer-target-props={target-category=VALUE, implementation-data-type=NvM_RequestResultType}  # This parameter points to the user variable which shall receive the current error/status information for the block selected by the most previously triggered auxiliary service. Please refer to the description of the NvM_RequestResultType for a list of all possible request results and their meaning.
    NvM_Rb_AuxGetMigrationResult: service-id=238, is-reentrant=false, is-synchronous=true, call-type=REGULAR, execution-context=UNSPECIFIED  # Service to read the auxiliary migration result. | This service allows the NvM user to read the result of the migration for the block used by the most previously triggered auxiliary service.
      return type ReturnValue: direction=OUT, implementation-data-type=Std_ReturnType  # E_OK is returned if the auxiliary migration result has been successfully read. Otherwise, E_NOT_OK is returned. | Possible reasons for NvM_Rb_AuxGetMigrationResult returning E_NOT_OK are: NvM is not yet initialized. The MigrationResultPtr parameter is a NULL pointer. If you are absolutely sure that you always provide a non-NULL request result pointer when calling this service, you may decide to not check this service's return value.
      sw service arg MigrationResultPtr: category=DATA_REFERENCE, direction=OUT, sw-pointer-target-props={target-category=VALUE, implementation-data-type=NvM_Rb_MigrationResult_ten}  # This parameter points to the user variable which shall receive the current migration result for the block used by the most previously triggered auxiliary service. Please refer to the description of the NvM_Rb_MigrationResult_ten for a list of all possible migration results and their meaning.
    NvM_Rb_AuxInvalidateNvBlock: service-id=245, is-reentrant=true, is-synchronous=false, call-type=REGULAR, execution-context=UNSPECIFIED  # Service to invalidate an NV block | This service allows the NvM user to invalidate a block in persistent storage. After successful execution of this service, reading this block will fail due to invalidated NV block data (NVM_REQ_NV_INVALIDATED). The request for invalidating a block is only put into an NvM-internal queue and the actual invalidation operation is then carried out asynchronously. The NvM user can poll the request result of this operation via NvM_Rb_AuxGetErrorStatus. | If enhanced dynamic configuration is enabled and the current block is selected for ReadAll and is not resistant to changed software then the request NvM_Rb_AuxInvalidateNvBlock will be not accepted by NvM as long as NvM_ReadAll has not been initiated. The following request results (not return values!) from NvM_Rb_AuxInvalidateNvBlock (retrieved by a subsequent call of NvM_Rb_AuxGetErrorStatus) are possible: NVM_REQ_OK: Indicates that the invalidation operation was successful. NVM_REQ_PENDING: Indicates that the invalidation operation is still ongoing. NVM_REQ_NOT_OK: Indicates that the invalidation operation failed due to an unexpected event. This is typically (but not always) due to integration errors.
      return type ReturnValue: direction=OUT, implementation-data-type=Std_ReturnType  # E_OK is returned if the invalidation operation has been successfully triggered. Otherwise, E_NOT_OK is returned. | Possible reasons for NvM_Rb_AuxInvalidateNvBlock returning E_NOT_OK are: NvM is not yet initialized. The BlockId parameter is out of range. The dataset index set by NvM_Rb_AuxSetDataIndex is out of range for the NvM block selected by the BlockId parameter. The NvM block selected by the BlockId parameter is write protected. The NvM block selected by the BlockId parameter is of type NVM_BLOCK_DATASET and the dataset index set by NvM_Rb_AuxSetDataIndex points to a ROM block instead of an NV block. There is currently another operation in progress which is triggered by an auxiliary user. The queue for auxiliary requests is full.
      sw service arg BlockId: direction=IN, implementation-data-type=NvM_BlockIdType  # This parameter selects the block which shall be invalidated in persistent storage.
    NvM_Rb_AuxReadBlock: service-id=246, is-reentrant=true, is-synchronous=false, call-type=REGULAR, execution-context=UNSPECIFIED  # Service to copy the data of a single NV block to a temporary RAM block | This service allows the NvM user to read block data from persistent storage into a temporary RAM block. The request for reading a block is only put into an NvM-internal queue and the actual read operation is then carried out asynchronously. The NvM user can poll the request result of this operation via NvM_Rb_AuxGetErrorStatus. | If the NvM block is of type NVM_BLOCK_DATASET and the dataset index points to a ROM block, the "read" operation consists in copying default data from the ROM block to the temporary RAM block. Even after NvM_Rb_AuxReadBlock returned, the variable pointed to by NvM_DstPtr will be used internally by NvM until the actual read operation is finished. This is due to the asynchronous nature of this service. If enhanced dynamic configuration is enabled and the current block is selected for ReadAll and is not resistant to changed software then the request NvM_Rb_AuxReadBlock will be not accepted by NvM as long as NvM_ReadAll has not been initiated. The following request results (not return values!) from NvM_Rb_AuxReadBlock (retrieved by a subsequent call of NvM_Rb_AuxGetErrorStatus) are possible: NVM_REQ_OK: Indicates that the read operation was successful. NVM_REQ_PENDING: Indicates that the read operation is still ongoing. NVM_REQ_REDUNDANCY_FAILED: Indicates that the redundancy of the current block in has been lost on the persistent media (but the block could still be read successfully). In the current version of NvM, this state can never occur. NVM_REQ_RESTORED_FROM_ROM: Indicates that ROM data has been read for this block instead of NV data if an implicit recovery occurred. NVM_REQ_NV_INVALIDATED: Indicates that the read operation only found an invalidated block on the persistent media instead of an NV block containing "real" data. The temporary RAM block remains untouched in this case. NVM_REQ_INTEGRITY_FAILED: Indicates that the read operation did not find any valid data for this block on the persistent media. NVM_REQ_NOT_OK: Indicates that the read operation failed due to an unexpected event. Typical reasons for this request result are integration or hardware errors. If the request result of this service is NVM_REQ_INTEGRITY_FAILED or NVM_REQ_NOT_OK, then the temporary RAM block's contents may be corrupted. You may want to bring back the temporary RAM block into a consistent state in this case.
      return type ReturnValue: direction=OUT, implementation-data-type=Std_ReturnType  # E_OK is returned if the read operation has been successfully triggered. Otherwise, E_NOT_OK is returned. | Possible reasons for NvM_Rb_AuxReadBlock returning E_NOT_OK are: NvM is not yet initialized. The BlockId parameter is out of range. The dataset index set by NvM_Rb_AuxSetDataIndex is out of range for the NvM block selected by the BlockId parameter. The NvM_DstPtr parameter is a NULL pointer. There is currently another operation in progress which is triggered by an auxiliary user. The queue for auxiliary requests is full.
      sw service arg BlockId: direction=IN, implementation-data-type=NvM_BlockIdType  # This parameter selects the block which shall be read from persistent storage.
      sw service arg NvM_DstPtr: direction=OUT, implementation-data-type=NvM_Rb_VoidPtr  # This parameter points to a temporary RAM block receiving the data read from the corresponding NV block.
    NvM_Rb_AuxSetDataIndex: service-id=247, is-reentrant=true, is-synchronous=true, call-type=REGULAR, execution-context=UNSPECIFIED  # Service for setting the dataset index of an NvM block of type NVM_BLOCK_DATASET | This service allows the NvM user to select the NV block which is to be used for accesses to NvM blocks of type NVM_BLOCK_DATASET carried out by an auxiliary user. It leaves the NV block(s) untouched in any case.
      return type ReturnValue: direction=OUT, implementation-data-type=Std_ReturnType  # E_OK is returned if the dataset index has been set successfully. Otherwise, E_NOT_OK is returned. | Possible reasons for NvM_Rb_AuxSetDataIndex returning E_NOT_OK are: NvM is not yet initialized. There is currently another operation in progress which is triggered by an auxiliary user.
      sw service arg DataIndex: direction=IN, implementation-data-type=uint8  # This parameter defines the new dataset index to be used in subsequent operations triggered by an auxiliary user.
    NvM_Rb_AuxWriteBlock: service-id=248, is-reentrant=true, is-synchronous=false, call-type=REGULAR, execution-context=UNSPECIFIED  # Service to copy the data of a temporary RAM block to a single NV block | This service allows the NvM user to write data from a temporary RAM block into persistent storage. The request for writing a block is only put into an NvM-internal queue and the actual write operation is then carried out asynchronously. The NvM user can poll the request result of this operation via NvM_Rb_AuxGetErrorStatus. | Even after NvM_Rb_AuxWriteBlock returned, the variable pointed to by NvM_SrcPtr will be used internally by NvM until the actual write operation is finished. This is due to the asynchronous nature of this service. If enhanced dynamic configuration is enabled and the current block is selected for ReadAll and is not resistant to changed software then the request NvM_Rb_AuxWriteBlock will be not accepted by NvM as long as NvM_ReadAll has not been initiated. The following request results (not return values!) from NvM_Rb_AuxWriteBlock (retrieved by a subsequent call of NvM_Rb_AuxGetErrorStatus) are possible: NVM_REQ_OK: Indicates that the write operation was successful. NVM_REQ_PENDING: Indicates that the write operation is still ongoing. NVM_REQ_NOT_OK: Indicates that the write operation failed due to an unexpected event. This is typically (but not always) due to integration errors.
      return type ReturnValue: direction=OUT, implementation-data-type=Std_ReturnType  # E_OK is returned if the write operation has been successfully triggered. Otherwise, E_NOT_OK is returned. | Possible reasons for NvM_Rb_AuxWriteBlock returning E_NOT_OK are: NvM is not yet initialized. The BlockId parameter is out of range. The dataset index set by NvM_Rb_AuxSetDataIndex is out of range for the NvM block selected by the BlockId parameter. The NvM_SrcPtr parameter is a NULL pointer. The NvM block selected by the BlockId parameter is write protected. The NvM block selected by the BlockId parameter is of type NVM_BLOCK_DATASET and the dataset index set by NvM_Rb_AuxSetDataIndex points to a ROM block instead of an NV block. There is currently another operation in progress which is triggered by an auxiliary user. The queue for auxiliary requests is full.
      sw service arg BlockId: direction=IN, implementation-data-type=NvM_BlockIdType  # This parameter selects the block which shall be written to persistent storage.
      sw service arg NvM_SrcPtr: category=DATA_REFERENCE, direction=IN, implementation-data-type=NvM_Rb_ConstVoidPtr  # This parameter points to a temporary RAM block holding the data to be written to the corresponding NV block.
    NvM_Rb_ClrWriteMonCntrs: service-id=235, is-reentrant=true, is-synchronous=true, call-type=REGULAR, execution-context=UNSPECIFIED  # Service to clear write monitoring counters. | This service clears all write monitoring counters if configured otherwise this service does nothing.
      return type ReturnValue: direction=OUT, implementation-data-type=Std_ReturnType  # E_OK is returned if write monitor counters has been cleared successfully. | This service always returns E_OK.
    NvM_Rb_FirstInitAll: service-id=251, is-reentrant=false, is-synchronous=false, call-type=REGULAR, execution-context=UNSPECIFIED  # Service to trigger a multi block (re-) initialization operation | This service triggers the (re-) initialization of an entire range of NvM blocks both on persistent storage and in the corresponding RAM blocks. For a proper initialisation of a native or a redundant NvM block, such a block needs to have at least one recovery data source (i.e. a ROM block or an InitBlockCallback), to have a permanent RAM block or to be configured to use explicit synchronization mechanism and to be selected for this operation (via configuration parameter NvMRbSelectBlockForFirstInitAll). An NvM block, selected for this operation and which has no ROM block and no InitBlockCallback, is simply invalidated by the NvM_Rb_FirstInitAll operation. All the NV blocks of an NvM block of type NVM_BLOCK_DATASET, selected for this operation, are simply invalidated by the NvM_Rb_FirstInitAll job. NvM_Rb_FirstInitAll shall not be called by any regular NvM user. This is the task of a special first initialization control instance. First initialization consists of the following actions per block: If a ROM block or an InitBlockCallback has been configured for the corresponding native or redundant block, a restore job is performed, immediately followed by a write job. After successful execution, both the RAM block and the NV block are initialized with default data and the NvM block itself is internally marked as valid and unchanged. Otherwise , an invalidation job is performed on this block, leaving the RAM block including its internal status untouched and the NV block in an "intentionally marked as invalid" state. If a block is of type NvM_BLOCK_DATASET, all its NV blocks are invalidated. The invalidation job is performed on this block, leaving the RAM block including its internal status untouched and the NV blocks in an "intentionally marked as invalid" state. The write protection status of a block is ignored during the execution of this service. The request for (re-) initializing multiple blocks is only put into an NvM-internal queue and the actual initialization operations are then carried out asynchronously. The NvM user can poll the overall result of this operation via NvM_GetErrorStatus (providing 0 for the block ID) or can be informed by a callback function upon completion (see NvM_MultiBlockCallbackFunction). Additionally, the status information of all participating blocks is maintained and all configured callbacks for these blocks are invoked just as in the case of single-block requests. The order of single-block operations during NvM_Rb_FirstInitAll is dictated by the block IDs (ascending order). The following multi-block request results from NvM_Rb_FirstInitAll (retrieved by a subsequent call of NvM_GetErrorStatus) are possible: NVM_REQ_OK: Indicates that all single-block operations carried out during the multi-block first initialization operation were successful. NVM_REQ_PENDING: Indicates that the multi-block first initialization operation is still ongoing. NVM_REQ_NOT_OK: Indicates that at least one single-block operation carried out during the multi-block first initialization operation failed due to an unexpected event. Typical reasons for this event are integration or hardware errors or explicit synchronization callbacks which failed after too many retries (see also the configuration parameter NvMRepeatMirrorOperations). A block which is not participating in the multi-block read operation gets the request result NVM_REQ_BLOCK_SKIPPED assigned in its single-block status if it is not already pending due to a previously queued single block request. The RAM status (changed/unchanged, valid/invalid) of skipped blocks remains untouched.
    NvM_Rb_GetActiveService: service-id=252, is-reentrant=true, is-synchronous=true, call-type=REGULAR, execution-context=UNSPECIFIED  # Service to read the ID of the currently active service of the NVRAM manager | This overall status is maintained within the NvM_MainFunction, so it does not take any asynchronous single block or multi block request into consideration before this has been arbitrated by the NvM_MainFunction. This service is mainly intended to be called within the InitBlockCallback. Also check the "Get Active Service" choater in the NvM Docu.
      return type ReturnValue: direction=OUT, implementation-data-type=Std_ReturnType  # E_OK is returned if the active NvM service was retrieved successfully. Otherwise, E_NOT_OK is returned. | Possible reasons for NvM_Rb_GetActiveService returning E_NOT_OK are: The ServiceIdPtr parameter is a NULL pointer.
      sw service arg ServiceIdPtr: category=DATA_REFERENCE, direction=OUT, sw-pointer-target-props={target-category=VALUE, implementation-data-type=uint8}  # This parameter points to the user variable which shall receive the currently active NvM service.
    NvM_Rb_GetBlockId: service-id=250, is-reentrant=true, is-synchronous=true, call-type=REGULAR, execution-context=UNSPECIFIED  # Service for getting the NvM block ID using the persistent ID input parameter
      return type ReturnValue: direction=OUT, implementation-data-type=Std_ReturnType  # E_OK is returned if the block ID was retrieved successfully from the corresponding NvM block desriptor. Otherwise, E_NOT_OK is returned. | Possible reasons for NvM_Rb_GetBlockId returning E_NOT_OK are: No block with the given PersistentId has been configured. The BlockIdPtr parameter is a NULL pointer.
      sw service arg PersistentId: direction=IN, implementation-data-type=uint16  # This parameter is the persistent ID of the NvM block for which the ID is to be retrieved.
      sw service arg BlockIdPtr: category=DATA_REFERENCE, direction=OUT, sw-pointer-target-props={target-category=VALUE, implementation-data-type=NvM_BlockIdType}  # This parameter points to the user variable which shall receive the ID of the NvM block whose persistent ID is equal to the value of the PersistentId passed parameter.
    NvM_Rb_GetBlockIdCausingLastDetError: service-id=236, is-reentrant=true, is-synchronous=true, call-type=REGULAR, execution-context=UNSPECIFIED  # Service to get the block ID used in NvM service which has caused the last DET error | Service to get the block ID used in NvM service which has caused the last DET error. As defined in AR if a DET error occurs then the NvM reports it to the DET together with the ID of the service which has triggered this error. Additionally the user can get the block ID used in NvM service which has caused the last DET error via this service. Since DET error ID and service ID are reported separately from the block ID it is possible that the block ID belongs to the DET error which has occured later. So the user of this service shall consider it while evaluating the block ID.
      return type ReturnValue: direction=OUT, implementation-data-type=NvM_BlockIdType  # Block identifier used in NvM service which has caused the last DET error | Typical use case for this function is to be used as callback within the DET. If NvM service which has caused the last DET error does not use any block or no DET error has occured yet, then this function returns 0.
    NvM_Rb_GetErrorInfoDetail: service-id=229, is-reentrant=false, is-synchronous=true, call-type=REGULAR, execution-context=UNSPECIFIED  # Service to read more detailed error information | This service allows the NvM user to read detailed error information. It is defined only in case a read job finished with NVM_REQ_INTEGRITY_FAILED or NVM_REQ_RESTORED_FROM_ROM.
      return type ReturnValue: direction=OUT, implementation-data-type=Std_ReturnType  # E_OK is returned if the detailed error information has been successfully read. Otherwise, E_NOT_OK is returned. | Possible reasons for NvM_Rb_GetErrorInfoDetail returning E_NOT_OK are: NvM is not yet initialized. The BlockId parameter is not a valid block. The result_pen parameter is a NULL pointer.
      sw service arg BlockId: direction=IN, implementation-data-type=NvM_BlockIdType  # This parameter selects the block for which the detailed error information shall be read.
      sw service arg result_pen: category=DATA_REFERENCE, direction=OUT, sw-pointer-target-props={target-category=VALUE, implementation-data-type=NvM_Rb_ErrorInfoDetail_ten}  # This parameter points to the user variable which shall receive the detailed error information for the block. Please refer to the description of the NvM_Rb_ErrorInfoDetail_ten for a list of all possible detailed error information and their meaning.
    NvM_Rb_GetMigrationResult: service-id=239, is-reentrant=false, is-synchronous=true, call-type=REGULAR, execution-context=UNSPECIFIED  # Service to read the result of the migration operation | This service allows the NvM user to read the result of the migration for the block.
      return type ReturnValue: direction=OUT, implementation-data-type=Std_ReturnType  # E_OK is returned if the migration result has been successfully read. Otherwise, E_NOT_OK is returned. | Possible reasons for NvM_Rb_GetMigrationResult returning E_NOT_OK are: NvM is not yet initialized. The MigrationResultPtr parameter is a NULL pointer. If you are absolutely sure that you always provide a non-NULL request result pointer when calling this service, you may decide to not check this service's return value.
      sw service arg BlockId: direction=IN, implementation-data-type=NvM_BlockIdType  # This parameter selects the block for which the migration result shall be read.
      sw service arg MigrationResultPtr: category=DATA_REFERENCE, direction=OUT, sw-pointer-target-props={target-category=VALUE, implementation-data-type=NvM_Rb_MigrationResult_ten}  # This parameter points to the user variable which shall receive the current migration result for the block used by the most previously triggered auxiliary service. Please refer to the description of the NvM_Rb_MigrationResult_ten for a list of all possible migration results and their meaning.
    NvM_Rb_GetNvBlockLength: service-id=253, is-reentrant=true, is-synchronous=true, call-type=REGULAR, execution-context=UNSPECIFIED  # Service for getting the configured NV block length in bytes of an NvM block
      return type ReturnValue: direction=OUT, implementation-data-type=Std_ReturnType  # E_OK is returned if the NV block length was retrieved successfully from the corresponding NvM block desriptor. Otherwise, E_NOT_OK is returned. | Possible reasons for NvM_Rb_GetNvBlockLength returning E_NOT_OK are: The BlockId parameter is out of range. The NvBlockLengthPtr parameter is a NULL pointer.
      sw service arg BlockId: direction=IN, implementation-data-type=NvM_BlockIdType  # This parameter selects the block for which the NV block length is to be retrieved.
      sw service arg NvBlockLengthPtr: category=DATA_REFERENCE, direction=OUT, sw-pointer-target-props={target-category=VALUE, implementation-data-type=uint16}  # This parameter points to the user variable which shall receive the NV block length for the block selected by the BlockId parameter.
    NvM_Rb_GetRequestType: service-id=237, is-reentrant=true, is-synchronous=true, call-type=REGULAR, execution-context=UNSPECIFIED  # Service for reading the type of the currently active service
      return type ReturnValue: direction=OUT, implementation-data-type=NvM_Rb_RequestType_ten  # Type of the currently active block request. | Typical use case for this function is to get the type of the block request for which a callback function has been called. So it is appropriate to call this function only in a callback.
    NvM_Rb_GetStatus: service-id=255, is-reentrant=true, is-synchronous=true, call-type=REGULAR, execution-context=UNSPECIFIED  # Service for reading the overall status of NvM
      return type ReturnValue: direction=OUT, implementation-data-type=Std_ReturnType  # E_OK is returned if the overall status information has been successfully retrieved. Otherwise, E_NOT_OK is returned. | Possible reasons for NvM_Rb_GetStatus returning E_NOT_OK are: The StatusPtr parameter is a NULL pointer. If you are absolutely sure that you always provide a non-NULL status variable pointer when calling this service, you may decide to not check this service's return value.
      sw service arg StatusPtr: category=DATA_REFERENCE, direction=OUT, sw-pointer-target-props={target-category=VALUE, implementation-data-type=NvM_Rb_StatusType}  # This parameter points to the user variable which shall receive the overall status of the NvM. Please refer to the description of NvM_Rb_StatusType for a list of all possible values and their meaning.
    NvM_Rb_GetWriteCounter: service-id=230, is-reentrant=true, is-synchronous=true, call-type=REGULAR, execution-context=UNSPECIFIED  # Service to get the write counter for a NVRAM block
      return type ReturnValue: direction=OUT, implementation-data-type=Std_ReturnType  # E_OK is returned if the block specific write counter has been read successfully. Otherwise, E_NOT_OK is returned. | Possible reasons for NvM_Rb_GetStatus returning E_NOT_OK are: NvM is not yet initialized. The BlockId parameter is out of range. The cntrWrite_puo parameter is a NULL pointer. Write counter not configured.
      sw service arg BlockId: direction=IN, implementation-data-type=NvM_BlockIdType  # This parameter selects the block for which the write counter shall be retrieved.
      sw service arg cntrWrite_puo: category=DATA_REFERENCE, direction=OUT, sw-pointer-target-props={target-category=VALUE, implementation-data-type=uint32}  # This parameter points to the user variable which shall receive the current write counter for the block selected by the BlockId parameter.
    NvM_Rb_MainFunctionAndDependency: is-reentrant=false, is-synchronous=true, call-type=REGULAR, execution-context=UNSPECIFIED  # Service for MainFunction and Dependency invocation | This service invokes NvM MainFunction and Dependency invocation. This service is useful during system initialisation and shutdown scenarios.
    NvM_Rb_ObserverCallbackFunction: is-reentrant=false, is-synchronous=true, call-type=CALLBACK, execution-context=UNSPECIFIED  # Callback routine to notify an NvM observer that the processing of a job for a block within an asynchronous request has been finished | A callback routine with this signature (but typically not with the same name) is called by NvM once a single block asynchronous operation or the processing of a block within an asynchronous multi-block operation has finished. The actual name of the callback routine is configured by an NvM observer via the common NvMRbObserverCallback configuration parameter. It is not allowed to call any NvM or DEM functions from within this callback function!
      return type ReturnValue: direction=OUT, implementation-data-type=Std_ReturnType  # The NvM observer returns E_OK if the callback is successful. Otherwise, E_NOT_OK shall be returned. NvM does not evaluate this return value.
      sw service arg BlockId: direction=IN, implementation-data-type=NvM_BlockIdType  # This parameter selects the block for which the job result is to be delivered via the JobResult passed parameter.
      sw service arg ServiceId: direction=IN, implementation-data-type=uint8  # With this service parameter, the NvM observer is told which service has finished the processing of the block identified by the BlockId passed parameter. The service or BlockRequest IDs are uniquely specified for each NvM service.
      sw service arg JobResult: direction=IN, implementation-data-type=NvM_RequestResultType  # The job result parameter informs the NvM observer about the result of the just finished job operated on a block (identified by the BlockId passed parameter) within an asynchronous request. This is the same value which would also be reported by the NvM_GetErrorStatus API.
    NvM_Rb_SetWriteAllTrigger: service-id=241, is-reentrant=true, is-synchronous=true, call-type=REGULAR, execution-context=UNSPECIFIED  # Alternative service for triggering a multi-block write operation | This service is an alternative service to NvM_SetRamBlockStatus. This API allows the NvM user to trigger a multi-block write operation without caring about the RAM block state or whether another operation on the same block is still in progress.
      return type ReturnValue: direction=OUT, implementation-data-type=Std_ReturnType  # E_OK is returned if the trigger of the multi-block write has been accepted by NvM. Otherwise, E_NOT_OK is returned. | Possible reasons for NvM_Rb_SetWriteAllTrigger returning E_NOT_OK are: NvM is not yet initialized. The BlockId parameter is out of range. The service has been called for an NvM block which has no permanent RAM block assigned via configuration.
      sw service arg BlockId: direction=IN, implementation-data-type=NvM_BlockIdType  # This parameter selects the block for which the WriteAll trigger shall be set.
      sw service arg WriteAllTrigger: direction=IN, implementation-data-type=boolean  # This parameter sets or resets the WriteAll trigger. TRUE means that the NvM_WriteAll shall be triggered for the selected blockId, FALSE means that this trigger shall not be set (but alternative triggers such as a VALID/CHANGED RAM block state are not reset).
    NvM_ReadAll: service-id=12, is-reentrant=true, is-synchronous=false, call-type=REGULAR, execution-context=UNSPECIFIED  # Service to trigger a multi-block read operation | This service triggers the reading of an entire range of NvM blocks from persistent storage to the corresponding RAM blocks. Only blocks which have a permanent RAM block (or which are configured to use explicit synchronization mechanism), are selected for this operation (via configuration parameter NvMSelectBlockForReadAll) and whose RAM status bits indicate that the RAM block is VALID (see also the "RAM block states" figure) participate in multi-block reads. NvM_ReadAll is typically only called during the startup phase of an ECU. | NvM_ReadAll shall not be called by any regular NvM user. This is the task of system control only. The request for reading multiple blocks is only put into an NvM-internal queue and the actual read operations are then carried out asynchronously. The NvM user can poll the overall result of this operation via NvM_GetErrorStatus (providing 0 for the block ID) or can be informed by a callback function upon completion (see NvM_MultiBlockCallbackFunction). Additionally, the status information of all participating blocks is maintained and all configured callbacks for these blocks are invoked just as in the case of single-block read requests. The order of single-block reads during NvM_ReadAll is dictated by the block IDs (ascending order). The following multi-block request results from NvM_ReadAll (retrieved by a subsequent call of NvM_GetErrorStatus) are possible: NVM_REQ_OK: Indicates that all single-block read operations participating in the multi-block read operation were successful. NVM_REQ_PENDING: Indicates that the multi-block read operation is still ongoing. NVM_REQ_NOT_OK: Indicates that at least one single-block read operation participating in the multi-block read operation was not entirely successful (e.g. due to the invalidation of one participating block or if a block is not read successfully and a configured default value is restored). If the dynamic configuration feature is enabled (configuration parameter NvMDynamicConfiguration), the following special read behaviour is activated: NvM_ReadAll starts with reading the block with the reserved block ID 1 (named NvM_ConfigId). If the data contents of this block matches the ID configured in configuration parameter NvMCompiledConfigId, the multi-block read operation continues regularly. If a mismatch has been detected, only blocks configured as being resistant to changed software (configuration parameter NvMResistantToChangedSw set to true) will participate in the multi-block read operation. Blocks not configured as being resistant will be skipped. A block which is not participating in the multi-block read operation gets the request result NVM_REQ_BLOCK_SKIPPED assigned in its single-block status if it is not already pending due to a previously queued single block request. This is independent of the reason why the block did not participate in the multi-block read operation (no permanent RAM block or no explicit synchronization, not selected for ReadAll, not resistant to changed software in case the configuration ID did not match). The RAM block contents and RAM status (changed/unchanged, valid/invalid) of skipped blocks remain untouched.
    NvM_ReadBlock: service-id=6, is-reentrant=true, is-synchronous=false, call-type=REGULAR, execution-context=UNSPECIFIED  # Service to copy the data of a single NV block to its corresponding RAM block | This service allows the NvM user to read block data from persistent storage into RAM. The request for reading a block is only put into an NvM-internal queue and the actual read operation is then carried out asynchronously. The NvM user can poll the request result of this operation via NvM_GetErrorStatus or can be informed by a callback function upon completion (see NvM_SingleBlockCallbackFunction). | If the NvM block is of type NVM_BLOCK_DATASET and the dataset index points to a ROM block, the "read" operation consists in copying default data from the ROM block to the RAM block. Additionally, if this NvM block has an InitBlockCallback configured, this callback is also called. Even after NvM_ReadBlock returned, the variable pointed to by NvM_DstPtr will be used internally by NvM until the actual read operation is finished. This is due to the asynchronous nature of this service. If enhanced dynamic configuration is enabled and the current block is selected for ReadAll and is not resistant to changed software then the request NvM_ReadBlock will be not accepted by NvM as long as NvM_ReadAll has not been initiated. The following request results (not return values!) from NvM_ReadBlock (retrieved by a subsequent call of NvM_GetErrorStatus) are possible: NVM_REQ_OK: Indicates that the read operation was successful. NVM_REQ_PENDING: Indicates that the read operation is still ongoing. NVM_REQ_REDUNDANCY_FAILED: Indicates that the redundancy of the current block in has been lost on the persistent media (but the block could still be read successfully). In the current version of NvM, this state can never occur. NVM_REQ_RESTORED_FROM_ROM: Indicates that ROM data has been read for this block instead of NV data if an implicit recovery occurred. NVM_REQ_NV_INVALIDATED: Indicates that the read operation only found an invalidated block on the persistent media instead of an NV block containing "real" data. The RAM block remains untouched in this case. NVM_REQ_INTEGRITY_FAILED: Indicates that the read operation did not find any valid data for this block on the persistent media. NVM_REQ_NOT_OK: Indicates that the read operation failed due to an unexpected event. Typical reasons for this request result are integration or hardware errors or explicit synchronization read callbacks which failed after too many retries (see also the configuration parameter NvMRepeatMirrorOperations). If the request result of this service is NVM_REQ_INTEGRITY_FAILED or NVM_REQ_NOT_OK, then the RAM block's contents may be corrupted. You may want to bring back the RAM block into a consistent state in this case. If the permanent RAM block is defined as the destination of the read operation, then the internal block status is set to invalid as soon as the read request has been successfully enqueued. If the read operation to the permanent RAM block was successful, the internal block status is set to unchanged and valid upon completion.
      return type ReturnValue: direction=OUT, implementation-data-type=Std_ReturnType  # E_OK is returned if the read operation has been successfully triggered. Otherwise, E_NOT_OK is returned. | Possible reasons for NvM_ReadBlock returning E_NOT_OK are: NvM is not yet initialized. The BlockId parameter is out of range. The NvM_DstPtr parameter is a NULL pointer and there is also no permanent RAM block configured for the NvM block selected by the BlockId parameter. There is currently a single-block or multi-block operation in progress on the selected block. The queue for single-block requests is full.
      sw service arg BlockId: direction=IN, implementation-data-type=NvM_BlockIdType  # This parameter selects the block which shall be read from persistent storage.
      sw service arg NvM_DstPtr: direction=OUT, implementation-data-type=NvM_Rb_VoidPtr  # This parameter points to a temporary RAM block receiving the data read from the corresponding NV block. If this parameter is set to a NULL pointer, the permanent RAM block of the NvM block selected by the BlockId parameter is used as the data destination.
    NvM_ReadPRAMBlock: service-id=22, is-reentrant=true, is-synchronous=false, call-type=REGULAR, execution-context=UNSPECIFIED  # Service to copy the data of a single NV block to its corresponding permanent RAM block | This service allows the NvM user to read block data from persistent storage into the configured permanent RAM block. The request for reading a block is only put into an NvM-internal queue and the actual read operation is then carried out asynchronously. The NvM user can poll the request result of this operation via NvM_GetErrorStatus or can be informed by a callback function upon completion (see NvM_SingleBlockCallbackFunction). | If the NvM block is of type NVM_BLOCK_DATASET and the dataset index points to a ROM block, the "read" operation consists in copying default data from the ROM block to the RAM block. Additionally, if this NvM block has an InitBlockCallback configured, this callback is also called. Even after NvM_ReadPRAMBlock returned, the configured permanent RAM block will be used internally by NvM until the actual read operation is finished. This is due to the asynchronous nature of this service. If enhanced dynamic configuration is enabled and the current block is selected for ReadAll and is not resistant to changed software then the request NvM_ReadPRAMBlock will be not accepted by NvM as long as NvM_ReadAll has not been initiated. The following request results (not return values!) from NvM_ReadPRAMBlock (retrieved by a subsequent call of NvM_GetErrorStatus) are possible: NVM_REQ_OK: Indicates that the read operation from persistent storage into the configured permanent RAM block was successful. NVM_REQ_PENDING: Indicates that the read operation from persistent storage into the configured permanent RAM block is still ongoing. NVM_REQ_REDUNDANCY_FAILED: Indicates that the redundancy of the current block has been lost on the persistent media (but the block could still be read successfully). In the current version of NvM, this state can never occur. NVM_REQ_RESTORED_FROM_ROM: Indicates that ROM data has been read into the configured permanent RAM block for this block instead of NV data if an implicit recovery occurred. NVM_REQ_NV_INVALIDATED: Indicates that the read operation only found an invalidated block on the persistent media instead of an NV block containing "real" data. The configured permanent RAM block remains untouched in this case. NVM_REQ_INTEGRITY_FAILED: Indicates that the read operation did not find any valid data for this block on the persistent media. NVM_REQ_NOT_OK: Indicates that the read operation failed due to an unexpected event. Typical reasons for this request result are integration or hardware errors or explicit synchronization read callbacks which failed after too many retries (see also the configuration parameter NvMRepeatMirrorOperations). If the request result of this service is NVM_REQ_INTEGRITY_FAILED or NVM_REQ_NOT_OK, then contents of the configured permanent RAM block may be corrupted. You may want to bring back the configured permanent RAM block into a consistent state in this case. The internal block status of the configured permanent RAM block is set to invalid as soon as the read request has been successfully enqueued. If the read operation to the permanent RAM block was successful, the internal block status is set to unchanged and valid upon completion.
      return type ReturnValue: direction=OUT, implementation-data-type=Std_ReturnType  # E_OK is returned if the read operation from persistent storage into the configured permanent RAM block has been successfully triggered. Otherwise, E_NOT_OK is returned. | Possible reasons for NvM_ReadPRAMBlock returning E_NOT_OK are: NvM is not yet initialized. The BlockId parameter is out of range. The NvM block selected by the BlockId parameter has no configured permanent RAM block. There is currently a single-block or multi-block operation in progress on the selected block. The queue for single-block requests is full.
      sw service arg BlockId: direction=IN, implementation-data-type=NvM_BlockIdType  # This parameter selects the block which shall be read from persistent storage into the configured permanent RAM block.
    NvM_ReadRamBlockFromNvm: is-reentrant=false, is-synchronous=true, call-type=CALLBACK, execution-context=UNSPECIFIED  # Read callback routine for an NvM block configured with explicit synchronization. | A callback routine with this signature (but typically not with the same name) is called by NvM once the actual read job on Fee or Ea finished (for a read request) or once default data has been copied from ROM to NvM mirror (for a restore request or during implicit recovery). This notifies the NvM user that data copy from NvM mirror to user RAM is required. The actual name of the callback routine is configured by the NvM user via the NvMReadRamBlockFromNvCallback configuration parameter. It is not allowed to call any NvM or DEM functions from within this callback function!
      return type ReturnValue: direction=OUT, implementation-data-type=Std_ReturnType  # The NvM user returns E_OK if the callback is successful. Otherwise, E_NOT_OK shall be returned.
      sw service arg NvMBuffer: direction=OUT, implementation-data-type=NvM_Rb_VoidPtr  # The address of the NvM mirror from which data shall be copied.
    NvM_RestoreBlockDefaults: service-id=8, is-reentrant=true, is-synchronous=false, call-type=REGULAR, execution-context=UNSPECIFIED  # Service to copy default data to a RAM block | This service allows the NvM user to read block data from a source of default values defined in NvM's block configuration into RAM. The source of the default values can be a fixed block in ROM or can be asked from the NvM user at runtime via a dedicated callback routine. Both options can be specified in the corresponding block's configuration. Fixed ROM values are defined by the configuration parameter NvMRomBlockDataAddress. An initialization callback is defined by the configuration parameter NvMInitBlockCallback. If both default sources are configured, initialization with ROM block data is executed by NvM before the initialization callback is invoked. | The request for restoring block defaults is only put into an NvM-internal queue and the actual restore operation is then carried out asynchronously. The NvM user can poll the request result of this operation via NvM_GetErrorStatus or can be informed by a callback function upon completion (see NvM_SingleBlockCallbackFunction). Even after NvM_RestoreBlockDefaults returned, the variable pointed to by NvM_DstPtr will be used internally by NvM until the actual restore operation is finished. This is due to the asynchronous nature of this service. If enhanced dynamic configuration is enabled and the current block is selected for ReadAll and is not resistant to changed software then the request NvM_RestoreBlockDefaults will be not accepted by NvM as long as NvM_ReadAll has not been initiated. If a DATASET block has only an InitBlockCallback (i.e. no ROM block) configured, the NvM_RestoreBlockDefaults request is accepted. If a DATASET block has at least one ROM block, the NvM_RestoreBlockDefaults request is accepted only if the dataset index points to a ROM block regardless whether the block has an InitBlockCallback or not. The following request results (not return values!) from NvM_RestoreBlockDefaults (retrieved by a subsequent call of NvM_GetErrorStatus) are possible: NVM_REQ_OK: Indicates that the restore operation was successful. NVM_REQ_PENDING: Indicates that the restore operation is still ongoing. NVM_REQ_NOT_OK: Indicates that the restore operation failed due to an unexpected event. Typical reason for this request result is an explicit synchronization read callback which failed after too many retries (see also the configuration parameter NvMRepeatMirrorOperations). If the permanent RAM block is defined as the destination of the restore operation, then the internal block status is set to invalid as soon as the restore request has been successfully enqueued. If the restore operation to the permanent RAM block was also successful in this case, the internal block status is set to changed and valid upon completion.
      return type ReturnValue: direction=OUT, implementation-data-type=Std_ReturnType  # E_OK is returned if the restore operation has been successfully triggered. Otherwise, E_NOT_OK is returned. | Possible reasons for NvM_RestoreBlockDefaults returning E_NOT_OK are: NvM is not yet initialized. The BlockId parameter is out of range. The NvM_DstPtr parameter is a NULL pointer and there is also no permanent RAM block configured for the NvM block selected by the BlockId parameter (only applicable in case of a fixed ROM block as the source of default data). Neither a fixed ROM block nor an initialization callback is configured for the NvM block selected by the BlockId parameter. There is currently a single-block or multi-block operation in progress on the selected block. The queue for single-block requests is full.
      sw service arg BlockId: direction=IN, implementation-data-type=NvM_BlockIdType  # This parameter selects the block which shall be restored with default values.
      sw service arg NvM_DstPtr: category=DATA_REFERENCE, direction=OUT, implementation-data-type=NvM_Rb_VoidPtr  # This parameter points to a temporary RAM block receiving the data restored from the configured source of default data. If this parameter is set to a NULL pointer, the permanent RAM block of the NvM block selected by the BlockId parameter is used as the data destination.
    NvM_RestorePRAMBlockDefaults: service-id=24, is-reentrant=true, is-synchronous=false, call-type=REGULAR, execution-context=UNSPECIFIED  # Service to copy default data to the configured permanent RAM block | This service allows the NvM user to read block data from a source of default values defined in NvM's block configuration into the configured permanent RAM block. The source of the default values can be a fixed block in ROM or can be asked from the NvM user at runtime via a dedicated callback routine. Both options can be specified in the corresponding block's configuration. Fixed ROM values are defined by the configuration parameter NvMRomBlockDataAddress. An initialization callback is defined by the configuration parameter NvMInitBlockCallback. If both default sources are configured, initialization with ROM block data is executed by NvM before the initialization callback is invoked. | The request for restoring block defaults is only put into an NvM-internal queue and the actual restore operation is then carried out asynchronously. The NvM user can poll the request result of this operation via NvM_GetErrorStatus or can be informed by a callback function upon completion (see NvM_SingleBlockCallbackFunction). If enhanced dynamic configuration is enabled and the current block is selected for ReadAll and is not resistant to changed software then the request NvM_RestorePRAMBlockDefaults will be not accepted by NvM as long as NvM_ReadAll has not been initiated. If a DATASET block has only an InitBlockCallback (i.e. no ROM block) configured, the NvM_RestorePRAMBlockDefaults request is accepted. If a DATASET block has at least one ROM block, the NvM_RestorePRAMBlockDefaults request is accepted only if the dataset index points to a ROM block regardless whether the block has an InitBlockCallback or not. The following request results (not return values!) from NvM_RestorePRAMBlockDefaults (retrieved by a subsequent call of NvM_GetErrorStatus) are possible: NVM_REQ_OK: Indicates that the restore operation was successful. NVM_REQ_PENDING: Indicates that the restore operation is still ongoing. NVM_REQ_NOT_OK: Indicates that the restore operation failed due to an unexpected event. Typical reason for this request result is an explicit synchronization read callback which failed after too many retries (see also the configuration parameter NvMRepeatMirrorOperations). The internal block status of the configured permanent RAM block is set to invalid as soon as the restore request has been successfully enqueued. If the restore operation to the permanent RAM block was also successful in this case, the internal block status is set to changed and valid upon completion.
      return type ReturnValue: direction=OUT, implementation-data-type=Std_ReturnType  # E_OK is returned if the restore operation has been successfully triggered. Otherwise, E_NOT_OK is returned. | Possible reasons for NvM_RestoreBlockDefaults returning E_NOT_OK are: NvM is not yet initialized. The BlockId parameter is out of range. The NvM block selected by the BlockId parameter has no configured permanent RAM block. Neither a fixed ROM block nor an initialization callback is configured for the NvM block selected by the BlockId parameter. There is currently a single-block or multi-block operation in progress on the selected block. The queue for single-block requests is full.
      sw service arg BlockId: direction=IN, implementation-data-type=NvM_BlockIdType  # This parameter selects the block which shall be restored with default values.
    NvM_SetBlockLockStatus: service-id=19, is-reentrant=true, is-synchronous=true, call-type=REGULAR, execution-context=UNSPECIFIED  # Service for locking/unlocking an NvM block with respect to any operation that could change the NV block | This service allows the NvM user to completely lock an NvM block against any modification of its persistent part. This is very similar to write protection (see NvM_SetBlockProtection) but is not intended for regular NvM users. | Since the current version of NvM does not support block locking yet, this service is only there for API completeness.
      sw service arg BlockId: direction=IN, implementation-data-type=NvM_BlockIdType  # This parameter selects the block which shall be locked or unlocked.
      sw service arg BlockLocked: direction=IN, implementation-data-type=boolean  # This parameter defines whether the block selected by the BlockId parameter shall be locked (TRUE) or unlocked (FALSE).
    NvM_SetBlockProtection: service-id=3, is-reentrant=true, is-synchronous=true, call-type=REGULAR, execution-context=UNSPECIFIED  # Service for enabling/disabling write protection for an NvM block | This service allows the NvM user to control an NvM block's write protection state. If an NvM block is write protected, all operations which would alter the persistent part of this NvM block are rejected.
      return type ReturnValue: direction=OUT, implementation-data-type=Std_ReturnType  # E_OK is returned if the write protection state has been successfully set to the state given by the ProtectionEnabled parameter. Otherwise, E_NOT_OK is returned. | Possible reasons for NvM_SetBlockProtection returning E_NOT_OK are: NvM is not yet initialized. The BlockId parameter is out of range. The selected block has been configured to be writable only once (via configuration parameter NvMWriteBlockOnce). There is currently a single-block or multi-block operation in progress on the selected block.
      sw service arg BlockId: direction=IN, implementation-data-type=NvM_BlockIdType  # This parameter selects the block for which the write protection state shall be set.
      sw service arg ProtectionEnabled: direction=IN, implementation-data-type=boolean  # This parameter defines whether write protection shall be enabled (TRUE) or disabled (FALSE) for the block selected by the BlockId parameter.
    NvM_SetDataIndex: service-id=1, is-reentrant=true, is-synchronous=true, call-type=REGULAR, execution-context=UNSPECIFIED  # Service for setting the dataset index of an NvM block of type NVM_BLOCK_DATASET | This service allows the NvM user to select the NV block which is to be used for the given NvM block. It is only useful for NvM blocks of type NVM_BLOCK_DATASET. It leaves both the NV block(s) and RAM block untouched in any case.
      return type ReturnValue: direction=OUT, implementation-data-type=Std_ReturnType  # E_OK is returned if the dataset index has been set successfully. Otherwise, E_NOT_OK is returned. | Possible reasons for NvM_SetDataIndex returning E_NOT_OK are: NvM is not yet initialized. The BlockId parameter is out of range. The DataIndex parameter is out of range. The service has been called for an NvM block of a type different from NVM_BLOCK_DATASET. There is currently a single-block or multi-block operation in progress on the selected block.
      sw service arg BlockId: direction=IN, implementation-data-type=NvM_BlockIdType  # This parameter selects the block for which the dataset index shall be set.
      sw service arg DataIndex: direction=IN, implementation-data-type=uint8  # This parameter defines the new dataset index for the block selected by the BlockId parameter.
    NvM_SetRamBlockStatus: service-id=5, is-reentrant=true, is-synchronous=true, call-type=REGULAR, execution-context=UNSPECIFIED  # Service for setting the RAM block status of an NvM block to changed or unchanged | This service allows the NvM user to set the changed/unchanged state of a RAM block. Only blocks which have this state set to changed will be written as part of multi-block write operations. It is assumed that a changed RAM block is also valid.
      return type ReturnValue: direction=OUT, implementation-data-type=Std_ReturnType  # E_OK is returned if the RAM block status has been set successfully. Otherwise, E_NOT_OK is returned. | Possible reasons for NvM_SetRamBlockStatus returning E_NOT_OK are: NvM is not yet initialized. The BlockId parameter is out of range. The service has been called for an NvM block which has no permanent RAM block assigned via configuration. There is currently a single-block or multi-block operation in progress on the selected block.
      sw service arg BlockId: direction=IN, implementation-data-type=NvM_BlockIdType  # This parameter selects the block for which the RAM block changed/unchanged state shall be set.
      sw service arg BlockChanged: direction=IN, implementation-data-type=boolean  # This parameter defines the new RAM block status for the block selected by the BlockId parameter. TRUE means that the RAM block has been changed, FALSE means that it is unchanged.
    NvM_SingleBlockCallbackFunction: is-reentrant=false, is-synchronous=true, call-type=CALLBACK, execution-context=UNSPECIFIED  # Per block callback routine to notify the NvM user that the processing of the job for this block within an asynchronous request has been finished | A callback routine with this signature (but typically not with the same name) is called by NvM once a single block asynchronous operation or the processing of a block within an asynchronous multi-block operation has finished. The actual name of the callback routine is configured by the NvM user via the NvMSingleBlockCallback configuration parameter. It is not allowed to call any NvM or DEM functions from within this callback function!
      return type ReturnValue: direction=OUT, implementation-data-type=Std_ReturnType  # The NvM user shall always return E_OK as the return value of the single-block callback. NvM does not evaluate this return value at all.
      sw service arg ServiceId: direction=IN, implementation-data-type=uint8  # The request type (read, write, ... etc.) of the previous processed block job.
      sw service arg JobResult: direction=IN, implementation-data-type=NvM_RequestResultType  # The job result parameter informs the NvM user about the result of the just finished job operated on this block within an asynchronous request. This is the same value which would also be reported by the NvM_GetErrorStatus API.
    NvM_Rb_SingleBlockStartCallbackFunction: is-reentrant=false, is-synchronous=true, call-type=CALLBACK, execution-context=UNSPECIFIED  # Per block callback routine to notify the NvM user that the processing of the job for this block within an asynchronous request has been started | A callback routine with this signature (but typically not with the same name) is called by NvM once a single block asynchronous operation or the processing of a block within an asynchronous multi-block operation has started. The actual name of the callback routine is configured by the NvM user via the NvMRbSingleBlockStartCallback configuration parameter. It is not allowed to call any NvM or DEM functions from within this callback function!
      return type ReturnValue: direction=OUT, implementation-data-type=Std_ReturnType  # The NvM user shall always return E_OK as the return value of the single-block callback. NvM does not evaluate this return value at all.
      sw service arg ServiceId: direction=IN, implementation-data-type=uint8  # The request type (read, write, ... etc.) of the previous processed block job.
    NvM_ValidateAll: service-id=25, is-reentrant=true, is-synchronous=false, call-type=REGULAR, execution-context=UNSPECIFIED  # Service to trigger a multi-block validation operation | This service triggers the setting of the RAM block state of an entire range of NvM blocks to VALID/CHANGED. Only blocks which have a permanent RAM block or are configured to use explicit synchronization mechanism are selected for this operation (via configuration parameter NvMBlockUseAutoValidation) are internally marked as valid (which is not the case after initial NvM initialization) participate in this multi-block operation. NvM_ValidateAll shall not be called by any regular NvM user. This is the task of system control only. The request for validating multiple blocks is only put into an NvM-internal queue and the actual validation operations are then carried out asynchronously. The NvM user can poll the overall result of this operation via NvM_GetErrorStatus (providing 0 for the block ID) or can be informed by a callback function upon completion (see NvM_MultiBlockCallbackFunction). Additionally, the status information of all participating blocks is maintained and all configured callbacks for these blocks are invoked just as in the case of e.g. single-block write requests. The order of single-block validations during NvM_ValidateAll is dictated by the block IDs (ascending order). The following multi-block request results from NvM_ValidateAll (retrieved by a subsequent call of NvM_GetErrorStatus) are possible: NVM_REQ_OK: Indicates that the entire multi-block validation operation was successful. NVM_REQ_PENDING: Indicates that the multi-block validation operation is still ongoing. The contents of permanent RAM blocks are untouched by NvM_ValidateAll in any case.
    NvM_WriteAll: service-id=13, is-reentrant=true, is-synchronous=false, call-type=REGULAR, execution-context=UNSPECIFIED  # Service to trigger a multi-block write operation | This service triggers the writing of an entire range of NvM blocks to persistent storage from the corresponding RAM blocks. Only blocks which have a permanent RAM block or are configured to use explicit synchronization mechanism are selected for this operation (via configuration parameter NvMSelectBlockForWriteAll) are not write protected and are internally marked as changed and valid (see also NvM_SetRamBlockStatus) participate in multi-block writes. NvM_WriteAll is typically only called during the shutdown phase of an ECU. NvM_WriteAll shall not be called by any regular NvM user. This is the task of system control only. The request for writing multiple blocks is only put into an NvM-internal queue and the actual write operations are then carried out asynchronously. The NvM user can poll the overall result of this operation via NvM_GetErrorStatus (providing 0 for the block ID) or can be informed by a callback function upon completion (see NvM_MultiBlockCallbackFunction). Additionally, the status information of all participating blocks is maintained and all configured callbacks for these blocks are invoked just as in the case of single-block write requests. The order of single-block writes during NvM_WriteAll is dictated by the block IDs (ascending order). The following multi-block request results from NvM_WriteAll (retrieved by a subsequent call of NvM_GetErrorStatus) are possible: NVM_REQ_OK: Indicates that all single-block write operations participating in the multi-block write operation were successful. NVM_REQ_PENDING: Indicates that the multi-block write operation is still ongoing. NVM_REQ_NOT_OK: Indicates that at least one single-block write operation participating in the multi-block write operation failed due to an unexpected event. This is typically (but not always) due to integration errors. NVM_REQ_CANCELED: Indicates that NvM_CancelWriteAll was invoked in order to cancel the processing of the pending WriteAll operation. A block which is not participating in the multi-block write operation gets the request result NVM_REQ_BLOCK_SKIPPED assigned in its single-block status if it is not already pending due to a previously queued single block request. This is independent of the reason why the block did not participate in the multi-block write operation. The RAM status (changed/unchanged, valid/invalid) of skipped blocks remains untouched. The contents of permanent RAM blocks are untouched by NvM_WriteAll in any case.
    NvM_WriteBlock: service-id=7, is-reentrant=true, is-synchronous=false, call-type=REGULAR, execution-context=UNSPECIFIED  # Service to copy the data of a single RAM block to its corresponding NV block | This service allows the NvM user to write block data from RAM into persistent storage. The request for writing a block is only put into an NvM-internal queue and the actual write operation is then carried out asynchronously. The NvM user can poll the request result of this operation via NvM_GetErrorStatus or can be informed by a callback function upon completion (see NvM_SingleBlockCallbackFunction). | Even after NvM_WriteBlock returned, the variable pointed to by NvM_SrcPtr will be used internally by NvM until the actual write operation is finished. This is due to the asynchronous nature of this service. If enhanced dynamic configuration is enabled and the current block is selected for ReadAll and is not resistant to changed software then the request NvM_WriteBlock will be not accepted by NvM as long as NvM_ReadAll has not been initiated. The following request results (not return values!) from NvM_WriteBlock (retrieved by a subsequent call of NvM_GetErrorStatus) are possible: NVM_REQ_OK: Indicates that the write operation was successful. NVM_REQ_PENDING: Indicates that the write operation is still ongoing. NVM_REQ_NOT_OK: Indicates that the write operation failed due to an unexpected event. This is typically (but not always) due to integration errors. If the permanent RAM block is defined as the source of the write operation, then the internal block status is set to valid as soon as the write request has been successfully enqueued. If the write operation to the permanent RAM block was successful, the internal block status is set to unchanged upon completion.
      return type ReturnValue: direction=OUT, implementation-data-type=Std_ReturnType  # E_OK is returned if the write operation has been successfully triggered. Otherwise, E_NOT_OK is returned. | Possible reasons for NvM_WriteBlock returning E_NOT_OK are: NvM is not yet initialized. The BlockId parameter is out of range. The NvM_SrcPtr parameter is a NULL pointer and there is also no permanent RAM block configured for the NvM block selected by the BlockId parameter. The NvM block selected by the BlockId parameter is write protected. The NvM block selected by the BlockId parameter is of type NVM_BLOCK_DATASET and its dataset index points to a ROM block instead of an NV block. There is currently a single-block or multi-block operation in progress on the selected block. The standard or the immediate queue for single-block requests is full.
      sw service arg BlockId: direction=IN, implementation-data-type=NvM_BlockIdType  # This parameter selects the block which shall be written to persistent storage.
      sw service arg NvM_SrcPtr: direction=IN, implementation-data-type=NvM_Rb_ConstVoidPtr  # This parameter points to a temporary RAM block holding the data to be written to the corresponding NV block. If this parameter is set to a NULL pointer, the permanent RAM block of the NvM block selected by the BlockId parameter is used as the data source.
    NvM_WritePRAMBlock: service-id=23, is-reentrant=true, is-synchronous=false, call-type=REGULAR, execution-context=UNSPECIFIED  # Service to copy the data of the permanent RAM block to its corresponding NV block | This service allows the NvM user to write block data from the configured permanent RAM block into persistent storage. The request for writing a block is only put into an NvM-internal queue and the actual write operation is then carried out asynchronously. The NvM user can poll the request result of this operation via NvM_GetErrorStatus or can be informed by a callback function upon completion (see NvM_SingleBlockCallbackFunction). | Even after NvM_WritePRAMBlock returned, the configured permanent RAM block will be used internally by NvM until the actual write operation is finished. This is due to the asynchronous nature of this service. If enhanced dynamic configuration is enabled and the current block is selected for ReadAll and is not resistant to changed software then the request NvM_WritePRAMBlock will be not accepted by NvM as long as NvM_ReadAll has not been initiated. The following request results (not return values!) from NvM_WritePRAMBlock (retrieved by a subsequent call of NvM_GetErrorStatus) are possible: NVM_REQ_OK: Indicates that the write operation was successful. NVM_REQ_PENDING: Indicates that the write operation is still ongoing. NVM_REQ_NOT_OK: Indicates that the write operation failed due to an unexpected event. This is typically (but not always) due to integration errors. The internal status of the configured permanent RAM block is set to valid as soon as the write request has been successfully enqueued. If the write operation to the permanent RAM block was successful, the internal block status is set to unchanged upon completion.
      return type ReturnValue: direction=OUT, implementation-data-type=Std_ReturnType  # E_OK is returned if the write operation has been successfully triggered. Otherwise, E_NOT_OK is returned. | Possible reasons for NvM_WritePRAMBlock returning E_NOT_OK are: NvM is not yet initialized. The BlockId parameter is out of range. The NvM block selected by the BlockId parameter has no configured permanent RAM block. The NvM block selected by the BlockId parameter is write protected. The NvM block selected by the BlockId parameter is of type NVM_BLOCK_DATASET and its dataset index points to a ROM block instead of an NV block. There is currently a single-block or multi-block operation in progress on the selected block. The standard or the immediate queue for single-block requests is full.
      sw service arg BlockId: direction=IN, implementation-data-type=NvM_BlockIdType  # This parameter selects the block which shall be written to persistent storage.
    NvM_WriteRamBlockToNvm: is-reentrant=false, is-synchronous=true, call-type=CALLBACK, execution-context=UNSPECIFIED  # Write callback routine for an NvM block configured with explicit synchronization. | A callback routine with this signature (but typically not with the same name) is called by NvM before starting the actual write job on Fee or Ea. This notifies the NvM user that data copy from user RAM to NvM mirror is required. The actual name of the callback routine is configured by the NvM user via the NvMWriteRamBlockToNvCallback configuration parameter. It is not allowed to call any NvM or DEM functions from within this callback function!
      return type ReturnValue: direction=OUT, implementation-data-type=Std_ReturnType  # The NvM user returns E_OK if the callback is successful. Otherwise, E_NOT_OK shall be returned.
      sw service arg NvMBuffer: direction=IN, implementation-data-type=NvM_Rb_ConstVoidPtr  # The address of the NvM mirror to which user data shall be written.
package /AUTOSAR_NvM/ImplementationDataTypes
  8 x impl type:
    NvM_BlockIdType: implementation-data-type=uint16  # Type used for identifying an NvM block in NvM's service functions | NvM reserves the values 0 and 1 for its own internal use. All other values in the uint16 range can be used for user blocks (but there shall not be any gap in the sequence of block IDs).
    NvM_Rb_ConstVoidPtr: category=DATA_REFERENCE, sw-pointer-target-props={target-category=VALUE, base-type=void, sw-impl-policy=CONST}  # Type used for addressing constant block data | Defining this type as part of NvM is only a temporary solution until a central ConstVoidPtr type is defined for general use. It has only been created for use in client/server interfaces, not for use within ASW or BSW code.
    NvM_Rb_StatusType: compu-method=NvM_Rb_StatusType, implementation-data-type=uint8, type-emitter=HEADER_FILE  # Enumeration type for general NvM status information | The NvM_Rb_GetStatus service provides information based on this type.
    NvM_Rb_VoidPtr: category=DATA_REFERENCE, sw-pointer-target-props={target-category=VALUE, base-type=void}  # Type used for addressing changeable block data | Defining this type as part of NvM is only a temporary solution until a central VoidPtr type is defined for general use. It has only been created for use in client/server interfaces, not for use within ASW or BSW code.
    NvM_RequestResultType: compu-method=NvM_RequestResultType, implementation-data-type=uint8  # Enumeration type for results of asynchronous block operations | The NvM_GetErrorStatus service as well as single and multi block callbacks provide information based on this type.
    NvM_Rb_ErrorInfoDetail_ten: compu-method=NvM_Rb_ErrorInfoDetail_ten, implementation-data-type=uint8, type-emitter=HEADER_FILE  # Enumeration for detailed error information | The NvM_Rb_GetErrorInfoDetail and NvM_Rb_AuxGetErrorInfoDetail services provide information based on this type.
    NvM_Rb_MigrationResult_ten: compu-method=NvM_Rb_MigrationResult_ten, implementation-data-type=uint8, type-emitter=HEADER_FILE  # Enumeration for the NvM migration status information | The NvM_Rb_GetMigrationResult and NvM_Rb_AuxGetMigrationResult services provide information based on this type.
    NvM_Rb_RequestType_ten: compu-method=NvM_Rb_RequestType_ten, implementation-data-type=uint8, type-emitter=HEADER_FILE  # Enumeration type for the block request type | The NvM_Rb_GetRequestType service provides information based on this type.
package /AUTOSAR_NvM/BswImplementations
  bsw implementation NvM: programming-language=C, sw-version=21.0.0, swc-bsw-mapping=NvM, ar-release-version=4.5.0, behavior=BswInternalBehavior
    code-descriptors:
      code CodeDescriptor: artifact-descriptors=autosar-engineering-object={short-label=ArEngObj, category=SWSRC}
    resource consumption NvM_ResourceConsumption
      26 x memory section:
        NvM_CODE: prefix=NvM, sw-addrmethod=CODE, symbol=CODE
        NVM_CODE: prefix=NVM, sw-addrmethod=CODE, symbol=CODE
        NVM_VAR_CLEARED_8: alignment=8, prefix=NVM, sw-addrmethod=VAR_CLEARED, symbol=VAR_CLEARED_8
        NVM_VAR_CLEARED_16: alignment=16, prefix=NVM, sw-addrmethod=VAR_CLEARED, symbol=VAR_CLEARED_16
        NVM_VAR_CLEARED_32: alignment=32, prefix=NVM, sw-addrmethod=VAR_CLEARED, symbol=VAR_CLEARED_32
        NVM_VAR_CLEARED_UNSPECIFIED: alignment=UNSPECIFIED, prefix=NVM, sw-addrmethod=VAR_CLEARED, symbol=VAR_CLEARED_UNSPECIFIED
        NVM_VAR_INIT_8: alignment=8, prefix=NVM, sw-addrmethod=VAR_INIT, symbol=VAR_INIT_8
        NVM_VAR_INIT_16: alignment=16, prefix=NVM, sw-addrmethod=VAR_INIT, symbol=VAR_INIT_16
        NVM_VAR_INIT_32: alignment=32, prefix=NVM, sw-addrmethod=VAR_INIT, symbol=VAR_INIT_32
        NVM_VAR_INIT_UNSPECIFIED: alignment=UNSPECIFIED, prefix=NVM, sw-addrmethod=VAR_INIT, symbol=VAR_INIT_UNSPECIFIED
        NVM_VAR_SAVED_ZONE_8: alignment=8, prefix=NVM, sw-addrmethod=VAR_SAVED_ZONE, symbol=VAR_SAVED_ZONE_8
        NVM_VAR_SAVED_ZONE_16: alignment=16, prefix=NVM, sw-addrmethod=VAR_SAVED_ZONE, symbol=VAR_SAVED_ZONE_16
        NVM_VAR_SAVED_ZONE_32: alignment=32, prefix=NVM, sw-addrmethod=VAR_SAVED_ZONE, symbol=VAR_SAVED_ZONE_32
        NVM_VAR_SAVED_ZONE_UNSPECIFIED: alignment=UNSPECIFIED, prefix=NVM, sw-addrmethod=VAR_SAVED_ZONE, symbol=VAR_SAVED_ZONE_UNSPECIFIED
        NVM_CONST_8: alignment=8, prefix=NVM, sw-addrmethod=CONST, symbol=CONST_8
        NVM_CONST_16: alignment=16, prefix=NVM, sw-addrmethod=CONST, symbol=CONST_16
        NVM_CONST_32: alignment=32, prefix=NVM, sw-addrmethod=CONST, symbol=CONST_32
        NVM_CONST_UNSPECIFIED: alignment=UNSPECIFIED, prefix=NVM, sw-addrmethod=CONST, symbol=CONST_UNSPECIFIED
        NVM_CONST_SAVED_RECOVERY_ZONE_8: alignment=8, prefix=NVM, sw-addrmethod=CONST_SAVED_RECOVERY_ZONE, symbol=CONST_SAVED_RECOVERY_ZONE_8
        NVM_CONST_SAVED_RECOVERY_ZONE_16: alignment=16, prefix=NVM, sw-addrmethod=CONST_SAVED_RECOVERY_ZONE, symbol=CONST_SAVED_RECOVERY_ZONE_16
        NVM_CONST_SAVED_RECOVERY_ZONE_32: alignment=32, prefix=NVM, sw-addrmethod=CONST_SAVED_RECOVERY_ZONE, symbol=CONST_SAVED_RECOVERY_ZONE_32
        NVM_CONST_SAVED_RECOVERY_ZONE_UNSPECIFIED: alignment=UNSPECIFIED, prefix=NVM, sw-addrmethod=CONST_SAVED_RECOVERY_ZONE, symbol=CONST_SAVED_RECOVERY_ZONE_UNSPECIFIED
        NVM_VAR_SECURED_CLEARED_8: alignment=8, prefix=NVM, sw-addrmethod=VAR_SECURED_CLEARED, symbol=VAR_SECURED_CLEARED_8
        NVM_VAR_SECURED_CLEARED_32: alignment=32, prefix=NVM, sw-addrmethod=VAR_SECURED_CLEARED, symbol=VAR_SECURED_CLEARED_32
        NVM_VAR_SECURED_CLEARED_UNSPECIFIED: alignment=UNSPECIFIED, prefix=NVM, sw-addrmethod=VAR_SECURED_CLEARED, symbol=VAR_SECURED_CLEARED_UNSPECIFIED
        NVM_VAR_SECURED_CACHED_RAM_ALIGNED_CLEARED_UNSPECIFIED: alignment=UNSPECIFIED, prefix=NVM, sw-addrmethod=VAR_SECURED_CACHED_RAM_ALIGNED_CLEARED, symbol=VAR_SECURED_CACHED_RAM_ALIGNED_CLEARED_UNSPECIFIED
      section name prefix NvM
      section name prefix NVM
