[part 2 of 2: package /STLASharedInterfaces/IFCOEs/IFPlatform_Lin]
AUTOSAR XML (schema 4-3-0)
package /STLASharedInterfaces/IFCOEs/IFPlatform_Lin  (continued)
  972 x sender receiver interface:  (continued)
    VeLINR_b_EEXV_ERR_TO: service-kind=ANY-STANDARDIZED, invalidation-policy{data-element=VeLINR_b_EEXV_ERR_TO, handle-invalid=DONT-INVALIDATE}  # - Time Out
      data VeLINR_b_EEXV_ERR_TO: category=VALUE, sw-calibration-access=READ-ONLY, type=ADTSBoolean, init-value=VeLINR_b_EEXV_ERR_TOValue:0
    VeLINR_b_EEXV_PosActTO: service-kind=ANY-STANDARDIZED, invalidation-policy{data-element=VeLINR_b_EEXV_PosActTO, handle-invalid=DONT-INVALIDATE}  # - Time Out
      data VeLINR_b_EEXV_PosActTO: category=VALUE, sw-calibration-access=READ-ONLY, type=ADTSBoolean, init-value=VeLINR_b_EEXV_PosActTOValue:0
    VeLINR_b_EEXV_Refrig_PressureTO: service-kind=ANY-STANDARDIZED, invalidation-policy{data-element=VeLINR_b_EEXV_Refrig_PressureTO, handle-invalid=DONT-INVALIDATE}  # - Time Out
      data VeLINR_b_EEXV_Refrig_PressureTO: category=VALUE, sw-calibration-access=READ-ONLY, type=ADTSBoolean, init-value=VeLINR_b_EEXV_Refrig_PressureTOValue:0
    VeLINR_b_EEXV_Refrigerant_TempTO: service-kind=ANY-STANDARDIZED, invalidation-policy{data-element=VeLINR_b_EEXV_Refrigerant_TempTO, handle-invalid=DONT-INVALIDATE}  # - Time Out
      data VeLINR_b_EEXV_Refrigerant_TempTO: category=VALUE, sw-calibration-access=READ-ONLY, type=ADTSBoolean, init-value=VeLINR_b_EEXV_Refrigerant_TempTOValue:0
    VeLINR_b_EEXV_StsTO: service-kind=ANY-STANDARDIZED, invalidation-policy{data-element=VeLINR_b_EEXV_StsTO, handle-invalid=DONT-INVALIDATE}  # - Time Out
      data VeLINR_b_EEXV_StsTO: category=VALUE, sw-calibration-access=READ-ONLY, type=ADTSBoolean, init-value=VeLINR_b_EEXV_StsTOValue:0
    VeLINR_b_EEXV_SupplyVoltTO: service-kind=ANY-STANDARDIZED, invalidation-policy{data-element=VeLINR_b_EEXV_SupplyVoltTO, handle-invalid=DONT-INVALIDATE}  # - Time Out
      data VeLINR_b_EEXV_SupplyVoltTO: category=VALUE, sw-calibration-access=READ-ONLY, type=ADTSBoolean, init-value=VeLINR_b_EEXV_SupplyVoltTOValue:0
    VeLINR_b_EOPA_CURR_TO: service-kind=ANY-STANDARDIZED, invalidation-policy{data-element=VeLINR_b_EOPA_CURR_TO, handle-invalid=DONT-INVALIDATE}  # - Time Out
      data VeLINR_b_EOPA_CURR_TO: category=VALUE, sw-calibration-access=READ-ONLY, type=ADTSBoolean, init-value=VeLINR_b_EOPA_CURR_TOValue:0
    VeLINR_b_EOPA_DR_RN_ER_TO: service-kind=ANY-STANDARDIZED, invalidation-policy{data-element=VeLINR_b_EOPA_DR_RN_ER_TO, handle-invalid=DONT-INVALIDATE}  # - Time Out
      data VeLINR_b_EOPA_DR_RN_ER_TO: category=VALUE, sw-calibration-access=READ-ONLY, type=ADTSBoolean, init-value=VeLINR_b_EOPA_DR_RN_ER_TOValue:0
    VeLINR_b_EOPA_HW_VER_TO: service-kind=ANY-STANDARDIZED, invalidation-policy{data-element=VeLINR_b_EOPA_HW_VER_TO, handle-invalid=DONT-INVALIDATE}  # - Time Out
      data VeLINR_b_EOPA_HW_VER_TO: category=VALUE, sw-calibration-access=READ-ONLY, type=ADTSBoolean, init-value=VeLINR_b_EOPA_HW_VER_TOValue:0
    VeLINR_b_EOPA_LMP_HM_AN_ON_TO: service-kind=ANY-STANDARDIZED, invalidation-policy{data-element=VeLINR_b_EOPA_LMP_HM_AN_ON_TO, handle-invalid=DONT-INVALIDATE}  # - Time Out
      data VeLINR_b_EOPA_LMP_HM_AN_ON_TO: category=VALUE, sw-calibration-access=READ-ONLY, type=ADTSBoolean, init-value=VeLINR_b_EOPA_LMP_HM_AN_ON_TOValue:0
    VeLINR_b_EOPA_LOW_TMP_STAT_TO: service-kind=ANY-STANDARDIZED, invalidation-policy{data-element=VeLINR_b_EOPA_LOW_TMP_STAT_TO, handle-invalid=DONT-INVALIDATE}  # - Time Out
      data VeLINR_b_EOPA_LOW_TMP_STAT_TO: category=VALUE, sw-calibration-access=READ-ONLY, type=ADTSBoolean, init-value=VeLINR_b_EOPA_LOW_TMP_STAT_TOValue:0
    VeLINR_b_EOPA_MONTRNG_RPM_TO: service-kind=ANY-STANDARDIZED, invalidation-policy{data-element=VeLINR_b_EOPA_MONTRNG_RPM_TO, handle-invalid=DONT-INVALIDATE}  # - Time Out
      data VeLINR_b_EOPA_MONTRNG_RPM_TO: category=VALUE, sw-calibration-access=READ-ONLY, type=ADTSBoolean, init-value=VeLINR_b_EOPA_MONTRNG_RPM_TOValue:0
    VeLINR_b_EOPA_OIL_TEMP_TO: service-kind=ANY-STANDARDIZED, invalidation-policy{data-element=VeLINR_b_EOPA_OIL_TEMP_TO, handle-invalid=DONT-INVALIDATE}  # - Time Out
      data VeLINR_b_EOPA_OIL_TEMP_TO: category=VALUE, sw-calibration-access=READ-ONLY, type=ADTSBoolean, init-value=VeLINR_b_EOPA_OIL_TEMP_TOValue:0
    VeLINR_b_EOPA_OV_CUR_ER_TO: service-kind=ANY-STANDARDIZED, invalidation-policy{data-element=VeLINR_b_EOPA_OV_CUR_ER_TO, handle-invalid=DONT-INVALIDATE}  # - Time Out
      data VeLINR_b_EOPA_OV_CUR_ER_TO: category=VALUE, sw-calibration-access=READ-ONLY, type=ADTSBoolean, init-value=VeLINR_b_EOPA_OV_CUR_ER_TOValue:0
    VeLINR_b_EOPA_OV_TMP_ER_TO: service-kind=ANY-STANDARDIZED, invalidation-policy{data-element=VeLINR_b_EOPA_OV_TMP_ER_TO, handle-invalid=DONT-INVALIDATE}  # - Time Out
      data VeLINR_b_EOPA_OV_TMP_ER_TO: category=VALUE, sw-calibration-access=READ-ONLY, type=ADTSBoolean, init-value=VeLINR_b_EOPA_OV_TMP_ER_TOValue:0
    VeLINR_b_EOPA_POST_RUN_STAT_TO: service-kind=ANY-STANDARDIZED, invalidation-policy{data-element=VeLINR_b_EOPA_POST_RUN_STAT_TO, handle-invalid=DONT-INVALIDATE}  # - Time Out
      data VeLINR_b_EOPA_POST_RUN_STAT_TO: category=VALUE, sw-calibration-access=READ-ONLY, type=ADTSBoolean, init-value=VeLINR_b_EOPA_POST_RUN_STAT_TOValue:0
    VeLINR_b_EOPA_RPM_ACTL_TO: service-kind=ANY-STANDARDIZED, invalidation-policy{data-element=VeLINR_b_EOPA_RPM_ACTL_TO, handle-invalid=DONT-INVALIDATE}  # - Time Out
      data VeLINR_b_EOPA_RPM_ACTL_TO: category=VALUE, sw-calibration-access=READ-ONLY, type=ADTSBoolean, init-value=VeLINR_b_EOPA_RPM_ACTL_TOValue:0
    VeLINR_b_EOPA_RPM_TGT_TO: service-kind=ANY-STANDARDIZED, invalidation-policy{data-element=VeLINR_b_EOPA_RPM_TGT_TO, handle-invalid=DONT-INVALIDATE}  # - Time Out
      data VeLINR_b_EOPA_RPM_TGT_TO: category=VALUE, sw-calibration-access=READ-ONLY, type=ADTSBoolean, init-value=VeLINR_b_EOPA_RPM_TGT_TOValue:0
    VeLINR_b_EOPA_SW_VER_TO: service-kind=ANY-STANDARDIZED, invalidation-policy{data-element=VeLINR_b_EOPA_SW_VER_TO, handle-invalid=DONT-INVALIDATE}  # - Time Out
      data VeLINR_b_EOPA_SW_VER_TO: category=VALUE, sw-calibration-access=READ-ONLY, type=ADTSBoolean, init-value=VeLINR_b_EOPA_SW_VER_TOValue:0
    VeLINR_b_EOPA_Stall_EventTO: service-kind=ANY-STANDARDIZED, invalidation-policy{data-element=VeLINR_b_EOPA_Stall_EventTO, handle-invalid=DONT-INVALIDATE}  # - Time Out
      data VeLINR_b_EOPA_Stall_EventTO: category=VALUE, sw-calibration-access=READ-ONLY, type=ADTSBoolean, init-value=VeLINR_b_EOPA_Stall_EventTOValue:0
    VeLINR_b_EOPA_TEMP_TO: service-kind=ANY-STANDARDIZED, invalidation-policy{data-element=VeLINR_b_EOPA_TEMP_TO, handle-invalid=DONT-INVALIDATE}  # - Time Out
      data VeLINR_b_EOPA_TEMP_TO: category=VALUE, sw-calibration-access=READ-ONLY, type=ADTSBoolean, init-value=VeLINR_b_EOPA_TEMP_TOValue:0
    VeLINR_b_EOPA_VLTG_ER_TO: service-kind=ANY-STANDARDIZED, invalidation-policy{data-element=VeLINR_b_EOPA_VLTG_ER_TO, handle-invalid=DONT-INVALIDATE}  # - Time Out
      data VeLINR_b_EOPA_VLTG_ER_TO: category=VALUE, sw-calibration-access=READ-ONLY, type=ADTSBoolean, init-value=VeLINR_b_EOPA_VLTG_ER_TOValue:0
    VeLINR_b_EOPA_VLTG_TO: service-kind=ANY-STANDARDIZED, invalidation-policy{data-element=VeLINR_b_EOPA_VLTG_TO, handle-invalid=DONT-INVALIDATE}  # - Time Out
      data VeLINR_b_EOPA_VLTG_TO: category=VALUE, sw-calibration-access=READ-ONLY, type=ADTSBoolean, init-value=VeLINR_b_EOPA_VLTG_TOValue:0
    VeLINR_b_EOPB_CURR_TO: service-kind=ANY-STANDARDIZED, invalidation-policy{data-element=VeLINR_b_EOPB_CURR_TO, handle-invalid=DONT-INVALIDATE}  # - Time Out
      data VeLINR_b_EOPB_CURR_TO: category=VALUE, sw-calibration-access=READ-ONLY, type=ADTSBoolean, init-value=VeLINR_b_EOPB_CURR_TOValue:0
    VeLINR_b_EOPB_DR_RN_ER_TO: service-kind=ANY-STANDARDIZED, invalidation-policy{data-element=VeLINR_b_EOPB_DR_RN_ER_TO, handle-invalid=DONT-INVALIDATE}  # - Time Out
      data VeLINR_b_EOPB_DR_RN_ER_TO: category=VALUE, sw-calibration-access=READ-ONLY, type=ADTSBoolean, init-value=VeLINR_b_EOPB_DR_RN_ER_TOValue:0
    VeLINR_b_EOPB_HW_VER_TO: service-kind=ANY-STANDARDIZED, invalidation-policy{data-element=VeLINR_b_EOPB_HW_VER_TO, handle-invalid=DONT-INVALIDATE}  # - Time Out
      data VeLINR_b_EOPB_HW_VER_TO: category=VALUE, sw-calibration-access=READ-ONLY, type=ADTSBoolean, init-value=VeLINR_b_EOPB_HW_VER_TOValue:0
    VeLINR_b_EOPB_LMP_HM_AN_ON_TO: service-kind=ANY-STANDARDIZED, invalidation-policy{data-element=VeLINR_b_EOPB_LMP_HM_AN_ON_TO, handle-invalid=DONT-INVALIDATE}  # - Time Out
      data VeLINR_b_EOPB_LMP_HM_AN_ON_TO: category=VALUE, sw-calibration-access=READ-ONLY, type=ADTSBoolean, init-value=VeLINR_b_EOPB_LMP_HM_AN_ON_TOValue:0
    VeLINR_b_EOPB_LOW_TMP_STAT_TO: service-kind=ANY-STANDARDIZED, invalidation-policy{data-element=VeLINR_b_EOPB_LOW_TMP_STAT_TO, handle-invalid=DONT-INVALIDATE}  # - Time Out
      data VeLINR_b_EOPB_LOW_TMP_STAT_TO: category=VALUE, sw-calibration-access=READ-ONLY, type=ADTSBoolean, init-value=VeLINR_b_EOPB_LOW_TMP_STAT_TOValue:0
    VeLINR_b_EOPB_MONTRNG_RPM_TO: service-kind=ANY-STANDARDIZED, invalidation-policy{data-element=VeLINR_b_EOPB_MONTRNG_RPM_TO, handle-invalid=DONT-INVALIDATE}  # - Time Out
      data VeLINR_b_EOPB_MONTRNG_RPM_TO: category=VALUE, sw-calibration-access=READ-ONLY, type=ADTSBoolean, init-value=VeLINR_b_EOPB_MONTRNG_RPM_TOValue:0
    VeLINR_b_EOPB_OIL_TEMP_TO: service-kind=ANY-STANDARDIZED, invalidation-policy{data-element=VeLINR_b_EOPB_OIL_TEMP_TO, handle-invalid=DONT-INVALIDATE}  # - Time Out
      data VeLINR_b_EOPB_OIL_TEMP_TO: category=VALUE, sw-calibration-access=READ-ONLY, type=ADTSBoolean, init-value=VeLINR_b_EOPB_OIL_TEMP_TOValue:0
    VeLINR_b_EOPB_OV_CUR_ER_TO: service-kind=ANY-STANDARDIZED, invalidation-policy{data-element=VeLINR_b_EOPB_OV_CUR_ER_TO, handle-invalid=DONT-INVALIDATE}  # - Time Out
      data VeLINR_b_EOPB_OV_CUR_ER_TO: category=VALUE, sw-calibration-access=READ-ONLY, type=ADTSBoolean, init-value=VeLINR_b_EOPB_OV_CUR_ER_TOValue:0
    VeLINR_b_EOPB_OV_TMP_ER_TO: service-kind=ANY-STANDARDIZED, invalidation-policy{data-element=VeLINR_b_EOPB_OV_TMP_ER_TO, handle-invalid=DONT-INVALIDATE}  # - Time Out
      data VeLINR_b_EOPB_OV_TMP_ER_TO: category=VALUE, sw-calibration-access=READ-ONLY, type=ADTSBoolean, init-value=VeLINR_b_EOPB_OV_TMP_ER_TOValue:0
    VeLINR_b_EOPB_POST_RUN_STAT_TO: service-kind=ANY-STANDARDIZED, invalidation-policy{data-element=VeLINR_b_EOPB_POST_RUN_STAT_TO, handle-invalid=DONT-INVALIDATE}  # - Time Out
      data VeLINR_b_EOPB_POST_RUN_STAT_TO: category=VALUE, sw-calibration-access=READ-ONLY, type=ADTSBoolean, init-value=VeLINR_b_EOPB_POST_RUN_STAT_TOValue:0
    VeLINR_b_EOPB_RPM_ACTL_TO: service-kind=ANY-STANDARDIZED, invalidation-policy{data-element=VeLINR_b_EOPB_RPM_ACTL_TO, handle-invalid=DONT-INVALIDATE}  # - Time Out
      data VeLINR_b_EOPB_RPM_ACTL_TO: category=VALUE, sw-calibration-access=READ-ONLY, type=ADTSBoolean, init-value=VeLINR_b_EOPB_RPM_ACTL_TOValue:0
    VeLINR_b_EOPB_RPM_TGT_TO: service-kind=ANY-STANDARDIZED, invalidation-policy{data-element=VeLINR_b_EOPB_RPM_TGT_TO, handle-invalid=DONT-INVALIDATE}  # - Time Out
      data VeLINR_b_EOPB_RPM_TGT_TO: category=VALUE, sw-calibration-access=READ-ONLY, type=ADTSBoolean, init-value=VeLINR_b_EOPB_RPM_TGT_TOValue:0
    VeLINR_b_EOPB_SW_VER_TO: service-kind=ANY-STANDARDIZED, invalidation-policy{data-element=VeLINR_b_EOPB_SW_VER_TO, handle-invalid=DONT-INVALIDATE}  # - Time Out
      data VeLINR_b_EOPB_SW_VER_TO: category=VALUE, sw-calibration-access=READ-ONLY, type=ADTSBoolean, init-value=VeLINR_b_EOPB_SW_VER_TOValue:0
    VeLINR_b_EOPB_Stall_EventTO: service-kind=ANY-STANDARDIZED, invalidation-policy{data-element=VeLINR_b_EOPB_Stall_EventTO, handle-invalid=DONT-INVALIDATE}  # - Time Out
      data VeLINR_b_EOPB_Stall_EventTO: category=VALUE, sw-calibration-access=READ-ONLY, type=ADTSBoolean, init-value=VeLINR_b_EOPB_Stall_EventTOValue:0
    VeLINR_b_EOPB_TEMP_TO: service-kind=ANY-STANDARDIZED, invalidation-policy{data-element=VeLINR_b_EOPB_TEMP_TO, handle-invalid=DONT-INVALIDATE}  # - Time Out
      data VeLINR_b_EOPB_TEMP_TO: category=VALUE, sw-calibration-access=READ-ONLY, type=ADTSBoolean, init-value=VeLINR_b_EOPB_TEMP_TOValue:0
    VeLINR_b_EOPB_VLTG_ER_TO: service-kind=ANY-STANDARDIZED, invalidation-policy{data-element=VeLINR_b_EOPB_VLTG_ER_TO, handle-invalid=DONT-INVALIDATE}  # - Time Out
      data VeLINR_b_EOPB_VLTG_ER_TO: category=VALUE, sw-calibration-access=READ-ONLY, type=ADTSBoolean, init-value=VeLINR_b_EOPB_VLTG_ER_TOValue:0
    VeLINR_b_EOPB_VLTG_TO: service-kind=ANY-STANDARDIZED, invalidation-policy{data-element=VeLINR_b_EOPB_VLTG_TO, handle-invalid=DONT-INVALIDATE}  # - Time Out
      data VeLINR_b_EOPB_VLTG_TO: category=VALUE, sw-calibration-access=READ-ONLY, type=ADTSBoolean, init-value=VeLINR_b_EOPB_VLTG_TOValue:0
    VeLINR_b_ESaveModeRq_LIN_TO: service-kind=ANY-STANDARDIZED, invalidation-policy{data-element=VeLINR_b_ESaveModeRq_LIN_TO, handle-invalid=DONT-INVALIDATE}  # - Time Out
      data VeLINR_b_ESaveModeRq_LIN_TO: category=VALUE, sw-calibration-access=READ-ONLY, type=ADTSBoolean, init-value=VeLINR_b_ESaveModeRq_LIN_TOValue:0
    VeLINR_b_EXVM_Board_TempTO: service-kind=ANY-STANDARDIZED, invalidation-policy{data-element=VeLINR_b_EXVM_Board_TempTO, handle-invalid=DONT-INVALIDATE}  # - Time Out
      data VeLINR_b_EXVM_Board_TempTO: category=VALUE, sw-calibration-access=READ-ONLY, type=ADTSBoolean, init-value=VeLINR_b_EXVM_Board_TempTOValue:0
    VeLINR_b_EXVM_CalRq: service-kind=ANY-STANDARDIZED, invalidation-policy{data-element=VeLINR_b_EXVM_CalRq, handle-invalid=DONT-INVALIDATE}  # -
      data VeLINR_b_EXVM_CalRq: category=VALUE, sw-calibration-access=READ-ONLY, type=ADTSBoolean, init-value=VeLINR_b_EXVM_CalRqValue:0
    VeLINR_b_EXVM_CalRqTO: service-kind=ANY-STANDARDIZED, invalidation-policy{data-element=VeLINR_b_EXVM_CalRqTO, handle-invalid=DONT-INVALIDATE}  # - Time Out
      data VeLINR_b_EXVM_CalRqTO: category=VALUE, sw-calibration-access=READ-ONLY, type=ADTSBoolean, init-value=VeLINR_b_EXVM_CalRqTOValue:0
    VeLINR_b_EXVM_CalStatTO: service-kind=ANY-STANDARDIZED, invalidation-policy{data-element=VeLINR_b_EXVM_CalStatTO, handle-invalid=DONT-INVALIDATE}  # - Time Out
      data VeLINR_b_EXVM_CalStatTO: category=VALUE, sw-calibration-access=READ-ONLY, type=ADTSBoolean, init-value=VeLINR_b_EXVM_CalStatTOValue:0
    VeLINR_b_EXVM_ERR_TO: service-kind=ANY-STANDARDIZED, invalidation-policy{data-element=VeLINR_b_EXVM_ERR_TO, handle-invalid=DONT-INVALIDATE}  # - Time Out
      data VeLINR_b_EXVM_ERR_TO: category=VALUE, sw-calibration-access=READ-ONLY, type=ADTSBoolean, init-value=VeLINR_b_EXVM_ERR_TOValue:0
    VeLINR_b_EXVM_PosActTO: service-kind=ANY-STANDARDIZED, invalidation-policy{data-element=VeLINR_b_EXVM_PosActTO, handle-invalid=DONT-INVALIDATE}  # - Time Out
      data VeLINR_b_EXVM_PosActTO: category=VALUE, sw-calibration-access=READ-ONLY, type=ADTSBoolean, init-value=VeLINR_b_EXVM_PosActTOValue:0
    VeLINR_b_EXVM_Refrig_PressureTO: service-kind=ANY-STANDARDIZED, invalidation-policy{data-element=VeLINR_b_EXVM_Refrig_PressureTO, handle-invalid=DONT-INVALIDATE}  # - Time Out
      data VeLINR_b_EXVM_Refrig_PressureTO: category=VALUE, sw-calibration-access=READ-ONLY, type=ADTSBoolean, init-value=VeLINR_b_EXVM_Refrig_PressureTOValue:0
    VeLINR_b_EXVM_Refrigerant_TempTO: service-kind=ANY-STANDARDIZED, invalidation-policy{data-element=VeLINR_b_EXVM_Refrigerant_TempTO, handle-invalid=DONT-INVALIDATE}  # - Time Out
      data VeLINR_b_EXVM_Refrigerant_TempTO: category=VALUE, sw-calibration-access=READ-ONLY, type=ADTSBoolean, init-value=VeLINR_b_EXVM_Refrigerant_TempTOValue:0
    VeLINR_b_EXVM_StsTO: service-kind=ANY-STANDARDIZED, invalidation-policy{data-element=VeLINR_b_EXVM_StsTO, handle-invalid=DONT-INVALIDATE}  # - Time Out
      data VeLINR_b_EXVM_StsTO: category=VALUE, sw-calibration-access=READ-ONLY, type=ADTSBoolean, init-value=VeLINR_b_EXVM_StsTOValue:0
    VeLINR_b_EXVM_SupplyVoltTO: service-kind=ANY-STANDARDIZED, invalidation-policy{data-element=VeLINR_b_EXVM_SupplyVoltTO, handle-invalid=DONT-INVALIDATE}  # - Time Out
      data VeLINR_b_EXVM_SupplyVoltTO: category=VALUE, sw-calibration-access=READ-ONLY, type=ADTSBoolean, init-value=VeLINR_b_EXVM_SupplyVoltTOValue:0
    VeLINR_b_ElectricModeRq_LIN_TO: service-kind=ANY-STANDARDIZED, invalidation-policy{data-element=VeLINR_b_ElectricModeRq_LIN_TO, handle-invalid=DONT-INVALIDATE}  # - Time Out
      data VeLINR_b_ElectricModeRq_LIN_TO: category=VALUE, sw-calibration-access=READ-ONLY, type=ADTSBoolean, init-value=VeLINR_b_ElectricModeRq_LIN_TOValue:0
    VeLINR_b_HClHrSrFtClTInSnFltTO: service-kind=ANY-STANDARDIZED, invalidation-policy{data-element=VeLINR_b_HClHrSrFtClTInSnFltTO, handle-invalid=DONT-INVALIDATE}  # - Time Out
      data VeLINR_b_HClHrSrFtClTInSnFltTO: category=VALUE, sw-calibration-access=READ-ONLY, type=ADTSBoolean, init-value=VeLINR_b_HClHrSrFtClTInSnFltTOValue:0
    VeLINR_b_HClHrSrFtClTOtSnFltTO: service-kind=ANY-STANDARDIZED, invalidation-policy{data-element=VeLINR_b_HClHrSrFtClTOtSnFltTO, handle-invalid=DONT-INVALIDATE}  # - Time Out
      data VeLINR_b_HClHrSrFtClTOtSnFltTO: category=VALUE, sw-calibration-access=READ-ONLY, type=ADTSBoolean, init-value=VeLINR_b_HClHrSrFtClTOtSnFltTOValue:0
    VeLINR_b_HClHrSrFtTInMtrlSnFltTO: service-kind=ANY-STANDARDIZED, invalidation-policy{data-element=VeLINR_b_HClHrSrFtTInMtrlSnFltTO, handle-invalid=DONT-INVALIDATE}  # - Time Out
      data VeLINR_b_HClHrSrFtTInMtrlSnFltTO: category=VALUE, sw-calibration-access=READ-ONLY, type=ADTSBoolean, init-value=VeLINR_b_HClHrSrFtTInMtrlSnFltTOValue:0
    VeLINR_b_HClHrSrRqCrFrDrShOrOpTO: service-kind=ANY-STANDARDIZED, invalidation-policy{data-element=VeLINR_b_HClHrSrRqCrFrDrShOrOpTO, handle-invalid=DONT-INVALIDATE}  # - Time Out
      data VeLINR_b_HClHrSrRqCrFrDrShOrOpTO: category=VALUE, sw-calibration-access=READ-ONLY, type=ADTSBoolean, init-value=VeLINR_b_HClHrSrRqCrFrDrShOrOpTOValue:0
    VeLINR_b_HClHrSrRqICnsOtOfRngTO: service-kind=ANY-STANDARDIZED, invalidation-policy{data-element=VeLINR_b_HClHrSrRqICnsOtOfRngTO, handle-invalid=DONT-INVALIDATE}  # - Time Out
      data VeLINR_b_HClHrSrRqICnsOtOfRngTO: category=VALUE, sw-calibration-access=READ-ONLY, type=ADTSBoolean, init-value=VeLINR_b_HClHrSrRqICnsOtOfRngTOValue:0
    VeLINR_b_HClHrSrRqMemErrTO: service-kind=ANY-STANDARDIZED, invalidation-policy{data-element=VeLINR_b_HClHrSrRqMemErrTO, handle-invalid=DONT-INVALIDATE}  # - Time Out
      data VeLINR_b_HClHrSrRqMemErrTO: category=VALUE, sw-calibration-access=READ-ONLY, type=ADTSBoolean, init-value=VeLINR_b_HClHrSrRqMemErrTOValue:0
    VeLINR_b_HClHrSrRqSrvRqTO: service-kind=ANY-STANDARDIZED, invalidation-policy{data-element=VeLINR_b_HClHrSrRqSrvRqTO, handle-invalid=DONT-INVALIDATE}  # - Time Out
      data VeLINR_b_HClHrSrRqSrvRqTO: category=VALUE, sw-calibration-access=READ-ONLY, type=ADTSBoolean, init-value=VeLINR_b_HClHrSrRqSrvRqTOValue:0
    VeLINR_b_HTLBV_CalStatTO: service-kind=ANY-STANDARDIZED, invalidation-policy{data-element=VeLINR_b_HTLBV_CalStatTO, handle-invalid=DONT-INVALIDATE}  # - Time Out
      data VeLINR_b_HTLBV_CalStatTO: category=VALUE, sw-calibration-access=READ-ONLY, type=ADTSBoolean, init-value=VeLINR_b_HTLBV_CalStatTOValue:0
    VeLINR_b_HTLBV_ERR_TO: service-kind=ANY-STANDARDIZED, invalidation-policy{data-element=VeLINR_b_HTLBV_ERR_TO, handle-invalid=DONT-INVALIDATE}  # - Time Out
      data VeLINR_b_HTLBV_ERR_TO: category=VALUE, sw-calibration-access=READ-ONLY, type=ADTSBoolean, init-value=VeLINR_b_HTLBV_ERR_TOValue:0
    VeLINR_b_HTLBV_MotorVoltTO: service-kind=ANY-STANDARDIZED, invalidation-policy{data-element=VeLINR_b_HTLBV_MotorVoltTO, handle-invalid=DONT-INVALIDATE}  # - Time Out
      data VeLINR_b_HTLBV_MotorVoltTO: category=VALUE, sw-calibration-access=READ-ONLY, type=ADTSBoolean, init-value=VeLINR_b_HTLBV_MotorVoltTOValue:0
    VeLINR_b_HTLBV_PosActTO: service-kind=ANY-STANDARDIZED, invalidation-policy{data-element=VeLINR_b_HTLBV_PosActTO, handle-invalid=DONT-INVALIDATE}  # - Time Out
      data VeLINR_b_HTLBV_PosActTO: category=VALUE, sw-calibration-access=READ-ONLY, type=ADTSBoolean, init-value=VeLINR_b_HTLBV_PosActTOValue:0
    VeLINR_b_HTLBV_StsTO: service-kind=ANY-STANDARDIZED, invalidation-policy{data-element=VeLINR_b_HTLBV_StsTO, handle-invalid=DONT-INVALIDATE}  # - Time Out
      data VeLINR_b_HTLBV_StsTO: category=VALUE, sw-calibration-access=READ-ONLY, type=ADTSBoolean, init-value=VeLINR_b_HTLBV_StsTOValue:0
    VeLINR_b_HVH_UnlockCounterTO: service-kind=ANY-STANDARDIZED, invalidation-policy{data-element=VeLINR_b_HVH_UnlockCounterTO, handle-invalid=DONT-INVALIDATE}  # - Time Out
      data VeLINR_b_HVH_UnlockCounterTO: category=VALUE, sw-calibration-access=READ-ONLY, type=ADTSBoolean, init-value=VeLINR_b_HVH_UnlockCounterTOValue:0
    VeLINR_b_HvCltHrPrtnSfTmpHwPrtnTO: service-kind=ANY-STANDARDIZED, invalidation-policy{data-element=VeLINR_b_HvCltHrPrtnSfTmpHwPrtnTO, handle-invalid=DONT-INVALIDATE}  # - Time Out
      data VeLINR_b_HvCltHrPrtnSfTmpHwPrtnTO: category=VALUE, sw-calibration-access=READ-ONLY, type=ADTSBoolean, init-value=VeLINR_b_HvCltHrPrtnSfTmpHwPrtnTOValue:0
    VeLINR_b_HvCltHrPrtnSfTmpOvrhtgTO: service-kind=ANY-STANDARDIZED, invalidation-policy{data-element=VeLINR_b_HvCltHrPrtnSfTmpOvrhtgTO, handle-invalid=DONT-INVALIDATE}  # - Time Out
      data VeLINR_b_HvCltHrPrtnSfTmpOvrhtgTO: category=VALUE, sw-calibration-access=READ-ONLY, type=ADTSBoolean, init-value=VeLINR_b_HvCltHrPrtnSfTmpOvrhtgTOValue:0
    VeLINR_b_HvCltHtrWrnCltTOtOfRngTO: service-kind=ANY-STANDARDIZED, invalidation-policy{data-element=VeLINR_b_HvCltHtrWrnCltTOtOfRngTO, handle-invalid=DONT-INVALIDATE}  # - Time Out
      data VeLINR_b_HvCltHtrWrnCltTOtOfRngTO: category=VALUE, sw-calibration-access=READ-ONLY, type=ADTSBoolean, init-value=VeLINR_b_HvCltHtrWrnCltTOtOfRngTOValue:0
    VeLINR_b_HvCltHtrWrnFltInComTO: service-kind=ANY-STANDARDIZED, invalidation-policy{data-element=VeLINR_b_HvCltHtrWrnFltInComTO, handle-invalid=DONT-INVALIDATE}  # - Time Out
      data VeLINR_b_HvCltHtrWrnFltInComTO: category=VALUE, sw-calibration-access=READ-ONLY, type=ADTSBoolean, init-value=VeLINR_b_HvCltHtrWrnFltInComTOValue:0
    VeLINR_b_HvCltHtrWrnHvOtOfRngTO: service-kind=ANY-STANDARDIZED, invalidation-policy{data-element=VeLINR_b_HvCltHtrWrnHvOtOfRngTO, handle-invalid=DONT-INVALIDATE}  # - Time Out
      data VeLINR_b_HvCltHtrWrnHvOtOfRngTO: category=VALUE, sw-calibration-access=READ-ONLY, type=ADTSBoolean, init-value=VeLINR_b_HvCltHtrWrnHvOtOfRngTOValue:0
    VeLINR_b_HvCltHtrWrnULoOtOfRngTO: service-kind=ANY-STANDARDIZED, invalidation-policy{data-element=VeLINR_b_HvCltHtrWrnULoOtOfRngTO, handle-invalid=DONT-INVALIDATE}  # - Time Out
      data VeLINR_b_HvCltHtrWrnULoOtOfRngTO: category=VALUE, sw-calibration-access=READ-ONLY, type=ADTSBoolean, init-value=VeLINR_b_HvCltHtrWrnULoOtOfRngTOValue:0
    VeLINR_b_HvCltWtrHtrWtrTInIntkTO: service-kind=ANY-STANDARDIZED, invalidation-policy{data-element=VeLINR_b_HvCltWtrHtrWtrTInIntkTO, handle-invalid=DONT-INVALIDATE}  # - Time Out
      data VeLINR_b_HvCltWtrHtrWtrTInIntkTO: category=VALUE, sw-calibration-access=READ-ONLY, type=ADTSBoolean, init-value=VeLINR_b_HvCltWtrHtrWtrTInIntkTOValue:0
    VeLINR_b_HvCooltHVmeasTO: service-kind=ANY-STANDARDIZED, invalidation-policy{data-element=VeLINR_b_HvCooltHVmeasTO, handle-invalid=DONT-INVALIDATE}  # - Time Out
      data VeLINR_b_HvCooltHVmeasTO: category=VALUE, sw-calibration-access=READ-ONLY, type=ADTSBoolean, init-value=VeLINR_b_HvCooltHVmeasTOValue:0
    VeLINR_b_HvCooltHeatrICnsTO: service-kind=ANY-STANDARDIZED, invalidation-policy{data-element=VeLINR_b_HvCooltHeatrICnsTO, handle-invalid=DONT-INVALIDATE}  # - Time Out
      data VeLINR_b_HvCooltHeatrICnsTO: category=VALUE, sw-calibration-access=READ-ONLY, type=ADTSBoolean, init-value=VeLINR_b_HvCooltHeatrICnsTOValue:0
    VeLINR_b_HvCooltHeatrStsTO: service-kind=ANY-STANDARDIZED, invalidation-policy{data-element=VeLINR_b_HvCooltHeatrStsTO, handle-invalid=DONT-INVALIDATE}  # - Time Out
      data VeLINR_b_HvCooltHeatrStsTO: category=VALUE, sw-calibration-access=READ-ONLY, type=ADTSBoolean, init-value=VeLINR_b_HvCooltHeatrStsTOValue:0
    VeLINR_b_HvHeatrPwrCnsDesTO: service-kind=ANY-STANDARDIZED, invalidation-policy{data-element=VeLINR_b_HvHeatrPwrCnsDesTO, handle-invalid=DONT-INVALIDATE}  # - Time Out
      data VeLINR_b_HvHeatrPwrCnsDesTO: category=VALUE, sw-calibration-access=READ-ONLY, type=ADTSBoolean, init-value=VeLINR_b_HvHeatrPwrCnsDesTOValue:0
    VeLINR_b_HvHeatrPwrCnsTO: service-kind=ANY-STANDARDIZED, invalidation-policy{data-element=VeLINR_b_HvHeatrPwrCnsTO, handle-invalid=DONT-INVALIDATE}  # - Time Out
      data VeLINR_b_HvHeatrPwrCnsTO: category=VALUE, sw-calibration-access=READ-ONLY, type=ADTSBoolean, init-value=VeLINR_b_HvHeatrPwrCnsTOValue:0
    VeLINR_b_HvWtrHeatrWtrT_TO: service-kind=ANY-STANDARDIZED, invalidation-policy{data-element=VeLINR_b_HvWtrHeatrWtrT_TO, handle-invalid=DONT-INVALIDATE}  # - Time Out
      data VeLINR_b_HvWtrHeatrWtrT_TO: category=VALUE, sw-calibration-access=READ-ONLY, type=ADTSBoolean, init-value=VeLINR_b_HvWtrHeatrWtrT_TOValue:0
    VeLINR_b_HybridModeRq_LIN_TO: service-kind=ANY-STANDARDIZED, invalidation-policy{data-element=VeLINR_b_HybridModeRq_LIN_TO, handle-invalid=DONT-INVALIDATE}  # - Time Out
      data VeLINR_b_HybridModeRq_LIN_TO: category=VALUE, sw-calibration-access=READ-ONLY, type=ADTSBoolean, init-value=VeLINR_b_HybridModeRq_LIN_TOValue:0
    VeLINR_b_Icon1_FailSts: service-kind=ANY-STANDARDIZED, invalidation-policy{data-element=VeLINR_b_Icon1_FailSts, handle-invalid=DONT-INVALIDATE}  # -
      data VeLINR_b_Icon1_FailSts: category=VALUE, sw-calibration-access=READ-ONLY, type=ADTSBoolean, init-value=VeLINR_b_Icon1_FailStsValue:0
    VeLINR_b_Icon1_FailStsTO: service-kind=ANY-STANDARDIZED, invalidation-policy{data-element=VeLINR_b_Icon1_FailStsTO, handle-invalid=DONT-INVALIDATE}  # - Time Out
      data VeLINR_b_Icon1_FailStsTO: category=VALUE, sw-calibration-access=READ-ONLY, type=ADTSBoolean, init-value=VeLINR_b_Icon1_FailStsTOValue:0
    VeLINR_b_Icon1_StsTO: service-kind=ANY-STANDARDIZED, invalidation-policy{data-element=VeLINR_b_Icon1_StsTO, handle-invalid=DONT-INVALIDATE}  # - Time Out
      data VeLINR_b_Icon1_StsTO: category=VALUE, sw-calibration-access=READ-ONLY, type=ADTSBoolean, init-value=VeLINR_b_Icon1_StsTOValue:0
    VeLINR_b_Icon2_FailSts: service-kind=ANY-STANDARDIZED, invalidation-policy{data-element=VeLINR_b_Icon2_FailSts, handle-invalid=DONT-INVALIDATE}  # -
      data VeLINR_b_Icon2_FailSts: category=VALUE, sw-calibration-access=READ-ONLY, type=ADTSBoolean, init-value=VeLINR_b_Icon2_FailStsValue:0
    VeLINR_b_Icon2_FailStsTO: service-kind=ANY-STANDARDIZED, invalidation-policy{data-element=VeLINR_b_Icon2_FailStsTO, handle-invalid=DONT-INVALIDATE}  # - Time Out
      data VeLINR_b_Icon2_FailStsTO: category=VALUE, sw-calibration-access=READ-ONLY, type=ADTSBoolean, init-value=VeLINR_b_Icon2_FailStsTOValue:0
    VeLINR_b_Icon2_StsTO: service-kind=ANY-STANDARDIZED, invalidation-policy{data-element=VeLINR_b_Icon2_StsTO, handle-invalid=DONT-INVALIDATE}  # - Time Out
      data VeLINR_b_Icon2_StsTO: category=VALUE, sw-calibration-access=READ-ONLY, type=ADTSBoolean, init-value=VeLINR_b_Icon2_StsTOValue:0
    VeLINR_b_Inlet_Temp1_DC_TO: service-kind=ANY-STANDARDIZED, invalidation-policy{data-element=VeLINR_b_Inlet_Temp1_DC_TO, handle-invalid=DONT-INVALIDATE}  # - Time Out
      data VeLINR_b_Inlet_Temp1_DC_TO: category=VALUE, sw-calibration-access=READ-ONLY, type=ADTSBoolean, init-value=VeLINR_b_Inlet_Temp1_DC_TOValue:0
    VeLINR_b_Inlet_Temp2_DC_TO: service-kind=ANY-STANDARDIZED, invalidation-policy{data-element=VeLINR_b_Inlet_Temp2_DC_TO, handle-invalid=DONT-INVALIDATE}  # - Time Out
      data VeLINR_b_Inlet_Temp2_DC_TO: category=VALUE, sw-calibration-access=READ-ONLY, type=ADTSBoolean, init-value=VeLINR_b_Inlet_Temp2_DC_TOValue:0
    VeLINR_b_LTRBV_CalStatTO: service-kind=ANY-STANDARDIZED, invalidation-policy{data-element=VeLINR_b_LTRBV_CalStatTO, handle-invalid=DONT-INVALIDATE}  # - Time Out
      data VeLINR_b_LTRBV_CalStatTO: category=VALUE, sw-calibration-access=READ-ONLY, type=ADTSBoolean, init-value=VeLINR_b_LTRBV_CalStatTOValue:0
    VeLINR_b_LTRBV_ERR_TO: service-kind=ANY-STANDARDIZED, invalidation-policy{data-element=VeLINR_b_LTRBV_ERR_TO, handle-invalid=DONT-INVALIDATE}  # - Time Out
      data VeLINR_b_LTRBV_ERR_TO: category=VALUE, sw-calibration-access=READ-ONLY, type=ADTSBoolean, init-value=VeLINR_b_LTRBV_ERR_TOValue:0
    VeLINR_b_LTRBV_MotorVoltTO: service-kind=ANY-STANDARDIZED, invalidation-policy{data-element=VeLINR_b_LTRBV_MotorVoltTO, handle-invalid=DONT-INVALIDATE}  # - Time Out
      data VeLINR_b_LTRBV_MotorVoltTO: category=VALUE, sw-calibration-access=READ-ONLY, type=ADTSBoolean, init-value=VeLINR_b_LTRBV_MotorVoltTOValue:0
    VeLINR_b_LTRBV_PosActTO: service-kind=ANY-STANDARDIZED, invalidation-policy{data-element=VeLINR_b_LTRBV_PosActTO, handle-invalid=DONT-INVALIDATE}  # - Time Out
      data VeLINR_b_LTRBV_PosActTO: category=VALUE, sw-calibration-access=READ-ONLY, type=ADTSBoolean, init-value=VeLINR_b_LTRBV_PosActTOValue:0
    VeLINR_b_LTRBV_StsTO: service-kind=ANY-STANDARDIZED, invalidation-policy{data-element=VeLINR_b_LTRBV_StsTO, handle-invalid=DONT-INVALIDATE}  # - Time Out
      data VeLINR_b_LTRBV_StsTO: category=VALUE, sw-calibration-access=READ-ONLY, type=ADTSBoolean, init-value=VeLINR_b_LTRBV_StsTOValue:0
    VeLINR_b_OEXV_Board_TempTO: service-kind=ANY-STANDARDIZED, invalidation-policy{data-element=VeLINR_b_OEXV_Board_TempTO, handle-invalid=DONT-INVALIDATE}  # - Time Out
      data VeLINR_b_OEXV_Board_TempTO: category=VALUE, sw-calibration-access=READ-ONLY, type=ADTSBoolean, init-value=VeLINR_b_OEXV_Board_TempTOValue:0
    VeLINR_b_OEXV_CalRq: service-kind=ANY-STANDARDIZED, invalidation-policy{data-element=VeLINR_b_OEXV_CalRq, handle-invalid=DONT-INVALIDATE}  # -
      data VeLINR_b_OEXV_CalRq: category=VALUE, sw-calibration-access=READ-ONLY, type=ADTSBoolean, init-value=VeLINR_b_OEXV_CalRqValue:0
    VeLINR_b_OEXV_CalRqTO: service-kind=ANY-STANDARDIZED, invalidation-policy{data-element=VeLINR_b_OEXV_CalRqTO, handle-invalid=DONT-INVALIDATE}  # - Time Out
      data VeLINR_b_OEXV_CalRqTO: category=VALUE, sw-calibration-access=READ-ONLY, type=ADTSBoolean, init-value=VeLINR_b_OEXV_CalRqTOValue:0
    VeLINR_b_OEXV_CalStatTO: service-kind=ANY-STANDARDIZED, invalidation-policy{data-element=VeLINR_b_OEXV_CalStatTO, handle-invalid=DONT-INVALIDATE}  # - Time Out
      data VeLINR_b_OEXV_CalStatTO: category=VALUE, sw-calibration-access=READ-ONLY, type=ADTSBoolean, init-value=VeLINR_b_OEXV_CalStatTOValue:0
    VeLINR_b_OEXV_ERR_TO: service-kind=ANY-STANDARDIZED, invalidation-policy{data-element=VeLINR_b_OEXV_ERR_TO, handle-invalid=DONT-INVALIDATE}  # - Time Out
      data VeLINR_b_OEXV_ERR_TO: category=VALUE, sw-calibration-access=READ-ONLY, type=ADTSBoolean, init-value=VeLINR_b_OEXV_ERR_TOValue:0
    VeLINR_b_OEXV_PosActTO: service-kind=ANY-STANDARDIZED, invalidation-policy{data-element=VeLINR_b_OEXV_PosActTO, handle-invalid=DONT-INVALIDATE}  # - Time Out
      data VeLINR_b_OEXV_PosActTO: category=VALUE, sw-calibration-access=READ-ONLY, type=ADTSBoolean, init-value=VeLINR_b_OEXV_PosActTOValue:0
    VeLINR_b_OEXV_Refrig_PresTO: service-kind=ANY-STANDARDIZED, invalidation-policy{data-element=VeLINR_b_OEXV_Refrig_PresTO, handle-invalid=DONT-INVALIDATE}  # - Time Out
      data VeLINR_b_OEXV_Refrig_PresTO: category=VALUE, sw-calibration-access=READ-ONLY, type=ADTSBoolean, init-value=VeLINR_b_OEXV_Refrig_PresTOValue:0
    VeLINR_b_OEXV_Refrigerant_TempTO: service-kind=ANY-STANDARDIZED, invalidation-policy{data-element=VeLINR_b_OEXV_Refrigerant_TempTO, handle-invalid=DONT-INVALIDATE}  # - Time Out
      data VeLINR_b_OEXV_Refrigerant_TempTO: category=VALUE, sw-calibration-access=READ-ONLY, type=ADTSBoolean, init-value=VeLINR_b_OEXV_Refrigerant_TempTOValue:0
    VeLINR_b_OEXV_StsTO: service-kind=ANY-STANDARDIZED, invalidation-policy{data-element=VeLINR_b_OEXV_StsTO, handle-invalid=DONT-INVALIDATE}  # - Time Out
      data VeLINR_b_OEXV_StsTO: category=VALUE, sw-calibration-access=READ-ONLY, type=ADTSBoolean, init-value=VeLINR_b_OEXV_StsTOValue:0
    VeLINR_b_OEXV_SupplyVoltTO: service-kind=ANY-STANDARDIZED, invalidation-policy{data-element=VeLINR_b_OEXV_SupplyVoltTO, handle-invalid=DONT-INVALIDATE}  # - Time Out
      data VeLINR_b_OEXV_SupplyVoltTO: category=VALUE, sw-calibration-access=READ-ONLY, type=ADTSBoolean, init-value=VeLINR_b_OEXV_SupplyVoltTOValue:0
    VeLINR_b_PECP2_AIR_PRE_ERR_TO: service-kind=ANY-STANDARDIZED, invalidation-policy{data-element=VeLINR_b_PECP2_AIR_PRE_ERR_TO, handle-invalid=DONT-INVALIDATE}  # - Time Out
      data VeLINR_b_PECP2_AIR_PRE_ERR_TO: category=VALUE, sw-calibration-access=READ-ONLY, type=ADTSBoolean, init-value=VeLINR_b_PECP2_AIR_PRE_ERR_TOValue:0
    VeLINR_b_PECP2_CURR_TO: service-kind=ANY-STANDARDIZED, invalidation-policy{data-element=VeLINR_b_PECP2_CURR_TO, handle-invalid=DONT-INVALIDATE}  # - Time Out
      data VeLINR_b_PECP2_CURR_TO: category=VALUE, sw-calibration-access=READ-ONLY, type=ADTSBoolean, init-value=VeLINR_b_PECP2_CURR_TOValue:0
    VeLINR_b_PECP2_DBLK_ACTV_TO: service-kind=ANY-STANDARDIZED, invalidation-policy{data-element=VeLINR_b_PECP2_DBLK_ACTV_TO, handle-invalid=DONT-INVALIDATE}  # - Time Out
      data VeLINR_b_PECP2_DBLK_ACTV_TO: category=VALUE, sw-calibration-access=READ-ONLY, type=ADTSBoolean, init-value=VeLINR_b_PECP2_DBLK_ACTV_TOValue:0
    VeLINR_b_PECP2_DR_RN_ERR_TO: service-kind=ANY-STANDARDIZED, invalidation-policy{data-element=VeLINR_b_PECP2_DR_RN_ERR_TO, handle-invalid=DONT-INVALIDATE}  # - Time Out
      data VeLINR_b_PECP2_DR_RN_ERR_TO: category=VALUE, sw-calibration-access=READ-ONLY, type=ADTSBoolean, init-value=VeLINR_b_PECP2_DR_RN_ERR_TOValue:0
    VeLINR_b_PECP2_FL_SAFE_ACTVTD_TO: service-kind=ANY-STANDARDIZED, invalidation-policy{data-element=VeLINR_b_PECP2_FL_SAFE_ACTVTD_TO, handle-invalid=DONT-INVALIDATE}  # - Time Out
      data VeLINR_b_PECP2_FL_SAFE_ACTVTD_TO: category=VALUE, sw-calibration-access=READ-ONLY, type=ADTSBoolean, init-value=VeLINR_b_PECP2_FL_SAFE_ACTVTD_TOValue:0
    VeLINR_b_PECP2_LMP_HM_AN_ON_TO: service-kind=ANY-STANDARDIZED, invalidation-policy{data-element=VeLINR_b_PECP2_LMP_HM_AN_ON_TO, handle-invalid=DONT-INVALIDATE}  # - Time Out
      data VeLINR_b_PECP2_LMP_HM_AN_ON_TO: category=VALUE, sw-calibration-access=READ-ONLY, type=ADTSBoolean, init-value=VeLINR_b_PECP2_LMP_HM_AN_ON_TOValue:0
    VeLINR_b_PECP2_MONTRNG_RPM_TO: service-kind=ANY-STANDARDIZED, invalidation-policy{data-element=VeLINR_b_PECP2_MONTRNG_RPM_TO, handle-invalid=DONT-INVALIDATE}  # - Time Out
      data VeLINR_b_PECP2_MONTRNG_RPM_TO: category=VALUE, sw-calibration-access=READ-ONLY, type=ADTSBoolean, init-value=VeLINR_b_PECP2_MONTRNG_RPM_TOValue:0
    VeLINR_b_PECP2_NODE_ERR_TO: service-kind=ANY-STANDARDIZED, invalidation-policy{data-element=VeLINR_b_PECP2_NODE_ERR_TO, handle-invalid=DONT-INVALIDATE}  # - Time Out
      data VeLINR_b_PECP2_NODE_ERR_TO: category=VALUE, sw-calibration-access=READ-ONLY, type=ADTSBoolean, init-value=VeLINR_b_PECP2_NODE_ERR_TOValue:0
    VeLINR_b_PECP2_OVR_CUR_ERR_TO: service-kind=ANY-STANDARDIZED, invalidation-policy{data-element=VeLINR_b_PECP2_OVR_CUR_ERR_TO, handle-invalid=DONT-INVALIDATE}  # - Time Out
      data VeLINR_b_PECP2_OVR_CUR_ERR_TO: category=VALUE, sw-calibration-access=READ-ONLY, type=ADTSBoolean, init-value=VeLINR_b_PECP2_OVR_CUR_ERR_TOValue:0
    VeLINR_b_PECP2_OVR_TMP_ERR_TO: service-kind=ANY-STANDARDIZED, invalidation-policy{data-element=VeLINR_b_PECP2_OVR_TMP_ERR_TO, handle-invalid=DONT-INVALIDATE}  # - Time Out
      data VeLINR_b_PECP2_OVR_TMP_ERR_TO: category=VALUE, sw-calibration-access=READ-ONLY, type=ADTSBoolean, init-value=VeLINR_b_PECP2_OVR_TMP_ERR_TOValue:0
    VeLINR_b_PECP2_POST_RUN_STAT_TO: service-kind=ANY-STANDARDIZED, invalidation-policy{data-element=VeLINR_b_PECP2_POST_RUN_STAT_TO, handle-invalid=DONT-INVALIDATE}  # - Time Out
      data VeLINR_b_PECP2_POST_RUN_STAT_TO: category=VALUE, sw-calibration-access=READ-ONLY, type=ADTSBoolean, init-value=VeLINR_b_PECP2_POST_RUN_STAT_TOValue:0
    VeLINR_b_PECP2_RPM_ACTL_PERCT_TO: service-kind=ANY-STANDARDIZED, invalidation-policy{data-element=VeLINR_b_PECP2_RPM_ACTL_PERCT_TO, handle-invalid=DONT-INVALIDATE}  # - Time Out
      data VeLINR_b_PECP2_RPM_ACTL_PERCT_TO: category=VALUE, sw-calibration-access=READ-ONLY, type=ADTSBoolean, init-value=VeLINR_b_PECP2_RPM_ACTL_PERCT_TOValue:0
    VeLINR_b_PECP2_RPM_TGT_PERCT_TO: service-kind=ANY-STANDARDIZED, invalidation-policy{data-element=VeLINR_b_PECP2_RPM_TGT_PERCT_TO, handle-invalid=DONT-INVALIDATE}  # - Time Out
      data VeLINR_b_PECP2_RPM_TGT_PERCT_TO: category=VALUE, sw-calibration-access=READ-ONLY, type=ADTSBoolean, init-value=VeLINR_b_PECP2_RPM_TGT_PERCT_TOValue:0
    VeLINR_b_PECP2_SUPPLIER_TO: service-kind=ANY-STANDARDIZED, invalidation-policy{data-element=VeLINR_b_PECP2_SUPPLIER_TO, handle-invalid=DONT-INVALIDATE}  # - Time Out
      data VeLINR_b_PECP2_SUPPLIER_TO: category=VALUE, sw-calibration-access=READ-ONLY, type=ADTSBoolean, init-value=VeLINR_b_PECP2_SUPPLIER_TOValue:0
    VeLINR_b_PECP2_TEMP_TO: service-kind=ANY-STANDARDIZED, invalidation-policy{data-element=VeLINR_b_PECP2_TEMP_TO, handle-invalid=DONT-INVALIDATE}  # - Time Out
      data VeLINR_b_PECP2_TEMP_TO: category=VALUE, sw-calibration-access=READ-ONLY, type=ADTSBoolean, init-value=VeLINR_b_PECP2_TEMP_TOValue:0
    VeLINR_b_PECP2_VERSION_TO: service-kind=ANY-STANDARDIZED, invalidation-policy{data-element=VeLINR_b_PECP2_VERSION_TO, handle-invalid=DONT-INVALIDATE}  # - Time Out
      data VeLINR_b_PECP2_VERSION_TO: category=VALUE, sw-calibration-access=READ-ONLY, type=ADTSBoolean, init-value=VeLINR_b_PECP2_VERSION_TOValue:0
    VeLINR_b_PECP2_VLTG_ERR_TO: service-kind=ANY-STANDARDIZED, invalidation-policy{data-element=VeLINR_b_PECP2_VLTG_ERR_TO, handle-invalid=DONT-INVALIDATE}  # - Time Out
      data VeLINR_b_PECP2_VLTG_ERR_TO: category=VALUE, sw-calibration-access=READ-ONLY, type=ADTSBoolean, init-value=VeLINR_b_PECP2_VLTG_ERR_TOValue:0
    VeLINR_b_PECP2_VLTG_TO: service-kind=ANY-STANDARDIZED, invalidation-policy{data-element=VeLINR_b_PECP2_VLTG_TO, handle-invalid=DONT-INVALIDATE}  # - Time Out
      data VeLINR_b_PECP2_VLTG_TO: category=VALUE, sw-calibration-access=READ-ONLY, type=ADTSBoolean, init-value=VeLINR_b_PECP2_VLTG_TOValue:0
    VeLINR_b_PECP_AIR_PRE_ERR_TO: service-kind=ANY-STANDARDIZED, invalidation-policy{data-element=VeLINR_b_PECP_AIR_PRE_ERR_TO, handle-invalid=DONT-INVALIDATE}  # - Time Out
      data VeLINR_b_PECP_AIR_PRE_ERR_TO: category=VALUE, sw-calibration-access=READ-ONLY, type=ADTSBoolean, init-value=VeLINR_b_PECP_AIR_PRE_ERR_TOValue:0
    VeLINR_b_PECP_CURR_TO: service-kind=ANY-STANDARDIZED, invalidation-policy{data-element=VeLINR_b_PECP_CURR_TO, handle-invalid=DONT-INVALIDATE}  # - Time Out
      data VeLINR_b_PECP_CURR_TO: category=VALUE, sw-calibration-access=READ-ONLY, type=ADTSBoolean, init-value=VeLINR_b_PECP_CURR_TOValue:0
    VeLINR_b_PECP_DBLK_ACTV_TO: service-kind=ANY-STANDARDIZED, invalidation-policy{data-element=VeLINR_b_PECP_DBLK_ACTV_TO, handle-invalid=DONT-INVALIDATE}  # - Time Out
      data VeLINR_b_PECP_DBLK_ACTV_TO: category=VALUE, sw-calibration-access=READ-ONLY, type=ADTSBoolean, init-value=VeLINR_b_PECP_DBLK_ACTV_TOValue:0
    VeLINR_b_PECP_DR_RN_ERR_TO: service-kind=ANY-STANDARDIZED, invalidation-policy{data-element=VeLINR_b_PECP_DR_RN_ERR_TO, handle-invalid=DONT-INVALIDATE}  # - Time Out
      data VeLINR_b_PECP_DR_RN_ERR_TO: category=VALUE, sw-calibration-access=READ-ONLY, type=ADTSBoolean, init-value=VeLINR_b_PECP_DR_RN_ERR_TOValue:0
    VeLINR_b_PECP_FL_SAFE_ACTVTD_TO: service-kind=ANY-STANDARDIZED, invalidation-policy{data-element=VeLINR_b_PECP_FL_SAFE_ACTVTD_TO, handle-invalid=DONT-INVALIDATE}  # - Time Out
      data VeLINR_b_PECP_FL_SAFE_ACTVTD_TO: category=VALUE, sw-calibration-access=READ-ONLY, type=ADTSBoolean, init-value=VeLINR_b_PECP_FL_SAFE_ACTVTD_TOValue:0
    VeLINR_b_PECP_LMP_HM_AN_ON_TO: service-kind=ANY-STANDARDIZED, invalidation-policy{data-element=VeLINR_b_PECP_LMP_HM_AN_ON_TO, handle-invalid=DONT-INVALIDATE}  # - Time Out
      data VeLINR_b_PECP_LMP_HM_AN_ON_TO: category=VALUE, sw-calibration-access=READ-ONLY, type=ADTSBoolean, init-value=VeLINR_b_PECP_LMP_HM_AN_ON_TOValue:0
    VeLINR_b_PECP_MONTRNG_RPM_TO: service-kind=ANY-STANDARDIZED, invalidation-policy{data-element=VeLINR_b_PECP_MONTRNG_RPM_TO, handle-invalid=DONT-INVALIDATE}  # - Time Out
      data VeLINR_b_PECP_MONTRNG_RPM_TO: category=VALUE, sw-calibration-access=READ-ONLY, type=ADTSBoolean, init-value=VeLINR_b_PECP_MONTRNG_RPM_TOValue:0
    VeLINR_b_PECP_NODE_ERR_TO: service-kind=ANY-STANDARDIZED, invalidation-policy{data-element=VeLINR_b_PECP_NODE_ERR_TO, handle-invalid=DONT-INVALIDATE}  # - Time Out
      data VeLINR_b_PECP_NODE_ERR_TO: category=VALUE, sw-calibration-access=READ-ONLY, type=ADTSBoolean, init-value=VeLINR_b_PECP_NODE_ERR_TOValue:0
    VeLINR_b_PECP_OVR_CUR_ERR_TO: service-kind=ANY-STANDARDIZED, invalidation-policy{data-element=VeLINR_b_PECP_OVR_CUR_ERR_TO, handle-invalid=DONT-INVALIDATE}  # - Time Out
      data VeLINR_b_PECP_OVR_CUR_ERR_TO: category=VALUE, sw-calibration-access=READ-ONLY, type=ADTSBoolean, init-value=VeLINR_b_PECP_OVR_CUR_ERR_TOValue:0
    VeLINR_b_PECP_OVR_TMP_ERR_TO: service-kind=ANY-STANDARDIZED, invalidation-policy{data-element=VeLINR_b_PECP_OVR_TMP_ERR_TO, handle-invalid=DONT-INVALIDATE}  # - Time Out
      data VeLINR_b_PECP_OVR_TMP_ERR_TO: category=VALUE, sw-calibration-access=READ-ONLY, type=ADTSBoolean, init-value=VeLINR_b_PECP_OVR_TMP_ERR_TOValue:0
    VeLINR_b_PECP_POST_RUN_STAT_TO: service-kind=ANY-STANDARDIZED, invalidation-policy{data-element=VeLINR_b_PECP_POST_RUN_STAT_TO, handle-invalid=DONT-INVALIDATE}  # - Time Out
      data VeLINR_b_PECP_POST_RUN_STAT_TO: category=VALUE, sw-calibration-access=READ-ONLY, type=ADTSBoolean, init-value=VeLINR_b_PECP_POST_RUN_STAT_TOValue:0
    VeLINR_b_PECP_RPM_ACTL_PERCT_TO: service-kind=ANY-STANDARDIZED, invalidation-policy{data-element=VeLINR_b_PECP_RPM_ACTL_PERCT_TO, handle-invalid=DONT-INVALIDATE}  # - Time Out
      data VeLINR_b_PECP_RPM_ACTL_PERCT_TO: category=VALUE, sw-calibration-access=READ-ONLY, type=ADTSBoolean, init-value=VeLINR_b_PECP_RPM_ACTL_PERCT_TOValue:0
    VeLINR_b_PECP_RPM_TGT_PERCT_TO: service-kind=ANY-STANDARDIZED, invalidation-policy{data-element=VeLINR_b_PECP_RPM_TGT_PERCT_TO, handle-invalid=DONT-INVALIDATE}  # - Time Out
      data VeLINR_b_PECP_RPM_TGT_PERCT_TO: category=VALUE, sw-calibration-access=READ-ONLY, type=ADTSBoolean, init-value=VeLINR_b_PECP_RPM_TGT_PERCT_TOValue:0
    VeLINR_b_PECP_SUPPLIER_TO: service-kind=ANY-STANDARDIZED, invalidation-policy{data-element=VeLINR_b_PECP_SUPPLIER_TO, handle-invalid=DONT-INVALIDATE}  # - Time Out
      data VeLINR_b_PECP_SUPPLIER_TO: category=VALUE, sw-calibration-access=READ-ONLY, type=ADTSBoolean, init-value=VeLINR_b_PECP_SUPPLIER_TOValue:0
    VeLINR_b_PECP_TEMP_TO: service-kind=ANY-STANDARDIZED, invalidation-policy{data-element=VeLINR_b_PECP_TEMP_TO, handle-invalid=DONT-INVALIDATE}  # - Time Out
      data VeLINR_b_PECP_TEMP_TO: category=VALUE, sw-calibration-access=READ-ONLY, type=ADTSBoolean, init-value=VeLINR_b_PECP_TEMP_TOValue:0
    VeLINR_b_PECP_VERSION_TO: service-kind=ANY-STANDARDIZED, invalidation-policy{data-element=VeLINR_b_PECP_VERSION_TO, handle-invalid=DONT-INVALIDATE}  # - Time Out
      data VeLINR_b_PECP_VERSION_TO: category=VALUE, sw-calibration-access=READ-ONLY, type=ADTSBoolean, init-value=VeLINR_b_PECP_VERSION_TOValue:0
    VeLINR_b_PECP_VLTG_ERR_TO: service-kind=ANY-STANDARDIZED, invalidation-policy{data-element=VeLINR_b_PECP_VLTG_ERR_TO, handle-invalid=DONT-INVALIDATE}  # - Time Out
      data VeLINR_b_PECP_VLTG_ERR_TO: category=VALUE, sw-calibration-access=READ-ONLY, type=ADTSBoolean, init-value=VeLINR_b_PECP_VLTG_ERR_TOValue:0
    VeLINR_b_PECP_VLTG_TO: service-kind=ANY-STANDARDIZED, invalidation-policy{data-element=VeLINR_b_PECP_VLTG_TO, handle-invalid=DONT-INVALIDATE}  # - Time Out
      data VeLINR_b_PECP_VLTG_TO: category=VALUE, sw-calibration-access=READ-ONLY, type=ADTSBoolean, init-value=VeLINR_b_PECP_VLTG_TOValue:0
    VeLINR_b_PowPan2_Gnd_Fault_Det: service-kind=ANY-STANDARDIZED, invalidation-policy{data-element=VeLINR_b_PowPan2_Gnd_Fault_Det, handle-invalid=DONT-INVALIDATE}  # -
      data VeLINR_b_PowPan2_Gnd_Fault_Det: category=VALUE, sw-calibration-access=READ-ONLY, type=ADTSBoolean, init-value=VeLINR_b_PowPan2_Gnd_Fault_DetValue:0
    VeLINR_b_PowPan2_Gnd_Fault_DetTO: service-kind=ANY-STANDARDIZED, invalidation-policy{data-element=VeLINR_b_PowPan2_Gnd_Fault_DetTO, handle-invalid=DONT-INVALIDATE}  # - Time Out
      data VeLINR_b_PowPan2_Gnd_Fault_DetTO: category=VALUE, sw-calibration-access=READ-ONLY, type=ADTSBoolean, init-value=VeLINR_b_PowPan2_Gnd_Fault_DetTOValue:0
    VeLINR_b_PowPan2_LED_A_Col_FdbkTO: service-kind=ANY-STANDARDIZED, invalidation-policy{data-element=VeLINR_b_PowPan2_LED_A_Col_FdbkTO, handle-invalid=DONT-INVALIDATE}  # - Time Out
      data VeLINR_b_PowPan2_LED_A_Col_FdbkTO: category=VALUE, sw-calibration-access=READ-ONLY, type=ADTSBoolean, init-value=VeLINR_b_PowPan2_LED_A_Col_FdbkTOValue:0
    VeLINR_b_PowPan2_LED_A_FailStatTO: service-kind=ANY-STANDARDIZED, invalidation-policy{data-element=VeLINR_b_PowPan2_LED_A_FailStatTO, handle-invalid=DONT-INVALIDATE}  # - Time Out
      data VeLINR_b_PowPan2_LED_A_FailStatTO: category=VALUE, sw-calibration-access=READ-ONLY, type=ADTSBoolean, init-value=VeLINR_b_PowPan2_LED_A_FailStatTOValue:0
    VeLINR_b_PowPan2_LED_B_Col_FdbkTO: service-kind=ANY-STANDARDIZED, invalidation-policy{data-element=VeLINR_b_PowPan2_LED_B_Col_FdbkTO, handle-invalid=DONT-INVALIDATE}  # - Time Out
      data VeLINR_b_PowPan2_LED_B_Col_FdbkTO: category=VALUE, sw-calibration-access=READ-ONLY, type=ADTSBoolean, init-value=VeLINR_b_PowPan2_LED_B_Col_FdbkTOValue:0
    VeLINR_b_PowPan2_LED_B_FailStatTO: service-kind=ANY-STANDARDIZED, invalidation-policy{data-element=VeLINR_b_PowPan2_LED_B_FailStatTO, handle-invalid=DONT-INVALIDATE}  # - Time Out
      data VeLINR_b_PowPan2_LED_B_FailStatTO: category=VALUE, sw-calibration-access=READ-ONLY, type=ADTSBoolean, init-value=VeLINR_b_PowPan2_LED_B_FailStatTOValue:0
    VeLINR_b_PowPan2_LIN_Cksm_Err: service-kind=ANY-STANDARDIZED, invalidation-policy{data-element=VeLINR_b_PowPan2_LIN_Cksm_Err, handle-invalid=DONT-INVALIDATE}  # -
      data VeLINR_b_PowPan2_LIN_Cksm_Err: category=VALUE, sw-calibration-access=READ-ONLY, type=ADTSBoolean, init-value=VeLINR_b_PowPan2_LIN_Cksm_ErrValue:0
    VeLINR_b_PowPan2_LIN_Cksm_ErrTO: service-kind=ANY-STANDARDIZED, invalidation-policy{data-element=VeLINR_b_PowPan2_LIN_Cksm_ErrTO, handle-invalid=DONT-INVALIDATE}  # - Time Out
      data VeLINR_b_PowPan2_LIN_Cksm_ErrTO: category=VALUE, sw-calibration-access=READ-ONLY, type=ADTSBoolean, init-value=VeLINR_b_PowPan2_LIN_Cksm_ErrTOValue:0
    VeLINR_b_PowPan2_LIN_Data_Err: service-kind=ANY-STANDARDIZED, invalidation-policy{data-element=VeLINR_b_PowPan2_LIN_Data_Err, handle-invalid=DONT-INVALIDATE}  # -
      data VeLINR_b_PowPan2_LIN_Data_Err: category=VALUE, sw-calibration-access=READ-ONLY, type=ADTSBoolean, init-value=VeLINR_b_PowPan2_LIN_Data_ErrValue:0
    VeLINR_b_PowPan2_LIN_Data_ErrTO: service-kind=ANY-STANDARDIZED, invalidation-policy{data-element=VeLINR_b_PowPan2_LIN_Data_ErrTO, handle-invalid=DONT-INVALIDATE}  # - Time Out
      data VeLINR_b_PowPan2_LIN_Data_ErrTO: category=VALUE, sw-calibration-access=READ-ONLY, type=ADTSBoolean, init-value=VeLINR_b_PowPan2_LIN_Data_ErrTOValue:0
    VeLINR_b_PowPan2_LIN_Parity_Err: service-kind=ANY-STANDARDIZED, invalidation-policy{data-element=VeLINR_b_PowPan2_LIN_Parity_Err, handle-invalid=DONT-INVALIDATE}  # -
      data VeLINR_b_PowPan2_LIN_Parity_Err: category=VALUE, sw-calibration-access=READ-ONLY, type=ADTSBoolean, init-value=VeLINR_b_PowPan2_LIN_Parity_ErrValue:0
    VeLINR_b_PowPan2_LIN_Parity_ErrTO: service-kind=ANY-STANDARDIZED, invalidation-policy{data-element=VeLINR_b_PowPan2_LIN_Parity_ErrTO, handle-invalid=DONT-INVALIDATE}  # - Time Out
      data VeLINR_b_PowPan2_LIN_Parity_ErrTO: category=VALUE, sw-calibration-access=READ-ONLY, type=ADTSBoolean, init-value=VeLINR_b_PowPan2_LIN_Parity_ErrTOValue:0
    VeLINR_b_PowerPanel2ButtonState: service-kind=ANY-STANDARDIZED, invalidation-policy{data-element=VeLINR_b_PowerPanel2ButtonState, handle-invalid=DONT-INVALIDATE}  # -
      data VeLINR_b_PowerPanel2ButtonState: category=VALUE, sw-calibration-access=READ-ONLY, type=ADTSBoolean, init-value=VeLINR_b_PowerPanel2ButtonStateValue:0
    VeLINR_b_PowerPanel2ButtonStateTO: service-kind=ANY-STANDARDIZED, invalidation-policy{data-element=VeLINR_b_PowerPanel2ButtonStateTO, handle-invalid=DONT-INVALIDATE}  # - Time Out
      data VeLINR_b_PowerPanel2ButtonStateTO: category=VALUE, sw-calibration-access=READ-ONLY, type=ADTSBoolean, init-value=VeLINR_b_PowerPanel2ButtonStateTOValue:0
    VeLINR_b_PowerPanel2_FaultTO: service-kind=ANY-STANDARDIZED, invalidation-policy{data-element=VeLINR_b_PowerPanel2_FaultTO, handle-invalid=DONT-INVALIDATE}  # - Time Out
      data VeLINR_b_PowerPanel2_FaultTO: category=VALUE, sw-calibration-access=READ-ONLY, type=ADTSBoolean, init-value=VeLINR_b_PowerPanel2_FaultTOValue:0
    VeLINR_b_PowerPanel2_LED_A_FdbkTO: service-kind=ANY-STANDARDIZED, invalidation-policy{data-element=VeLINR_b_PowerPanel2_LED_A_FdbkTO, handle-invalid=DONT-INVALIDATE}  # - Time Out
      data VeLINR_b_PowerPanel2_LED_A_FdbkTO: category=VALUE, sw-calibration-access=READ-ONLY, type=ADTSBoolean, init-value=VeLINR_b_PowerPanel2_LED_A_FdbkTOValue:0
    VeLINR_b_PowerPanel2_LED_B_FdbkTO: service-kind=ANY-STANDARDIZED, invalidation-policy{data-element=VeLINR_b_PowerPanel2_LED_B_FdbkTO, handle-invalid=DONT-INVALIDATE}  # - Time Out
      data VeLINR_b_PowerPanel2_LED_B_FdbkTO: category=VALUE, sw-calibration-access=READ-ONLY, type=ADTSBoolean, init-value=VeLINR_b_PowerPanel2_LED_B_FdbkTOValue:0
    VeLINR_b_PowerPanel2_RatedPowerTO: service-kind=ANY-STANDARDIZED, invalidation-policy{data-element=VeLINR_b_PowerPanel2_RatedPowerTO, handle-invalid=DONT-INVALIDATE}  # - Time Out
      data VeLINR_b_PowerPanel2_RatedPowerTO: category=VALUE, sw-calibration-access=READ-ONLY, type=ADTSBoolean, init-value=VeLINR_b_PowerPanel2_RatedPowerTOValue:0
    VeLINR_b_PowerPanelButton_State: service-kind=ANY-STANDARDIZED, invalidation-policy{data-element=VeLINR_b_PowerPanelButton_State, handle-invalid=DONT-INVALIDATE}  # -
      data VeLINR_b_PowerPanelButton_State: category=VALUE, sw-calibration-access=READ-ONLY, type=ADTSBoolean, init-value=VeLINR_b_PowerPanelButton_StateValue:0
    VeLINR_b_PowerPanelButton_StateTO: service-kind=ANY-STANDARDIZED, invalidation-policy{data-element=VeLINR_b_PowerPanelButton_StateTO, handle-invalid=DONT-INVALIDATE}  # - Time Out
      data VeLINR_b_PowerPanelButton_StateTO: category=VALUE, sw-calibration-access=READ-ONLY, type=ADTSBoolean, init-value=VeLINR_b_PowerPanelButton_StateTOValue:0
    VeLINR_b_PowerPanel_FaultReasonTO: service-kind=ANY-STANDARDIZED, invalidation-policy{data-element=VeLINR_b_PowerPanel_FaultReasonTO, handle-invalid=DONT-INVALIDATE}  # - Time Out
      data VeLINR_b_PowerPanel_FaultReasonTO: category=VALUE, sw-calibration-access=READ-ONLY, type=ADTSBoolean, init-value=VeLINR_b_PowerPanel_FaultReasonTOValue:0
    VeLINR_b_PowerPanel_FaultTO: service-kind=ANY-STANDARDIZED, invalidation-policy{data-element=VeLINR_b_PowerPanel_FaultTO, handle-invalid=DONT-INVALIDATE}  # - Time Out
      data VeLINR_b_PowerPanel_FaultTO: category=VALUE, sw-calibration-access=READ-ONLY, type=ADTSBoolean, init-value=VeLINR_b_PowerPanel_FaultTOValue:0
    VeLINR_b_PowerPanel_RatedPowerTO: service-kind=ANY-STANDARDIZED, invalidation-policy{data-element=VeLINR_b_PowerPanel_RatedPowerTO, handle-invalid=DONT-INVALIDATE}  # - Time Out
      data VeLINR_b_PowerPanel_RatedPowerTO: category=VALUE, sw-calibration-access=READ-ONLY, type=ADTSBoolean, init-value=VeLINR_b_PowerPanel_RatedPowerTOValue:0
    VeLINR_b_PwrPanel2AC_PrsntSens1: service-kind=ANY-STANDARDIZED, invalidation-policy{data-element=VeLINR_b_PwrPanel2AC_PrsntSens1, handle-invalid=DONT-INVALIDATE}  # -
      data VeLINR_b_PwrPanel2AC_PrsntSens1: category=VALUE, sw-calibration-access=READ-ONLY, type=ADTSBoolean, init-value=VeLINR_b_PwrPanel2AC_PrsntSens1Value:0
    VeLINR_b_PwrPanel2AC_PrsntSens1TO: service-kind=ANY-STANDARDIZED, invalidation-policy{data-element=VeLINR_b_PwrPanel2AC_PrsntSens1TO, handle-invalid=DONT-INVALIDATE}  # - Time Out
      data VeLINR_b_PwrPanel2AC_PrsntSens1TO: category=VALUE, sw-calibration-access=READ-ONLY, type=ADTSBoolean, init-value=VeLINR_b_PwrPanel2AC_PrsntSens1TOValue:0
    VeLINR_b_PwrPanel2AC_PrsntSens2: service-kind=ANY-STANDARDIZED, invalidation-policy{data-element=VeLINR_b_PwrPanel2AC_PrsntSens2, handle-invalid=DONT-INVALIDATE}  # -
      data VeLINR_b_PwrPanel2AC_PrsntSens2: category=VALUE, sw-calibration-access=READ-ONLY, type=ADTSBoolean, init-value=VeLINR_b_PwrPanel2AC_PrsntSens2Value:0
    VeLINR_b_PwrPanel2AC_PrsntSens2TO: service-kind=ANY-STANDARDIZED, invalidation-policy{data-element=VeLINR_b_PwrPanel2AC_PrsntSens2TO, handle-invalid=DONT-INVALIDATE}  # - Time Out
      data VeLINR_b_PwrPanel2AC_PrsntSens2TO: category=VALUE, sw-calibration-access=READ-ONLY, type=ADTSBoolean, init-value=VeLINR_b_PwrPanel2AC_PrsntSens2TOValue:0
    VeLINR_b_PwrPanel2CurrDrawSens1TO: service-kind=ANY-STANDARDIZED, invalidation-policy{data-element=VeLINR_b_PwrPanel2CurrDrawSens1TO, handle-invalid=DONT-INVALIDATE}  # - Time Out
      data VeLINR_b_PwrPanel2CurrDrawSens1TO: category=VALUE, sw-calibration-access=READ-ONLY, type=ADTSBoolean, init-value=VeLINR_b_PwrPanel2CurrDrawSens1TOValue:0
    VeLINR_b_PwrPanel2CurrDrawSens2TO: service-kind=ANY-STANDARDIZED, invalidation-policy{data-element=VeLINR_b_PwrPanel2CurrDrawSens2TO, handle-invalid=DONT-INVALIDATE}  # - Time Out
      data VeLINR_b_PwrPanel2CurrDrawSens2TO: category=VALUE, sw-calibration-access=READ-ONLY, type=ADTSBoolean, init-value=VeLINR_b_PwrPanel2CurrDrawSens2TOValue:0
    VeLINR_b_PwrPanel2LidSwtSts120A: service-kind=ANY-STANDARDIZED, invalidation-policy{data-element=VeLINR_b_PwrPanel2LidSwtSts120A, handle-invalid=DONT-INVALIDATE}  # -
      data VeLINR_b_PwrPanel2LidSwtSts120A: category=VALUE, sw-calibration-access=READ-ONLY, type=ADTSBoolean, init-value=VeLINR_b_PwrPanel2LidSwtSts120AValue:0
    VeLINR_b_PwrPanel2LidSwtSts120A_TO: service-kind=ANY-STANDARDIZED, invalidation-policy{data-element=VeLINR_b_PwrPanel2LidSwtSts120A_TO, handle-invalid=DONT-INVALIDATE}  # - Time Out
      data VeLINR_b_PwrPanel2LidSwtSts120A_TO: category=VALUE, sw-calibration-access=READ-ONLY, type=ADTSBoolean, init-value=VeLINR_b_PwrPanel2LidSwtSts120A_TOValue:0
    VeLINR_b_PwrPanel2LidSwtSts120B: service-kind=ANY-STANDARDIZED, invalidation-policy{data-element=VeLINR_b_PwrPanel2LidSwtSts120B, handle-invalid=DONT-INVALIDATE}  # -
      data VeLINR_b_PwrPanel2LidSwtSts120B: category=VALUE, sw-calibration-access=READ-ONLY, type=ADTSBoolean, init-value=VeLINR_b_PwrPanel2LidSwtSts120BValue:0
    VeLINR_b_PwrPanel2LidSwtSts120B_TO: service-kind=ANY-STANDARDIZED, invalidation-policy{data-element=VeLINR_b_PwrPanel2LidSwtSts120B_TO, handle-invalid=DONT-INVALIDATE}  # - Time Out
      data VeLINR_b_PwrPanel2LidSwtSts120B_TO: category=VALUE, sw-calibration-access=READ-ONLY, type=ADTSBoolean, init-value=VeLINR_b_PwrPanel2LidSwtSts120B_TOValue:0
    VeLINR_b_PwrPanel2LidSwtSts240: service-kind=ANY-STANDARDIZED, invalidation-policy{data-element=VeLINR_b_PwrPanel2LidSwtSts240, handle-invalid=DONT-INVALIDATE}  # -
      data VeLINR_b_PwrPanel2LidSwtSts240: category=VALUE, sw-calibration-access=READ-ONLY, type=ADTSBoolean, init-value=VeLINR_b_PwrPanel2LidSwtSts240Value:0
    VeLINR_b_PwrPanel2LidSwtSts240TO: service-kind=ANY-STANDARDIZED, invalidation-policy{data-element=VeLINR_b_PwrPanel2LidSwtSts240TO, handle-invalid=DONT-INVALIDATE}  # - Time Out
      data VeLINR_b_PwrPanel2LidSwtSts240TO: category=VALUE, sw-calibration-access=READ-ONLY, type=ADTSBoolean, init-value=VeLINR_b_PwrPanel2LidSwtSts240TOValue:0
    VeLINR_b_PwrPanel2_Fault_ReasonTO: service-kind=ANY-STANDARDIZED, invalidation-policy{data-element=VeLINR_b_PwrPanel2_Fault_ReasonTO, handle-invalid=DONT-INVALIDATE}  # - Time Out
      data VeLINR_b_PwrPanel2_Fault_ReasonTO: category=VALUE, sw-calibration-access=READ-ONLY, type=ADTSBoolean, init-value=VeLINR_b_PwrPanel2_Fault_ReasonTOValue:0
    VeLINR_b_PwrPanelAC_PresntSens1: service-kind=ANY-STANDARDIZED, invalidation-policy{data-element=VeLINR_b_PwrPanelAC_PresntSens1, handle-invalid=DONT-INVALIDATE}  # -
      data VeLINR_b_PwrPanelAC_PresntSens1: category=VALUE, sw-calibration-access=READ-ONLY, type=ADTSBoolean, init-value=VeLINR_b_PwrPanelAC_PresntSens1Value:0
    VeLINR_b_PwrPanelAC_PresntSens1TO: service-kind=ANY-STANDARDIZED, invalidation-policy{data-element=VeLINR_b_PwrPanelAC_PresntSens1TO, handle-invalid=DONT-INVALIDATE}  # - Time Out
      data VeLINR_b_PwrPanelAC_PresntSens1TO: category=VALUE, sw-calibration-access=READ-ONLY, type=ADTSBoolean, init-value=VeLINR_b_PwrPanelAC_PresntSens1TOValue:0
    VeLINR_b_PwrPanelAC_PresntSens2: service-kind=ANY-STANDARDIZED, invalidation-policy{data-element=VeLINR_b_PwrPanelAC_PresntSens2, handle-invalid=DONT-INVALIDATE}  # -
      data VeLINR_b_PwrPanelAC_PresntSens2: category=VALUE, sw-calibration-access=READ-ONLY, type=ADTSBoolean, init-value=VeLINR_b_PwrPanelAC_PresntSens2Value:0
    VeLINR_b_PwrPanelAC_PresntSens2TO: service-kind=ANY-STANDARDIZED, invalidation-policy{data-element=VeLINR_b_PwrPanelAC_PresntSens2TO, handle-invalid=DONT-INVALIDATE}  # - Time Out
      data VeLINR_b_PwrPanelAC_PresntSens2TO: category=VALUE, sw-calibration-access=READ-ONLY, type=ADTSBoolean, init-value=VeLINR_b_PwrPanelAC_PresntSens2TOValue:0
    VeLINR_b_PwrPanelCurrDrawSens1TO: service-kind=ANY-STANDARDIZED, invalidation-policy{data-element=VeLINR_b_PwrPanelCurrDrawSens1TO, handle-invalid=DONT-INVALIDATE}  # - Time Out
      data VeLINR_b_PwrPanelCurrDrawSens1TO: category=VALUE, sw-calibration-access=READ-ONLY, type=ADTSBoolean, init-value=VeLINR_b_PwrPanelCurrDrawSens1TOValue:0
    VeLINR_b_PwrPanelCurrDrawSens2TO: service-kind=ANY-STANDARDIZED, invalidation-policy{data-element=VeLINR_b_PwrPanelCurrDrawSens2TO, handle-invalid=DONT-INVALIDATE}  # - Time Out
      data VeLINR_b_PwrPanelCurrDrawSens2TO: category=VALUE, sw-calibration-access=READ-ONLY, type=ADTSBoolean, init-value=VeLINR_b_PwrPanelCurrDrawSens2TOValue:0
    VeLINR_b_PwrPanelGndFltDetected: service-kind=ANY-STANDARDIZED, invalidation-policy{data-element=VeLINR_b_PwrPanelGndFltDetected, handle-invalid=DONT-INVALIDATE}  # -
      data VeLINR_b_PwrPanelGndFltDetected: category=VALUE, sw-calibration-access=READ-ONLY, type=ADTSBoolean, init-value=VeLINR_b_PwrPanelGndFltDetectedValue:0
    VeLINR_b_PwrPanelGndFltDetectedTO: service-kind=ANY-STANDARDIZED, invalidation-policy{data-element=VeLINR_b_PwrPanelGndFltDetectedTO, handle-invalid=DONT-INVALIDATE}  # - Time Out
      data VeLINR_b_PwrPanelGndFltDetectedTO: category=VALUE, sw-calibration-access=READ-ONLY, type=ADTSBoolean, init-value=VeLINR_b_PwrPanelGndFltDetectedTOValue:0
    VeLINR_b_PwrPanelLEDAColorFdbckTO: service-kind=ANY-STANDARDIZED, invalidation-policy{data-element=VeLINR_b_PwrPanelLEDAColorFdbckTO, handle-invalid=DONT-INVALIDATE}  # - Time Out
      data VeLINR_b_PwrPanelLEDAColorFdbckTO: category=VALUE, sw-calibration-access=READ-ONLY, type=ADTSBoolean, init-value=VeLINR_b_PwrPanelLEDAColorFdbckTOValue:0
    VeLINR_b_PwrPanelLEDBColorFdbckTO: service-kind=ANY-STANDARDIZED, invalidation-policy{data-element=VeLINR_b_PwrPanelLEDBColorFdbckTO, handle-invalid=DONT-INVALIDATE}  # - Time Out
      data VeLINR_b_PwrPanelLEDBColorFdbckTO: category=VALUE, sw-calibration-access=READ-ONLY, type=ADTSBoolean, init-value=VeLINR_b_PwrPanelLEDBColorFdbckTOValue:0
    VeLINR_b_PwrPanelLEDCColorFdbckTO: service-kind=ANY-STANDARDIZED, invalidation-policy{data-element=VeLINR_b_PwrPanelLEDCColorFdbckTO, handle-invalid=DONT-INVALIDATE}  # - Time Out
      data VeLINR_b_PwrPanelLEDCColorFdbckTO: category=VALUE, sw-calibration-access=READ-ONLY, type=ADTSBoolean, init-value=VeLINR_b_PwrPanelLEDCColorFdbckTOValue:0
    VeLINR_b_PwrPanelLidSwtSts120A: service-kind=ANY-STANDARDIZED, invalidation-policy{data-element=VeLINR_b_PwrPanelLidSwtSts120A, handle-invalid=DONT-INVALIDATE}  # -
      data VeLINR_b_PwrPanelLidSwtSts120A: category=VALUE, sw-calibration-access=READ-ONLY, type=ADTSBoolean, init-value=VeLINR_b_PwrPanelLidSwtSts120AValue:0
    VeLINR_b_PwrPanelLidSwtSts120A_TO: service-kind=ANY-STANDARDIZED, invalidation-policy{data-element=VeLINR_b_PwrPanelLidSwtSts120A_TO, handle-invalid=DONT-INVALIDATE}  # - Time Out
      data VeLINR_b_PwrPanelLidSwtSts120A_TO: category=VALUE, sw-calibration-access=READ-ONLY, type=ADTSBoolean, init-value=VeLINR_b_PwrPanelLidSwtSts120A_TOValue:0
    VeLINR_b_PwrPanelLidSwtSts120B: service-kind=ANY-STANDARDIZED, invalidation-policy{data-element=VeLINR_b_PwrPanelLidSwtSts120B, handle-invalid=DONT-INVALIDATE}  # -
      data VeLINR_b_PwrPanelLidSwtSts120B: category=VALUE, sw-calibration-access=READ-ONLY, type=ADTSBoolean, init-value=VeLINR_b_PwrPanelLidSwtSts120BValue:0
    VeLINR_b_PwrPanelLidSwtSts120B_TO: service-kind=ANY-STANDARDIZED, invalidation-policy{data-element=VeLINR_b_PwrPanelLidSwtSts120B_TO, handle-invalid=DONT-INVALIDATE}  # - Time Out
      data VeLINR_b_PwrPanelLidSwtSts120B_TO: category=VALUE, sw-calibration-access=READ-ONLY, type=ADTSBoolean, init-value=VeLINR_b_PwrPanelLidSwtSts120B_TOValue:0
    VeLINR_b_PwrPanelLidSwtSts240: service-kind=ANY-STANDARDIZED, invalidation-policy{data-element=VeLINR_b_PwrPanelLidSwtSts240, handle-invalid=DONT-INVALIDATE}  # -
      data VeLINR_b_PwrPanelLidSwtSts240: category=VALUE, sw-calibration-access=READ-ONLY, type=ADTSBoolean, init-value=VeLINR_b_PwrPanelLidSwtSts240Value:0
    VeLINR_b_PwrPanelLidSwtSts240TO: service-kind=ANY-STANDARDIZED, invalidation-policy{data-element=VeLINR_b_PwrPanelLidSwtSts240TO, handle-invalid=DONT-INVALIDATE}  # - Time Out
      data VeLINR_b_PwrPanelLidSwtSts240TO: category=VALUE, sw-calibration-access=READ-ONLY, type=ADTSBoolean, init-value=VeLINR_b_PwrPanelLidSwtSts240TOValue:0
    VeLINR_b_PwrPanel_LEDA_FailStsTO: service-kind=ANY-STANDARDIZED, invalidation-policy{data-element=VeLINR_b_PwrPanel_LEDA_FailStsTO, handle-invalid=DONT-INVALIDATE}  # - Time Out
      data VeLINR_b_PwrPanel_LEDA_FailStsTO: category=VALUE, sw-calibration-access=READ-ONLY, type=ADTSBoolean, init-value=VeLINR_b_PwrPanel_LEDA_FailStsTOValue:0
    VeLINR_b_PwrPanel_LEDA_FeedbackTO: service-kind=ANY-STANDARDIZED, invalidation-policy{data-element=VeLINR_b_PwrPanel_LEDA_FeedbackTO, handle-invalid=DONT-INVALIDATE}  # - Time Out
      data VeLINR_b_PwrPanel_LEDA_FeedbackTO: category=VALUE, sw-calibration-access=READ-ONLY, type=ADTSBoolean, init-value=VeLINR_b_PwrPanel_LEDA_FeedbackTOValue:0
    VeLINR_b_PwrPanel_LEDB_FailStsTO: service-kind=ANY-STANDARDIZED, invalidation-policy{data-element=VeLINR_b_PwrPanel_LEDB_FailStsTO, handle-invalid=DONT-INVALIDATE}  # - Time Out
      data VeLINR_b_PwrPanel_LEDB_FailStsTO: category=VALUE, sw-calibration-access=READ-ONLY, type=ADTSBoolean, init-value=VeLINR_b_PwrPanel_LEDB_FailStsTOValue:0
    VeLINR_b_PwrPanel_LEDB_FeedbackTO: service-kind=ANY-STANDARDIZED, invalidation-policy{data-element=VeLINR_b_PwrPanel_LEDB_FeedbackTO, handle-invalid=DONT-INVALIDATE}  # - Time Out
      data VeLINR_b_PwrPanel_LEDB_FeedbackTO: category=VALUE, sw-calibration-access=READ-ONLY, type=ADTSBoolean, init-value=VeLINR_b_PwrPanel_LEDB_FeedbackTOValue:0
    VeLINR_b_PwrPanel_LEDC_FailStsTO: service-kind=ANY-STANDARDIZED, invalidation-policy{data-element=VeLINR_b_PwrPanel_LEDC_FailStsTO, handle-invalid=DONT-INVALIDATE}  # - Time Out
      data VeLINR_b_PwrPanel_LEDC_FailStsTO: category=VALUE, sw-calibration-access=READ-ONLY, type=ADTSBoolean, init-value=VeLINR_b_PwrPanel_LEDC_FailStsTOValue:0
    VeLINR_b_PwrPanel_LEDC_FeedbackTO: service-kind=ANY-STANDARDIZED, invalidation-policy{data-element=VeLINR_b_PwrPanel_LEDC_FeedbackTO, handle-invalid=DONT-INVALIDATE}  # - Time Out
      data VeLINR_b_PwrPanel_LEDC_FeedbackTO: category=VALUE, sw-calibration-access=READ-ONLY, type=ADTSBoolean, init-value=VeLINR_b_PwrPanel_LEDC_FeedbackTOValue:0
    VeLINR_b_PwrPanel_LIN_ChksumErr: service-kind=ANY-STANDARDIZED, invalidation-policy{data-element=VeLINR_b_PwrPanel_LIN_ChksumErr, handle-invalid=DONT-INVALIDATE}  # -
      data VeLINR_b_PwrPanel_LIN_ChksumErr: category=VALUE, sw-calibration-access=READ-ONLY, type=ADTSBoolean, init-value=VeLINR_b_PwrPanel_LIN_ChksumErrValue:0
    VeLINR_b_PwrPanel_LIN_ChksumErrTO: service-kind=ANY-STANDARDIZED, invalidation-policy{data-element=VeLINR_b_PwrPanel_LIN_ChksumErrTO, handle-invalid=DONT-INVALIDATE}  # - Time Out
      data VeLINR_b_PwrPanel_LIN_ChksumErrTO: category=VALUE, sw-calibration-access=READ-ONLY, type=ADTSBoolean, init-value=VeLINR_b_PwrPanel_LIN_ChksumErrTOValue:0
    VeLINR_b_PwrPanel_LIN_DataError: service-kind=ANY-STANDARDIZED, invalidation-policy{data-element=VeLINR_b_PwrPanel_LIN_DataError, handle-invalid=DONT-INVALIDATE}  # -
      data VeLINR_b_PwrPanel_LIN_DataError: category=VALUE, sw-calibration-access=READ-ONLY, type=ADTSBoolean, init-value=VeLINR_b_PwrPanel_LIN_DataErrorValue:0
    VeLINR_b_PwrPanel_LIN_DataErrorTO: service-kind=ANY-STANDARDIZED, invalidation-policy{data-element=VeLINR_b_PwrPanel_LIN_DataErrorTO, handle-invalid=DONT-INVALIDATE}  # - Time Out
      data VeLINR_b_PwrPanel_LIN_DataErrorTO: category=VALUE, sw-calibration-access=READ-ONLY, type=ADTSBoolean, init-value=VeLINR_b_PwrPanel_LIN_DataErrorTOValue:0
    VeLINR_b_PwrPanel_LIN_ParityErr: service-kind=ANY-STANDARDIZED, invalidation-policy{data-element=VeLINR_b_PwrPanel_LIN_ParityErr, handle-invalid=DONT-INVALIDATE}  # -
      data VeLINR_b_PwrPanel_LIN_ParityErr: category=VALUE, sw-calibration-access=READ-ONLY, type=ADTSBoolean, init-value=VeLINR_b_PwrPanel_LIN_ParityErrValue:0
    VeLINR_b_PwrPanel_LIN_ParityErrTO: service-kind=ANY-STANDARDIZED, invalidation-policy{data-element=VeLINR_b_PwrPanel_LIN_ParityErrTO, handle-invalid=DONT-INVALIDATE}  # - Time Out
      data VeLINR_b_PwrPanel_LIN_ParityErrTO: category=VALUE, sw-calibration-access=READ-ONLY, type=ADTSBoolean, init-value=VeLINR_b_PwrPanel_LIN_ParityErrTOValue:0
    VeLINR_b_Refrig_Temp_LIN2TO: service-kind=ANY-STANDARDIZED, invalidation-policy{data-element=VeLINR_b_Refrig_Temp_LIN2TO, handle-invalid=DONT-INVALIDATE}  # - Time Out
      data VeLINR_b_Refrig_Temp_LIN2TO: category=VALUE, sw-calibration-access=READ-ONLY, type=ADTSBoolean, init-value=VeLINR_b_Refrig_Temp_LIN2TOValue:0
    VeLINR_b_ResponseErrorStsCPIM: service-kind=ANY-STANDARDIZED, invalidation-policy{data-element=VeLINR_b_ResponseErrorStsCPIM, handle-invalid=DONT-INVALIDATE}  # -
      data VeLINR_b_ResponseErrorStsCPIM: category=VALUE, sw-calibration-access=READ-ONLY, type=ADTSBoolean, init-value=VeLINR_b_ResponseErrorStsCPIMValue:0
    VeLINR_b_ResponseErrorStsCPIM_TO: service-kind=ANY-STANDARDIZED, invalidation-policy{data-element=VeLINR_b_ResponseErrorStsCPIM_TO, handle-invalid=DONT-INVALIDATE}  # - Time Out
      data VeLINR_b_ResponseErrorStsCPIM_TO: category=VALUE, sw-calibration-access=READ-ONLY, type=ADTSBoolean, init-value=VeLINR_b_ResponseErrorStsCPIM_TOValue:0
    VeLINR_b_RsErr_AAD: service-kind=ANY-STANDARDIZED, invalidation-policy{data-element=VeLINR_b_RsErr_AAD, handle-invalid=DONT-INVALIDATE}  # -
      data VeLINR_b_RsErr_AAD: category=VALUE, sw-calibration-access=READ-ONLY, type=ADTSBoolean, init-value=VeLINR_b_RsErr_AADValue:0
    VeLINR_b_RsErr_AAD_TO: service-kind=ANY-STANDARDIZED, invalidation-policy{data-element=VeLINR_b_RsErr_AAD_TO, handle-invalid=DONT-INVALIDATE}  # - Time Out
      data VeLINR_b_RsErr_AAD_TO: category=VALUE, sw-calibration-access=READ-ONLY, type=ADTSBoolean, init-value=VeLINR_b_RsErr_AAD_TOValue:0
    VeLINR_b_RsErr_AGS: service-kind=ANY-STANDARDIZED, invalidation-policy{data-element=VeLINR_b_RsErr_AGS, handle-invalid=DONT-INVALIDATE}  # -
      data VeLINR_b_RsErr_AGS: category=VALUE, sw-calibration-access=READ-ONLY, type=ADTSBoolean, init-value=VeLINR_b_RsErr_AGSValue:0
    VeLINR_b_RsErr_AGS2: service-kind=ANY-STANDARDIZED, invalidation-policy{data-element=VeLINR_b_RsErr_AGS2, handle-invalid=DONT-INVALIDATE}  # -
      data VeLINR_b_RsErr_AGS2: category=VALUE, sw-calibration-access=READ-ONLY, type=ADTSBoolean, init-value=VeLINR_b_RsErr_AGS2Value:0
    VeLINR_b_RsErr_AGS2TO: service-kind=ANY-STANDARDIZED, invalidation-policy{data-element=VeLINR_b_RsErr_AGS2TO, handle-invalid=DONT-INVALIDATE}  # - Time Out
      data VeLINR_b_RsErr_AGS2TO: category=VALUE, sw-calibration-access=READ-ONLY, type=ADTSBoolean, init-value=VeLINR_b_RsErr_AGS2TOValue:0
    VeLINR_b_RsErr_AGS_TO: service-kind=ANY-STANDARDIZED, invalidation-policy{data-element=VeLINR_b_RsErr_AGS_TO, handle-invalid=DONT-INVALIDATE}  # - Time Out
      data VeLINR_b_RsErr_AGS_TO: category=VALUE, sw-calibration-access=READ-ONLY, type=ADTSBoolean, init-value=VeLINR_b_RsErr_AGS_TOValue:0
    VeLINR_b_RsErr_AHP_PUMP: service-kind=ANY-STANDARDIZED, invalidation-policy{data-element=VeLINR_b_RsErr_AHP_PUMP, handle-invalid=DONT-INVALIDATE}  # -
      data VeLINR_b_RsErr_AHP_PUMP: category=VALUE, sw-calibration-access=READ-ONLY, type=ADTSBoolean, init-value=VeLINR_b_RsErr_AHP_PUMPValue:0
    VeLINR_b_RsErr_AHP_PUMP_TO: service-kind=ANY-STANDARDIZED, invalidation-policy{data-element=VeLINR_b_RsErr_AHP_PUMP_TO, handle-invalid=DONT-INVALIDATE}  # - Time Out
      data VeLINR_b_RsErr_AHP_PUMP_TO: category=VALUE, sw-calibration-access=READ-ONLY, type=ADTSBoolean, init-value=VeLINR_b_RsErr_AHP_PUMP_TOValue:0
    VeLINR_b_RsErr_BCP_PUMP: service-kind=ANY-STANDARDIZED, invalidation-policy{data-element=VeLINR_b_RsErr_BCP_PUMP, handle-invalid=DONT-INVALIDATE}  # -
      data VeLINR_b_RsErr_BCP_PUMP: category=VALUE, sw-calibration-access=READ-ONLY, type=ADTSBoolean, init-value=VeLINR_b_RsErr_BCP_PUMPValue:0
    VeLINR_b_RsErr_BCP_PUMP_TO: service-kind=ANY-STANDARDIZED, invalidation-policy{data-element=VeLINR_b_RsErr_BCP_PUMP_TO, handle-invalid=DONT-INVALIDATE}  # - Time Out
      data VeLINR_b_RsErr_BCP_PUMP_TO: category=VALUE, sw-calibration-access=READ-ONLY, type=ADTSBoolean, init-value=VeLINR_b_RsErr_BCP_PUMP_TOValue:0
    VeLINR_b_RsErr_BHV: service-kind=ANY-STANDARDIZED, invalidation-policy{data-element=VeLINR_b_RsErr_BHV, handle-invalid=DONT-INVALIDATE}  # -
      data VeLINR_b_RsErr_BHV: category=VALUE, sw-calibration-access=READ-ONLY, type=ADTSBoolean, init-value=VeLINR_b_RsErr_BHVValue:0
    VeLINR_b_RsErr_BHV_TO: service-kind=ANY-STANDARDIZED, invalidation-policy{data-element=VeLINR_b_RsErr_BHV_TO, handle-invalid=DONT-INVALIDATE}  # - Time Out
      data VeLINR_b_RsErr_BHV_TO: category=VALUE, sw-calibration-access=READ-ONLY, type=ADTSBoolean, init-value=VeLINR_b_RsErr_BHV_TOValue:0
    VeLINR_b_RsErr_CEXV: service-kind=ANY-STANDARDIZED, invalidation-policy{data-element=VeLINR_b_RsErr_CEXV, handle-invalid=DONT-INVALIDATE}  # -
      data VeLINR_b_RsErr_CEXV: category=VALUE, sw-calibration-access=READ-ONLY, type=ADTSBoolean, init-value=VeLINR_b_RsErr_CEXVValue:0
    VeLINR_b_RsErr_CEXV_TO: service-kind=ANY-STANDARDIZED, invalidation-policy{data-element=VeLINR_b_RsErr_CEXV_TO, handle-invalid=DONT-INVALIDATE}  # - Time Out
      data VeLINR_b_RsErr_CEXV_TO: category=VALUE, sw-calibration-access=READ-ONLY, type=ADTSBoolean, init-value=VeLINR_b_RsErr_CEXV_TOValue:0
    VeLINR_b_RsErr_CPV: service-kind=ANY-STANDARDIZED, invalidation-policy{data-element=VeLINR_b_RsErr_CPV, handle-invalid=DONT-INVALIDATE}  # -
      data VeLINR_b_RsErr_CPV: category=VALUE, sw-calibration-access=READ-ONLY, type=ADTSBoolean, init-value=VeLINR_b_RsErr_CPVValue:0
    VeLINR_b_RsErr_CPV_TO: service-kind=ANY-STANDARDIZED, invalidation-policy{data-element=VeLINR_b_RsErr_CPV_TO, handle-invalid=DONT-INVALIDATE}  # - Time Out
      data VeLINR_b_RsErr_CPV_TO: category=VALUE, sw-calibration-access=READ-ONLY, type=ADTSBoolean, init-value=VeLINR_b_RsErr_CPV_TOValue:0
    VeLINR_b_RsErr_EAC2: service-kind=ANY-STANDARDIZED, invalidation-policy{data-element=VeLINR_b_RsErr_EAC2, handle-invalid=DONT-INVALIDATE}  # -
      data VeLINR_b_RsErr_EAC2: category=VALUE, sw-calibration-access=READ-ONLY, type=ADTSBoolean, init-value=VeLINR_b_RsErr_EAC2Value:0
    VeLINR_b_RsErr_EAC2TO: service-kind=ANY-STANDARDIZED, invalidation-policy{data-element=VeLINR_b_RsErr_EAC2TO, handle-invalid=DONT-INVALIDATE}  # - Time Out
      data VeLINR_b_RsErr_EAC2TO: category=VALUE, sw-calibration-access=READ-ONLY, type=ADTSBoolean, init-value=VeLINR_b_RsErr_EAC2TOValue:0
    VeLINR_b_RsErr_EAC2_800: service-kind=ANY-STANDARDIZED, invalidation-policy{data-element=VeLINR_b_RsErr_EAC2_800, handle-invalid=DONT-INVALIDATE}  # -
      data VeLINR_b_RsErr_EAC2_800: category=VALUE, sw-calibration-access=READ-ONLY, type=ADTSBoolean, init-value=VeLINR_b_RsErr_EAC2_800Value:0
    VeLINR_b_RsErr_EAC2_800TO: service-kind=ANY-STANDARDIZED, invalidation-policy{data-element=VeLINR_b_RsErr_EAC2_800TO, handle-invalid=DONT-INVALIDATE}  # - Time Out
      data VeLINR_b_RsErr_EAC2_800TO: category=VALUE, sw-calibration-access=READ-ONLY, type=ADTSBoolean, init-value=VeLINR_b_RsErr_EAC2_800TOValue:0
    VeLINR_b_RsErr_EAH: service-kind=ANY-STANDARDIZED, invalidation-policy{data-element=VeLINR_b_RsErr_EAH, handle-invalid=DONT-INVALIDATE}  # -
      data VeLINR_b_RsErr_EAH: category=VALUE, sw-calibration-access=READ-ONLY, type=ADTSBoolean, init-value=VeLINR_b_RsErr_EAHValue:0
    VeLINR_b_RsErr_EAH_TO: service-kind=ANY-STANDARDIZED, invalidation-policy{data-element=VeLINR_b_RsErr_EAH_TO, handle-invalid=DONT-INVALIDATE}  # - Time Out
      data VeLINR_b_RsErr_EAH_TO: category=VALUE, sw-calibration-access=READ-ONLY, type=ADTSBoolean, init-value=VeLINR_b_RsErr_EAH_TOValue:0
    VeLINR_b_RsErr_ECH: service-kind=ANY-STANDARDIZED, invalidation-policy{data-element=VeLINR_b_RsErr_ECH, handle-invalid=DONT-INVALIDATE}  # -
      data VeLINR_b_RsErr_ECH: category=VALUE, sw-calibration-access=READ-ONLY, type=ADTSBoolean, init-value=VeLINR_b_RsErr_ECHValue:0
    VeLINR_b_RsErr_ECH_TO: service-kind=ANY-STANDARDIZED, invalidation-policy{data-element=VeLINR_b_RsErr_ECH_TO, handle-invalid=DONT-INVALIDATE}  # - Time Out
      data VeLINR_b_RsErr_ECH_TO: category=VALUE, sw-calibration-access=READ-ONLY, type=ADTSBoolean, init-value=VeLINR_b_RsErr_ECH_TOValue:0
    VeLINR_b_RsErr_EEXV: service-kind=ANY-STANDARDIZED, invalidation-policy{data-element=VeLINR_b_RsErr_EEXV, handle-invalid=DONT-INVALIDATE}  # -
      data VeLINR_b_RsErr_EEXV: category=VALUE, sw-calibration-access=READ-ONLY, type=ADTSBoolean, init-value=VeLINR_b_RsErr_EEXVValue:0
    VeLINR_b_RsErr_EEXV_TO: service-kind=ANY-STANDARDIZED, invalidation-policy{data-element=VeLINR_b_RsErr_EEXV_TO, handle-invalid=DONT-INVALIDATE}  # - Time Out
      data VeLINR_b_RsErr_EEXV_TO: category=VALUE, sw-calibration-access=READ-ONLY, type=ADTSBoolean, init-value=VeLINR_b_RsErr_EEXV_TOValue:0
    VeLINR_b_RsErr_EOPA: service-kind=ANY-STANDARDIZED, invalidation-policy{data-element=VeLINR_b_RsErr_EOPA, handle-invalid=DONT-INVALIDATE}  # -
      data VeLINR_b_RsErr_EOPA: category=VALUE, sw-calibration-access=READ-ONLY, type=ADTSBoolean, init-value=VeLINR_b_RsErr_EOPAValue:0
    VeLINR_b_RsErr_EOPA_TO: service-kind=ANY-STANDARDIZED, invalidation-policy{data-element=VeLINR_b_RsErr_EOPA_TO, handle-invalid=DONT-INVALIDATE}  # - Time Out
      data VeLINR_b_RsErr_EOPA_TO: category=VALUE, sw-calibration-access=READ-ONLY, type=ADTSBoolean, init-value=VeLINR_b_RsErr_EOPA_TOValue:0
    VeLINR_b_RsErr_EOPB: service-kind=ANY-STANDARDIZED, invalidation-policy{data-element=VeLINR_b_RsErr_EOPB, handle-invalid=DONT-INVALIDATE}  # -
      data VeLINR_b_RsErr_EOPB: category=VALUE, sw-calibration-access=READ-ONLY, type=ADTSBoolean, init-value=VeLINR_b_RsErr_EOPBValue:0
    VeLINR_b_RsErr_EOPB_TO: service-kind=ANY-STANDARDIZED, invalidation-policy{data-element=VeLINR_b_RsErr_EOPB_TO, handle-invalid=DONT-INVALIDATE}  # - Time Out
      data VeLINR_b_RsErr_EOPB_TO: category=VALUE, sw-calibration-access=READ-ONLY, type=ADTSBoolean, init-value=VeLINR_b_RsErr_EOPB_TOValue:0
    VeLINR_b_RsErr_ESBM: service-kind=ANY-STANDARDIZED, invalidation-policy{data-element=VeLINR_b_RsErr_ESBM, handle-invalid=DONT-INVALIDATE}  # -
      data VeLINR_b_RsErr_ESBM: category=VALUE, sw-calibration-access=READ-ONLY, type=ADTSBoolean, init-value=VeLINR_b_RsErr_ESBMValue:0
    VeLINR_b_RsErr_ESBM_TO: service-kind=ANY-STANDARDIZED, invalidation-policy{data-element=VeLINR_b_RsErr_ESBM_TO, handle-invalid=DONT-INVALIDATE}  # - Time Out
      data VeLINR_b_RsErr_ESBM_TO: category=VALUE, sw-calibration-access=READ-ONLY, type=ADTSBoolean, init-value=VeLINR_b_RsErr_ESBM_TOValue:0
    VeLINR_b_RsErr_EXVM: service-kind=ANY-STANDARDIZED, invalidation-policy{data-element=VeLINR_b_RsErr_EXVM, handle-invalid=DONT-INVALIDATE}  # -
      data VeLINR_b_RsErr_EXVM: category=VALUE, sw-calibration-access=READ-ONLY, type=ADTSBoolean, init-value=VeLINR_b_RsErr_EXVMValue:0
    VeLINR_b_RsErr_EXVM_TO: service-kind=ANY-STANDARDIZED, invalidation-policy{data-element=VeLINR_b_RsErr_EXVM_TO, handle-invalid=DONT-INVALIDATE}  # - Time Out
      data VeLINR_b_RsErr_EXVM_TO: category=VALUE, sw-calibration-access=READ-ONLY, type=ADTSBoolean, init-value=VeLINR_b_RsErr_EXVM_TOValue:0
    VeLINR_b_RsErr_HTLBV: service-kind=ANY-STANDARDIZED, invalidation-policy{data-element=VeLINR_b_RsErr_HTLBV, handle-invalid=DONT-INVALIDATE}  # -
      data VeLINR_b_RsErr_HTLBV: category=VALUE, sw-calibration-access=READ-ONLY, type=ADTSBoolean, init-value=VeLINR_b_RsErr_HTLBVValue:0
    VeLINR_b_RsErr_HTLBV_TO: service-kind=ANY-STANDARDIZED, invalidation-policy{data-element=VeLINR_b_RsErr_HTLBV_TO, handle-invalid=DONT-INVALIDATE}  # - Time Out
      data VeLINR_b_RsErr_HTLBV_TO: category=VALUE, sw-calibration-access=READ-ONLY, type=ADTSBoolean, init-value=VeLINR_b_RsErr_HTLBV_TOValue:0
    VeLINR_b_RsErr_LTRBV: service-kind=ANY-STANDARDIZED, invalidation-policy{data-element=VeLINR_b_RsErr_LTRBV, handle-invalid=DONT-INVALIDATE}  # -
      data VeLINR_b_RsErr_LTRBV: category=VALUE, sw-calibration-access=READ-ONLY, type=ADTSBoolean, init-value=VeLINR_b_RsErr_LTRBVValue:0
    VeLINR_b_RsErr_LTRBV_TO: service-kind=ANY-STANDARDIZED, invalidation-policy{data-element=VeLINR_b_RsErr_LTRBV_TO, handle-invalid=DONT-INVALIDATE}  # - Time Out
      data VeLINR_b_RsErr_LTRBV_TO: category=VALUE, sw-calibration-access=READ-ONLY, type=ADTSBoolean, init-value=VeLINR_b_RsErr_LTRBV_TOValue:0
    VeLINR_b_RsErr_OEXV: service-kind=ANY-STANDARDIZED, invalidation-policy{data-element=VeLINR_b_RsErr_OEXV, handle-invalid=DONT-INVALIDATE}  # -
      data VeLINR_b_RsErr_OEXV: category=VALUE, sw-calibration-access=READ-ONLY, type=ADTSBoolean, init-value=VeLINR_b_RsErr_OEXVValue:0
    VeLINR_b_RsErr_OEXV_TO: service-kind=ANY-STANDARDIZED, invalidation-policy{data-element=VeLINR_b_RsErr_OEXV_TO, handle-invalid=DONT-INVALIDATE}  # - Time Out
      data VeLINR_b_RsErr_OEXV_TO: category=VALUE, sw-calibration-access=READ-ONLY, type=ADTSBoolean, init-value=VeLINR_b_RsErr_OEXV_TOValue:0
    VeLINR_b_RsErr_PECP2_PUMP: service-kind=ANY-STANDARDIZED, invalidation-policy{data-element=VeLINR_b_RsErr_PECP2_PUMP, handle-invalid=DONT-INVALIDATE}  # -
      data VeLINR_b_RsErr_PECP2_PUMP: category=VALUE, sw-calibration-access=READ-ONLY, type=ADTSBoolean, init-value=VeLINR_b_RsErr_PECP2_PUMPValue:0
    VeLINR_b_RsErr_PECP2_PUMP_TO: service-kind=ANY-STANDARDIZED, invalidation-policy{data-element=VeLINR_b_RsErr_PECP2_PUMP_TO, handle-invalid=DONT-INVALIDATE}  # - Time Out
      data VeLINR_b_RsErr_PECP2_PUMP_TO: category=VALUE, sw-calibration-access=READ-ONLY, type=ADTSBoolean, init-value=VeLINR_b_RsErr_PECP2_PUMP_TOValue:0
    VeLINR_b_RsErr_PECP_PUMP: service-kind=ANY-STANDARDIZED, invalidation-policy{data-element=VeLINR_b_RsErr_PECP_PUMP, handle-invalid=DONT-INVALIDATE}  # -
      data VeLINR_b_RsErr_PECP_PUMP: category=VALUE, sw-calibration-access=READ-ONLY, type=ADTSBoolean, init-value=VeLINR_b_RsErr_PECP_PUMPValue:0
    VeLINR_b_RsErr_PECP_PUMP_TO: service-kind=ANY-STANDARDIZED, invalidation-policy{data-element=VeLINR_b_RsErr_PECP_PUMP_TO, handle-invalid=DONT-INVALIDATE}  # - Time Out
      data VeLINR_b_RsErr_PECP_PUMP_TO: category=VALUE, sw-calibration-access=READ-ONLY, type=ADTSBoolean, init-value=VeLINR_b_RsErr_PECP_PUMP_TOValue:0
    VeLINR_b_RsErr_SPP: service-kind=ANY-STANDARDIZED, invalidation-policy{data-element=VeLINR_b_RsErr_SPP, handle-invalid=DONT-INVALIDATE}  # -
      data VeLINR_b_RsErr_SPP: category=VALUE, sw-calibration-access=READ-ONLY, type=ADTSBoolean, init-value=VeLINR_b_RsErr_SPPValue:0
    VeLINR_b_RsErr_SPP2: service-kind=ANY-STANDARDIZED, invalidation-policy{data-element=VeLINR_b_RsErr_SPP2, handle-invalid=DONT-INVALIDATE}  # -
      data VeLINR_b_RsErr_SPP2: category=VALUE, sw-calibration-access=READ-ONLY, type=ADTSBoolean, init-value=VeLINR_b_RsErr_SPP2Value:0
    VeLINR_b_RsErr_SPP2TO: service-kind=ANY-STANDARDIZED, invalidation-policy{data-element=VeLINR_b_RsErr_SPP2TO, handle-invalid=DONT-INVALIDATE}  # - Time Out
      data VeLINR_b_RsErr_SPP2TO: category=VALUE, sw-calibration-access=READ-ONLY, type=ADTSBoolean, init-value=VeLINR_b_RsErr_SPP2TOValue:0
    VeLINR_b_RsErr_SPP_TO: service-kind=ANY-STANDARDIZED, invalidation-policy{data-element=VeLINR_b_RsErr_SPP_TO, handle-invalid=DONT-INVALIDATE}  # - Time Out
      data VeLINR_b_RsErr_SPP_TO: category=VALUE, sw-calibration-access=READ-ONLY, type=ADTSBoolean, init-value=VeLINR_b_RsErr_SPP_TOValue:0
    VeLINR_b_S2MRes1Bit: service-kind=ANY-STANDARDIZED, invalidation-policy{data-element=VeLINR_b_S2MRes1Bit, handle-invalid=DONT-INVALIDATE}  # -
      data VeLINR_b_S2MRes1Bit: category=VALUE, sw-calibration-access=READ-ONLY, type=ADTSBoolean, init-value=VeLINR_b_S2MRes1BitValue:0
    VeLINR_b_S2MRes1BitTO: service-kind=ANY-STANDARDIZED, invalidation-policy{data-element=VeLINR_b_S2MRes1BitTO, handle-invalid=DONT-INVALIDATE}  # - Time Out
      data VeLINR_b_S2MRes1BitTO: category=VALUE, sw-calibration-access=READ-ONLY, type=ADTSBoolean, init-value=VeLINR_b_S2MRes1BitTOValue:0
    VeLINR_b_S2MResBit1_AGS2: service-kind=ANY-STANDARDIZED, invalidation-policy{data-element=VeLINR_b_S2MResBit1_AGS2, handle-invalid=DONT-INVALIDATE}  # -
      data VeLINR_b_S2MResBit1_AGS2: category=VALUE, sw-calibration-access=READ-ONLY, type=ADTSBoolean, init-value=VeLINR_b_S2MResBit1_AGS2Value:0
    VeLINR_b_S2MResBit1_AGS2TO: service-kind=ANY-STANDARDIZED, invalidation-policy{data-element=VeLINR_b_S2MResBit1_AGS2TO, handle-invalid=DONT-INVALIDATE}  # - Time Out
      data VeLINR_b_S2MResBit1_AGS2TO: category=VALUE, sw-calibration-access=READ-ONLY, type=ADTSBoolean, init-value=VeLINR_b_S2MResBit1_AGS2TOValue:0
    VeLINR_b_S2MResByte1TO: service-kind=ANY-STANDARDIZED, invalidation-policy{data-element=VeLINR_b_S2MResByte1TO, handle-invalid=DONT-INVALIDATE}  # - Time Out
      data VeLINR_b_S2MResByte1TO: category=VALUE, sw-calibration-access=READ-ONLY, type=ADTSBoolean, init-value=VeLINR_b_S2MResByte1TOValue:0
    VeLINR_b_S2MResByte1_AGS2TO: service-kind=ANY-STANDARDIZED, invalidation-policy{data-element=VeLINR_b_S2MResByte1_AGS2TO, handle-invalid=DONT-INVALIDATE}  # - Time Out
      data VeLINR_b_S2MResByte1_AGS2TO: category=VALUE, sw-calibration-access=READ-ONLY, type=ADTSBoolean, init-value=VeLINR_b_S2MResByte1_AGS2TOValue:0
    VeLINR_b_S2MResByte2TO: service-kind=ANY-STANDARDIZED, invalidation-policy{data-element=VeLINR_b_S2MResByte2TO, handle-invalid=DONT-INVALIDATE}  # - Time Out
      data VeLINR_b_S2MResByte2TO: category=VALUE, sw-calibration-access=READ-ONLY, type=ADTSBoolean, init-value=VeLINR_b_S2MResByte2TOValue:0
    VeLINR_b_S2MResByte2_AGS2TO: service-kind=ANY-STANDARDIZED, invalidation-policy{data-element=VeLINR_b_S2MResByte2_AGS2TO, handle-invalid=DONT-INVALIDATE}  # - Time Out
      data VeLINR_b_S2MResByte2_AGS2TO: category=VALUE, sw-calibration-access=READ-ONLY, type=ADTSBoolean, init-value=VeLINR_b_S2MResByte2_AGS2TOValue:0
    VeLINR_d_CoolVal_ActuatPosTrgt: service-kind=ANY-STANDARDIZED, invalidation-policy{data-element=VeLINR_d_CoolVal_ActuatPosTrgt, handle-invalid=DONT-INVALIDATE}  # -
      data VeLINR_d_CoolVal_ActuatPosTrgt: category=VALUE, sw-calibration-access=READ-ONLY, type=ADTSCoolVal_ActuatPosTrgt, init-value=VeLINR_d_CoolVal_ActuatPosTrgtValue:0
    VeLINR_d_CoolantVal_ActuPosAct: service-kind=ANY-STANDARDIZED, invalidation-policy{data-element=VeLINR_d_CoolantVal_ActuPosAct, handle-invalid=DONT-INVALIDATE}  # -
      data VeLINR_d_CoolantVal_ActuPosAct: category=VALUE, sw-calibration-access=READ-ONLY, type=ADTSCoolantVal_ActuPosAct, init-value=VeLINR_d_CoolantVal_ActuPosActValue:0
    VeLINR_d_LIN_SlavePrsntSts_LIN1
      data VeLINR_d_LIN_SlavePrsntSts_LIN1: type=uint16
    VeLINR_d_LIN_SlavePrsntSts_LIN2
      data VeLINR_d_LIN_SlavePrsntSts_LIN2: type=uint16
    VeLINR_d_LIN_SlavePrsntSts_LIN3
      data VeLINR_d_LIN_SlavePrsntSts_LIN3: type=uint16
    VeLINR_d_PwrPanel2CurrDrawSens1: service-kind=ANY-STANDARDIZED, invalidation-policy{data-element=VeLINR_d_PwrPanel2CurrDrawSens1, handle-invalid=KEEP}  # -
      data VeLINR_d_PwrPanel2CurrDrawSens1: category=VALUE, sw-calibration-access=READ-ONLY, type=ADTSPwrPanel2CurrDrawSens1, init-value=VeLINR_d_PwrPanel2CurrDrawSens1Value:0
    VeLINR_d_PwrPanel2CurrDrawSens2: service-kind=ANY-STANDARDIZED, invalidation-policy{data-element=VeLINR_d_PwrPanel2CurrDrawSens2, handle-invalid=KEEP}  # -
      data VeLINR_d_PwrPanel2CurrDrawSens2: category=VALUE, sw-calibration-access=READ-ONLY, type=ADTSPwrPanel2CurrDrawSens2, init-value=VeLINR_d_PwrPanel2CurrDrawSens2Value:0
    VeLINR_d_PwrPanelCurrDrawSens1: service-kind=ANY-STANDARDIZED, invalidation-policy{data-element=VeLINR_d_PwrPanelCurrDrawSens1, handle-invalid=KEEP}  # -
      data VeLINR_d_PwrPanelCurrDrawSens1: category=VALUE, sw-calibration-access=READ-ONLY, type=ADTSPwrPanelCurrDrawSens1, init-value=VeLINR_d_PwrPanelCurrDrawSens1Value:0
    VeLINR_d_PwrPanelCurrDrawSens2: service-kind=ANY-STANDARDIZED, invalidation-policy{data-element=VeLINR_d_PwrPanelCurrDrawSens2, handle-invalid=KEEP}  # -
      data VeLINR_d_PwrPanelCurrDrawSens2: category=VALUE, sw-calibration-access=READ-ONLY, type=ADTSPwrPanelCurrDrawSens2, init-value=VeLINR_d_PwrPanelCurrDrawSens2Value:0
    VeLINR_e_AAD_CurrPos: service-kind=ANY-STANDARDIZED, invalidation-policy{data-element=VeLINR_e_AAD_CurrPos, handle-invalid=KEEP}  # -
      data VeLINR_e_AAD_CurrPos: category=VALUE, sw-calibration-access=READ-ONLY, type=ADTSAAD_CurrPos, init-value=VeLINR_e_AAD_CurrPosValue:15
    VeLINR_e_AGS2_CurrPos: service-kind=ANY-STANDARDIZED, invalidation-policy{data-element=VeLINR_e_AGS2_CurrPos, handle-invalid=KEEP}  # -
      data VeLINR_e_AGS2_CurrPos: category=VALUE, sw-calibration-access=READ-ONLY, type=ADTSAGS2_CurrPos, init-value=VeLINR_e_AGS2_CurrPosValue:0
    VeLINR_e_AGS2_ErrLIN: service-kind=ANY-STANDARDIZED, invalidation-policy{data-element=VeLINR_e_AGS2_ErrLIN, handle-invalid=KEEP}  # -
      data VeLINR_e_AGS2_ErrLIN: category=VALUE, sw-calibration-access=READ-ONLY, type=ADTSAGS2_ErrLIN, init-value=VeLINR_e_AGS2_ErrLINValue:0
    VeLINR_e_AGS_CurrPos: service-kind=ANY-STANDARDIZED, invalidation-policy{data-element=VeLINR_e_AGS_CurrPos, handle-invalid=KEEP}  # -
      data VeLINR_e_AGS_CurrPos: category=VALUE, sw-calibration-access=READ-ONLY, type=ADTSAGS_CurrPos, init-value=VeLINR_e_AGS_CurrPosValue:0
    VeLINR_e_AGS_ErrLIN: service-kind=ANY-STANDARDIZED, invalidation-policy{data-element=VeLINR_e_AGS_ErrLIN, handle-invalid=KEEP}  # -
      data VeLINR_e_AGS_ErrLIN: category=VALUE, sw-calibration-access=READ-ONLY, type=ADTSAGS_ErrLIN, init-value=VeLINR_e_AGS_ErrLINValue:0
    VeLINR_e_AHP_AIR_PRE_ERR: service-kind=ANY-STANDARDIZED, invalidation-policy{data-element=VeLINR_e_AHP_AIR_PRE_ERR, handle-invalid=KEEP}  # -
      data VeLINR_e_AHP_AIR_PRE_ERR: category=VALUE, sw-calibration-access=READ-ONLY, type=ADTSAHP_AIR_PRE_ERR, init-value=VeLINR_e_AHP_AIR_PRE_ERRValue:3
    VeLINR_e_AHP_DBLK_ACTV: service-kind=ANY-STANDARDIZED, invalidation-policy{data-element=VeLINR_e_AHP_DBLK_ACTV, handle-invalid=KEEP}  # -
      data VeLINR_e_AHP_DBLK_ACTV: category=VALUE, sw-calibration-access=READ-ONLY, type=ADTSAHP_DBLK_ACTV, init-value=VeLINR_e_AHP_DBLK_ACTVValue:3
    VeLINR_e_AHP_DR_RN_ERR: service-kind=ANY-STANDARDIZED, invalidation-policy{data-element=VeLINR_e_AHP_DR_RN_ERR, handle-invalid=KEEP}  # -
      data VeLINR_e_AHP_DR_RN_ERR: category=VALUE, sw-calibration-access=READ-ONLY, type=ADTSAHP_DR_RN_ERR, init-value=VeLINR_e_AHP_DR_RN_ERRValue:3
    VeLINR_e_AHP_FL_SAFE_ACTVTD: service-kind=ANY-STANDARDIZED, invalidation-policy{data-element=VeLINR_e_AHP_FL_SAFE_ACTVTD, handle-invalid=KEEP}  # -
      data VeLINR_e_AHP_FL_SAFE_ACTVTD: category=VALUE, sw-calibration-access=READ-ONLY, type=ADTSAHP_FL_SAFE_ACTVTD, init-value=VeLINR_e_AHP_FL_SAFE_ACTVTDValue:3
    VeLINR_e_AHP_LMP_HM_AN_ON: service-kind=ANY-STANDARDIZED, invalidation-policy{data-element=VeLINR_e_AHP_LMP_HM_AN_ON, handle-invalid=KEEP}  # -
      data VeLINR_e_AHP_LMP_HM_AN_ON: category=VALUE, sw-calibration-access=READ-ONLY, type=ADTSAHP_LMP_HM_AN_ON, init-value=VeLINR_e_AHP_LMP_HM_AN_ONValue:3
    VeLINR_e_AHP_MONTRNG_RPM: service-kind=ANY-STANDARDIZED, invalidation-policy{data-element=VeLINR_e_AHP_MONTRNG_RPM, handle-invalid=KEEP}  # -
      data VeLINR_e_AHP_MONTRNG_RPM: category=VALUE, sw-calibration-access=READ-ONLY, type=ADTSAHP_MONTRNG_RPM, init-value=VeLINR_e_AHP_MONTRNG_RPMValue:3
    VeLINR_e_AHP_NODE_ERR: service-kind=ANY-STANDARDIZED, invalidation-policy{data-element=VeLINR_e_AHP_NODE_ERR, handle-invalid=KEEP}  # -
      data VeLINR_e_AHP_NODE_ERR: category=VALUE, sw-calibration-access=READ-ONLY, type=ADTSAHP_NODE_ERR, init-value=VeLINR_e_AHP_NODE_ERRValue:3
    VeLINR_e_AHP_OVR_CUR_ERR: service-kind=ANY-STANDARDIZED, invalidation-policy{data-element=VeLINR_e_AHP_OVR_CUR_ERR, handle-invalid=KEEP}  # -
      data VeLINR_e_AHP_OVR_CUR_ERR: category=VALUE, sw-calibration-access=READ-ONLY, type=ADTSAHP_OVR_CUR_ERR, init-value=VeLINR_e_AHP_OVR_CUR_ERRValue:3
    VeLINR_e_AHP_OVR_TMP_ERR: service-kind=ANY-STANDARDIZED, invalidation-policy{data-element=VeLINR_e_AHP_OVR_TMP_ERR, handle-invalid=KEEP}  # -
      data VeLINR_e_AHP_OVR_TMP_ERR: category=VALUE, sw-calibration-access=READ-ONLY, type=ADTSAHP_OVR_TMP_ERR, init-value=VeLINR_e_AHP_OVR_TMP_ERRValue:3
    VeLINR_e_AHP_POST_RUN_STAT: service-kind=ANY-STANDARDIZED, invalidation-policy{data-element=VeLINR_e_AHP_POST_RUN_STAT, handle-invalid=KEEP}  # -
      data VeLINR_e_AHP_POST_RUN_STAT: category=VALUE, sw-calibration-access=READ-ONLY, type=ADTSAHP_POST_RUN_STAT, init-value=VeLINR_e_AHP_POST_RUN_STATValue:7
    VeLINR_e_AHP_SUPPLIER: service-kind=ANY-STANDARDIZED, invalidation-policy{data-element=VeLINR_e_AHP_SUPPLIER, handle-invalid=DONT-INVALIDATE}  # -
      data VeLINR_e_AHP_SUPPLIER: category=VALUE, sw-calibration-access=READ-ONLY, type=ADTSAHP_SUPPLIER, init-value=VeLINR_e_AHP_SUPPLIERValue:0
    VeLINR_e_AHP_VLTG_ERR: service-kind=ANY-STANDARDIZED, invalidation-policy{data-element=VeLINR_e_AHP_VLTG_ERR, handle-invalid=KEEP}  # -
      data VeLINR_e_AHP_VLTG_ERR: category=VALUE, sw-calibration-access=READ-ONLY, type=ADTSAHP_VLTG_ERR, init-value=VeLINR_e_AHP_VLTG_ERRValue:3
    VeLINR_e_AirHeatrDmgHVISnsrFlt: service-kind=ANY-STANDARDIZED, invalidation-policy{data-element=VeLINR_e_AirHeatrDmgHVISnsrFlt, handle-invalid=KEEP}  # -
      data VeLINR_e_AirHeatrDmgHVISnsrFlt: category=VALUE, sw-calibration-access=READ-ONLY, type=ADTSAirHeatrDmgHVISnsrFlt, init-value=VeLINR_e_AirHeatrDmgHVISnsrFltValue:3
    VeLINR_e_AirHeatrDmgIntHwProtn: service-kind=ANY-STANDARDIZED, invalidation-policy{data-element=VeLINR_e_AirHeatrDmgIntHwProtn, handle-invalid=KEEP}  # -
      data VeLINR_e_AirHeatrDmgIntHwProtn: category=VALUE, sw-calibration-access=READ-ONLY, type=ADTSAirHeatrDmgIntHwProtn, init-value=VeLINR_e_AirHeatrDmgIntHwProtnValue:3
    VeLINR_e_AirHeatrDmgMemErr: service-kind=ANY-STANDARDIZED, invalidation-policy{data-element=VeLINR_e_AirHeatrDmgMemErr, handle-invalid=KEEP}  # -
      data VeLINR_e_AirHeatrDmgMemErr: category=VALUE, sw-calibration-access=READ-ONLY, type=ADTSAirHeatrDmgMemErr, init-value=VeLINR_e_AirHeatrDmgMemErrValue:3
    VeLINR_e_AirHeatrSts: service-kind=ANY-STANDARDIZED, invalidation-policy{data-element=VeLINR_e_AirHeatrSts, handle-invalid=DONT-INVALIDATE}  # -
      data VeLINR_e_AirHeatrSts: category=VALUE, sw-calibration-access=READ-ONLY, type=ADTSAirHeatrSts, init-value=VeLINR_e_AirHeatrStsValue:0
    VeLINR_e_AirHeatrWarnFltInCom: service-kind=ANY-STANDARDIZED, invalidation-policy{data-element=VeLINR_e_AirHeatrWarnFltInCom, handle-invalid=KEEP}  # -
      data VeLINR_e_AirHeatrWarnFltInCom: category=VALUE, sw-calibration-access=READ-ONLY, type=ADTSAirHeatrWarnFltInCom, init-value=VeLINR_e_AirHeatrWarnFltInComValue:3
    VeLINR_e_AirHeatrWarnHvOutOfRng: service-kind=ANY-STANDARDIZED, invalidation-policy{data-element=VeLINR_e_AirHeatrWarnHvOutOfRng, handle-invalid=KEEP}  # -
      data VeLINR_e_AirHeatrWarnHvOutOfRng: category=VALUE, sw-calibration-access=READ-ONLY, type=ADTSAirHeatrWarnHvOutOfRng, init-value=VeLINR_e_AirHeatrWarnHvOutOfRngValue:3
    VeLINR_e_AirHeatrWarnPCBOvrTmp: service-kind=ANY-STANDARDIZED, invalidation-policy{data-element=VeLINR_e_AirHeatrWarnPCBOvrTmp, handle-invalid=KEEP}  # -
      data VeLINR_e_AirHeatrWarnPCBOvrTmp: category=VALUE, sw-calibration-access=READ-ONLY, type=ADTSAirHeatrWarnPCBOvrTmp, init-value=VeLINR_e_AirHeatrWarnPCBOvrTmpValue:3
    VeLINR_e_AirHtrDmgCirDrvrShoOpn: service-kind=ANY-STANDARDIZED, invalidation-policy{data-element=VeLINR_e_AirHtrDmgCirDrvrShoOpn, handle-invalid=KEEP}  # -
      data VeLINR_e_AirHtrDmgCirDrvrShoOpn: category=VALUE, sw-calibration-access=READ-ONLY, type=ADTSAirHtrDmgCirDrvrShoOpn, init-value=VeLINR_e_AirHtrDmgCirDrvrShoOpnValue:3
    VeLINR_e_AirHtrDmgHtrCorTS_Flt: service-kind=ANY-STANDARDIZED, invalidation-policy{data-element=VeLINR_e_AirHtrDmgHtrCorTS_Flt, handle-invalid=KEEP}  # -
      data VeLINR_e_AirHtrDmgHtrCorTS_Flt: category=VALUE, sw-calibration-access=READ-ONLY, type=ADTSAirHtrDmgHtrCorTS_Flt, init-value=VeLINR_e_AirHtrDmgHtrCorTS_FltValue:3
    VeLINR_e_AirHtrDmgPCBTmpSnsrFlt: service-kind=ANY-STANDARDIZED, invalidation-policy{data-element=VeLINR_e_AirHtrDmgPCBTmpSnsrFlt, handle-invalid=KEEP}  # -
      data VeLINR_e_AirHtrDmgPCBTmpSnsrFlt: category=VALUE, sw-calibration-access=READ-ONLY, type=ADTSAirHtrDmgPCBTmpSnsrFlt, init-value=VeLINR_e_AirHtrDmgPCBTmpSnsrFltValue:3
    VeLINR_e_AirHtrWarnICnsOutOfRng: service-kind=ANY-STANDARDIZED, invalidation-policy{data-element=VeLINR_e_AirHtrWarnICnsOutOfRng, handle-invalid=KEEP}  # -
      data VeLINR_e_AirHtrWarnICnsOutOfRng: category=VALUE, sw-calibration-access=READ-ONLY, type=ADTSAirHtrWarnICnsOutOfRng, init-value=VeLINR_e_AirHtrWarnICnsOutOfRngValue:3
    VeLINR_e_AirHtrWarnTmpOvrheatg: service-kind=ANY-STANDARDIZED, invalidation-policy{data-element=VeLINR_e_AirHtrWarnTmpOvrheatg, handle-invalid=KEEP}  # -
      data VeLINR_e_AirHtrWarnTmpOvrheatg: category=VALUE, sw-calibration-access=READ-ONLY, type=ADTSAirHtrWarnTmpOvrheatg, init-value=VeLINR_e_AirHtrWarnTmpOvrheatgValue:3
    VeLINR_e_AirHtrWarnULoOutOfRng: service-kind=ANY-STANDARDIZED, invalidation-policy{data-element=VeLINR_e_AirHtrWarnULoOutOfRng, handle-invalid=KEEP}  # -
      data VeLINR_e_AirHtrWarnULoOutOfRng: category=VALUE, sw-calibration-access=READ-ONLY, type=ADTSAirHtrWarnULoOutOfRng, init-value=VeLINR_e_AirHtrWarnULoOutOfRngValue:3
    VeLINR_e_AirHtrWrnHtrCorOvrTmp: service-kind=ANY-STANDARDIZED, invalidation-policy{data-element=VeLINR_e_AirHtrWrnHtrCorOvrTmp, handle-invalid=KEEP}  # -
      data VeLINR_e_AirHtrWrnHtrCorOvrTmp: category=VALUE, sw-calibration-access=READ-ONLY, type=ADTSAirHtrWrnHtrCorOvrTmp, init-value=VeLINR_e_AirHtrWrnHtrCorOvrTmpValue:3
    VeLINR_e_Ambient_Temp: service-kind=ANY-STANDARDIZED, invalidation-policy{data-element=VeLINR_e_Ambient_Temp, handle-invalid=KEEP}  # -
      data VeLINR_e_Ambient_Temp: category=VALUE, sw-calibration-access=READ-ONLY, type=ADTSAmbient_Temp, init-value=VeLINR_e_Ambient_TempValue:-40
    VeLINR_e_BCP_AIR_PRE_ERR: service-kind=ANY-STANDARDIZED, invalidation-policy{data-element=VeLINR_e_BCP_AIR_PRE_ERR, handle-invalid=KEEP}  # -
      data VeLINR_e_BCP_AIR_PRE_ERR: category=VALUE, sw-calibration-access=READ-ONLY, type=ADTSBCP_AIR_PRE_ERR, init-value=VeLINR_e_BCP_AIR_PRE_ERRValue:3
    VeLINR_e_BCP_DBLK_ACTV: service-kind=ANY-STANDARDIZED, invalidation-policy{data-element=VeLINR_e_BCP_DBLK_ACTV, handle-invalid=KEEP}  # -
      data VeLINR_e_BCP_DBLK_ACTV: category=VALUE, sw-calibration-access=READ-ONLY, type=ADTSBCP_DBLK_ACTV, init-value=VeLINR_e_BCP_DBLK_ACTVValue:3
    VeLINR_e_BCP_DR_RN_ERR: service-kind=ANY-STANDARDIZED, invalidation-policy{data-element=VeLINR_e_BCP_DR_RN_ERR, handle-invalid=KEEP}  # -
      data VeLINR_e_BCP_DR_RN_ERR: category=VALUE, sw-calibration-access=READ-ONLY, type=ADTSBCP_DR_RN_ERR, init-value=VeLINR_e_BCP_DR_RN_ERRValue:3
    VeLINR_e_BCP_FL_SAFE_ACTVTD: service-kind=ANY-STANDARDIZED, invalidation-policy{data-element=VeLINR_e_BCP_FL_SAFE_ACTVTD, handle-invalid=KEEP}  # -
      data VeLINR_e_BCP_FL_SAFE_ACTVTD: category=VALUE, sw-calibration-access=READ-ONLY, type=ADTSBCP_FL_SAFE_ACTVTD, init-value=VeLINR_e_BCP_FL_SAFE_ACTVTDValue:3
    VeLINR_e_BCP_LMP_HM_AN_ON: service-kind=ANY-STANDARDIZED, invalidation-policy{data-element=VeLINR_e_BCP_LMP_HM_AN_ON, handle-invalid=KEEP}  # -
      data VeLINR_e_BCP_LMP_HM_AN_ON: category=VALUE, sw-calibration-access=READ-ONLY, type=ADTSBCP_LMP_HM_AN_ON, init-value=VeLINR_e_BCP_LMP_HM_AN_ONValue:3
    VeLINR_e_BCP_MONTRNG_RPM: service-kind=ANY-STANDARDIZED, invalidation-policy{data-element=VeLINR_e_BCP_MONTRNG_RPM, handle-invalid=KEEP}  # -
      data VeLINR_e_BCP_MONTRNG_RPM: category=VALUE, sw-calibration-access=READ-ONLY, type=ADTSBCP_MONTRNG_RPM, init-value=VeLINR_e_BCP_MONTRNG_RPMValue:3
    VeLINR_e_BCP_NODE_ERR: service-kind=ANY-STANDARDIZED, invalidation-policy{data-element=VeLINR_e_BCP_NODE_ERR, handle-invalid=KEEP}  # -
      data VeLINR_e_BCP_NODE_ERR: category=VALUE, sw-calibration-access=READ-ONLY, type=ADTSBCP_NODE_ERR, init-value=VeLINR_e_BCP_NODE_ERRValue:3
    VeLINR_e_BCP_OVR_CUR_ERR: service-kind=ANY-STANDARDIZED, invalidation-policy{data-element=VeLINR_e_BCP_OVR_CUR_ERR, handle-invalid=KEEP}  # -
      data VeLINR_e_BCP_OVR_CUR_ERR: category=VALUE, sw-calibration-access=READ-ONLY, type=ADTSBCP_OVR_CUR_ERR, init-value=VeLINR_e_BCP_OVR_CUR_ERRValue:3
    VeLINR_e_BCP_OVR_TMP_ERR: service-kind=ANY-STANDARDIZED, invalidation-policy{data-element=VeLINR_e_BCP_OVR_TMP_ERR, handle-invalid=KEEP}  # -
      data VeLINR_e_BCP_OVR_TMP_ERR: category=VALUE, sw-calibration-access=READ-ONLY, type=ADTSBCP_OVR_TMP_ERR, init-value=VeLINR_e_BCP_OVR_TMP_ERRValue:3
    VeLINR_e_BCP_POST_RUN_STAT: service-kind=ANY-STANDARDIZED, invalidation-policy{data-element=VeLINR_e_BCP_POST_RUN_STAT, handle-invalid=KEEP}  # -
      data VeLINR_e_BCP_POST_RUN_STAT: category=VALUE, sw-calibration-access=READ-ONLY, type=ADTSBCP_POST_RUN_STAT, init-value=VeLINR_e_BCP_POST_RUN_STATValue:7
    VeLINR_e_BCP_SUPPLIER: service-kind=ANY-STANDARDIZED, invalidation-policy{data-element=VeLINR_e_BCP_SUPPLIER, handle-invalid=DONT-INVALIDATE}  # -
      data VeLINR_e_BCP_SUPPLIER: category=VALUE, sw-calibration-access=READ-ONLY, type=ADTSBCP_SUPPLIER, init-value=VeLINR_e_BCP_SUPPLIERValue:0
    VeLINR_e_BCP_VLTG_ERR: service-kind=ANY-STANDARDIZED, invalidation-policy{data-element=VeLINR_e_BCP_VLTG_ERR, handle-invalid=KEEP}  # -
      data VeLINR_e_BCP_VLTG_ERR: category=VALUE, sw-calibration-access=READ-ONLY, type=ADTSBCP_VLTG_ERR, init-value=VeLINR_e_BCP_VLTG_ERRValue:3
    VeLINR_e_BHV_CalStat: service-kind=ANY-STANDARDIZED, invalidation-policy{data-element=VeLINR_e_BHV_CalStat, handle-invalid=DONT-INVALIDATE}  # -
      data VeLINR_e_BHV_CalStat: category=VALUE, sw-calibration-access=READ-ONLY, type=ADTSBHV_CalStat, init-value=VeLINR_e_BHV_CalStatValue:0
    VeLINR_e_BHV_ERR: service-kind=ANY-STANDARDIZED, invalidation-policy{data-element=VeLINR_e_BHV_ERR, handle-invalid=KEEP}  # -
      data VeLINR_e_BHV_ERR: category=VALUE, sw-calibration-access=READ-ONLY, type=ADTSBHV_ERR, init-value=VeLINR_e_BHV_ERRValue:0
    VeLINR_e_BHV_Sts: service-kind=ANY-STANDARDIZED, invalidation-policy{data-element=VeLINR_e_BHV_Sts, handle-invalid=KEEP}  # -
      data VeLINR_e_BHV_Sts: category=VALUE, sw-calibration-access=READ-ONLY, type=ADTSBHV_Sts, init-value=VeLINR_e_BHV_StsValue:0
    VeLINR_e_Below_60V: service-kind=ANY-STANDARDIZED, invalidation-policy{data-element=VeLINR_e_Below_60V, handle-invalid=KEEP}  # -
      data VeLINR_e_Below_60V: category=VALUE, sw-calibration-access=READ-ONLY, type=ADTSBelow_60V, init-value=VeLINR_e_Below_60VValue:3
    VeLINR_e_CEXV_CalStat: service-kind=ANY-STANDARDIZED, invalidation-policy{data-element=VeLINR_e_CEXV_CalStat, handle-invalid=KEEP}  # -
      data VeLINR_e_CEXV_CalStat: category=VALUE, sw-calibration-access=READ-ONLY, type=ADTSCEXV_CalStat, init-value=VeLINR_e_CEXV_CalStatValue:0
    VeLINR_e_CEXV_ERR: service-kind=ANY-STANDARDIZED, invalidation-policy{data-element=VeLINR_e_CEXV_ERR, handle-invalid=KEEP}  # -
      data VeLINR_e_CEXV_ERR: category=VALUE, sw-calibration-access=READ-ONLY, type=ADTSCEXV_ERR, init-value=VeLINR_e_CEXV_ERRValue:0
    VeLINR_e_CEXV_Refrigerant_Press: service-kind=ANY-STANDARDIZED, invalidation-policy{data-element=VeLINR_e_CEXV_Refrigerant_Press, handle-invalid=KEEP}  # -
      data VeLINR_e_CEXV_Refrigerant_Press: category=VALUE, sw-calibration-access=READ-ONLY, type=ADTSCEXV_Refrigerant_Press, init-value=VeLINR_e_CEXV_Refrigerant_PressValue:1638.3
    VeLINR_e_CEXV_Refrigerant_Temp: service-kind=ANY-STANDARDIZED, invalidation-policy{data-element=VeLINR_e_CEXV_Refrigerant_Temp, handle-invalid=KEEP}  # -
      data VeLINR_e_CEXV_Refrigerant_Temp: category=VALUE, sw-calibration-access=READ-ONLY, type=ADTSCEXV_Refrigerant_Temp, init-value=VeLINR_e_CEXV_Refrigerant_TempValue:-40
    VeLINR_e_CEXV_Sts: service-kind=ANY-STANDARDIZED, invalidation-policy{data-element=VeLINR_e_CEXV_Sts, handle-invalid=KEEP}  # -
      data VeLINR_e_CEXV_Sts: category=VALUE, sw-calibration-access=READ-ONLY, type=ADTSCEXV_Sts, init-value=VeLINR_e_CEXV_StsValue:0
    VeLINR_e_CPIM_IND1_FailSts: service-kind=ANY-STANDARDIZED, invalidation-policy{data-element=VeLINR_e_CPIM_IND1_FailSts, handle-invalid=DONT-INVALIDATE}  # -
      data VeLINR_e_CPIM_IND1_FailSts: category=VALUE, sw-calibration-access=READ-ONLY, type=ADTSCPIM_IND1_FailSts, init-value=VeLINR_e_CPIM_IND1_FailStsValue:0
    VeLINR_e_CPIM_IND1_Fdbk: service-kind=ANY-STANDARDIZED, invalidation-policy{data-element=VeLINR_e_CPIM_IND1_Fdbk, handle-invalid=KEEP}  # -
      data VeLINR_e_CPIM_IND1_Fdbk: category=VALUE, sw-calibration-access=READ-ONLY, type=ADTSCPIM_IND1_Fdbk, init-value=VeLINR_e_CPIM_IND1_FdbkValue:0
    VeLINR_e_CPIM_IND2_FailSts: service-kind=ANY-STANDARDIZED, invalidation-policy{data-element=VeLINR_e_CPIM_IND2_FailSts, handle-invalid=DONT-INVALIDATE}  # -
      data VeLINR_e_CPIM_IND2_FailSts: category=VALUE, sw-calibration-access=READ-ONLY, type=ADTSCPIM_IND2_FailSts, init-value=VeLINR_e_CPIM_IND2_FailStsValue:0
    VeLINR_e_CPIM_IND2_Fdbk: service-kind=ANY-STANDARDIZED, invalidation-policy{data-element=VeLINR_e_CPIM_IND2_Fdbk, handle-invalid=KEEP}  # -
      data VeLINR_e_CPIM_IND2_Fdbk: category=VALUE, sw-calibration-access=READ-ONLY, type=ADTSCPIM_IND2_Fdbk, init-value=VeLINR_e_CPIM_IND2_FdbkValue:0
    VeLINR_e_CPIM_IND3_FailSts: service-kind=ANY-STANDARDIZED, invalidation-policy{data-element=VeLINR_e_CPIM_IND3_FailSts, handle-invalid=DONT-INVALIDATE}  # -
      data VeLINR_e_CPIM_IND3_FailSts: category=VALUE, sw-calibration-access=READ-ONLY, type=ADTSCPIM_IND3_FailSts, init-value=VeLINR_e_CPIM_IND3_FailStsValue:0
    VeLINR_e_CPIM_IND3_Fdbk: service-kind=ANY-STANDARDIZED, invalidation-policy{data-element=VeLINR_e_CPIM_IND3_Fdbk, handle-invalid=KEEP}  # -
      data VeLINR_e_CPIM_IND3_Fdbk: category=VALUE, sw-calibration-access=READ-ONLY, type=ADTSCPIM_IND3_Fdbk, init-value=VeLINR_e_CPIM_IND3_FdbkValue:0
    VeLINR_e_CPIM_IND4_FailSts: service-kind=ANY-STANDARDIZED, invalidation-policy{data-element=VeLINR_e_CPIM_IND4_FailSts, handle-invalid=DONT-INVALIDATE}  # -
      data VeLINR_e_CPIM_IND4_FailSts: category=VALUE, sw-calibration-access=READ-ONLY, type=ADTSCPIM_IND4_FailSts, init-value=VeLINR_e_CPIM_IND4_FailStsValue:0
    VeLINR_e_CPIM_IND4_Fdbk: service-kind=ANY-STANDARDIZED, invalidation-policy{data-element=VeLINR_e_CPIM_IND4_Fdbk, handle-invalid=KEEP}  # -
      data VeLINR_e_CPIM_IND4_Fdbk: category=VALUE, sw-calibration-access=READ-ONLY, type=ADTSCPIM_IND4_Fdbk, init-value=VeLINR_e_CPIM_IND4_FdbkValue:0
    VeLINR_e_CPIM_IND5_FailSts: service-kind=ANY-STANDARDIZED, invalidation-policy{data-element=VeLINR_e_CPIM_IND5_FailSts, handle-invalid=DONT-INVALIDATE}  # -
      data VeLINR_e_CPIM_IND5_FailSts: category=VALUE, sw-calibration-access=READ-ONLY, type=ADTSCPIM_IND5_FailSts, init-value=VeLINR_e_CPIM_IND5_FailStsValue:0
    VeLINR_e_CPIM_IND5_Fdbk: service-kind=ANY-STANDARDIZED, invalidation-policy{data-element=VeLINR_e_CPIM_IND5_Fdbk, handle-invalid=KEEP}  # -
      data VeLINR_e_CPIM_IND5_Fdbk: category=VALUE, sw-calibration-access=READ-ONLY, type=ADTSCPIM_IND5_Fdbk, init-value=VeLINR_e_CPIM_IND5_FdbkValue:0
    VeLINR_e_CPIM_IND_Color_Fdbk: service-kind=ANY-STANDARDIZED, invalidation-policy{data-element=VeLINR_e_CPIM_IND_Color_Fdbk, handle-invalid=KEEP}  # -
      data VeLINR_e_CPIM_IND_Color_Fdbk: category=VALUE, sw-calibration-access=READ-ONLY, type=ADTSCPIM_IND_Color_Fdbk, init-value=VeLINR_e_CPIM_IND_Color_FdbkValue:0
    VeLINR_e_CPV_CalStat: service-kind=ANY-STANDARDIZED, invalidation-policy{data-element=VeLINR_e_CPV_CalStat, handle-invalid=DONT-INVALIDATE}  # -
      data VeLINR_e_CPV_CalStat: category=VALUE, sw-calibration-access=READ-ONLY, type=ADTSCPV_CalStat, init-value=VeLINR_e_CPV_CalStatValue:0
    VeLINR_e_CPV_ERR: service-kind=ANY-STANDARDIZED, invalidation-policy{data-element=VeLINR_e_CPV_ERR, handle-invalid=KEEP}  # -
      data VeLINR_e_CPV_ERR: category=VALUE, sw-calibration-access=READ-ONLY, type=ADTSCPV_ERR, init-value=VeLINR_e_CPV_ERRValue:0
    VeLINR_e_CPV_Sts: service-kind=ANY-STANDARDIZED, invalidation-policy{data-element=VeLINR_e_CPV_Sts, handle-invalid=KEEP}  # -
      data VeLINR_e_CPV_Sts: category=VALUE, sw-calibration-access=READ-ONLY, type=ADTSCPV_Sts, init-value=VeLINR_e_CPV_StsValue:0
    VeLINR_e_ChrgPortDoor_Sts: service-kind=ANY-STANDARDIZED, invalidation-policy{data-element=VeLINR_e_ChrgPortDoor_Sts, handle-invalid=KEEP}  # -
      data VeLINR_e_ChrgPortDoor_Sts: category=VALUE, sw-calibration-access=READ-ONLY, type=ADTSChrgPortDoor_Sts, init-value=VeLINR_e_ChrgPortDoor_StsValue:0
    VeLINR_e_ChrgPortLock_FailSts: service-kind=ANY-STANDARDIZED, invalidation-policy{data-element=VeLINR_e_ChrgPortLock_FailSts, handle-invalid=KEEP}  # -
      data VeLINR_e_ChrgPortLock_FailSts: category=VALUE, sw-calibration-access=READ-ONLY, type=ADTSChrgPortLock_FailSts, init-value=VeLINR_e_ChrgPortLock_FailStsValue:0
    VeLINR_e_Chrg_Inlet_Temp: service-kind=ANY-STANDARDIZED, invalidation-policy{data-element=VeLINR_e_Chrg_Inlet_Temp, handle-invalid=KEEP}  # -
      data VeLINR_e_Chrg_Inlet_Temp: category=VALUE, sw-calibration-access=READ-ONLY, type=ADTSChrg_Inlet_Temp, init-value=VeLINR_e_Chrg_Inlet_TempValue:-40
    VeLINR_e_CompFaultStat: service-kind=ANY-STANDARDIZED, invalidation-policy{data-element=VeLINR_e_CompFaultStat, handle-invalid=KEEP}  # -
      data VeLINR_e_CompFaultStat: category=VALUE, sw-calibration-access=READ-ONLY, type=ADTSCompFaultStat, init-value=VeLINR_e_CompFaultStatValue:0
    VeLINR_e_CompFaultStat_800: service-kind=ANY-STANDARDIZED, invalidation-policy{data-element=VeLINR_e_CompFaultStat_800, handle-invalid=KEEP}  # -
      data VeLINR_e_CompFaultStat_800: category=VALUE, sw-calibration-access=READ-ONLY, type=ADTSCompFaultStat_800, init-value=VeLINR_e_CompFaultStat_800Value:0
    VeLINR_e_CompStat: service-kind=ANY-STANDARDIZED, invalidation-policy{data-element=VeLINR_e_CompStat, handle-invalid=KEEP}  # -
      data VeLINR_e_CompStat: category=VALUE, sw-calibration-access=READ-ONLY, type=ADTSCompStat, init-value=VeLINR_e_CompStatValue:0
    VeLINR_e_CompStat_800: service-kind=ANY-STANDARDIZED, invalidation-policy{data-element=VeLINR_e_CompStat_800, handle-invalid=KEEP}  # -
      data VeLINR_e_CompStat_800: category=VALUE, sw-calibration-access=READ-ONLY, type=ADTSCompStat_800, init-value=VeLINR_e_CompStat_800Value:0
    VeLINR_e_CoolantVal_SystemState: service-kind=ANY-STANDARDIZED, invalidation-policy{data-element=VeLINR_e_CoolantVal_SystemState, handle-invalid=DONT-INVALIDATE}  # -
      data VeLINR_e_CoolantVal_SystemState: category=VALUE, sw-calibration-access=READ-ONLY, type=ADTSCoolantVal_SystemState, init-value=VeLINR_e_CoolantVal_SystemStateValue:0
    VeLINR_e_CoolantValve_ErrLinCom: service-kind=ANY-STANDARDIZED, invalidation-policy{data-element=VeLINR_e_CoolantValve_ErrLinCom, handle-invalid=DONT-INVALIDATE}  # -
      data VeLINR_e_CoolantValve_ErrLinCom: category=VALUE, sw-calibration-access=READ-ONLY, type=ADTSCoolantValve_ErrLinCom, init-value=VeLINR_e_CoolantValve_ErrLinComValue:0
    VeLINR_e_CoolantValve_ErrPos: service-kind=ANY-STANDARDIZED, invalidation-policy{data-element=VeLINR_e_CoolantValve_ErrPos, handle-invalid=DONT-INVALIDATE}  # -
      data VeLINR_e_CoolantValve_ErrPos: category=VALUE, sw-calibration-access=READ-ONLY, type=ADTSCoolantValve_ErrPos, init-value=VeLINR_e_CoolantValve_ErrPosValue:0
    VeLINR_e_CoolantValve_Err_Ecu: service-kind=ANY-STANDARDIZED, invalidation-policy{data-element=VeLINR_e_CoolantValve_Err_Ecu, handle-invalid=DONT-INVALIDATE}  # -
      data VeLINR_e_CoolantValve_Err_Ecu: category=VALUE, sw-calibration-access=READ-ONLY, type=ADTSCoolantValve_Err_Ecu, init-value=VeLINR_e_CoolantValve_Err_EcuValue:0
    VeLINR_e_CoolantValve_Err_Motor: service-kind=ANY-STANDARDIZED, invalidation-policy{data-element=VeLINR_e_CoolantValve_Err_Motor, handle-invalid=DONT-INVALIDATE}  # -
      data VeLINR_e_CoolantValve_Err_Motor: category=VALUE, sw-calibration-access=READ-ONLY, type=ADTSCoolantValve_Err_Motor, init-value=VeLINR_e_CoolantValve_Err_MotorValue:0
    VeLINR_e_CoolantValve_Err_Volt: service-kind=ANY-STANDARDIZED, invalidation-policy{data-element=VeLINR_e_CoolantValve_Err_Volt, handle-invalid=DONT-INVALIDATE}  # -
      data VeLINR_e_CoolantValve_Err_Volt: category=VALUE, sw-calibration-access=READ-ONLY, type=ADTSCoolantValve_Err_Volt, init-value=VeLINR_e_CoolantValve_Err_VoltValue:0
    VeLINR_e_DriveMdReq: service-kind=ANY-STANDARDIZED, invalidation-policy{data-element=VeLINR_e_DriveMdReq, handle-invalid=KEEP}  # -
      data VeLINR_e_DriveMdReq: category=VALUE, sw-calibration-access=READ-ONLY, type=ADTSDriveMdReq, init-value=VeLINR_e_DriveMdReqValue:0
    VeLINR_e_ECH_InterlockStat: service-kind=ANY-STANDARDIZED, invalidation-policy{data-element=VeLINR_e_ECH_InterlockStat, handle-invalid=DONT-INVALIDATE}  # -
      data VeLINR_e_ECH_InterlockStat: category=VALUE, sw-calibration-access=READ-ONLY, type=ADTSECH_InterlockStat, init-value=VeLINR_e_ECH_InterlockStatValue:0
    VeLINR_e_EEXV_CalStat: service-kind=ANY-STANDARDIZED, invalidation-policy{data-element=VeLINR_e_EEXV_CalStat, handle-invalid=KEEP}  # -
      data VeLINR_e_EEXV_CalStat: category=VALUE, sw-calibration-access=READ-ONLY, type=ADTSEEXV_CalStat, init-value=VeLINR_e_EEXV_CalStatValue:0
    VeLINR_e_EEXV_ERR: service-kind=ANY-STANDARDIZED, invalidation-policy{data-element=VeLINR_e_EEXV_ERR, handle-invalid=KEEP}  # -
      data VeLINR_e_EEXV_ERR: category=VALUE, sw-calibration-access=READ-ONLY, type=ADTSEEXV_ERR, init-value=VeLINR_e_EEXV_ERRValue:0
    VeLINR_e_EEXV_Refrig_Pressure: service-kind=ANY-STANDARDIZED, invalidation-policy{data-element=VeLINR_e_EEXV_Refrig_Pressure, handle-invalid=KEEP}  # -
      data VeLINR_e_EEXV_Refrig_Pressure: category=VALUE, sw-calibration-access=READ-ONLY, type=ADTSEEXV_Refrig_Pressure, init-value=VeLINR_e_EEXV_Refrig_PressureValue:1638.3
    VeLINR_e_EEXV_Refrigerant_Temp: service-kind=ANY-STANDARDIZED, invalidation-policy{data-element=VeLINR_e_EEXV_Refrigerant_Temp, handle-invalid=KEEP}  # -
      data VeLINR_e_EEXV_Refrigerant_Temp: category=VALUE, sw-calibration-access=READ-ONLY, type=ADTSEEXV_Refrigerant_Temp, init-value=VeLINR_e_EEXV_Refrigerant_TempValue:-40
    VeLINR_e_EEXV_Sts: service-kind=ANY-STANDARDIZED, invalidation-policy{data-element=VeLINR_e_EEXV_Sts, handle-invalid=KEEP}  # -
      data VeLINR_e_EEXV_Sts: category=VALUE, sw-calibration-access=READ-ONLY, type=ADTSEEXV_Sts, init-value=VeLINR_e_EEXV_StsValue:0
    VeLINR_e_EOPA_DR_RN_ER: service-kind=ANY-STANDARDIZED, invalidation-policy{data-element=VeLINR_e_EOPA_DR_RN_ER, handle-invalid=KEEP}  # -
      data VeLINR_e_EOPA_DR_RN_ER: category=VALUE, sw-calibration-access=READ-ONLY, type=ADTSEOPA_DR_RN_ER, init-value=VeLINR_e_EOPA_DR_RN_ERValue:3
    VeLINR_e_EOPA_LMP_HM_AN_ON: service-kind=ANY-STANDARDIZED, invalidation-policy{data-element=VeLINR_e_EOPA_LMP_HM_AN_ON, handle-invalid=KEEP}  # -
      data VeLINR_e_EOPA_LMP_HM_AN_ON: category=VALUE, sw-calibration-access=READ-ONLY, type=ADTSEOPA_LMP_HM_AN_ON, init-value=VeLINR_e_EOPA_LMP_HM_AN_ONValue:3
    VeLINR_e_EOPA_LOW_TMP_STAT: service-kind=ANY-STANDARDIZED, invalidation-policy{data-element=VeLINR_e_EOPA_LOW_TMP_STAT, handle-invalid=KEEP}  # -
      data VeLINR_e_EOPA_LOW_TMP_STAT: category=VALUE, sw-calibration-access=READ-ONLY, type=ADTSEOPA_LOW_TMP_STAT, init-value=VeLINR_e_EOPA_LOW_TMP_STATValue:3
    VeLINR_e_EOPA_MONTRNG_RPM: service-kind=ANY-STANDARDIZED, invalidation-policy{data-element=VeLINR_e_EOPA_MONTRNG_RPM, handle-invalid=KEEP}  # -
      data VeLINR_e_EOPA_MONTRNG_RPM: category=VALUE, sw-calibration-access=READ-ONLY, type=ADTSEOPA_MONTRNG_RPM, init-value=VeLINR_e_EOPA_MONTRNG_RPMValue:3
    VeLINR_e_EOPA_OV_CUR_ER: service-kind=ANY-STANDARDIZED, invalidation-policy{data-element=VeLINR_e_EOPA_OV_CUR_ER, handle-invalid=KEEP}  # -
      data VeLINR_e_EOPA_OV_CUR_ER: category=VALUE, sw-calibration-access=READ-ONLY, type=ADTSEOPA_OV_CUR_ER, init-value=VeLINR_e_EOPA_OV_CUR_ERValue:3
    VeLINR_e_EOPA_OV_TMP_ER: service-kind=ANY-STANDARDIZED, invalidation-policy{data-element=VeLINR_e_EOPA_OV_TMP_ER, handle-invalid=KEEP}  # -
      data VeLINR_e_EOPA_OV_TMP_ER: category=VALUE, sw-calibration-access=READ-ONLY, type=ADTSEOPA_OV_TMP_ER, init-value=VeLINR_e_EOPA_OV_TMP_ERValue:3
    VeLINR_e_EOPA_POST_RUN_STAT: service-kind=ANY-STANDARDIZED, invalidation-policy{data-element=VeLINR_e_EOPA_POST_RUN_STAT, handle-invalid=KEEP}  # -
      data VeLINR_e_EOPA_POST_RUN_STAT: category=VALUE, sw-calibration-access=READ-ONLY, type=ADTSEOPA_POST_RUN_STAT, init-value=VeLINR_e_EOPA_POST_RUN_STATValue:7
    VeLINR_e_EOPA_RPM_ACTL: service-kind=ANY-STANDARDIZED, invalidation-policy{data-element=VeLINR_e_EOPA_RPM_ACTL, handle-invalid=KEEP}  # -
      data VeLINR_e_EOPA_RPM_ACTL: category=VALUE, sw-calibration-access=READ-ONLY, type=ADTSEOPA_RPM_ACTL, init-value=VeLINR_e_EOPA_RPM_ACTLValue:6120
    VeLINR_e_EOPA_RPM_TGT: service-kind=ANY-STANDARDIZED, invalidation-policy{data-element=VeLINR_e_EOPA_RPM_TGT, handle-invalid=KEEP}  # -
      data VeLINR_e_EOPA_RPM_TGT: category=VALUE, sw-calibration-access=READ-ONLY, type=ADTSEOPA_RPM_TGT, init-value=VeLINR_e_EOPA_RPM_TGTValue:6120
    VeLINR_e_EOPA_Stall_Event: service-kind=ANY-STANDARDIZED, invalidation-policy{data-element=VeLINR_e_EOPA_Stall_Event, handle-invalid=KEEP}  # -
      data VeLINR_e_EOPA_Stall_Event: category=VALUE, sw-calibration-access=READ-ONLY, type=ADTSEOPA_Stall_Event, init-value=VeLINR_e_EOPA_Stall_EventValue:3
    VeLINR_e_EOPA_VLTG_ER: service-kind=ANY-STANDARDIZED, invalidation-policy{data-element=VeLINR_e_EOPA_VLTG_ER, handle-invalid=KEEP}  # -
      data VeLINR_e_EOPA_VLTG_ER: category=VALUE, sw-calibration-access=READ-ONLY, type=ADTSEOPA_VLTG_ER, init-value=VeLINR_e_EOPA_VLTG_ERValue:3
    VeLINR_e_EOPB_DR_RN_ER: service-kind=ANY-STANDARDIZED, invalidation-policy{data-element=VeLINR_e_EOPB_DR_RN_ER, handle-invalid=KEEP}  # -
      data VeLINR_e_EOPB_DR_RN_ER: category=VALUE, sw-calibration-access=READ-ONLY, type=ADTSEOPB_DR_RN_ER, init-value=VeLINR_e_EOPB_DR_RN_ERValue:3
    VeLINR_e_EOPB_LMP_HM_AN_ON: service-kind=ANY-STANDARDIZED, invalidation-policy{data-element=VeLINR_e_EOPB_LMP_HM_AN_ON, handle-invalid=KEEP}  # -
      data VeLINR_e_EOPB_LMP_HM_AN_ON: category=VALUE, sw-calibration-access=READ-ONLY, type=ADTSEOPB_LMP_HM_AN_ON, init-value=VeLINR_e_EOPB_LMP_HM_AN_ONValue:3
    VeLINR_e_EOPB_LOW_TMP_STAT: service-kind=ANY-STANDARDIZED, invalidation-policy{data-element=VeLINR_e_EOPB_LOW_TMP_STAT, handle-invalid=KEEP}  # -
      data VeLINR_e_EOPB_LOW_TMP_STAT: category=VALUE, sw-calibration-access=READ-ONLY, type=ADTSEOPB_LOW_TMP_STAT, init-value=VeLINR_e_EOPB_LOW_TMP_STATValue:3
    VeLINR_e_EOPB_MONTRNG_RPM: service-kind=ANY-STANDARDIZED, invalidation-policy{data-element=VeLINR_e_EOPB_MONTRNG_RPM, handle-invalid=KEEP}  # -
      data VeLINR_e_EOPB_MONTRNG_RPM: category=VALUE, sw-calibration-access=READ-ONLY, type=ADTSEOPB_MONTRNG_RPM, init-value=VeLINR_e_EOPB_MONTRNG_RPMValue:3
    VeLINR_e_EOPB_OV_CUR_ER: service-kind=ANY-STANDARDIZED, invalidation-policy{data-element=VeLINR_e_EOPB_OV_CUR_ER, handle-invalid=KEEP}  # -
      data VeLINR_e_EOPB_OV_CUR_ER: category=VALUE, sw-calibration-access=READ-ONLY, type=ADTSEOPB_OV_CUR_ER, init-value=VeLINR_e_EOPB_OV_CUR_ERValue:3
    VeLINR_e_EOPB_OV_TMP_ER: service-kind=ANY-STANDARDIZED, invalidation-policy{data-element=VeLINR_e_EOPB_OV_TMP_ER, handle-invalid=KEEP}  # -
      data VeLINR_e_EOPB_OV_TMP_ER: category=VALUE, sw-calibration-access=READ-ONLY, type=ADTSEOPB_OV_TMP_ER, init-value=VeLINR_e_EOPB_OV_TMP_ERValue:3
    VeLINR_e_EOPB_POST_RUN_STAT: service-kind=ANY-STANDARDIZED, invalidation-policy{data-element=VeLINR_e_EOPB_POST_RUN_STAT, handle-invalid=KEEP}  # -
      data VeLINR_e_EOPB_POST_RUN_STAT: category=VALUE, sw-calibration-access=READ-ONLY, type=ADTSEOPB_POST_RUN_STAT, init-value=VeLINR_e_EOPB_POST_RUN_STATValue:7
    VeLINR_e_EOPB_RPM_ACTL: service-kind=ANY-STANDARDIZED, invalidation-policy{data-element=VeLINR_e_EOPB_RPM_ACTL, handle-invalid=KEEP}  # -
      data VeLINR_e_EOPB_RPM_ACTL: category=VALUE, sw-calibration-access=READ-ONLY, type=ADTSEOPB_RPM_ACTL, init-value=VeLINR_e_EOPB_RPM_ACTLValue:6120
    VeLINR_e_EOPB_RPM_TGT: service-kind=ANY-STANDARDIZED, invalidation-policy{data-element=VeLINR_e_EOPB_RPM_TGT, handle-invalid=KEEP}  # -
      data VeLINR_e_EOPB_RPM_TGT: category=VALUE, sw-calibration-access=READ-ONLY, type=ADTSEOPB_RPM_TGT, init-value=VeLINR_e_EOPB_RPM_TGTValue:6120
    VeLINR_e_EOPB_Stall_Event: service-kind=ANY-STANDARDIZED, invalidation-policy{data-element=VeLINR_e_EOPB_Stall_Event, handle-invalid=KEEP}  # -
      data VeLINR_e_EOPB_Stall_Event: category=VALUE, sw-calibration-access=READ-ONLY, type=ADTSEOPB_Stall_Event, init-value=VeLINR_e_EOPB_Stall_EventValue:3
    VeLINR_e_EOPB_VLTG_ER: service-kind=ANY-STANDARDIZED, invalidation-policy{data-element=VeLINR_e_EOPB_VLTG_ER, handle-invalid=KEEP}  # -
      data VeLINR_e_EOPB_VLTG_ER: category=VALUE, sw-calibration-access=READ-ONLY, type=ADTSEOPB_VLTG_ER, init-value=VeLINR_e_EOPB_VLTG_ERValue:3
    VeLINR_e_ESaveModeRq_LIN: service-kind=ANY-STANDARDIZED, invalidation-policy{data-element=VeLINR_e_ESaveModeRq_LIN, handle-invalid=KEEP}  # -
      data VeLINR_e_ESaveModeRq_LIN: category=VALUE, sw-calibration-access=READ-ONLY, type=ADTSESaveModeRq_LIN, init-value=VeLINR_e_ESaveModeRq_LINValue:0
    VeLINR_e_EXVM_CalStat: service-kind=ANY-STANDARDIZED, invalidation-policy{data-element=VeLINR_e_EXVM_CalStat, handle-invalid=KEEP}  # -
      data VeLINR_e_EXVM_CalStat: category=VALUE, sw-calibration-access=READ-ONLY, type=ADTSEXVM_CalStat, init-value=VeLINR_e_EXVM_CalStatValue:0
    VeLINR_e_EXVM_ERR: service-kind=ANY-STANDARDIZED, invalidation-policy{data-element=VeLINR_e_EXVM_ERR, handle-invalid=KEEP}  # -
      data VeLINR_e_EXVM_ERR: category=VALUE, sw-calibration-access=READ-ONLY, type=ADTSEXVM_ERR, init-value=VeLINR_e_EXVM_ERRValue:0
    VeLINR_e_EXVM_Refrig_Pressure: service-kind=ANY-STANDARDIZED, invalidation-policy{data-element=VeLINR_e_EXVM_Refrig_Pressure, handle-invalid=KEEP}  # -
      data VeLINR_e_EXVM_Refrig_Pressure: category=VALUE, sw-calibration-access=READ-ONLY, type=ADTSEXVM_Refrig_Pressure, init-value=VeLINR_e_EXVM_Refrig_PressureValue:1638.3
    VeLINR_e_EXVM_Refrigerant_Temp: service-kind=ANY-STANDARDIZED, invalidation-policy{data-element=VeLINR_e_EXVM_Refrigerant_Temp, handle-invalid=KEEP}  # -
      data VeLINR_e_EXVM_Refrigerant_Temp: category=VALUE, sw-calibration-access=READ-ONLY, type=ADTSEXVM_Refrigerant_Temp, init-value=VeLINR_e_EXVM_Refrigerant_TempValue:-40
    VeLINR_e_EXVM_Sts: service-kind=ANY-STANDARDIZED, invalidation-policy{data-element=VeLINR_e_EXVM_Sts, handle-invalid=KEEP}  # -
      data VeLINR_e_EXVM_Sts: category=VALUE, sw-calibration-access=READ-ONLY, type=ADTSEXVM_Sts, init-value=VeLINR_e_EXVM_StsValue:0
    VeLINR_e_ElectricModeRq_LIN: service-kind=ANY-STANDARDIZED, invalidation-policy{data-element=VeLINR_e_ElectricModeRq_LIN, handle-invalid=KEEP}  # -
      data VeLINR_e_ElectricModeRq_LIN: category=VALUE, sw-calibration-access=READ-ONLY, type=ADTSElectricModeRq_LIN, init-value=VeLINR_e_ElectricModeRq_LINValue:0
    VeLINR_e_HClHrSrFtClTInSnFlt: service-kind=ANY-STANDARDIZED, invalidation-policy{data-element=VeLINR_e_HClHrSrFtClTInSnFlt, handle-invalid=KEEP}  # -
      data VeLINR_e_HClHrSrFtClTInSnFlt: category=VALUE, sw-calibration-access=READ-ONLY, type=ADTSHClHrSrFtClTInSnFlt, init-value=VeLINR_e_HClHrSrFtClTInSnFltValue:3
    VeLINR_e_HClHrSrFtClTOtSnFlt: service-kind=ANY-STANDARDIZED, invalidation-policy{data-element=VeLINR_e_HClHrSrFtClTOtSnFlt, handle-invalid=KEEP}  # -
      data VeLINR_e_HClHrSrFtClTOtSnFlt: category=VALUE, sw-calibration-access=READ-ONLY, type=ADTSHClHrSrFtClTOtSnFlt, init-value=VeLINR_e_HClHrSrFtClTOtSnFltValue:3
    VeLINR_e_HClHrSrFtTInMtrlSnFlt: service-kind=ANY-STANDARDIZED, invalidation-policy{data-element=VeLINR_e_HClHrSrFtTInMtrlSnFlt, handle-invalid=KEEP}  # -
      data VeLINR_e_HClHrSrFtTInMtrlSnFlt: category=VALUE, sw-calibration-access=READ-ONLY, type=ADTSHClHrSrFtTInMtrlSnFlt, init-value=VeLINR_e_HClHrSrFtTInMtrlSnFltValue:3
    VeLINR_e_HClHrSrRqCrFrDrShOrOp: service-kind=ANY-STANDARDIZED, invalidation-policy{data-element=VeLINR_e_HClHrSrRqCrFrDrShOrOp, handle-invalid=KEEP}  # -
      data VeLINR_e_HClHrSrRqCrFrDrShOrOp: category=VALUE, sw-calibration-access=READ-ONLY, type=ADTSHClHrSrRqCrFrDrShOrOp, init-value=VeLINR_e_HClHrSrRqCrFrDrShOrOpValue:3
    VeLINR_e_HClHrSrRqICnsOtOfRng: service-kind=ANY-STANDARDIZED, invalidation-policy{data-element=VeLINR_e_HClHrSrRqICnsOtOfRng, handle-invalid=KEEP}  # -
      data VeLINR_e_HClHrSrRqICnsOtOfRng: category=VALUE, sw-calibration-access=READ-ONLY, type=ADTSHClHrSrRqICnsOtOfRng, init-value=VeLINR_e_HClHrSrRqICnsOtOfRngValue:3
    VeLINR_e_HClHrSrRqMemErr: service-kind=ANY-STANDARDIZED, invalidation-policy{data-element=VeLINR_e_HClHrSrRqMemErr, handle-invalid=KEEP}  # -
      data VeLINR_e_HClHrSrRqMemErr: category=VALUE, sw-calibration-access=READ-ONLY, type=ADTSHClHrSrRqMemErr, init-value=VeLINR_e_HClHrSrRqMemErrValue:3
    VeLINR_e_HClHrSrRqSrvRq: service-kind=ANY-STANDARDIZED, invalidation-policy{data-element=VeLINR_e_HClHrSrRqSrvRq, handle-invalid=KEEP}  # -
      data VeLINR_e_HClHrSrRqSrvRq: category=VALUE, sw-calibration-access=READ-ONLY, type=ADTSHClHrSrRqSrvRq, init-value=VeLINR_e_HClHrSrRqSrvRqValue:3
    VeLINR_e_HTLBV_CalStat: service-kind=ANY-STANDARDIZED, invalidation-policy{data-element=VeLINR_e_HTLBV_CalStat, handle-invalid=DONT-INVALIDATE}  # -
      data VeLINR_e_HTLBV_CalStat: category=VALUE, sw-calibration-access=READ-ONLY, type=ADTSHTLBV_CalStat, init-value=VeLINR_e_HTLBV_CalStatValue:0
    VeLINR_e_HTLBV_ERR: service-kind=ANY-STANDARDIZED, invalidation-policy{data-element=VeLINR_e_HTLBV_ERR, handle-invalid=KEEP}  # -
      data VeLINR_e_HTLBV_ERR: category=VALUE, sw-calibration-access=READ-ONLY, type=ADTSHTLBV_ERR, init-value=VeLINR_e_HTLBV_ERRValue:0
    VeLINR_e_HTLBV_Sts: service-kind=ANY-STANDARDIZED, invalidation-policy{data-element=VeLINR_e_HTLBV_Sts, handle-invalid=KEEP}  # -
      data VeLINR_e_HTLBV_Sts: category=VALUE, sw-calibration-access=READ-ONLY, type=ADTSHTLBV_Sts, init-value=VeLINR_e_HTLBV_StsValue:0
    VeLINR_e_HVH_UnlockCounter: service-kind=ANY-STANDARDIZED, invalidation-policy{data-element=VeLINR_e_HVH_UnlockCounter, handle-invalid=KEEP}  # -
      data VeLINR_e_HVH_UnlockCounter: category=VALUE, sw-calibration-access=READ-ONLY, type=ADTSHVH_UnlockCounter, init-value=VeLINR_e_HVH_UnlockCounterValue:0
    VeLINR_e_HvCltHrPrtnSfTmpHwPrtn: service-kind=ANY-STANDARDIZED, invalidation-policy{data-element=VeLINR_e_HvCltHrPrtnSfTmpHwPrtn, handle-invalid=KEEP}  # -
      data VeLINR_e_HvCltHrPrtnSfTmpHwPrtn: category=VALUE, sw-calibration-access=READ-ONLY, type=ADTSHvCltHrPrtnSfTmpHwPrtn, init-value=VeLINR_e_HvCltHrPrtnSfTmpHwPrtnValue:3
    VeLINR_e_HvCltHrPrtnSfTmpOvrhtg: service-kind=ANY-STANDARDIZED, invalidation-policy{data-element=VeLINR_e_HvCltHrPrtnSfTmpOvrhtg, handle-invalid=KEEP}  # -
      data VeLINR_e_HvCltHrPrtnSfTmpOvrhtg: category=VALUE, sw-calibration-access=READ-ONLY, type=ADTSHvCltHrPrtnSfTmpOvrhtg, init-value=VeLINR_e_HvCltHrPrtnSfTmpOvrhtgValue:3
    VeLINR_e_HvCltHtrWrnCltTOtOfRng: service-kind=ANY-STANDARDIZED, invalidation-policy{data-element=VeLINR_e_HvCltHtrWrnCltTOtOfRng, handle-invalid=KEEP}  # -
      data VeLINR_e_HvCltHtrWrnCltTOtOfRng: category=VALUE, sw-calibration-access=READ-ONLY, type=ADTSHvCltHtrWrnCltTOtOfRng, init-value=VeLINR_e_HvCltHtrWrnCltTOtOfRngValue:3
    VeLINR_e_HvCltHtrWrnFltInCom: service-kind=ANY-STANDARDIZED, invalidation-policy{data-element=VeLINR_e_HvCltHtrWrnFltInCom, handle-invalid=KEEP}  # -
      data VeLINR_e_HvCltHtrWrnFltInCom: category=VALUE, sw-calibration-access=READ-ONLY, type=ADTSHvCltHtrWrnFltInCom, init-value=VeLINR_e_HvCltHtrWrnFltInComValue:3
    VeLINR_e_HvCltHtrWrnHvOtOfRng: service-kind=ANY-STANDARDIZED, invalidation-policy{data-element=VeLINR_e_HvCltHtrWrnHvOtOfRng, handle-invalid=KEEP}  # -
      data VeLINR_e_HvCltHtrWrnHvOtOfRng: category=VALUE, sw-calibration-access=READ-ONLY, type=ADTSHvCltHtrWrnHvOtOfRng, init-value=VeLINR_e_HvCltHtrWrnHvOtOfRngValue:3
    VeLINR_e_HvCltHtrWrnULoOtOfRng: service-kind=ANY-STANDARDIZED, invalidation-policy{data-element=VeLINR_e_HvCltHtrWrnULoOtOfRng, handle-invalid=KEEP}  # -
      data VeLINR_e_HvCltHtrWrnULoOtOfRng: category=VALUE, sw-calibration-access=READ-ONLY, type=ADTSHvCltHtrWrnULoOtOfRng, init-value=VeLINR_e_HvCltHtrWrnULoOtOfRngValue:3
    VeLINR_e_HvCooltHeatrSts: service-kind=ANY-STANDARDIZED, invalidation-policy{data-element=VeLINR_e_HvCooltHeatrSts, handle-invalid=DONT-INVALIDATE}  # -
      data VeLINR_e_HvCooltHeatrSts: category=VALUE, sw-calibration-access=READ-ONLY, type=ADTSHvCooltHeatrSts, init-value=VeLINR_e_HvCooltHeatrStsValue:0
    VeLINR_e_HybridModeRq_LIN: service-kind=ANY-STANDARDIZED, invalidation-policy{data-element=VeLINR_e_HybridModeRq_LIN, handle-invalid=KEEP}  # -
      data VeLINR_e_HybridModeRq_LIN: category=VALUE, sw-calibration-access=READ-ONLY, type=ADTSHybridModeRq_LIN, init-value=VeLINR_e_HybridModeRq_LINValue:0
    VeLINR_e_Icon1_Sts: service-kind=ANY-STANDARDIZED, invalidation-policy{data-element=VeLINR_e_Icon1_Sts, handle-invalid=KEEP}  # -
      data VeLINR_e_Icon1_Sts: category=VALUE, sw-calibration-access=READ-ONLY, type=ADTSIcon1_Sts, init-value=VeLINR_e_Icon1_StsValue:0
    VeLINR_e_Icon2_Sts: service-kind=ANY-STANDARDIZED, invalidation-policy{data-element=VeLINR_e_Icon2_Sts, handle-invalid=KEEP}  # -
      data VeLINR_e_Icon2_Sts: category=VALUE, sw-calibration-access=READ-ONLY, type=ADTSIcon2_Sts, init-value=VeLINR_e_Icon2_StsValue:0
    VeLINR_e_Inlet_Temp1_DC: service-kind=ANY-STANDARDIZED, invalidation-policy{data-element=VeLINR_e_Inlet_Temp1_DC, handle-invalid=KEEP}  # -
      data VeLINR_e_Inlet_Temp1_DC: category=VALUE, sw-calibration-access=READ-ONLY, type=ADTSInlet_Temp1_DC, init-value=VeLINR_e_Inlet_Temp1_DCValue:-40
    VeLINR_e_Inlet_Temp2_DC: service-kind=ANY-STANDARDIZED, invalidation-policy{data-element=VeLINR_e_Inlet_Temp2_DC, handle-invalid=KEEP}  # -
      data VeLINR_e_Inlet_Temp2_DC: category=VALUE, sw-calibration-access=READ-ONLY, type=ADTSInlet_Temp2_DC, init-value=VeLINR_e_Inlet_Temp2_DCValue:-40
    VeLINR_e_LTRBV_CalStat: service-kind=ANY-STANDARDIZED, invalidation-policy{data-element=VeLINR_e_LTRBV_CalStat, handle-invalid=DONT-INVALIDATE}  # -
      data VeLINR_e_LTRBV_CalStat: category=VALUE, sw-calibration-access=READ-ONLY, type=ADTSLTRBV_CalStat, init-value=VeLINR_e_LTRBV_CalStatValue:0
    VeLINR_e_LTRBV_ERR: service-kind=ANY-STANDARDIZED, invalidation-policy{data-element=VeLINR_e_LTRBV_ERR, handle-invalid=KEEP}  # -
      data VeLINR_e_LTRBV_ERR: category=VALUE, sw-calibration-access=READ-ONLY, type=ADTSLTRBV_ERR, init-value=VeLINR_e_LTRBV_ERRValue:0
    VeLINR_e_LTRBV_Sts: service-kind=ANY-STANDARDIZED, invalidation-policy{data-element=VeLINR_e_LTRBV_Sts, handle-invalid=KEEP}  # -
      data VeLINR_e_LTRBV_Sts: category=VALUE, sw-calibration-access=READ-ONLY, type=ADTSLTRBV_Sts, init-value=VeLINR_e_LTRBV_StsValue:0
    VeLINR_e_OEXV_CalStat: service-kind=ANY-STANDARDIZED, invalidation-policy{data-element=VeLINR_e_OEXV_CalStat, handle-invalid=KEEP}  # -
      data VeLINR_e_OEXV_CalStat: category=VALUE, sw-calibration-access=READ-ONLY, type=ADTSOEXV_CalStat, init-value=VeLINR_e_OEXV_CalStatValue:0
    VeLINR_e_OEXV_ERR: service-kind=ANY-STANDARDIZED, invalidation-policy{data-element=VeLINR_e_OEXV_ERR, handle-invalid=KEEP}  # -
      data VeLINR_e_OEXV_ERR: category=VALUE, sw-calibration-access=READ-ONLY, type=ADTSOEXV_ERR, init-value=VeLINR_e_OEXV_ERRValue:0
    VeLINR_e_OEXV_Refrig_Pres: service-kind=ANY-STANDARDIZED, invalidation-policy{data-element=VeLINR_e_OEXV_Refrig_Pres, handle-invalid=KEEP}  # -
      data VeLINR_e_OEXV_Refrig_Pres: category=VALUE, sw-calibration-access=READ-ONLY, type=ADTSOEXV_Refrig_Pres, init-value=VeLINR_e_OEXV_Refrig_PresValue:8191.5
    VeLINR_e_OEXV_Refrigerant_Temp: service-kind=ANY-STANDARDIZED, invalidation-policy{data-element=VeLINR_e_OEXV_Refrigerant_Temp, handle-invalid=KEEP}  # -
      data VeLINR_e_OEXV_Refrigerant_Temp: category=VALUE, sw-calibration-access=READ-ONLY, type=ADTSOEXV_Refrigerant_Temp, init-value=VeLINR_e_OEXV_Refrigerant_TempValue:-40
    VeLINR_e_OEXV_Sts: service-kind=ANY-STANDARDIZED, invalidation-policy{data-element=VeLINR_e_OEXV_Sts, handle-invalid=KEEP}  # -
      data VeLINR_e_OEXV_Sts: category=VALUE, sw-calibration-access=READ-ONLY, type=ADTSOEXV_Sts, init-value=VeLINR_e_OEXV_StsValue:0
    VeLINR_e_PECP2_AIR_PRE_ERR: service-kind=ANY-STANDARDIZED, invalidation-policy{data-element=VeLINR_e_PECP2_AIR_PRE_ERR, handle-invalid=KEEP}  # -
      data VeLINR_e_PECP2_AIR_PRE_ERR: category=VALUE, sw-calibration-access=READ-ONLY, type=ADTSPECP2_AIR_PRE_ERR, init-value=VeLINR_e_PECP2_AIR_PRE_ERRValue:3
    VeLINR_e_PECP2_DBLK_ACTV: service-kind=ANY-STANDARDIZED, invalidation-policy{data-element=VeLINR_e_PECP2_DBLK_ACTV, handle-invalid=KEEP}  # -
      data VeLINR_e_PECP2_DBLK_ACTV: category=VALUE, sw-calibration-access=READ-ONLY, type=ADTSPECP2_DBLK_ACTV, init-value=VeLINR_e_PECP2_DBLK_ACTVValue:3
    VeLINR_e_PECP2_DR_RN_ERR: service-kind=ANY-STANDARDIZED, invalidation-policy{data-element=VeLINR_e_PECP2_DR_RN_ERR, handle-invalid=KEEP}  # -
      data VeLINR_e_PECP2_DR_RN_ERR: category=VALUE, sw-calibration-access=READ-ONLY, type=ADTSPECP2_DR_RN_ERR, init-value=VeLINR_e_PECP2_DR_RN_ERRValue:3
    VeLINR_e_PECP2_FL_SAFE_ACTVTD: service-kind=ANY-STANDARDIZED, invalidation-policy{data-element=VeLINR_e_PECP2_FL_SAFE_ACTVTD, handle-invalid=KEEP}  # -
      data VeLINR_e_PECP2_FL_SAFE_ACTVTD: category=VALUE, sw-calibration-access=READ-ONLY, type=ADTSPECP2_FL_SAFE_ACTVTD, init-value=VeLINR_e_PECP2_FL_SAFE_ACTVTDValue:3
    VeLINR_e_PECP2_LMP_HM_AN_ON: service-kind=ANY-STANDARDIZED, invalidation-policy{data-element=VeLINR_e_PECP2_LMP_HM_AN_ON, handle-invalid=KEEP}  # -
      data VeLINR_e_PECP2_LMP_HM_AN_ON: category=VALUE, sw-calibration-access=READ-ONLY, type=ADTSPECP2_LMP_HM_AN_ON, init-value=VeLINR_e_PECP2_LMP_HM_AN_ONValue:3
    VeLINR_e_PECP2_MONTRNG_RPM: service-kind=ANY-STANDARDIZED, invalidation-policy{data-element=VeLINR_e_PECP2_MONTRNG_RPM, handle-invalid=KEEP}  # -
      data VeLINR_e_PECP2_MONTRNG_RPM: category=VALUE, sw-calibration-access=READ-ONLY, type=ADTSPECP2_MONTRNG_RPM, init-value=VeLINR_e_PECP2_MONTRNG_RPMValue:3
    VeLINR_e_PECP2_NODE_ERR: service-kind=ANY-STANDARDIZED, invalidation-policy{data-element=VeLINR_e_PECP2_NODE_ERR, handle-invalid=KEEP}  # -
      data VeLINR_e_PECP2_NODE_ERR: category=VALUE, sw-calibration-access=READ-ONLY, type=ADTSPECP2_NODE_ERR, init-value=VeLINR_e_PECP2_NODE_ERRValue:3
    VeLINR_e_PECP2_OVR_CUR_ERR: service-kind=ANY-STANDARDIZED, invalidation-policy{data-element=VeLINR_e_PECP2_OVR_CUR_ERR, handle-invalid=KEEP}  # -
      data VeLINR_e_PECP2_OVR_CUR_ERR: category=VALUE, sw-calibration-access=READ-ONLY, type=ADTSPECP2_OVR_CUR_ERR, init-value=VeLINR_e_PECP2_OVR_CUR_ERRValue:3
    VeLINR_e_PECP2_OVR_TMP_ERR: service-kind=ANY-STANDARDIZED, invalidation-policy{data-element=VeLINR_e_PECP2_OVR_TMP_ERR, handle-invalid=KEEP}  # -
      data VeLINR_e_PECP2_OVR_TMP_ERR: category=VALUE, sw-calibration-access=READ-ONLY, type=ADTSPECP2_OVR_TMP_ERR, init-value=VeLINR_e_PECP2_OVR_TMP_ERRValue:3
    VeLINR_e_PECP2_POST_RUN_STAT: service-kind=ANY-STANDARDIZED, invalidation-policy{data-element=VeLINR_e_PECP2_POST_RUN_STAT, handle-invalid=KEEP}  # -
      data VeLINR_e_PECP2_POST_RUN_STAT: category=VALUE, sw-calibration-access=READ-ONLY, type=ADTSPECP2_POST_RUN_STAT, init-value=VeLINR_e_PECP2_POST_RUN_STATValue:7
    VeLINR_e_PECP2_SUPPLIER: service-kind=ANY-STANDARDIZED, invalidation-policy{data-element=VeLINR_e_PECP2_SUPPLIER, handle-invalid=DONT-INVALIDATE}  # -
      data VeLINR_e_PECP2_SUPPLIER: category=VALUE, sw-calibration-access=READ-ONLY, type=ADTSPECP2_SUPPLIER, init-value=VeLINR_e_PECP2_SUPPLIERValue:0
    VeLINR_e_PECP2_VLTG_ERR: service-kind=ANY-STANDARDIZED, invalidation-policy{data-element=VeLINR_e_PECP2_VLTG_ERR, handle-invalid=KEEP}  # -
      data VeLINR_e_PECP2_VLTG_ERR: category=VALUE, sw-calibration-access=READ-ONLY, type=ADTSPECP2_VLTG_ERR, init-value=VeLINR_e_PECP2_VLTG_ERRValue:3
    VeLINR_e_PECP_AIR_PRE_ERR: service-kind=ANY-STANDARDIZED, invalidation-policy{data-element=VeLINR_e_PECP_AIR_PRE_ERR, handle-invalid=KEEP}  # -
      data VeLINR_e_PECP_AIR_PRE_ERR: category=VALUE, sw-calibration-access=READ-ONLY, type=ADTSPECP_AIR_PRE_ERR, init-value=VeLINR_e_PECP_AIR_PRE_ERRValue:3
    VeLINR_e_PECP_DBLK_ACTV: service-kind=ANY-STANDARDIZED, invalidation-policy{data-element=VeLINR_e_PECP_DBLK_ACTV, handle-invalid=KEEP}  # -
      data VeLINR_e_PECP_DBLK_ACTV: category=VALUE, sw-calibration-access=READ-ONLY, type=ADTSPECP_DBLK_ACTV, init-value=VeLINR_e_PECP_DBLK_ACTVValue:3
    VeLINR_e_PECP_DR_RN_ERR: service-kind=ANY-STANDARDIZED, invalidation-policy{data-element=VeLINR_e_PECP_DR_RN_ERR, handle-invalid=KEEP}  # -
      data VeLINR_e_PECP_DR_RN_ERR: category=VALUE, sw-calibration-access=READ-ONLY, type=ADTSPECP_DR_RN_ERR, init-value=VeLINR_e_PECP_DR_RN_ERRValue:3
    VeLINR_e_PECP_FL_SAFE_ACTVTD: service-kind=ANY-STANDARDIZED, invalidation-policy{data-element=VeLINR_e_PECP_FL_SAFE_ACTVTD, handle-invalid=KEEP}  # -
      data VeLINR_e_PECP_FL_SAFE_ACTVTD: category=VALUE, sw-calibration-access=READ-ONLY, type=ADTSPECP_FL_SAFE_ACTVTD, init-value=VeLINR_e_PECP_FL_SAFE_ACTVTDValue:3
    VeLINR_e_PECP_LMP_HM_AN_ON: service-kind=ANY-STANDARDIZED, invalidation-policy{data-element=VeLINR_e_PECP_LMP_HM_AN_ON, handle-invalid=KEEP}  # -
      data VeLINR_e_PECP_LMP_HM_AN_ON: category=VALUE, sw-calibration-access=READ-ONLY, type=ADTSPECP_LMP_HM_AN_ON, init-value=VeLINR_e_PECP_LMP_HM_AN_ONValue:3
    VeLINR_e_PECP_MONTRNG_RPM: service-kind=ANY-STANDARDIZED, invalidation-policy{data-element=VeLINR_e_PECP_MONTRNG_RPM, handle-invalid=KEEP}  # -
      data VeLINR_e_PECP_MONTRNG_RPM: category=VALUE, sw-calibration-access=READ-ONLY, type=ADTSPECP_MONTRNG_RPM, init-value=VeLINR_e_PECP_MONTRNG_RPMValue:3
    VeLINR_e_PECP_NODE_ERR: service-kind=ANY-STANDARDIZED, invalidation-policy{data-element=VeLINR_e_PECP_NODE_ERR, handle-invalid=KEEP}  # -
      data VeLINR_e_PECP_NODE_ERR: category=VALUE, sw-calibration-access=READ-ONLY, type=ADTSPECP_NODE_ERR, init-value=VeLINR_e_PECP_NODE_ERRValue:3
    VeLINR_e_PECP_OVR_CUR_ERR: service-kind=ANY-STANDARDIZED, invalidation-policy{data-element=VeLINR_e_PECP_OVR_CUR_ERR, handle-invalid=KEEP}  # -
      data VeLINR_e_PECP_OVR_CUR_ERR: category=VALUE, sw-calibration-access=READ-ONLY, type=ADTSPECP_OVR_CUR_ERR, init-value=VeLINR_e_PECP_OVR_CUR_ERRValue:3
    VeLINR_e_PECP_OVR_TMP_ERR: service-kind=ANY-STANDARDIZED, invalidation-policy{data-element=VeLINR_e_PECP_OVR_TMP_ERR, handle-invalid=KEEP}  # -
      data VeLINR_e_PECP_OVR_TMP_ERR: category=VALUE, sw-calibration-access=READ-ONLY, type=ADTSPECP_OVR_TMP_ERR, init-value=VeLINR_e_PECP_OVR_TMP_ERRValue:3
    VeLINR_e_PECP_POST_RUN_STAT: service-kind=ANY-STANDARDIZED, invalidation-policy{data-element=VeLINR_e_PECP_POST_RUN_STAT, handle-invalid=KEEP}  # -
      data VeLINR_e_PECP_POST_RUN_STAT: category=VALUE, sw-calibration-access=READ-ONLY, type=ADTSPECP_POST_RUN_STAT, init-value=VeLINR_e_PECP_POST_RUN_STATValue:7
    VeLINR_e_PECP_SUPPLIER: service-kind=ANY-STANDARDIZED, invalidation-policy{data-element=VeLINR_e_PECP_SUPPLIER, handle-invalid=DONT-INVALIDATE}  # -
      data VeLINR_e_PECP_SUPPLIER: category=VALUE, sw-calibration-access=READ-ONLY, type=ADTSPECP_SUPPLIER, init-value=VeLINR_e_PECP_SUPPLIERValue:0
    VeLINR_e_PECP_VLTG_ERR: service-kind=ANY-STANDARDIZED, invalidation-policy{data-element=VeLINR_e_PECP_VLTG_ERR, handle-invalid=KEEP}  # -
      data VeLINR_e_PECP_VLTG_ERR: category=VALUE, sw-calibration-access=READ-ONLY, type=ADTSPECP_VLTG_ERR, init-value=VeLINR_e_PECP_VLTG_ERRValue:3
    VeLINR_e_PowPan2_LED_A_Col_Fdbk: service-kind=ANY-STANDARDIZED, invalidation-policy{data-element=VeLINR_e_PowPan2_LED_A_Col_Fdbk, handle-invalid=DONT-INVALIDATE}  # -
      data VeLINR_e_PowPan2_LED_A_Col_Fdbk: category=VALUE, sw-calibration-access=READ-ONLY, type=ADTSPowPan2_LED_A_Col_Fdbk, init-value=VeLINR_e_PowPan2_LED_A_Col_FdbkValue:0
    VeLINR_e_PowPan2_LED_A_FailStat: service-kind=ANY-STANDARDIZED, invalidation-policy{data-element=VeLINR_e_PowPan2_LED_A_FailStat, handle-invalid=DONT-INVALIDATE}  # -
      data VeLINR_e_PowPan2_LED_A_FailStat: category=VALUE, sw-calibration-access=READ-ONLY, type=ADTSPowPan2_LED_A_FailStat, init-value=VeLINR_e_PowPan2_LED_A_FailStatValue:0
    VeLINR_e_PowPan2_LED_B_Col_Fdbk: service-kind=ANY-STANDARDIZED, invalidation-policy{data-element=VeLINR_e_PowPan2_LED_B_Col_Fdbk, handle-invalid=DONT-INVALIDATE}  # -
      data VeLINR_e_PowPan2_LED_B_Col_Fdbk: category=VALUE, sw-calibration-access=READ-ONLY, type=ADTSPowPan2_LED_B_Col_Fdbk, init-value=VeLINR_e_PowPan2_LED_B_Col_FdbkValue:0
    VeLINR_e_PowPan2_LED_B_FailStat: service-kind=ANY-STANDARDIZED, invalidation-policy{data-element=VeLINR_e_PowPan2_LED_B_FailStat, handle-invalid=DONT-INVALIDATE}  # -
      data VeLINR_e_PowPan2_LED_B_FailStat: category=VALUE, sw-calibration-access=READ-ONLY, type=ADTSPowPan2_LED_B_FailStat, init-value=VeLINR_e_PowPan2_LED_B_FailStatValue:0
    VeLINR_e_PowerPanel2_Fault: service-kind=ANY-STANDARDIZED, invalidation-policy{data-element=VeLINR_e_PowerPanel2_Fault, handle-invalid=KEEP}  # -
      data VeLINR_e_PowerPanel2_Fault: category=VALUE, sw-calibration-access=READ-ONLY, type=ADTSPowerPanel2_Fault, init-value=VeLINR_e_PowerPanel2_FaultValue:0
    VeLINR_e_PowerPanel2_LED_A_Fdbk: service-kind=ANY-STANDARDIZED, invalidation-policy{data-element=VeLINR_e_PowerPanel2_LED_A_Fdbk, handle-invalid=KEEP}  # -
      data VeLINR_e_PowerPanel2_LED_A_Fdbk: category=VALUE, sw-calibration-access=READ-ONLY, type=ADTSPowerPanel2_LED_A_Fdbk, init-value=VeLINR_e_PowerPanel2_LED_A_FdbkValue:0
    VeLINR_e_PowerPanel2_LED_B_Fdbk: service-kind=ANY-STANDARDIZED, invalidation-policy{data-element=VeLINR_e_PowerPanel2_LED_B_Fdbk, handle-invalid=KEEP}  # -
      data VeLINR_e_PowerPanel2_LED_B_Fdbk: category=VALUE, sw-calibration-access=READ-ONLY, type=ADTSPowerPanel2_LED_B_Fdbk, init-value=VeLINR_e_PowerPanel2_LED_B_FdbkValue:0
    VeLINR_e_PowerPanel_Fault: service-kind=ANY-STANDARDIZED, invalidation-policy{data-element=VeLINR_e_PowerPanel_Fault, handle-invalid=KEEP}  # -
      data VeLINR_e_PowerPanel_Fault: category=VALUE, sw-calibration-access=READ-ONLY, type=ADTSPowerPanel_Fault, init-value=VeLINR_e_PowerPanel_FaultValue:0
    VeLINR_e_PowerPanel_FaultReason: service-kind=ANY-STANDARDIZED, invalidation-policy{data-element=VeLINR_e_PowerPanel_FaultReason, handle-invalid=KEEP}  # -
      data VeLINR_e_PowerPanel_FaultReason: category=VALUE, sw-calibration-access=READ-ONLY, type=ADTSPowerPanel_FaultReason, init-value=VeLINR_e_PowerPanel_FaultReasonValue:0
    VeLINR_e_PwrPanel2_Fault_Reason: service-kind=ANY-STANDARDIZED, invalidation-policy{data-element=VeLINR_e_PwrPanel2_Fault_Reason, handle-invalid=KEEP}  # -
      data VeLINR_e_PwrPanel2_Fault_Reason: category=VALUE, sw-calibration-access=READ-ONLY, type=ADTSPwrPanel2_Fault_Reason, init-value=VeLINR_e_PwrPanel2_Fault_ReasonValue:0
    VeLINR_e_PwrPanelLEDAColorFdbck: service-kind=ANY-STANDARDIZED, invalidation-policy{data-element=VeLINR_e_PwrPanelLEDAColorFdbck, handle-invalid=DONT-INVALIDATE}  # -
      data VeLINR_e_PwrPanelLEDAColorFdbck: category=VALUE, sw-calibration-access=READ-ONLY, type=ADTSPwrPanelLEDAColorFdbck, init-value=VeLINR_e_PwrPanelLEDAColorFdbckValue:0
    VeLINR_e_PwrPanelLEDBColorFdbck: service-kind=ANY-STANDARDIZED, invalidation-policy{data-element=VeLINR_e_PwrPanelLEDBColorFdbck, handle-invalid=DONT-INVALIDATE}  # -
      data VeLINR_e_PwrPanelLEDBColorFdbck: category=VALUE, sw-calibration-access=READ-ONLY, type=ADTSPwrPanelLEDBColorFdbck, init-value=VeLINR_e_PwrPanelLEDBColorFdbckValue:0
    VeLINR_e_PwrPanelLEDCColorFdbck: service-kind=ANY-STANDARDIZED, invalidation-policy{data-element=VeLINR_e_PwrPanelLEDCColorFdbck, handle-invalid=DONT-INVALIDATE}  # -
      data VeLINR_e_PwrPanelLEDCColorFdbck: category=VALUE, sw-calibration-access=READ-ONLY, type=ADTSPwrPanelLEDCColorFdbck, init-value=VeLINR_e_PwrPanelLEDCColorFdbckValue:0
    VeLINR_e_PwrPanel_LEDA_FailSts: service-kind=ANY-STANDARDIZED, invalidation-policy{data-element=VeLINR_e_PwrPanel_LEDA_FailSts, handle-invalid=DONT-INVALIDATE}  # -
      data VeLINR_e_PwrPanel_LEDA_FailSts: category=VALUE, sw-calibration-access=READ-ONLY, type=ADTSPwrPanel_LEDA_FailSts, init-value=VeLINR_e_PwrPanel_LEDA_FailStsValue:0
    VeLINR_e_PwrPanel_LEDA_Feedback: service-kind=ANY-STANDARDIZED, invalidation-policy{data-element=VeLINR_e_PwrPanel_LEDA_Feedback, handle-invalid=KEEP}  # -
      data VeLINR_e_PwrPanel_LEDA_Feedback: category=VALUE, sw-calibration-access=READ-ONLY, type=ADTSPwrPanel_LEDA_Feedback, init-value=VeLINR_e_PwrPanel_LEDA_FeedbackValue:0
    VeLINR_e_PwrPanel_LEDB_FailSts: service-kind=ANY-STANDARDIZED, invalidation-policy{data-element=VeLINR_e_PwrPanel_LEDB_FailSts, handle-invalid=DONT-INVALIDATE}  # -
      data VeLINR_e_PwrPanel_LEDB_FailSts: category=VALUE, sw-calibration-access=READ-ONLY, type=ADTSPwrPanel_LEDB_FailSts, init-value=VeLINR_e_PwrPanel_LEDB_FailStsValue:0
    VeLINR_e_PwrPanel_LEDB_Feedback: service-kind=ANY-STANDARDIZED, invalidation-policy{data-element=VeLINR_e_PwrPanel_LEDB_Feedback, handle-invalid=KEEP}  # -
      data VeLINR_e_PwrPanel_LEDB_Feedback: category=VALUE, sw-calibration-access=READ-ONLY, type=ADTSPwrPanel_LEDB_Feedback, init-value=VeLINR_e_PwrPanel_LEDB_FeedbackValue:0
    VeLINR_e_PwrPanel_LEDC_FailSts: service-kind=ANY-STANDARDIZED, invalidation-policy{data-element=VeLINR_e_PwrPanel_LEDC_FailSts, handle-invalid=DONT-INVALIDATE}  # -
      data VeLINR_e_PwrPanel_LEDC_FailSts: category=VALUE, sw-calibration-access=READ-ONLY, type=ADTSPwrPanel_LEDC_FailSts, init-value=VeLINR_e_PwrPanel_LEDC_FailStsValue:0
    VeLINR_e_PwrPanel_LEDC_Feedback: service-kind=ANY-STANDARDIZED, invalidation-policy{data-element=VeLINR_e_PwrPanel_LEDC_Feedback, handle-invalid=KEEP}  # -
      data VeLINR_e_PwrPanel_LEDC_Feedback: category=VALUE, sw-calibration-access=READ-ONLY, type=ADTSPwrPanel_LEDC_Feedback, init-value=VeLINR_e_PwrPanel_LEDC_FeedbackValue:0
    VeLINR_e_S2MResByte1: service-kind=ANY-STANDARDIZED, invalidation-policy{data-element=VeLINR_e_S2MResByte1, handle-invalid=DONT-INVALIDATE}  # -
      data VeLINR_e_S2MResByte1: category=VALUE, sw-calibration-access=READ-ONLY, type=ADTSS2MResByte1, init-value=VeLINR_e_S2MResByte1Value:0
    VeLINR_e_S2MResByte1_AGS2: service-kind=ANY-STANDARDIZED, invalidation-policy{data-element=VeLINR_e_S2MResByte1_AGS2, handle-invalid=DONT-INVALIDATE}  # -
      data VeLINR_e_S2MResByte1_AGS2: category=VALUE, sw-calibration-access=READ-ONLY, type=ADTSS2MResByte1_AGS2, init-value=VeLINR_e_S2MResByte1_AGS2Value:0
    VeLINR_e_S2MResByte2: service-kind=ANY-STANDARDIZED, invalidation-policy{data-element=VeLINR_e_S2MResByte2, handle-invalid=DONT-INVALIDATE}  # -
      data VeLINR_e_S2MResByte2: category=VALUE, sw-calibration-access=READ-ONLY, type=ADTSS2MResByte2, init-value=VeLINR_e_S2MResByte2Value:0
    VeLINR_e_S2MResByte2_AGS2: service-kind=ANY-STANDARDIZED, invalidation-policy{data-element=VeLINR_e_S2MResByte2_AGS2, handle-invalid=DONT-INVALIDATE}  # -
      data VeLINR_e_S2MResByte2_AGS2: category=VALUE, sw-calibration-access=READ-ONLY, type=ADTSS2MResByte2_AGS2, init-value=VeLINR_e_S2MResByte2_AGS2Value:0
    VeLINR_n_CompressorSpd: service-kind=ANY-STANDARDIZED, invalidation-policy{data-element=VeLINR_n_CompressorSpd, handle-invalid=KEEP}  # -
      data VeLINR_n_CompressorSpd: category=VALUE, sw-calibration-access=READ-ONLY, type=ADTSCompressorSpd, init-value=VeLINR_n_CompressorSpdValue:0
    VeLINR_n_CompressorSpd_800: service-kind=ANY-STANDARDIZED, invalidation-policy{data-element=VeLINR_n_CompressorSpd_800, handle-invalid=KEEP}  # -
      data VeLINR_n_CompressorSpd_800: category=VALUE, sw-calibration-access=READ-ONLY, type=ADTSCompressorSpd_800, init-value=VeLINR_n_CompressorSpd_800Value:0
    VeLINR_y_AHP_VERSION: service-kind=ANY-STANDARDIZED, invalidation-policy{data-element=VeLINR_y_AHP_VERSION, handle-invalid=KEEP}  # -
      data VeLINR_y_AHP_VERSION: category=VALUE, sw-calibration-access=READ-ONLY, type=ADTSAHP_VERSION, init-value=VeLINR_y_AHP_VERSIONValue:255
    VeLINR_y_BCP_VERSION: service-kind=ANY-STANDARDIZED, invalidation-policy{data-element=VeLINR_y_BCP_VERSION, handle-invalid=KEEP}  # -
      data VeLINR_y_BCP_VERSION: category=VALUE, sw-calibration-access=READ-ONLY, type=ADTSBCP_VERSION, init-value=VeLINR_y_BCP_VERSIONValue:255
    VeLINR_y_CoolantVal_EcuVoltage: service-kind=ANY-STANDARDIZED, invalidation-policy{data-element=VeLINR_y_CoolantVal_EcuVoltage, handle-invalid=DONT-INVALIDATE}  # -
      data VeLINR_y_CoolantVal_EcuVoltage: category=VALUE, sw-calibration-access=READ-ONLY, type=ADTSCoolantVal_EcuVoltage, init-value=VeLINR_y_CoolantVal_EcuVoltageValue:0
    VeLINR_y_CoolantValve_EcuTemp: service-kind=ANY-STANDARDIZED, invalidation-policy{data-element=VeLINR_y_CoolantValve_EcuTemp, handle-invalid=DONT-INVALIDATE}  # -
      data VeLINR_y_CoolantValve_EcuTemp: category=VALUE, sw-calibration-access=READ-ONLY, type=ADTSCoolantValve_EcuTemp, init-value=VeLINR_y_CoolantValve_EcuTempValue:-40
    VeLINR_y_EOPA_HW_VER: service-kind=ANY-STANDARDIZED, invalidation-policy{data-element=VeLINR_y_EOPA_HW_VER, handle-invalid=KEEP}  # -
      data VeLINR_y_EOPA_HW_VER: category=VALUE, sw-calibration-access=READ-ONLY, type=ADTSEOPA_HW_VER, init-value=VeLINR_y_EOPA_HW_VERValue:255
    VeLINR_y_EOPA_SW_VER: service-kind=ANY-STANDARDIZED, invalidation-policy{data-element=VeLINR_y_EOPA_SW_VER, handle-invalid=KEEP}  # -
      data VeLINR_y_EOPA_SW_VER: category=VALUE, sw-calibration-access=READ-ONLY, type=ADTSEOPA_SW_VER, init-value=VeLINR_y_EOPA_SW_VERValue:255
    VeLINR_y_EOPB_HW_VER: service-kind=ANY-STANDARDIZED, invalidation-policy{data-element=VeLINR_y_EOPB_HW_VER, handle-invalid=KEEP}  # -
      data VeLINR_y_EOPB_HW_VER: category=VALUE, sw-calibration-access=READ-ONLY, type=ADTSEOPB_HW_VER, init-value=VeLINR_y_EOPB_HW_VERValue:255
    VeLINR_y_EOPB_SW_VER: service-kind=ANY-STANDARDIZED, invalidation-policy{data-element=VeLINR_y_EOPB_SW_VER, handle-invalid=KEEP}  # -
      data VeLINR_y_EOPB_SW_VER: category=VALUE, sw-calibration-access=READ-ONLY, type=ADTSEOPB_SW_VER, init-value=VeLINR_y_EOPB_SW_VERValue:255
    VeLINR_y_PECP2_VERSION: service-kind=ANY-STANDARDIZED, invalidation-policy{data-element=VeLINR_y_PECP2_VERSION, handle-invalid=KEEP}  # -
      data VeLINR_y_PECP2_VERSION: category=VALUE, sw-calibration-access=READ-ONLY, type=ADTSPECP2_VERSION, init-value=VeLINR_y_PECP2_VERSIONValue:255
    VeLINR_y_PECP_VERSION: service-kind=ANY-STANDARDIZED, invalidation-policy{data-element=VeLINR_y_PECP_VERSION, handle-invalid=KEEP}  # -
      data VeLINR_y_PECP_VERSION: category=VALUE, sw-calibration-access=READ-ONLY, type=ADTSPECP_VERSION, init-value=VeLINR_y_PECP_VERSIONValue:255
    VeLINR_y_PowerPanel2_RatedPower: service-kind=ANY-STANDARDIZED, invalidation-policy{data-element=VeLINR_y_PowerPanel2_RatedPower, handle-invalid=DONT-INVALIDATE}  # -
      data VeLINR_y_PowerPanel2_RatedPower: category=VALUE, sw-calibration-access=READ-ONLY, type=ADTSPowerPanel2_RatedPower, init-value=VeLINR_y_PowerPanel2_RatedPowerValue:0
    VeLINR_y_PowerPanel_RatedPower: service-kind=ANY-STANDARDIZED, invalidation-policy{data-element=VeLINR_y_PowerPanel_RatedPower, handle-invalid=DONT-INVALIDATE}  # -
      data VeLINR_y_PowerPanel_RatedPower: category=VALUE, sw-calibration-access=READ-ONLY, type=ADTSPowerPanel_RatedPower, init-value=VeLINR_y_PowerPanel_RatedPowerValue:0
