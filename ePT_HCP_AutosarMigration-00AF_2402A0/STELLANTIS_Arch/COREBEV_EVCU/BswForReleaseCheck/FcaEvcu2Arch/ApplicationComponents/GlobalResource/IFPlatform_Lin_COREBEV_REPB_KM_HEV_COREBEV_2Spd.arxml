[part 1 of 2: packages /MDG_LinEquid to /STLASharedInterfaces/IFCOEs/IFPlatform_Lin]
AUTOSAR XML (schema 4-3-0)
package /MDG_LinEquid
  mode declaration group MDG_Lin1Equid: category=EXPLICIT_ORDER, initial-mode=Lin1Equid_FALSE, on-transition-value=2
    mode Lin1Equid_FALSE: value=0
    mode Lin1Equid_TRUE: value=1
  mode declaration group MDG_Lin2Equid: category=EXPLICIT_ORDER, initial-mode=Lin2Equid_FALSE, on-transition-value=2
    mode Lin2Equid_FALSE: value=0
    mode Lin2Equid_TRUE: value=1
  mode declaration group MDG_Lin3Equid: category=EXPLICIT_ORDER, initial-mode=Lin3Equid_FALSE, on-transition-value=2
    mode Lin3Equid_FALSE: value=0
    mode Lin3Equid_TRUE: value=1
  data type mapping set MG_LinEquid_Mapping
    mode-request-type-maps:
      implementation-data-type=uint8, mode-group=MDG_Lin{1..3}Equid
  mode switch interface MSI_Lin1Equid
    mode group MDGP_MSI_Lin1Equid: type=MDG_Lin1Equid
  mode switch interface MSI_Lin2Equid
    mode group MDGP_MSI_Lin2Equid: type=MDG_Lin2Equid
  mode switch interface MSI_Lin3Equid
    mode group MDGP_MSI_Lin3Equid: type=MDG_Lin3Equid
package /MSI_LinSMComMod
  mode declaration group MDG_LinSMComMod: category=EXPLICIT_ORDER, initial-mode=LinSMComMod_NO_COMM, on-transition-value=2
    mode LinSMComMod_FULL_COMM: value=1
    mode LinSMComMod_NO_COMM: value=0
  mode switch interface MSI_LinSMComMod
    mode group MDGP_MSI_LinSMComMod: type=MDG_LinSMComMod
package /STLASharedInterfaces/IFCOEs/IFPlatform_Lin
  972 x sender receiver interface:
    SendLINR_AAD_CalRq: service-kind=ANY-STANDARDIZED, invalidation-policy{data-element=SendLINR_AAD_CalRq, handle-invalid=DONT-INVALIDATE}
      data SendLINR_AAD_CalRq: category=VALUE, sw-calibration-access=READ-ONLY, type=ADTSBoolean, init-value=SendLINR_AAD_CalRqValue:0
    SendLINR_AAD_CalRqVld: service-kind=ANY-STANDARDIZED, invalidation-policy{data-element=SendLINR_AAD_CalRqVld, handle-invalid=DONT-INVALIDATE}  # Valid
      data SendLINR_AAD_CalRqVld: category=VALUE, sw-calibration-access=READ-ONLY, type=ADTSBoolean, init-value=SendLINR_AAD_CalRqVldValue:1
    SendLINR_AAD_InitialIP_CalRq: service-kind=ANY-STANDARDIZED, invalidation-policy{data-element=SendLINR_AAD_InitialIP_CalRq, handle-invalid=DONT-INVALIDATE}
      data SendLINR_AAD_InitialIP_CalRq: category=VALUE, sw-calibration-access=READ-ONLY, type=ADTSBoolean, init-value=0
    SendLINR_AAD_InitialIP_CalRqVld: service-kind=ANY-STANDARDIZED, invalidation-policy{data-element=SendLINR_AAD_InitialIP_CalRqVld, handle-invalid=DONT-INVALIDATE}  # Valid
      data SendLINR_AAD_InitialIP_CalRqVld: category=VALUE, sw-calibration-access=READ-ONLY, type=ADTSBoolean, init-value=1
    SendLINR_AAD_PosRq: service-kind=ANY-STANDARDIZED, invalidation-policy{data-element=SendLINR_AAD_PosRq, handle-invalid=KEEP}
      data SendLINR_AAD_PosRq: category=VALUE, sw-calibration-access=READ-ONLY, type=ADTSAAD_PosRq, init-value=SendLINR_AAD_PosRqValue:15
    SendLINR_AAD_PosRqVld: service-kind=ANY-STANDARDIZED, invalidation-policy{data-element=SendLINR_AAD_PosRqVld, handle-invalid=DONT-INVALIDATE}  # Valid
      data SendLINR_AAD_PosRqVld: category=VALUE, sw-calibration-access=READ-ONLY, type=ADTSBoolean, init-value=SendLINR_AAD_PosRqVldValue:1
    SendLINR_AGS2_BoostRq: service-kind=ANY-STANDARDIZED, invalidation-policy{data-element=SendLINR_AGS2_BoostRq, handle-invalid=DONT-INVALIDATE}
      data SendLINR_AGS2_BoostRq: category=VALUE, sw-calibration-access=READ-ONLY, type=ADTSBoolean, init-value=SendLINR_AGS2_BoostRqValue:0
    SendLINR_AGS2_BoostRqVld: service-kind=ANY-STANDARDIZED, invalidation-policy{data-element=SendLINR_AGS2_BoostRqVld, handle-invalid=DONT-INVALIDATE}  # Valid
      data SendLINR_AGS2_BoostRqVld: category=VALUE, sw-calibration-access=READ-ONLY, type=ADTSBoolean, init-value=SendLINR_AGS2_BoostRqVldValue:1
    SendLINR_AGS2_CalRq: service-kind=ANY-STANDARDIZED, invalidation-policy{data-element=SendLINR_AGS2_CalRq, handle-invalid=DONT-INVALIDATE}
      data SendLINR_AGS2_CalRq: category=VALUE, sw-calibration-access=READ-ONLY, type=ADTSBoolean, init-value=SendLINR_AGS2_CalRqValue:0
    SendLINR_AGS2_CalRqVld: service-kind=ANY-STANDARDIZED, invalidation-policy{data-element=SendLINR_AGS2_CalRqVld, handle-invalid=DONT-INVALIDATE}  # Valid
      data SendLINR_AGS2_CalRqVld: category=VALUE, sw-calibration-access=READ-ONLY, type=ADTSBoolean, init-value=SendLINR_AGS2_CalRqVldValue:1
    SendLINR_AGS2_PosRq: service-kind=ANY-STANDARDIZED, invalidation-policy{data-element=SendLINR_AGS2_PosRq, handle-invalid=KEEP}
      data SendLINR_AGS2_PosRq: category=VALUE, sw-calibration-access=READ-ONLY, type=ADTSAGS2_PosRq, init-value=SendLINR_AGS2_PosRqValue:0
    SendLINR_AGS2_PosRqVld: service-kind=ANY-STANDARDIZED, invalidation-policy{data-element=SendLINR_AGS2_PosRqVld, handle-invalid=DONT-INVALIDATE}  # Valid
      data SendLINR_AGS2_PosRqVld: category=VALUE, sw-calibration-access=READ-ONLY, type=ADTSBoolean, init-value=SendLINR_AGS2_PosRqVldValue:1
    SendLINR_AGS_BoostRq: service-kind=ANY-STANDARDIZED, invalidation-policy{data-element=SendLINR_AGS_BoostRq, handle-invalid=DONT-INVALIDATE}
      data SendLINR_AGS_BoostRq: category=VALUE, sw-calibration-access=READ-ONLY, type=ADTSBoolean, init-value=SendLINR_AGS_BoostRqValue:0
    SendLINR_AGS_BoostRqVld: service-kind=ANY-STANDARDIZED, invalidation-policy{data-element=SendLINR_AGS_BoostRqVld, handle-invalid=DONT-INVALIDATE}  # Valid
      data SendLINR_AGS_BoostRqVld: category=VALUE, sw-calibration-access=READ-ONLY, type=ADTSBoolean, init-value=SendLINR_AGS_BoostRqVldValue:1
    SendLINR_AGS_CalRq: service-kind=ANY-STANDARDIZED, invalidation-policy{data-element=SendLINR_AGS_CalRq, handle-invalid=DONT-INVALIDATE}
      data SendLINR_AGS_CalRq: category=VALUE, sw-calibration-access=READ-ONLY, type=ADTSBoolean, init-value=SendLINR_AGS_CalRqValue:0
    SendLINR_AGS_CalRqVld: service-kind=ANY-STANDARDIZED, invalidation-policy{data-element=SendLINR_AGS_CalRqVld, handle-invalid=DONT-INVALIDATE}  # Valid
      data SendLINR_AGS_CalRqVld: category=VALUE, sw-calibration-access=READ-ONLY, type=ADTSBoolean, init-value=SendLINR_AGS_CalRqVldValue:1
    SendLINR_AGS_PosRq: service-kind=ANY-STANDARDIZED, invalidation-policy{data-element=SendLINR_AGS_PosRq, handle-invalid=KEEP}
      data SendLINR_AGS_PosRq: category=VALUE, sw-calibration-access=READ-ONLY, type=ADTSAGS_PosRq, init-value=SendLINR_AGS_PosRqValue:0
    SendLINR_AGS_PosRqVld: service-kind=ANY-STANDARDIZED, invalidation-policy{data-element=SendLINR_AGS_PosRqVld, handle-invalid=DONT-INVALIDATE}  # Valid
      data SendLINR_AGS_PosRqVld: category=VALUE, sw-calibration-access=READ-ONLY, type=ADTSBoolean, init-value=SendLINR_AGS_PosRqVldValue:1
    SendLINR_AHP_FL_SAFE_ACTVT: service-kind=ANY-STANDARDIZED, invalidation-policy{data-element=SendLINR_AHP_FL_SAFE_ACTVT, handle-invalid=KEEP}
      data SendLINR_AHP_FL_SAFE_ACTVT: category=VALUE, sw-calibration-access=READ-ONLY, type=ADTSAHP_FL_SAFE_ACTVT, init-value=SendLINR_AHP_FL_SAFE_ACTVTValue:3
    SendLINR_AHP_FL_SAFE_ACTVT_Vld: service-kind=ANY-STANDARDIZED, invalidation-policy{data-element=SendLINR_AHP_FL_SAFE_ACTVT_Vld, handle-invalid=DONT-INVALIDATE}  # Valid
      data SendLINR_AHP_FL_SAFE_ACTVT_Vld: category=VALUE, sw-calibration-access=READ-ONLY, type=ADTSBoolean, init-value=SendLINR_AHP_FL_SAFE_ACTVT_VldValue:1
    SendLINR_AHP_POST_RUN_REQ: service-kind=ANY-STANDARDIZED, invalidation-policy{data-element=SendLINR_AHP_POST_RUN_REQ, handle-invalid=KEEP}
      data SendLINR_AHP_POST_RUN_REQ: category=VALUE, sw-calibration-access=READ-ONLY, type=ADTSAHP_POST_RUN_REQ, init-value=SendLINR_AHP_POST_RUN_REQValue:7
    SendLINR_AHP_POST_RUN_REQ_Vld: service-kind=ANY-STANDARDIZED, invalidation-policy{data-element=SendLINR_AHP_POST_RUN_REQ_Vld, handle-invalid=DONT-INVALIDATE}  # Valid
      data SendLINR_AHP_POST_RUN_REQ_Vld: category=VALUE, sw-calibration-access=READ-ONLY, type=ADTSBoolean, init-value=SendLINR_AHP_POST_RUN_REQ_VldValue:1
    SendLINR_AHP_RPM_REQ_PERCT: service-kind=ANY-STANDARDIZED, invalidation-policy{data-element=SendLINR_AHP_RPM_REQ_PERCT, handle-invalid=KEEP}
      data SendLINR_AHP_RPM_REQ_PERCT: category=VALUE, sw-calibration-access=READ-ONLY, type=ADTSAHP_RPM_REQ_PERCT, init-value=SendLINR_AHP_RPM_REQ_PERCTValue:100.3935
    SendLINR_AHP_RPM_REQ_PERCT_Vld: service-kind=ANY-STANDARDIZED, invalidation-policy{data-element=SendLINR_AHP_RPM_REQ_PERCT_Vld, handle-invalid=DONT-INVALIDATE}  # Valid
      data SendLINR_AHP_RPM_REQ_PERCT_Vld: category=VALUE, sw-calibration-access=READ-ONLY, type=ADTSBoolean, init-value=SendLINR_AHP_RPM_REQ_PERCT_VldValue:1
    SendLINR_AirHeatrEnad: service-kind=ANY-STANDARDIZED, invalidation-policy{data-element=SendLINR_AirHeatrEnad, handle-invalid=DONT-INVALIDATE}
      data SendLINR_AirHeatrEnad: category=VALUE, sw-calibration-access=READ-ONLY, type=ADTSBoolean, init-value=SendLINR_AirHeatrEnadValue:0
    SendLINR_AirHeatrEnadVld: service-kind=ANY-STANDARDIZED, invalidation-policy{data-element=SendLINR_AirHeatrEnadVld, handle-invalid=DONT-INVALIDATE}  # Valid
      data SendLINR_AirHeatrEnadVld: category=VALUE, sw-calibration-access=READ-ONLY, type=ADTSBoolean, init-value=SendLINR_AirHeatrEnadVldValue:1
    SendLINR_AirHeatrPwrTgt: service-kind=ANY-STANDARDIZED, invalidation-policy{data-element=SendLINR_AirHeatrPwrTgt, handle-invalid=KEEP}
      data SendLINR_AirHeatrPwrTgt: category=VALUE, sw-calibration-access=READ-ONLY, type=ADTSAirHeatrPwrTgt, init-value=SendLINR_AirHeatrPwrTgtValue:255
    SendLINR_AirHeatrPwrTgtVld: service-kind=ANY-STANDARDIZED, invalidation-policy{data-element=SendLINR_AirHeatrPwrTgtVld, handle-invalid=DONT-INVALIDATE}  # Valid
      data SendLINR_AirHeatrPwrTgtVld: category=VALUE, sw-calibration-access=READ-ONLY, type=ADTSBoolean, init-value=SendLINR_AirHeatrPwrTgtVldValue:1
    SendLINR_BCP_FL_SAFE_ACTVT: service-kind=ANY-STANDARDIZED, invalidation-policy{data-element=SendLINR_BCP_FL_SAFE_ACTVT, handle-invalid=KEEP}
      data SendLINR_BCP_FL_SAFE_ACTVT: category=VALUE, sw-calibration-access=READ-ONLY, type=ADTSBCP_FL_SAFE_ACTVT, init-value=SendLINR_BCP_FL_SAFE_ACTVTValue:3
    SendLINR_BCP_FL_SAFE_ACTVT_Vld: service-kind=ANY-STANDARDIZED, invalidation-policy{data-element=SendLINR_BCP_FL_SAFE_ACTVT_Vld, handle-invalid=DONT-INVALIDATE}  # Valid
      data SendLINR_BCP_FL_SAFE_ACTVT_Vld: category=VALUE, sw-calibration-access=READ-ONLY, type=ADTSBoolean, init-value=SendLINR_BCP_FL_SAFE_ACTVT_VldValue:1
    SendLINR_BCP_POST_RUN_REQ: service-kind=ANY-STANDARDIZED, invalidation-policy{data-element=SendLINR_BCP_POST_RUN_REQ, handle-invalid=KEEP}
      data SendLINR_BCP_POST_RUN_REQ: category=VALUE, sw-calibration-access=READ-ONLY, type=ADTSBCP_POST_RUN_REQ, init-value=SendLINR_BCP_POST_RUN_REQValue:7
    SendLINR_BCP_POST_RUN_REQ_Vld: service-kind=ANY-STANDARDIZED, invalidation-policy{data-element=SendLINR_BCP_POST_RUN_REQ_Vld, handle-invalid=DONT-INVALIDATE}  # Valid
      data SendLINR_BCP_POST_RUN_REQ_Vld: category=VALUE, sw-calibration-access=READ-ONLY, type=ADTSBoolean, init-value=SendLINR_BCP_POST_RUN_REQ_VldValue:1
    SendLINR_BCP_RPM_REQ: service-kind=ANY-STANDARDIZED, invalidation-policy{data-element=SendLINR_BCP_RPM_REQ, handle-invalid=KEEP}
      data SendLINR_BCP_RPM_REQ: category=VALUE, sw-calibration-access=READ-ONLY, type=ADTSBCP_RPM_REQ, init-value=SendLINR_BCP_RPM_REQValue:100.3935
    SendLINR_BCP_RPM_REQ_Vld: service-kind=ANY-STANDARDIZED, invalidation-policy{data-element=SendLINR_BCP_RPM_REQ_Vld, handle-invalid=DONT-INVALIDATE}  # Valid
      data SendLINR_BCP_RPM_REQ_Vld: category=VALUE, sw-calibration-access=READ-ONLY, type=ADTSBoolean, init-value=SendLINR_BCP_RPM_REQ_VldValue:1
    SendLINR_BHV_CalRq: service-kind=ANY-STANDARDIZED, invalidation-policy{data-element=SendLINR_BHV_CalRq, handle-invalid=DONT-INVALIDATE}
      data SendLINR_BHV_CalRq: category=VALUE, sw-calibration-access=READ-ONLY, type=ADTSBHV_CalRq, init-value=SendLINR_BHV_CalRqValue:0
    SendLINR_BHV_CalRqVld: service-kind=ANY-STANDARDIZED, invalidation-policy{data-element=SendLINR_BHV_CalRqVld, handle-invalid=DONT-INVALIDATE}  # Valid
      data SendLINR_BHV_CalRqVld: category=VALUE, sw-calibration-access=READ-ONLY, type=ADTSBoolean, init-value=SendLINR_BHV_CalRqVldValue:1
    SendLINR_BHV_PosRq: service-kind=ANY-STANDARDIZED, invalidation-policy{data-element=SendLINR_BHV_PosRq, handle-invalid=DONT-INVALIDATE}
      data SendLINR_BHV_PosRq: category=VALUE, sw-calibration-access=READ-ONLY, type=ADTSBHV_PosRq, init-value=SendLINR_BHV_PosRqValue:0
    SendLINR_BHV_PosRqVld: service-kind=ANY-STANDARDIZED, invalidation-policy{data-element=SendLINR_BHV_PosRqVld, handle-invalid=DONT-INVALIDATE}  # Valid
      data SendLINR_BHV_PosRqVld: category=VALUE, sw-calibration-access=READ-ONLY, type=ADTSBoolean, init-value=SendLINR_BHV_PosRqVldValue:1
    SendLINR_BHV_PosSv: service-kind=ANY-STANDARDIZED, invalidation-policy{data-element=SendLINR_BHV_PosSv, handle-invalid=DONT-INVALIDATE}
      data SendLINR_BHV_PosSv: category=VALUE, sw-calibration-access=READ-ONLY, type=ADTSBoolean, init-value=SendLINR_BHV_PosSvValue:0
    SendLINR_BHV_PosSvVld: service-kind=ANY-STANDARDIZED, invalidation-policy{data-element=SendLINR_BHV_PosSvVld, handle-invalid=DONT-INVALIDATE}  # Valid
      data SendLINR_BHV_PosSvVld: category=VALUE, sw-calibration-access=READ-ONLY, type=ADTSBoolean, init-value=SendLINR_BHV_PosSvVldValue:1
    SendLINR_Backlight_Cmd: service-kind=ANY-STANDARDIZED, invalidation-policy{data-element=SendLINR_Backlight_Cmd, handle-invalid=DONT-INVALIDATE}
      data SendLINR_Backlight_Cmd: category=VALUE, sw-calibration-access=READ-ONLY, type=ADTSBoolean, init-value=SendLINR_Backlight_CmdValue:0
    SendLINR_Backlight_CmdVld: service-kind=ANY-STANDARDIZED, invalidation-policy{data-element=SendLINR_Backlight_CmdVld, handle-invalid=DONT-INVALIDATE}  # Valid
      data SendLINR_Backlight_CmdVld: category=VALUE, sw-calibration-access=READ-ONLY, type=ADTSBoolean, init-value=SendLINR_Backlight_CmdVldValue:1
    SendLINR_CEXV_CalCmd: service-kind=ANY-STANDARDIZED, invalidation-policy{data-element=SendLINR_CEXV_CalCmd, handle-invalid=DONT-INVALIDATE}
      data SendLINR_CEXV_CalCmd: category=VALUE, sw-calibration-access=READ-ONLY, type=ADTSCEXV_CalCmd, init-value=SendLINR_CEXV_CalCmdValue:0
    SendLINR_CEXV_CalCmdVld: service-kind=ANY-STANDARDIZED, invalidation-policy{data-element=SendLINR_CEXV_CalCmdVld, handle-invalid=DONT-INVALIDATE}  # Valid
      data SendLINR_CEXV_CalCmdVld: category=VALUE, sw-calibration-access=READ-ONLY, type=ADTSBoolean, init-value=SendLINR_CEXV_CalCmdVldValue:1
    SendLINR_CEXV_PosRq: service-kind=ANY-STANDARDIZED, invalidation-policy{data-element=SendLINR_CEXV_PosRq, handle-invalid=KEEP}
      data SendLINR_CEXV_PosRq: category=VALUE, sw-calibration-access=READ-ONLY, type=ADTSCEXV_PosRq, init-value=SendLINR_CEXV_PosRqValue:0
    SendLINR_CEXV_PosRqVld: service-kind=ANY-STANDARDIZED, invalidation-policy{data-element=SendLINR_CEXV_PosRqVld, handle-invalid=DONT-INVALIDATE}  # Valid
      data SendLINR_CEXV_PosRqVld: category=VALUE, sw-calibration-access=READ-ONLY, type=ADTSBoolean, init-value=SendLINR_CEXV_PosRqVldValue:1
    SendLINR_CPIM_Blink_Rate: service-kind=ANY-STANDARDIZED, invalidation-policy{data-element=SendLINR_CPIM_Blink_Rate, handle-invalid=KEEP}
      data SendLINR_CPIM_Blink_Rate: category=VALUE, sw-calibration-access=READ-ONLY, type=ADTSCPIM_Blink_Rate, init-value=SendLINR_CPIM_Blink_RateValue:0
    SendLINR_CPIM_Blink_RateVld: service-kind=ANY-STANDARDIZED, invalidation-policy{data-element=SendLINR_CPIM_Blink_RateVld, handle-invalid=DONT-INVALIDATE}  # Valid
      data SendLINR_CPIM_Blink_RateVld: category=VALUE, sw-calibration-access=READ-ONLY, type=ADTSBoolean, init-value=SendLINR_CPIM_Blink_RateVldValue:1
    SendLINR_CPIM_IND_Color: service-kind=ANY-STANDARDIZED, invalidation-policy{data-element=SendLINR_CPIM_IND_Color, handle-invalid=KEEP}
      data SendLINR_CPIM_IND_Color: category=VALUE, sw-calibration-access=READ-ONLY, type=ADTSCPIM_IND_Color, init-value=SendLINR_CPIM_IND_ColorValue:0
    SendLINR_CPIM_IND_ColorVld: service-kind=ANY-STANDARDIZED, invalidation-policy{data-element=SendLINR_CPIM_IND_ColorVld, handle-invalid=DONT-INVALIDATE}  # Valid
      data SendLINR_CPIM_IND_ColorVld: category=VALUE, sw-calibration-access=READ-ONLY, type=ADTSBoolean, init-value=SendLINR_CPIM_IND_ColorVldValue:1
    SendLINR_CPIM_SET_IND1: service-kind=ANY-STANDARDIZED, invalidation-policy{data-element=SendLINR_CPIM_SET_IND1, handle-invalid=KEEP}
      data SendLINR_CPIM_SET_IND1: category=VALUE, sw-calibration-access=READ-ONLY, type=ADTSCPIM_SET_IND1, init-value=SendLINR_CPIM_SET_IND1Value:0
    SendLINR_CPIM_SET_IND1Vld: service-kind=ANY-STANDARDIZED, invalidation-policy{data-element=SendLINR_CPIM_SET_IND1Vld, handle-invalid=DONT-INVALIDATE}  # Valid
      data SendLINR_CPIM_SET_IND1Vld: category=VALUE, sw-calibration-access=READ-ONLY, type=ADTSBoolean, init-value=SendLINR_CPIM_SET_IND1VldValue:1
    SendLINR_CPIM_SET_IND2: service-kind=ANY-STANDARDIZED, invalidation-policy{data-element=SendLINR_CPIM_SET_IND2, handle-invalid=KEEP}
      data SendLINR_CPIM_SET_IND2: category=VALUE, sw-calibration-access=READ-ONLY, type=ADTSCPIM_SET_IND2, init-value=SendLINR_CPIM_SET_IND2Value:0
    SendLINR_CPIM_SET_IND2Vld: service-kind=ANY-STANDARDIZED, invalidation-policy{data-element=SendLINR_CPIM_SET_IND2Vld, handle-invalid=DONT-INVALIDATE}  # Valid
      data SendLINR_CPIM_SET_IND2Vld: category=VALUE, sw-calibration-access=READ-ONLY, type=ADTSBoolean, init-value=SendLINR_CPIM_SET_IND2VldValue:1
    SendLINR_CPIM_SET_IND3: service-kind=ANY-STANDARDIZED, invalidation-policy{data-element=SendLINR_CPIM_SET_IND3, handle-invalid=KEEP}
      data SendLINR_CPIM_SET_IND3: category=VALUE, sw-calibration-access=READ-ONLY, type=ADTSCPIM_SET_IND3, init-value=SendLINR_CPIM_SET_IND3Value:0
    SendLINR_CPIM_SET_IND3Vld: service-kind=ANY-STANDARDIZED, invalidation-policy{data-element=SendLINR_CPIM_SET_IND3Vld, handle-invalid=DONT-INVALIDATE}  # Valid
      data SendLINR_CPIM_SET_IND3Vld: category=VALUE, sw-calibration-access=READ-ONLY, type=ADTSBoolean, init-value=SendLINR_CPIM_SET_IND3VldValue:1
    SendLINR_CPIM_SET_IND4: service-kind=ANY-STANDARDIZED, invalidation-policy{data-element=SendLINR_CPIM_SET_IND4, handle-invalid=KEEP}
      data SendLINR_CPIM_SET_IND4: category=VALUE, sw-calibration-access=READ-ONLY, type=ADTSCPIM_SET_IND4, init-value=SendLINR_CPIM_SET_IND4Value:0
    SendLINR_CPIM_SET_IND4Vld: service-kind=ANY-STANDARDIZED, invalidation-policy{data-element=SendLINR_CPIM_SET_IND4Vld, handle-invalid=DONT-INVALIDATE}  # Valid
      data SendLINR_CPIM_SET_IND4Vld: category=VALUE, sw-calibration-access=READ-ONLY, type=ADTSBoolean, init-value=SendLINR_CPIM_SET_IND4VldValue:1
    SendLINR_CPIM_SET_IND5: service-kind=ANY-STANDARDIZED, invalidation-policy{data-element=SendLINR_CPIM_SET_IND5, handle-invalid=KEEP}
      data SendLINR_CPIM_SET_IND5: category=VALUE, sw-calibration-access=READ-ONLY, type=ADTSCPIM_SET_IND5, init-value=SendLINR_CPIM_SET_IND5Value:0
    SendLINR_CPIM_SET_IND5Vld: service-kind=ANY-STANDARDIZED, invalidation-policy{data-element=SendLINR_CPIM_SET_IND5Vld, handle-invalid=DONT-INVALIDATE}  # Valid
      data SendLINR_CPIM_SET_IND5Vld: category=VALUE, sw-calibration-access=READ-ONLY, type=ADTSBoolean, init-value=SendLINR_CPIM_SET_IND5VldValue:1
    SendLINR_CPV_CalRq: service-kind=ANY-STANDARDIZED, invalidation-policy{data-element=SendLINR_CPV_CalRq, handle-invalid=DONT-INVALIDATE}
      data SendLINR_CPV_CalRq: category=VALUE, sw-calibration-access=READ-ONLY, type=ADTSCPV_CalRq, init-value=SendLINR_CPV_CalRqValue:0
    SendLINR_CPV_CalRqVld: service-kind=ANY-STANDARDIZED, invalidation-policy{data-element=SendLINR_CPV_CalRqVld, handle-invalid=DONT-INVALIDATE}  # Valid
      data SendLINR_CPV_CalRqVld: category=VALUE, sw-calibration-access=READ-ONLY, type=ADTSBoolean, init-value=SendLINR_CPV_CalRqVldValue:1
    SendLINR_CPV_PosRq: service-kind=ANY-STANDARDIZED, invalidation-policy{data-element=SendLINR_CPV_PosRq, handle-invalid=DONT-INVALIDATE}
      data SendLINR_CPV_PosRq: category=VALUE, sw-calibration-access=READ-ONLY, type=ADTSCPV_PosRq, init-value=SendLINR_CPV_PosRqValue:0
    SendLINR_CPV_PosRqVld: service-kind=ANY-STANDARDIZED, invalidation-policy{data-element=SendLINR_CPV_PosRqVld, handle-invalid=DONT-INVALIDATE}  # Valid
      data SendLINR_CPV_PosRqVld: category=VALUE, sw-calibration-access=READ-ONLY, type=ADTSBoolean, init-value=SendLINR_CPV_PosRqVldValue:1
    SendLINR_CPV_PosSv: service-kind=ANY-STANDARDIZED, invalidation-policy{data-element=SendLINR_CPV_PosSv, handle-invalid=DONT-INVALIDATE}
      data SendLINR_CPV_PosSv: category=VALUE, sw-calibration-access=READ-ONLY, type=ADTSBoolean, init-value=SendLINR_CPV_PosSvValue:0
    SendLINR_CPV_PosSvVld: service-kind=ANY-STANDARDIZED, invalidation-policy{data-element=SendLINR_CPV_PosSvVld, handle-invalid=DONT-INVALIDATE}  # Valid
      data SendLINR_CPV_PosSvVld: category=VALUE, sw-calibration-access=READ-ONLY, type=ADTSBoolean, init-value=SendLINR_CPV_PosSvVldValue:1
    SendLINR_ChrgPortLock_Cmd: service-kind=ANY-STANDARDIZED, invalidation-policy{data-element=SendLINR_ChrgPortLock_Cmd, handle-invalid=KEEP}
      data SendLINR_ChrgPortLock_Cmd: category=VALUE, sw-calibration-access=READ-ONLY, type=ADTSChrgPortLock_Cmd, init-value=SendLINR_ChrgPortLock_CmdValue:0
    SendLINR_ChrgPortLock_CmdVld: service-kind=ANY-STANDARDIZED, invalidation-policy{data-element=SendLINR_ChrgPortLock_CmdVld, handle-invalid=DONT-INVALIDATE}  # Valid
      data SendLINR_ChrgPortLock_CmdVld: category=VALUE, sw-calibration-access=READ-ONLY, type=ADTSBoolean, init-value=SendLINR_ChrgPortLock_CmdVldValue:1
    SendLINR_CompEnable: service-kind=ANY-STANDARDIZED, invalidation-policy{data-element=SendLINR_CompEnable, handle-invalid=KEEP}
      data SendLINR_CompEnable: category=VALUE, sw-calibration-access=READ-ONLY, type=ADTSCompEnable, init-value=SendLINR_CompEnableValue:3
    SendLINR_CompEnableVld: service-kind=ANY-STANDARDIZED, invalidation-policy{data-element=SendLINR_CompEnableVld, handle-invalid=DONT-INVALIDATE}  # Valid
      data SendLINR_CompEnableVld: category=VALUE, sw-calibration-access=READ-ONLY, type=ADTSBoolean, init-value=SendLINR_CompEnableVldValue:1
    SendLINR_CompressorSpdReq: service-kind=ANY-STANDARDIZED, invalidation-policy{data-element=SendLINR_CompressorSpdReq, handle-invalid=KEEP}
      data SendLINR_CompressorSpdReq: category=VALUE, sw-calibration-access=READ-ONLY, type=ADTSCompressorSpdReq, init-value=SendLINR_CompressorSpdReqValue:0
    SendLINR_CompressorSpdReqVld: service-kind=ANY-STANDARDIZED, invalidation-policy{data-element=SendLINR_CompressorSpdReqVld, handle-invalid=DONT-INVALIDATE}  # Valid
      data SendLINR_CompressorSpdReqVld: category=VALUE, sw-calibration-access=READ-ONLY, type=ADTSBoolean, init-value=SendLINR_CompressorSpdReqVldValue:1
    SendLINR_Control_BlockDetEnbl: service-kind=ANY-STANDARDIZED, invalidation-policy{data-element=SendLINR_Control_BlockDetEnbl, handle-invalid=DONT-INVALIDATE}
      data SendLINR_Control_BlockDetEnbl: category=VALUE, sw-calibration-access=READ-ONLY, type=ADTSControl_BlockDetEnbl, init-value=SendLINR_Control_BlockDetEnblValue:0
    SendLINR_Control_BlockDetEnblVld: service-kind=ANY-STANDARDIZED, invalidation-policy{data-element=SendLINR_Control_BlockDetEnblVld, handle-invalid=DONT-INVALIDATE}  # Valid
      data SendLINR_Control_BlockDetEnblVld: category=VALUE, sw-calibration-access=READ-ONLY, type=ADTSBoolean, init-value=SendLINR_Control_BlockDetEnblVldValue:1
    SendLINR_Control_DiagFunctnVal: service-kind=ANY-STANDARDIZED, invalidation-policy{data-element=SendLINR_Control_DiagFunctnVal, handle-invalid=DONT-INVALIDATE}
      data SendLINR_Control_DiagFunctnVal: category=VALUE, sw-calibration-access=READ-ONLY, type=ADTSControl_DiagFunctnVal, init-value=SendLINR_Control_DiagFunctnValValue:0
    SendLINR_Control_DiagFunctnValVld: service-kind=ANY-STANDARDIZED, invalidation-policy{data-element=SendLINR_Control_DiagFunctnValVld, handle-invalid=DONT-INVALIDATE}  # Valid
      data SendLINR_Control_DiagFunctnValVld: category=VALUE, sw-calibration-access=READ-ONLY, type=ADTSBoolean, init-value=SendLINR_Control_DiagFunctnValVldValue:1
    SendLINR_Control_Reserved1: service-kind=ANY-STANDARDIZED, invalidation-policy{data-element=SendLINR_Control_Reserved1, handle-invalid=DONT-INVALIDATE}
      data SendLINR_Control_Reserved1: category=VALUE, sw-calibration-access=READ-ONLY, type=ADTSControl_Reserved1, init-value=SendLINR_Control_Reserved1Value:0
    SendLINR_Control_Reserved1Vld: service-kind=ANY-STANDARDIZED, invalidation-policy{data-element=SendLINR_Control_Reserved1Vld, handle-invalid=DONT-INVALIDATE}  # Valid
      data SendLINR_Control_Reserved1Vld: category=VALUE, sw-calibration-access=READ-ONLY, type=ADTSBoolean, init-value=SendLINR_Control_Reserved1VldValue:1
    SendLINR_Control_Reserved2: service-kind=ANY-STANDARDIZED, invalidation-policy{data-element=SendLINR_Control_Reserved2, handle-invalid=DONT-INVALIDATE}
      data SendLINR_Control_Reserved2: category=VALUE, sw-calibration-access=READ-ONLY, type=ADTSControl_Reserved2, init-value=SendLINR_Control_Reserved2Value:0
    SendLINR_Control_Reserved2Vld: service-kind=ANY-STANDARDIZED, invalidation-policy{data-element=SendLINR_Control_Reserved2Vld, handle-invalid=DONT-INVALIDATE}  # Valid
      data SendLINR_Control_Reserved2Vld: category=VALUE, sw-calibration-access=READ-ONLY, type=ADTSBoolean, init-value=SendLINR_Control_Reserved2VldValue:1
    SendLINR_Control_Reserved3: service-kind=ANY-STANDARDIZED, invalidation-policy{data-element=SendLINR_Control_Reserved3, handle-invalid=DONT-INVALIDATE}
      data SendLINR_Control_Reserved3: category=VALUE, sw-calibration-access=READ-ONLY, type=ADTSControl_Reserved3, init-value=SendLINR_Control_Reserved3Value:0
    SendLINR_Control_Reserved3Vld: service-kind=ANY-STANDARDIZED, invalidation-policy{data-element=SendLINR_Control_Reserved3Vld, handle-invalid=DONT-INVALIDATE}  # Valid
      data SendLINR_Control_Reserved3Vld: category=VALUE, sw-calibration-access=READ-ONLY, type=ADTSBoolean, init-value=SendLINR_Control_Reserved3VldValue:1
    SendLINR_Control_Reserved4: service-kind=ANY-STANDARDIZED, invalidation-policy{data-element=SendLINR_Control_Reserved4, handle-invalid=DONT-INVALIDATE}
      data SendLINR_Control_Reserved4: category=VALUE, sw-calibration-access=READ-ONLY, type=ADTSControl_Reserved4, init-value=SendLINR_Control_Reserved4Value:0
    SendLINR_Control_Reserved4Vld: service-kind=ANY-STANDARDIZED, invalidation-policy{data-element=SendLINR_Control_Reserved4Vld, handle-invalid=DONT-INVALIDATE}  # Valid
      data SendLINR_Control_Reserved4Vld: category=VALUE, sw-calibration-access=READ-ONLY, type=ADTSBoolean, init-value=SendLINR_Control_Reserved4VldValue:1
    SendLINR_Control_Reserved5: service-kind=ANY-STANDARDIZED, invalidation-policy{data-element=SendLINR_Control_Reserved5, handle-invalid=DONT-INVALIDATE}
      data SendLINR_Control_Reserved5: category=VALUE, sw-calibration-access=READ-ONLY, type=ADTSControl_Reserved5, init-value=SendLINR_Control_Reserved5Value:0
    SendLINR_Control_Reserved5Vld: service-kind=ANY-STANDARDIZED, invalidation-policy{data-element=SendLINR_Control_Reserved5Vld, handle-invalid=DONT-INVALIDATE}  # Valid
      data SendLINR_Control_Reserved5Vld: category=VALUE, sw-calibration-access=READ-ONLY, type=ADTSBoolean, init-value=SendLINR_Control_Reserved5VldValue:1
    SendLINR_Control_Reserved6: service-kind=ANY-STANDARDIZED, invalidation-policy{data-element=SendLINR_Control_Reserved6, handle-invalid=DONT-INVALIDATE}
      data SendLINR_Control_Reserved6: category=VALUE, sw-calibration-access=READ-ONLY, type=ADTSControl_Reserved6, init-value=SendLINR_Control_Reserved6Value:0
    SendLINR_Control_Reserved6Vld: service-kind=ANY-STANDARDIZED, invalidation-policy{data-element=SendLINR_Control_Reserved6Vld, handle-invalid=DONT-INVALIDATE}  # Valid
      data SendLINR_Control_Reserved6Vld: category=VALUE, sw-calibration-access=READ-ONLY, type=ADTSBoolean, init-value=SendLINR_Control_Reserved6VldValue:1
    SendLINR_Control_TargetPos: service-kind=ANY-STANDARDIZED, invalidation-policy{data-element=SendLINR_Control_TargetPos, handle-invalid=DONT-INVALIDATE}
      data SendLINR_Control_TargetPos: category=VALUE, sw-calibration-access=READ-ONLY, type=ADTSControl_TargetPos, init-value=SendLINR_Control_TargetPosValue:0
    SendLINR_Control_TargetPosVld: service-kind=ANY-STANDARDIZED, invalidation-policy{data-element=SendLINR_Control_TargetPosVld, handle-invalid=DONT-INVALIDATE}  # Valid
      data SendLINR_Control_TargetPosVld: category=VALUE, sw-calibration-access=READ-ONLY, type=ADTSBoolean, init-value=SendLINR_Control_TargetPosVldValue:1
    SendLINR_DAY_LGT_MD: service-kind=ANY-STANDARDIZED, invalidation-policy{data-element=SendLINR_DAY_LGT_MD, handle-invalid=DONT-INVALIDATE}
      data SendLINR_DAY_LGT_MD: category=VALUE, sw-calibration-access=READ-ONLY, type=ADTSBoolean, init-value=SendLINR_DAY_LGT_MDValue:0
    SendLINR_DAY_LGT_MD_CPIM: service-kind=ANY-STANDARDIZED, invalidation-policy{data-element=SendLINR_DAY_LGT_MD_CPIM, handle-invalid=DONT-INVALIDATE}
      data SendLINR_DAY_LGT_MD_CPIM: category=VALUE, sw-calibration-access=READ-ONLY, type=ADTSBoolean, init-value=SendLINR_DAY_LGT_MD_CPIMValue:0
    SendLINR_DAY_LGT_MD_CPIM_Vld: service-kind=ANY-STANDARDIZED, invalidation-policy{data-element=SendLINR_DAY_LGT_MD_CPIM_Vld, handle-invalid=DONT-INVALIDATE}  # Valid
      data SendLINR_DAY_LGT_MD_CPIM_Vld: category=VALUE, sw-calibration-access=READ-ONLY, type=ADTSBoolean, init-value=SendLINR_DAY_LGT_MD_CPIM_VldValue:1
    SendLINR_DAY_LGT_MD_PowerPanel: service-kind=ANY-STANDARDIZED, invalidation-policy{data-element=SendLINR_DAY_LGT_MD_PowerPanel, handle-invalid=DONT-INVALIDATE}
      data SendLINR_DAY_LGT_MD_PowerPanel: category=VALUE, sw-calibration-access=READ-ONLY, type=ADTSBoolean, init-value=SendLINR_DAY_LGT_MD_PowerPanelValue:0
    SendLINR_DAY_LGT_MD_PowerPanel2: service-kind=ANY-STANDARDIZED, invalidation-policy{data-element=SendLINR_DAY_LGT_MD_PowerPanel2, handle-invalid=DONT-INVALIDATE}
      data SendLINR_DAY_LGT_MD_PowerPanel2: category=VALUE, sw-calibration-access=READ-ONLY, type=ADTSBoolean, init-value=SendLINR_DAY_LGT_MD_PowerPanel2Value:0
    SendLINR_DAY_LGT_MD_PowerPanel2Vld: service-kind=ANY-STANDARDIZED, invalidation-policy{data-element=SendLINR_DAY_LGT_MD_PowerPanel2Vld, handle-invalid=DONT-INVALIDATE}  # Valid
      data SendLINR_DAY_LGT_MD_PowerPanel2Vld: category=VALUE, sw-calibration-access=READ-ONLY, type=ADTSBoolean, init-value=SendLINR_DAY_LGT_MD_PowerPanel2VldValue:1
    SendLINR_DAY_LGT_MD_PowerPanelVld: service-kind=ANY-STANDARDIZED, invalidation-policy{data-element=SendLINR_DAY_LGT_MD_PowerPanelVld, handle-invalid=DONT-INVALIDATE}  # Valid
      data SendLINR_DAY_LGT_MD_PowerPanelVld: category=VALUE, sw-calibration-access=READ-ONLY, type=ADTSBoolean, init-value=SendLINR_DAY_LGT_MD_PowerPanelVldValue:1
    SendLINR_DAY_LGT_MD_Vld: service-kind=ANY-STANDARDIZED, invalidation-policy{data-element=SendLINR_DAY_LGT_MD_Vld, handle-invalid=DONT-INVALIDATE}  # Valid
      data SendLINR_DAY_LGT_MD_Vld: category=VALUE, sw-calibration-access=READ-ONLY, type=ADTSBoolean, init-value=SendLINR_DAY_LGT_MD_VldValue:1
    SendLINR_DriveESaveLmp: service-kind=ANY-STANDARDIZED, invalidation-policy{data-element=SendLINR_DriveESaveLmp, handle-invalid=KEEP}
      data SendLINR_DriveESaveLmp: category=VALUE, sw-calibration-access=READ-ONLY, type=ADTSDriveESaveLmp, init-value=SendLINR_DriveESaveLmpValue:0
    SendLINR_DriveESaveLmpVld: service-kind=ANY-STANDARDIZED, invalidation-policy{data-element=SendLINR_DriveESaveLmpVld, handle-invalid=DONT-INVALIDATE}  # Valid
      data SendLINR_DriveESaveLmpVld: category=VALUE, sw-calibration-access=READ-ONLY, type=ADTSBoolean, init-value=SendLINR_DriveESaveLmpVldValue:1
    SendLINR_DriveEcohybridLmp: service-kind=ANY-STANDARDIZED, invalidation-policy{data-element=SendLINR_DriveEcohybridLmp, handle-invalid=KEEP}
      data SendLINR_DriveEcohybridLmp: category=VALUE, sw-calibration-access=READ-ONLY, type=ADTSDriveEcohybridLmp, init-value=SendLINR_DriveEcohybridLmpValue:0
    SendLINR_DriveEcohybridLmpVld: service-kind=ANY-STANDARDIZED, invalidation-policy{data-element=SendLINR_DriveEcohybridLmpVld, handle-invalid=DONT-INVALIDATE}  # Valid
      data SendLINR_DriveEcohybridLmpVld: category=VALUE, sw-calibration-access=READ-ONLY, type=ADTSBoolean, init-value=SendLINR_DriveEcohybridLmpVldValue:1
    SendLINR_DriveElectricLmp: service-kind=ANY-STANDARDIZED, invalidation-policy{data-element=SendLINR_DriveElectricLmp, handle-invalid=KEEP}
      data SendLINR_DriveElectricLmp: category=VALUE, sw-calibration-access=READ-ONLY, type=ADTSDriveElectricLmp, init-value=SendLINR_DriveElectricLmpValue:0
    SendLINR_DriveElectricLmpVld: service-kind=ANY-STANDARDIZED, invalidation-policy{data-element=SendLINR_DriveElectricLmpVld, handle-invalid=DONT-INVALIDATE}  # Valid
      data SendLINR_DriveElectricLmpVld: category=VALUE, sw-calibration-access=READ-ONLY, type=ADTSBoolean, init-value=SendLINR_DriveElectricLmpVldValue:1
    SendLINR_DriveSportHybridLmp: service-kind=ANY-STANDARDIZED, invalidation-policy{data-element=SendLINR_DriveSportHybridLmp, handle-invalid=KEEP}
      data SendLINR_DriveSportHybridLmp: category=VALUE, sw-calibration-access=READ-ONLY, type=ADTSDriveSportHybridLmp, init-value=SendLINR_DriveSportHybridLmpValue:0
    SendLINR_DriveSportHybridLmpVld: service-kind=ANY-STANDARDIZED, invalidation-policy{data-element=SendLINR_DriveSportHybridLmpVld, handle-invalid=DONT-INVALIDATE}  # Valid
      data SendLINR_DriveSportHybridLmpVld: category=VALUE, sw-calibration-access=READ-ONLY, type=ADTSBoolean, init-value=SendLINR_DriveSportHybridLmpVldValue:1
    SendLINR_EEXV_CalCmd: service-kind=ANY-STANDARDIZED, invalidation-policy{data-element=SendLINR_EEXV_CalCmd, handle-invalid=DONT-INVALIDATE}
      data SendLINR_EEXV_CalCmd: category=VALUE, sw-calibration-access=READ-ONLY, type=ADTSEEXV_CalCmd, init-value=SendLINR_EEXV_CalCmdValue:0
    SendLINR_EEXV_CalCmdVld: service-kind=ANY-STANDARDIZED, invalidation-policy{data-element=SendLINR_EEXV_CalCmdVld, handle-invalid=DONT-INVALIDATE}  # Valid
      data SendLINR_EEXV_CalCmdVld: category=VALUE, sw-calibration-access=READ-ONLY, type=ADTSBoolean, init-value=SendLINR_EEXV_CalCmdVldValue:1
    SendLINR_EEXV_PosRq: service-kind=ANY-STANDARDIZED, invalidation-policy{data-element=SendLINR_EEXV_PosRq, handle-invalid=KEEP}
      data SendLINR_EEXV_PosRq: category=VALUE, sw-calibration-access=READ-ONLY, type=ADTSEEXV_PosRq, init-value=SendLINR_EEXV_PosRqValue:0
    SendLINR_EEXV_PosRqVld: service-kind=ANY-STANDARDIZED, invalidation-policy{data-element=SendLINR_EEXV_PosRqVld, handle-invalid=DONT-INVALIDATE}  # Valid
      data SendLINR_EEXV_PosRqVld: category=VALUE, sw-calibration-access=READ-ONLY, type=ADTSBoolean, init-value=SendLINR_EEXV_PosRqVldValue:1
    SendLINR_EOPA_POST_RUN_COM: service-kind=ANY-STANDARDIZED, invalidation-policy{data-element=SendLINR_EOPA_POST_RUN_COM, handle-invalid=KEEP}
      data SendLINR_EOPA_POST_RUN_COM: category=VALUE, sw-calibration-access=READ-ONLY, type=ADTSEOPA_POST_RUN_COM, init-value=SendLINR_EOPA_POST_RUN_COMValue:7
    SendLINR_EOPA_POST_RUN_COM_Vld: service-kind=ANY-STANDARDIZED, invalidation-policy{data-element=SendLINR_EOPA_POST_RUN_COM_Vld, handle-invalid=DONT-INVALIDATE}  # Valid
      data SendLINR_EOPA_POST_RUN_COM_Vld: category=VALUE, sw-calibration-access=READ-ONLY, type=ADTSBoolean, init-value=SendLINR_EOPA_POST_RUN_COM_VldValue:1
    SendLINR_EOPA_RPM_COM: service-kind=ANY-STANDARDIZED, invalidation-policy{data-element=SendLINR_EOPA_RPM_COM, handle-invalid=KEEP}
      data SendLINR_EOPA_RPM_COM: category=VALUE, sw-calibration-access=READ-ONLY, type=ADTSEOPA_RPM_COM, init-value=SendLINR_EOPA_RPM_COMValue:6120
    SendLINR_EOPA_RPM_COM_Vld: service-kind=ANY-STANDARDIZED, invalidation-policy{data-element=SendLINR_EOPA_RPM_COM_Vld, handle-invalid=DONT-INVALIDATE}  # Valid
      data SendLINR_EOPA_RPM_COM_Vld: category=VALUE, sw-calibration-access=READ-ONLY, type=ADTSBoolean, init-value=SendLINR_EOPA_RPM_COM_VldValue:1
    SendLINR_EOPB_POST_RUN_COM: service-kind=ANY-STANDARDIZED, invalidation-policy{data-element=SendLINR_EOPB_POST_RUN_COM, handle-invalid=KEEP}
      data SendLINR_EOPB_POST_RUN_COM: category=VALUE, sw-calibration-access=READ-ONLY, type=ADTSEOPB_POST_RUN_COM, init-value=SendLINR_EOPB_POST_RUN_COMValue:7
    SendLINR_EOPB_POST_RUN_COM_Vld: service-kind=ANY-STANDARDIZED, invalidation-policy{data-element=SendLINR_EOPB_POST_RUN_COM_Vld, handle-invalid=DONT-INVALIDATE}  # Valid
      data SendLINR_EOPB_POST_RUN_COM_Vld: category=VALUE, sw-calibration-access=READ-ONLY, type=ADTSBoolean, init-value=SendLINR_EOPB_POST_RUN_COM_VldValue:1
    SendLINR_EOPB_RPM_COM: service-kind=ANY-STANDARDIZED, invalidation-policy{data-element=SendLINR_EOPB_RPM_COM, handle-invalid=KEEP}
      data SendLINR_EOPB_RPM_COM: category=VALUE, sw-calibration-access=READ-ONLY, type=ADTSEOPB_RPM_COM, init-value=SendLINR_EOPB_RPM_COMValue:6120
    SendLINR_EOPB_RPM_COM_Vld: service-kind=ANY-STANDARDIZED, invalidation-policy{data-element=SendLINR_EOPB_RPM_COM_Vld, handle-invalid=DONT-INVALIDATE}  # Valid
      data SendLINR_EOPB_RPM_COM_Vld: category=VALUE, sw-calibration-access=READ-ONLY, type=ADTSBoolean, init-value=SendLINR_EOPB_RPM_COM_VldValue:1
    SendLINR_EXVM_CalCmd: service-kind=ANY-STANDARDIZED, invalidation-policy{data-element=SendLINR_EXVM_CalCmd, handle-invalid=DONT-INVALIDATE}
      data SendLINR_EXVM_CalCmd: category=VALUE, sw-calibration-access=READ-ONLY, type=ADTSEXVM_CalCmd, init-value=SendLINR_EXVM_CalCmdValue:0
    SendLINR_EXVM_CalCmdVld: service-kind=ANY-STANDARDIZED, invalidation-policy{data-element=SendLINR_EXVM_CalCmdVld, handle-invalid=DONT-INVALIDATE}  # Valid
      data SendLINR_EXVM_CalCmdVld: category=VALUE, sw-calibration-access=READ-ONLY, type=ADTSBoolean, init-value=SendLINR_EXVM_CalCmdVldValue:1
    SendLINR_EXVM_PosRq: service-kind=ANY-STANDARDIZED, invalidation-policy{data-element=SendLINR_EXVM_PosRq, handle-invalid=KEEP}
      data SendLINR_EXVM_PosRq: category=VALUE, sw-calibration-access=READ-ONLY, type=ADTSEXVM_PosRq, init-value=SendLINR_EXVM_PosRqValue:0
    SendLINR_EXVM_PosRqVld: service-kind=ANY-STANDARDIZED, invalidation-policy{data-element=SendLINR_EXVM_PosRqVld, handle-invalid=DONT-INVALIDATE}  # Valid
      data SendLINR_EXVM_PosRqVld: category=VALUE, sw-calibration-access=READ-ONLY, type=ADTSBoolean, init-value=SendLINR_EXVM_PosRqVldValue:1
    SendLINR_HTLBV_CalRq: service-kind=ANY-STANDARDIZED, invalidation-policy{data-element=SendLINR_HTLBV_CalRq, handle-invalid=DONT-INVALIDATE}
      data SendLINR_HTLBV_CalRq: category=VALUE, sw-calibration-access=READ-ONLY, type=ADTSHTLBV_CalRq, init-value=SendLINR_HTLBV_CalRqValue:0
    SendLINR_HTLBV_CalRqVld: service-kind=ANY-STANDARDIZED, invalidation-policy{data-element=SendLINR_HTLBV_CalRqVld, handle-invalid=DONT-INVALIDATE}  # Valid
      data SendLINR_HTLBV_CalRqVld: category=VALUE, sw-calibration-access=READ-ONLY, type=ADTSBoolean, init-value=SendLINR_HTLBV_CalRqVldValue:1
    SendLINR_HTLBV_PosRq: service-kind=ANY-STANDARDIZED, invalidation-policy{data-element=SendLINR_HTLBV_PosRq, handle-invalid=KEEP}
      data SendLINR_HTLBV_PosRq: category=VALUE, sw-calibration-access=READ-ONLY, type=ADTSHTLBV_PosRq, init-value=SendLINR_HTLBV_PosRqValue:0
    SendLINR_HTLBV_PosRqVld: service-kind=ANY-STANDARDIZED, invalidation-policy{data-element=SendLINR_HTLBV_PosRqVld, handle-invalid=DONT-INVALIDATE}  # Valid
      data SendLINR_HTLBV_PosRqVld: category=VALUE, sw-calibration-access=READ-ONLY, type=ADTSBoolean, init-value=SendLINR_HTLBV_PosRqVldValue:1
    SendLINR_HTLBV_PosSv: service-kind=ANY-STANDARDIZED, invalidation-policy{data-element=SendLINR_HTLBV_PosSv, handle-invalid=DONT-INVALIDATE}
      data SendLINR_HTLBV_PosSv: category=VALUE, sw-calibration-access=READ-ONLY, type=ADTSBoolean, init-value=SendLINR_HTLBV_PosSvValue:0
    SendLINR_HTLBV_PosSvVld: service-kind=ANY-STANDARDIZED, invalidation-policy{data-element=SendLINR_HTLBV_PosSvVld, handle-invalid=DONT-INVALIDATE}  # Valid
      data SendLINR_HTLBV_PosSvVld: category=VALUE, sw-calibration-access=READ-ONLY, type=ADTSBoolean, init-value=SendLINR_HTLBV_PosSvVldValue:1
    SendLINR_HVH_OverheatUnlock: service-kind=ANY-STANDARDIZED, invalidation-policy{data-element=SendLINR_HVH_OverheatUnlock, handle-invalid=DONT-INVALIDATE}
      data SendLINR_HVH_OverheatUnlock: category=VALUE, sw-calibration-access=READ-ONLY, type=ADTSBoolean, init-value=SendLINR_HVH_OverheatUnlockValue:0
    SendLINR_HVH_OverheatUnlockVld: service-kind=ANY-STANDARDIZED, invalidation-policy{data-element=SendLINR_HVH_OverheatUnlockVld, handle-invalid=DONT-INVALIDATE}  # Valid
      data SendLINR_HVH_OverheatUnlockVld: category=VALUE, sw-calibration-access=READ-ONLY, type=ADTSBoolean, init-value=SendLINR_HVH_OverheatUnlockVldValue:1
    SendLINR_HvCooltHeatrEnad: service-kind=ANY-STANDARDIZED, invalidation-policy{data-element=SendLINR_HvCooltHeatrEnad, handle-invalid=DONT-INVALIDATE}
      data SendLINR_HvCooltHeatrEnad: category=VALUE, sw-calibration-access=READ-ONLY, type=ADTSBoolean, init-value=SendLINR_HvCooltHeatrEnadValue:0
    SendLINR_HvCooltHeatrEnadVld: service-kind=ANY-STANDARDIZED, invalidation-policy{data-element=SendLINR_HvCooltHeatrEnadVld, handle-invalid=DONT-INVALIDATE}  # Valid
      data SendLINR_HvCooltHeatrEnadVld: category=VALUE, sw-calibration-access=READ-ONLY, type=ADTSBoolean, init-value=SendLINR_HvCooltHeatrEnadVldValue:1
    SendLINR_HvWtrHeatrPwrCnsAllwd: service-kind=ANY-STANDARDIZED, invalidation-policy{data-element=SendLINR_HvWtrHeatrPwrCnsAllwd, handle-invalid=KEEP}
      data SendLINR_HvWtrHeatrPwrCnsAllwd: category=VALUE, sw-calibration-access=READ-ONLY, type=ADTSHvWtrHeatrPwrCnsAllwd, init-value=SendLINR_HvWtrHeatrPwrCnsAllwdValue:10200
    SendLINR_HvWtrHeatrPwrCnsAllwdVld: service-kind=ANY-STANDARDIZED, invalidation-policy{data-element=SendLINR_HvWtrHeatrPwrCnsAllwdVld, handle-invalid=DONT-INVALIDATE}  # Valid
      data SendLINR_HvWtrHeatrPwrCnsAllwdVld: category=VALUE, sw-calibration-access=READ-ONLY, type=ADTSBoolean, init-value=SendLINR_HvWtrHeatrPwrCnsAllwdVldValue:1
    SendLINR_HvWtrHeatrWtrTDes: service-kind=ANY-STANDARDIZED, invalidation-policy{data-element=SendLINR_HvWtrHeatrWtrTDes, handle-invalid=KEEP}
      data SendLINR_HvWtrHeatrWtrTDes: category=VALUE, sw-calibration-access=READ-ONLY, type=ADTSHvWtrHeatrWtrTDes, init-value=SendLINR_HvWtrHeatrWtrTDesValue:215
    SendLINR_HvWtrHeatrWtrTDesVld: service-kind=ANY-STANDARDIZED, invalidation-policy{data-element=SendLINR_HvWtrHeatrWtrTDesVld, handle-invalid=DONT-INVALIDATE}  # Valid
      data SendLINR_HvWtrHeatrWtrTDesVld: category=VALUE, sw-calibration-access=READ-ONLY, type=ADTSBoolean, init-value=SendLINR_HvWtrHeatrWtrTDesVldValue:1
    SendLINR_LTRBV_CalRq: service-kind=ANY-STANDARDIZED, invalidation-policy{data-element=SendLINR_LTRBV_CalRq, handle-invalid=DONT-INVALIDATE}
      data SendLINR_LTRBV_CalRq: category=VALUE, sw-calibration-access=READ-ONLY, type=ADTSLTRBV_CalRq, init-value=SendLINR_LTRBV_CalRqValue:0
    SendLINR_LTRBV_CalRqVld: service-kind=ANY-STANDARDIZED, invalidation-policy{data-element=SendLINR_LTRBV_CalRqVld, handle-invalid=DONT-INVALIDATE}  # Valid
      data SendLINR_LTRBV_CalRqVld: category=VALUE, sw-calibration-access=READ-ONLY, type=ADTSBoolean, init-value=SendLINR_LTRBV_CalRqVldValue:1
    SendLINR_LTRBV_PosRq: service-kind=ANY-STANDARDIZED, invalidation-policy{data-element=SendLINR_LTRBV_PosRq, handle-invalid=KEEP}
      data SendLINR_LTRBV_PosRq: category=VALUE, sw-calibration-access=READ-ONLY, type=ADTSLTRBV_PosRq, init-value=SendLINR_LTRBV_PosRqValue:0
    SendLINR_LTRBV_PosRqVld: service-kind=ANY-STANDARDIZED, invalidation-policy{data-element=SendLINR_LTRBV_PosRqVld, handle-invalid=DONT-INVALIDATE}  # Valid
      data SendLINR_LTRBV_PosRqVld: category=VALUE, sw-calibration-access=READ-ONLY, type=ADTSBoolean, init-value=SendLINR_LTRBV_PosRqVldValue:1
    SendLINR_LTRBV_PosSv: service-kind=ANY-STANDARDIZED, invalidation-policy{data-element=SendLINR_LTRBV_PosSv, handle-invalid=DONT-INVALIDATE}
      data SendLINR_LTRBV_PosSv: category=VALUE, sw-calibration-access=READ-ONLY, type=ADTSBoolean, init-value=SendLINR_LTRBV_PosSvValue:0
    SendLINR_LTRBV_PosSvVld: service-kind=ANY-STANDARDIZED, invalidation-policy{data-element=SendLINR_LTRBV_PosSvVld, handle-invalid=DONT-INVALIDATE}  # Valid
      data SendLINR_LTRBV_PosSvVld: category=VALUE, sw-calibration-access=READ-ONLY, type=ADTSBoolean, init-value=SendLINR_LTRBV_PosSvVldValue:1
    SendLINR_M2SRes2Bit: service-kind=ANY-STANDARDIZED, invalidation-policy{data-element=SendLINR_M2SRes2Bit, handle-invalid=DONT-INVALIDATE}
      data SendLINR_M2SRes2Bit: category=VALUE, sw-calibration-access=READ-ONLY, type=ADTSM2SRes2Bit, init-value=SendLINR_M2SRes2BitValue:0
    SendLINR_M2SRes2BitVld: service-kind=ANY-STANDARDIZED, invalidation-policy{data-element=SendLINR_M2SRes2BitVld, handle-invalid=DONT-INVALIDATE}  # Valid
      data SendLINR_M2SRes2BitVld: category=VALUE, sw-calibration-access=READ-ONLY, type=ADTSBoolean, init-value=SendLINR_M2SRes2BitVldValue:1
    SendLINR_M2SRes2Bit_AGS2: service-kind=ANY-STANDARDIZED, invalidation-policy{data-element=SendLINR_M2SRes2Bit_AGS2, handle-invalid=DONT-INVALIDATE}
      data SendLINR_M2SRes2Bit_AGS2: category=VALUE, sw-calibration-access=READ-ONLY, type=ADTSM2SRes2Bit_AGS2, init-value=SendLINR_M2SRes2Bit_AGS2Value:0
    SendLINR_M2SRes2Bit_AGS2Vld: service-kind=ANY-STANDARDIZED, invalidation-policy{data-element=SendLINR_M2SRes2Bit_AGS2Vld, handle-invalid=DONT-INVALIDATE}  # Valid
      data SendLINR_M2SRes2Bit_AGS2Vld: category=VALUE, sw-calibration-access=READ-ONLY, type=ADTSBoolean, init-value=SendLINR_M2SRes2Bit_AGS2VldValue:1
    SendLINR_M2SResByte1: service-kind=ANY-STANDARDIZED, invalidation-policy{data-element=SendLINR_M2SResByte1, handle-invalid=DONT-INVALIDATE}
      data SendLINR_M2SResByte1: category=VALUE, sw-calibration-access=READ-ONLY, type=ADTSM2SResByte1, init-value=SendLINR_M2SResByte1Value:0
    SendLINR_M2SResByte1Vld: service-kind=ANY-STANDARDIZED, invalidation-policy{data-element=SendLINR_M2SResByte1Vld, handle-invalid=DONT-INVALIDATE}  # Valid
      data SendLINR_M2SResByte1Vld: category=VALUE, sw-calibration-access=READ-ONLY, type=ADTSBoolean, init-value=SendLINR_M2SResByte1VldValue:1
    SendLINR_M2SResByte1_AGS2: service-kind=ANY-STANDARDIZED, invalidation-policy{data-element=SendLINR_M2SResByte1_AGS2, handle-invalid=DONT-INVALIDATE}
      data SendLINR_M2SResByte1_AGS2: category=VALUE, sw-calibration-access=READ-ONLY, type=ADTSM2SResByte1_AGS2, init-value=SendLINR_M2SResByte1_AGS2Value:0
    SendLINR_M2SResByte1_AGS2Vld: service-kind=ANY-STANDARDIZED, invalidation-policy{data-element=SendLINR_M2SResByte1_AGS2Vld, handle-invalid=DONT-INVALIDATE}  # Valid
      data SendLINR_M2SResByte1_AGS2Vld: category=VALUE, sw-calibration-access=READ-ONLY, type=ADTSBoolean, init-value=SendLINR_M2SResByte1_AGS2VldValue:1
    SendLINR_M2SResByte2: service-kind=ANY-STANDARDIZED, invalidation-policy{data-element=SendLINR_M2SResByte2, handle-invalid=DONT-INVALIDATE}
      data SendLINR_M2SResByte2: category=VALUE, sw-calibration-access=READ-ONLY, type=ADTSM2SResByte2, init-value=SendLINR_M2SResByte2Value:0
    SendLINR_M2SResByte2Vld: service-kind=ANY-STANDARDIZED, invalidation-policy{data-element=SendLINR_M2SResByte2Vld, handle-invalid=DONT-INVALIDATE}  # Valid
      data SendLINR_M2SResByte2Vld: category=VALUE, sw-calibration-access=READ-ONLY, type=ADTSBoolean, init-value=SendLINR_M2SResByte2VldValue:1
    SendLINR_M2SResByte2_AGS2: service-kind=ANY-STANDARDIZED, invalidation-policy{data-element=SendLINR_M2SResByte2_AGS2, handle-invalid=DONT-INVALIDATE}
      data SendLINR_M2SResByte2_AGS2: category=VALUE, sw-calibration-access=READ-ONLY, type=ADTSM2SResByte2_AGS2, init-value=SendLINR_M2SResByte2_AGS2Value:0
    SendLINR_M2SResByte2_AGS2Vld: service-kind=ANY-STANDARDIZED, invalidation-policy{data-element=SendLINR_M2SResByte2_AGS2Vld, handle-invalid=DONT-INVALIDATE}  # Valid
      data SendLINR_M2SResByte2_AGS2Vld: category=VALUE, sw-calibration-access=READ-ONLY, type=ADTSBoolean, init-value=SendLINR_M2SResByte2_AGS2VldValue:1
    SendLINR_M2SResByte3: service-kind=ANY-STANDARDIZED, invalidation-policy{data-element=SendLINR_M2SResByte3, handle-invalid=DONT-INVALIDATE}
      data SendLINR_M2SResByte3: category=VALUE, sw-calibration-access=READ-ONLY, type=ADTSM2SResByte3, init-value=SendLINR_M2SResByte3Value:0
    SendLINR_M2SResByte3Vld: service-kind=ANY-STANDARDIZED, invalidation-policy{data-element=SendLINR_M2SResByte3Vld, handle-invalid=DONT-INVALIDATE}  # Valid
      data SendLINR_M2SResByte3Vld: category=VALUE, sw-calibration-access=READ-ONLY, type=ADTSBoolean, init-value=SendLINR_M2SResByte3VldValue:1
    SendLINR_M2SResByte3_AGS2: service-kind=ANY-STANDARDIZED, invalidation-policy{data-element=SendLINR_M2SResByte3_AGS2, handle-invalid=DONT-INVALIDATE}
      data SendLINR_M2SResByte3_AGS2: category=VALUE, sw-calibration-access=READ-ONLY, type=ADTSM2SResByte3_AGS2, init-value=SendLINR_M2SResByte3_AGS2Value:0
    SendLINR_M2SResByte3_AGS2Vld: service-kind=ANY-STANDARDIZED, invalidation-policy{data-element=SendLINR_M2SResByte3_AGS2Vld, handle-invalid=DONT-INVALIDATE}  # Valid
      data SendLINR_M2SResByte3_AGS2Vld: category=VALUE, sw-calibration-access=READ-ONLY, type=ADTSBoolean, init-value=SendLINR_M2SResByte3_AGS2VldValue:1
    SendLINR_OEXV_CalCmd: service-kind=ANY-STANDARDIZED, invalidation-policy{data-element=SendLINR_OEXV_CalCmd, handle-invalid=DONT-INVALIDATE}
      data SendLINR_OEXV_CalCmd: category=VALUE, sw-calibration-access=READ-ONLY, type=ADTSOEXV_CalCmd, init-value=SendLINR_OEXV_CalCmdValue:0
    SendLINR_OEXV_CalCmdVld: service-kind=ANY-STANDARDIZED, invalidation-policy{data-element=SendLINR_OEXV_CalCmdVld, handle-invalid=DONT-INVALIDATE}  # Valid
      data SendLINR_OEXV_CalCmdVld: category=VALUE, sw-calibration-access=READ-ONLY, type=ADTSBoolean, init-value=SendLINR_OEXV_CalCmdVldValue:1
    SendLINR_OEXV_PosRq: service-kind=ANY-STANDARDIZED, invalidation-policy{data-element=SendLINR_OEXV_PosRq, handle-invalid=KEEP}
      data SendLINR_OEXV_PosRq: category=VALUE, sw-calibration-access=READ-ONLY, type=ADTSOEXV_PosRq, init-value=SendLINR_OEXV_PosRqValue:0
    SendLINR_OEXV_PosRqVld: service-kind=ANY-STANDARDIZED, invalidation-policy{data-element=SendLINR_OEXV_PosRqVld, handle-invalid=DONT-INVALIDATE}  # Valid
      data SendLINR_OEXV_PosRqVld: category=VALUE, sw-calibration-access=READ-ONLY, type=ADTSBoolean, init-value=SendLINR_OEXV_PosRqVldValue:1
    SendLINR_PECP2_FL_SAFE_ACTVT: service-kind=ANY-STANDARDIZED, invalidation-policy{data-element=SendLINR_PECP2_FL_SAFE_ACTVT, handle-invalid=KEEP}
      data SendLINR_PECP2_FL_SAFE_ACTVT: category=VALUE, sw-calibration-access=READ-ONLY, type=ADTSPECP2_FL_SAFE_ACTVT, init-value=SendLINR_PECP2_FL_SAFE_ACTVTValue:3
    SendLINR_PECP2_FL_SAFE_ACTVT_Vld: service-kind=ANY-STANDARDIZED, invalidation-policy{data-element=SendLINR_PECP2_FL_SAFE_ACTVT_Vld, handle-invalid=DONT-INVALIDATE}  # Valid
      data SendLINR_PECP2_FL_SAFE_ACTVT_Vld: category=VALUE, sw-calibration-access=READ-ONLY, type=ADTSBoolean, init-value=SendLINR_PECP2_FL_SAFE_ACTVT_VldValue:1
    SendLINR_PECP2_POST_RUN_REQ: service-kind=ANY-STANDARDIZED, invalidation-policy{data-element=SendLINR_PECP2_POST_RUN_REQ, handle-invalid=KEEP}
      data SendLINR_PECP2_POST_RUN_REQ: category=VALUE, sw-calibration-access=READ-ONLY, type=ADTSPECP2_POST_RUN_REQ, init-value=SendLINR_PECP2_POST_RUN_REQValue:7
    SendLINR_PECP2_POST_RUN_REQ_Vld: service-kind=ANY-STANDARDIZED, invalidation-policy{data-element=SendLINR_PECP2_POST_RUN_REQ_Vld, handle-invalid=DONT-INVALIDATE}  # Valid
      data SendLINR_PECP2_POST_RUN_REQ_Vld: category=VALUE, sw-calibration-access=READ-ONLY, type=ADTSBoolean, init-value=SendLINR_PECP2_POST_RUN_REQ_VldValue:1
    SendLINR_PECP2_RPM_REQ_PERCT: service-kind=ANY-STANDARDIZED, invalidation-policy{data-element=SendLINR_PECP2_RPM_REQ_PERCT, handle-invalid=KEEP}
      data SendLINR_PECP2_RPM_REQ_PERCT: category=VALUE, sw-calibration-access=READ-ONLY, type=ADTSPECP2_RPM_REQ_PERCT, init-value=SendLINR_PECP2_RPM_REQ_PERCTValue:100.3935
    SendLINR_PECP2_RPM_REQ_PERCT_Vld: service-kind=ANY-STANDARDIZED, invalidation-policy{data-element=SendLINR_PECP2_RPM_REQ_PERCT_Vld, handle-invalid=DONT-INVALIDATE}  # Valid
      data SendLINR_PECP2_RPM_REQ_PERCT_Vld: category=VALUE, sw-calibration-access=READ-ONLY, type=ADTSBoolean, init-value=SendLINR_PECP2_RPM_REQ_PERCT_VldValue:1
    SendLINR_PECP_FL_SAFE_ACTVT: service-kind=ANY-STANDARDIZED, invalidation-policy{data-element=SendLINR_PECP_FL_SAFE_ACTVT, handle-invalid=KEEP}
      data SendLINR_PECP_FL_SAFE_ACTVT: category=VALUE, sw-calibration-access=READ-ONLY, type=ADTSPECP_FL_SAFE_ACTVT, init-value=SendLINR_PECP_FL_SAFE_ACTVTValue:3
    SendLINR_PECP_FL_SAFE_ACTVT_Vld: service-kind=ANY-STANDARDIZED, invalidation-policy{data-element=SendLINR_PECP_FL_SAFE_ACTVT_Vld, handle-invalid=DONT-INVALIDATE}  # Valid
      data SendLINR_PECP_FL_SAFE_ACTVT_Vld: category=VALUE, sw-calibration-access=READ-ONLY, type=ADTSBoolean, init-value=SendLINR_PECP_FL_SAFE_ACTVT_VldValue:1
    SendLINR_PECP_POST_RUN_REQ: service-kind=ANY-STANDARDIZED, invalidation-policy{data-element=SendLINR_PECP_POST_RUN_REQ, handle-invalid=KEEP}
      data SendLINR_PECP_POST_RUN_REQ: category=VALUE, sw-calibration-access=READ-ONLY, type=ADTSPECP_POST_RUN_REQ, init-value=SendLINR_PECP_POST_RUN_REQValue:7
    SendLINR_PECP_POST_RUN_REQ_Vld: service-kind=ANY-STANDARDIZED, invalidation-policy{data-element=SendLINR_PECP_POST_RUN_REQ_Vld, handle-invalid=DONT-INVALIDATE}  # Valid
      data SendLINR_PECP_POST_RUN_REQ_Vld: category=VALUE, sw-calibration-access=READ-ONLY, type=ADTSBoolean, init-value=SendLINR_PECP_POST_RUN_REQ_VldValue:1
    SendLINR_PECP_RPM_REQ_PERCT: service-kind=ANY-STANDARDIZED, invalidation-policy{data-element=SendLINR_PECP_RPM_REQ_PERCT, handle-invalid=KEEP}
      data SendLINR_PECP_RPM_REQ_PERCT: category=VALUE, sw-calibration-access=READ-ONLY, type=ADTSPECP_RPM_REQ_PERCT, init-value=SendLINR_PECP_RPM_REQ_PERCTValue:100.3935
    SendLINR_PECP_RPM_REQ_PERCT_Vld: service-kind=ANY-STANDARDIZED, invalidation-policy{data-element=SendLINR_PECP_RPM_REQ_PERCT_Vld, handle-invalid=DONT-INVALIDATE}  # Valid
      data SendLINR_PECP_RPM_REQ_PERCT_Vld: category=VALUE, sw-calibration-access=READ-ONLY, type=ADTSBoolean, init-value=SendLINR_PECP_RPM_REQ_PERCT_VldValue:1
    SendLINR_PanelIntensitySts: service-kind=ANY-STANDARDIZED, invalidation-policy{data-element=SendLINR_PanelIntensitySts, handle-invalid=KEEP}
      data SendLINR_PanelIntensitySts: category=VALUE, sw-calibration-access=READ-ONLY, type=ADTSPanelIntensitySts, init-value=SendLINR_PanelIntensityStsValue:0
    SendLINR_PanelIntensityStsVld: service-kind=ANY-STANDARDIZED, invalidation-policy{data-element=SendLINR_PanelIntensityStsVld, handle-invalid=DONT-INVALIDATE}  # Valid
      data SendLINR_PanelIntensityStsVld: category=VALUE, sw-calibration-access=READ-ONLY, type=ADTSBoolean, init-value=SendLINR_PanelIntensityStsVldValue:1
    SendLINR_PowPan2_LED_A_Col_Comm: service-kind=ANY-STANDARDIZED, invalidation-policy{data-element=SendLINR_PowPan2_LED_A_Col_Comm, handle-invalid=DONT-INVALIDATE}
      data SendLINR_PowPan2_LED_A_Col_Comm: category=VALUE, sw-calibration-access=READ-ONLY, type=ADTSPowPan2_LED_A_Col_Comm, init-value=SendLINR_PowPan2_LED_A_Col_CommValue:0
    SendLINR_PowPan2_LED_A_Col_CommVld: service-kind=ANY-STANDARDIZED, invalidation-policy{data-element=SendLINR_PowPan2_LED_A_Col_CommVld, handle-invalid=DONT-INVALIDATE}  # Valid
      data SendLINR_PowPan2_LED_A_Col_CommVld: category=VALUE, sw-calibration-access=READ-ONLY, type=ADTSBoolean, init-value=SendLINR_PowPan2_LED_A_Col_CommVldValue:1
    SendLINR_PowPan2_LED_B_Col_Comm: service-kind=ANY-STANDARDIZED, invalidation-policy{data-element=SendLINR_PowPan2_LED_B_Col_Comm, handle-invalid=DONT-INVALIDATE}
      data SendLINR_PowPan2_LED_B_Col_Comm: category=VALUE, sw-calibration-access=READ-ONLY, type=ADTSPowPan2_LED_B_Col_Comm, init-value=SendLINR_PowPan2_LED_B_Col_CommValue:0
    SendLINR_PowPan2_LED_B_Col_CommVld: service-kind=ANY-STANDARDIZED, invalidation-policy{data-element=SendLINR_PowPan2_LED_B_Col_CommVld, handle-invalid=DONT-INVALIDATE}  # Valid
      data SendLINR_PowPan2_LED_B_Col_CommVld: category=VALUE, sw-calibration-access=READ-ONLY, type=ADTSBoolean, init-value=SendLINR_PowPan2_LED_B_Col_CommVldValue:1
    SendLINR_PowerPanel2_LED_A_Cmnd: service-kind=ANY-STANDARDIZED, invalidation-policy{data-element=SendLINR_PowerPanel2_LED_A_Cmnd, handle-invalid=KEEP}
      data SendLINR_PowerPanel2_LED_A_Cmnd: category=VALUE, sw-calibration-access=READ-ONLY, type=ADTSPowerPanel2_LED_A_Cmnd, init-value=SendLINR_PowerPanel2_LED_A_CmndValue:0
    SendLINR_PowerPanel2_LED_A_CmndVld: service-kind=ANY-STANDARDIZED, invalidation-policy{data-element=SendLINR_PowerPanel2_LED_A_CmndVld, handle-invalid=DONT-INVALIDATE}  # Valid
      data SendLINR_PowerPanel2_LED_A_CmndVld: category=VALUE, sw-calibration-access=READ-ONLY, type=ADTSBoolean, init-value=SendLINR_PowerPanel2_LED_A_CmndVldValue:1
    SendLINR_PowerPanel2_LED_B_Cmnd: service-kind=ANY-STANDARDIZED, invalidation-policy{data-element=SendLINR_PowerPanel2_LED_B_Cmnd, handle-invalid=KEEP}
      data SendLINR_PowerPanel2_LED_B_Cmnd: category=VALUE, sw-calibration-access=READ-ONLY, type=ADTSPowerPanel2_LED_B_Cmnd, init-value=SendLINR_PowerPanel2_LED_B_CmndValue:0
    SendLINR_PowerPanel2_LED_B_CmndVld: service-kind=ANY-STANDARDIZED, invalidation-policy{data-element=SendLINR_PowerPanel2_LED_B_CmndVld, handle-invalid=DONT-INVALIDATE}  # Valid
      data SendLINR_PowerPanel2_LED_B_CmndVld: category=VALUE, sw-calibration-access=READ-ONLY, type=ADTSBoolean, init-value=SendLINR_PowerPanel2_LED_B_CmndVldValue:1
    SendLINR_PwrPanel_LEDA_ColorCmd: service-kind=ANY-STANDARDIZED, invalidation-policy{data-element=SendLINR_PwrPanel_LEDA_ColorCmd, handle-invalid=DONT-INVALIDATE}
      data SendLINR_PwrPanel_LEDA_ColorCmd: category=VALUE, sw-calibration-access=READ-ONLY, type=ADTSPwrPanel_LEDA_ColorCmd, init-value=SendLINR_PwrPanel_LEDA_ColorCmdValue:0
    SendLINR_PwrPanel_LEDA_ColorCmdVld: service-kind=ANY-STANDARDIZED, invalidation-policy{data-element=SendLINR_PwrPanel_LEDA_ColorCmdVld, handle-invalid=DONT-INVALIDATE}  # Valid
      data SendLINR_PwrPanel_LEDA_ColorCmdVld: category=VALUE, sw-calibration-access=READ-ONLY, type=ADTSBoolean, init-value=SendLINR_PwrPanel_LEDA_ColorCmdVldValue:1
    SendLINR_PwrPanel_LEDB_ColorCmd: service-kind=ANY-STANDARDIZED, invalidation-policy{data-element=SendLINR_PwrPanel_LEDB_ColorCmd, handle-invalid=DONT-INVALIDATE}
      data SendLINR_PwrPanel_LEDB_ColorCmd: category=VALUE, sw-calibration-access=READ-ONLY, type=ADTSPwrPanel_LEDB_ColorCmd, init-value=SendLINR_PwrPanel_LEDB_ColorCmdValue:0
    SendLINR_PwrPanel_LEDB_ColorCmdVld: service-kind=ANY-STANDARDIZED, invalidation-policy{data-element=SendLINR_PwrPanel_LEDB_ColorCmdVld, handle-invalid=DONT-INVALIDATE}  # Valid
      data SendLINR_PwrPanel_LEDB_ColorCmdVld: category=VALUE, sw-calibration-access=READ-ONLY, type=ADTSBoolean, init-value=SendLINR_PwrPanel_LEDB_ColorCmdVldValue:1
    SendLINR_PwrPanel_LEDC_ColorCmd: service-kind=ANY-STANDARDIZED, invalidation-policy{data-element=SendLINR_PwrPanel_LEDC_ColorCmd, handle-invalid=DONT-INVALIDATE}
      data SendLINR_PwrPanel_LEDC_ColorCmd: category=VALUE, sw-calibration-access=READ-ONLY, type=ADTSPwrPanel_LEDC_ColorCmd, init-value=SendLINR_PwrPanel_LEDC_ColorCmdValue:0
    SendLINR_PwrPanel_LEDC_ColorCmdVld: service-kind=ANY-STANDARDIZED, invalidation-policy{data-element=SendLINR_PwrPanel_LEDC_ColorCmdVld, handle-invalid=DONT-INVALIDATE}  # Valid
      data SendLINR_PwrPanel_LEDC_ColorCmdVld: category=VALUE, sw-calibration-access=READ-ONLY, type=ADTSBoolean, init-value=SendLINR_PwrPanel_LEDC_ColorCmdVldValue:1
    SendLINR_PwrPanel_LED_A_Command: service-kind=ANY-STANDARDIZED, invalidation-policy{data-element=SendLINR_PwrPanel_LED_A_Command, handle-invalid=KEEP}
      data SendLINR_PwrPanel_LED_A_Command: category=VALUE, sw-calibration-access=READ-ONLY, type=ADTSPwrPanel_LED_A_Command, init-value=SendLINR_PwrPanel_LED_A_CommandValue:0
    SendLINR_PwrPanel_LED_A_CommandVld: service-kind=ANY-STANDARDIZED, invalidation-policy{data-element=SendLINR_PwrPanel_LED_A_CommandVld, handle-invalid=DONT-INVALIDATE}  # Valid
      data SendLINR_PwrPanel_LED_A_CommandVld: category=VALUE, sw-calibration-access=READ-ONLY, type=ADTSBoolean, init-value=SendLINR_PwrPanel_LED_A_CommandVldValue:1
    SendLINR_PwrPanel_LED_B_Command: service-kind=ANY-STANDARDIZED, invalidation-policy{data-element=SendLINR_PwrPanel_LED_B_Command, handle-invalid=KEEP}
      data SendLINR_PwrPanel_LED_B_Command: category=VALUE, sw-calibration-access=READ-ONLY, type=ADTSPwrPanel_LED_B_Command, init-value=SendLINR_PwrPanel_LED_B_CommandValue:0
    SendLINR_PwrPanel_LED_B_CommandVld: service-kind=ANY-STANDARDIZED, invalidation-policy{data-element=SendLINR_PwrPanel_LED_B_CommandVld, handle-invalid=DONT-INVALIDATE}  # Valid
      data SendLINR_PwrPanel_LED_B_CommandVld: category=VALUE, sw-calibration-access=READ-ONLY, type=ADTSBoolean, init-value=SendLINR_PwrPanel_LED_B_CommandVldValue:1
    SendLINR_PwrPanel_LED_C_Command: service-kind=ANY-STANDARDIZED, invalidation-policy{data-element=SendLINR_PwrPanel_LED_C_Command, handle-invalid=KEEP}
      data SendLINR_PwrPanel_LED_C_Command: category=VALUE, sw-calibration-access=READ-ONLY, type=ADTSPwrPanel_LED_C_Command, init-value=SendLINR_PwrPanel_LED_C_CommandValue:0
    SendLINR_PwrPanel_LED_C_CommandVld: service-kind=ANY-STANDARDIZED, invalidation-policy{data-element=SendLINR_PwrPanel_LED_C_CommandVld, handle-invalid=DONT-INVALIDATE}  # Valid
      data SendLINR_PwrPanel_LED_C_CommandVld: category=VALUE, sw-calibration-access=READ-ONLY, type=ADTSBoolean, init-value=SendLINR_PwrPanel_LED_C_CommandVldValue:1
    SendLINR_Set_Icon1_cmd: service-kind=ANY-STANDARDIZED, invalidation-policy{data-element=SendLINR_Set_Icon1_cmd, handle-invalid=KEEP}
      data SendLINR_Set_Icon1_cmd: category=VALUE, sw-calibration-access=READ-ONLY, type=ADTSSet_Icon1_cmd, init-value=SendLINR_Set_Icon1_cmdValue:0
    SendLINR_Set_Icon1_cmdVld: service-kind=ANY-STANDARDIZED, invalidation-policy{data-element=SendLINR_Set_Icon1_cmdVld, handle-invalid=DONT-INVALIDATE}  # Valid
      data SendLINR_Set_Icon1_cmdVld: category=VALUE, sw-calibration-access=READ-ONLY, type=ADTSBoolean, init-value=SendLINR_Set_Icon1_cmdVldValue:1
    SendLINR_Set_Icon2_cmd: service-kind=ANY-STANDARDIZED, invalidation-policy{data-element=SendLINR_Set_Icon2_cmd, handle-invalid=KEEP}
      data SendLINR_Set_Icon2_cmd: category=VALUE, sw-calibration-access=READ-ONLY, type=ADTSSet_Icon2_cmd, init-value=SendLINR_Set_Icon2_cmdValue:0
    SendLINR_Set_Icon2_cmdVld: service-kind=ANY-STANDARDIZED, invalidation-policy{data-element=SendLINR_Set_Icon2_cmdVld, handle-invalid=DONT-INVALIDATE}  # Valid
      data SendLINR_Set_Icon2_cmdVld: category=VALUE, sw-calibration-access=READ-ONLY, type=ADTSBoolean, init-value=SendLINR_Set_Icon2_cmdVldValue:1
    SignalLINR_AAD_RdyForSleep: service-kind=ANY-STANDARDIZED, invalidation-policy{data-element=SignalLINR_AAD_RdyForSleep, handle-invalid=DONT-INVALIDATE}  # None
      data SignalLINR_AAD_RdyForSleep: category=VALUE, type=ADTSBoolean, init-value=SignalLINR_AAD_RdyForSleepValue:0
    SignalLINR_AGS2_RdyForSleep: service-kind=ANY-STANDARDIZED, invalidation-policy{data-element=SignalLINR_AGS2_RdyForSleep, handle-invalid=DONT-INVALIDATE}  # None
      data SignalLINR_AGS2_RdyForSleep: category=VALUE, type=ADTSBoolean, init-value=SignalLINR_AGS2_RdyForSleepValue:0
    SignalLINR_AGS_RdyForSleep: service-kind=ANY-STANDARDIZED, invalidation-policy{data-element=SignalLINR_AGS_RdyForSleep, handle-invalid=DONT-INVALIDATE}  # None
      data SignalLINR_AGS_RdyForSleep: category=VALUE, type=ADTSBoolean, init-value=SignalLINR_AGS_RdyForSleepValue:0
    SignalLINR_AHP_RdyForSleep: service-kind=ANY-STANDARDIZED, invalidation-policy{data-element=SignalLINR_AHP_RdyForSleep, handle-invalid=DONT-INVALIDATE}  # None
      data SignalLINR_AHP_RdyForSleep: category=VALUE, type=ADTSBoolean, init-value=SignalLINR_AHP_RdyForSleepValue:0
    SignalLINR_BCP_RdyForSleep: service-kind=ANY-STANDARDIZED, invalidation-policy{data-element=SignalLINR_BCP_RdyForSleep, handle-invalid=DONT-INVALIDATE}  # None
      data SignalLINR_BCP_RdyForSleep: category=VALUE, type=ADTSBoolean, init-value=SignalLINR_BCP_RdyForSleepValue:0
    SignalLINR_BHV_RdyForSleep: service-kind=ANY-STANDARDIZED, invalidation-policy{data-element=SignalLINR_BHV_RdyForSleep, handle-invalid=DONT-INVALIDATE}  # None
      data SignalLINR_BHV_RdyForSleep: category=VALUE, type=ADTSBoolean, init-value=SignalLINR_BHV_RdyForSleepValue:0
    SignalLINR_CACV_RdyForSleep: service-kind=ANY-STANDARDIZED, invalidation-policy{data-element=SignalLINR_CACV_RdyForSleep, handle-invalid=DONT-INVALIDATE}  # None
      data SignalLINR_CACV_RdyForSleep: category=VALUE, type=ADTSBoolean, init-value=SignalLINR_CACV_RdyForSleepValue:0
    SignalLINR_CEXV_RdyForSleep: service-kind=ANY-STANDARDIZED, invalidation-policy{data-element=SignalLINR_CEXV_RdyForSleep, handle-invalid=DONT-INVALIDATE}  # None
      data SignalLINR_CEXV_RdyForSleep: category=VALUE, type=ADTSBoolean, init-value=SignalLINR_CEXV_RdyForSleepValue:0
    SignalLINR_CPIM_RdyForSleep: service-kind=ANY-STANDARDIZED, invalidation-policy{data-element=SignalLINR_CPIM_RdyForSleep, handle-invalid=DONT-INVALIDATE}  # None
      data SignalLINR_CPIM_RdyForSleep: category=VALUE, type=ADTSBoolean, init-value=SignalLINR_CPIM_RdyForSleepValue:0
    SignalLINR_CPV_RdyForSleep: service-kind=ANY-STANDARDIZED, invalidation-policy{data-element=SignalLINR_CPV_RdyForSleep, handle-invalid=DONT-INVALIDATE}  # None
      data SignalLINR_CPV_RdyForSleep: category=VALUE, type=ADTSBoolean, init-value=SignalLINR_CPV_RdyForSleepValue:0
    SignalLINR_EAC2_RdyForSleep: service-kind=ANY-STANDARDIZED, invalidation-policy{data-element=SignalLINR_EAC2_RdyForSleep, handle-invalid=DONT-INVALIDATE}  # None
      data SignalLINR_EAC2_RdyForSleep: category=VALUE, type=ADTSBoolean, init-value=SignalLINR_EAC2_RdyForSleepValue:0
    SignalLINR_EAH_RdyForSleep: service-kind=ANY-STANDARDIZED, invalidation-policy{data-element=SignalLINR_EAH_RdyForSleep, handle-invalid=DONT-INVALIDATE}  # None
      data SignalLINR_EAH_RdyForSleep: category=VALUE, type=ADTSBoolean, init-value=SignalLINR_EAH_RdyForSleepValue:0
    SignalLINR_ECH_RdyForSleep: service-kind=ANY-STANDARDIZED, invalidation-policy{data-element=SignalLINR_ECH_RdyForSleep, handle-invalid=DONT-INVALIDATE}  # None
      data SignalLINR_ECH_RdyForSleep: category=VALUE, type=ADTSBoolean, init-value=SignalLINR_ECH_RdyForSleepValue:0
    SignalLINR_EEXV_RdyForSleep: service-kind=ANY-STANDARDIZED, invalidation-policy{data-element=SignalLINR_EEXV_RdyForSleep, handle-invalid=DONT-INVALIDATE}  # None
      data SignalLINR_EEXV_RdyForSleep: category=VALUE, type=ADTSBoolean, init-value=SignalLINR_EEXV_RdyForSleepValue:0
    SignalLINR_EOPA_RdyForSleep: service-kind=ANY-STANDARDIZED, invalidation-policy{data-element=SignalLINR_EOPA_RdyForSleep, handle-invalid=DONT-INVALIDATE}  # None
      data SignalLINR_EOPA_RdyForSleep: category=VALUE, type=ADTSBoolean, init-value=SignalLINR_EOPA_RdyForSleepValue:0
    SignalLINR_EOPB_RdyForSleep: service-kind=ANY-STANDARDIZED, invalidation-policy{data-element=SignalLINR_EOPB_RdyForSleep, handle-invalid=DONT-INVALIDATE}  # None
      data SignalLINR_EOPB_RdyForSleep: category=VALUE, type=ADTSBoolean, init-value=SignalLINR_EOPB_RdyForSleepValue:0
    SignalLINR_ESBM_RdyForSleep: service-kind=ANY-STANDARDIZED, invalidation-policy{data-element=SignalLINR_ESBM_RdyForSleep, handle-invalid=DONT-INVALIDATE}  # None
      data SignalLINR_ESBM_RdyForSleep: category=VALUE, type=ADTSBoolean, init-value=SignalLINR_ESBM_RdyForSleepValue:0
    SignalLINR_EXVM_RdyForSleep: service-kind=ANY-STANDARDIZED, invalidation-policy{data-element=SignalLINR_EXVM_RdyForSleep, handle-invalid=DONT-INVALIDATE}  # None
      data SignalLINR_EXVM_RdyForSleep: category=VALUE, type=ADTSBoolean, init-value=SignalLINR_EXVM_RdyForSleepValue:0
    SignalLINR_HTLBV_RdyForSleep: service-kind=ANY-STANDARDIZED, invalidation-policy{data-element=SignalLINR_HTLBV_RdyForSleep, handle-invalid=DONT-INVALIDATE}  # None
      data SignalLINR_HTLBV_RdyForSleep: category=VALUE, type=ADTSBoolean, init-value=SignalLINR_HTLBV_RdyForSleepValue:0
    SignalLINR_HTRBV_RdyForSleep: service-kind=ANY-STANDARDIZED, invalidation-policy{data-element=SignalLINR_HTRBV_RdyForSleep, handle-invalid=DONT-INVALIDATE}  # None
      data SignalLINR_HTRBV_RdyForSleep: category=VALUE, type=ADTSBoolean, init-value=SignalLINR_HTRBV_RdyForSleepValue:0
    SignalLINR_LTRBV_RdyForSleep: service-kind=ANY-STANDARDIZED, invalidation-policy{data-element=SignalLINR_LTRBV_RdyForSleep, handle-invalid=DONT-INVALIDATE}  # None
      data SignalLINR_LTRBV_RdyForSleep: category=VALUE, type=ADTSBoolean, init-value=SignalLINR_LTRBV_RdyForSleepValue:0
    SignalLINR_OEXV_RdyForSleep: service-kind=ANY-STANDARDIZED, invalidation-policy{data-element=SignalLINR_OEXV_RdyForSleep, handle-invalid=DONT-INVALIDATE}  # None
      data SignalLINR_OEXV_RdyForSleep: category=VALUE, type=ADTSBoolean, init-value=SignalLINR_OEXV_RdyForSleepValue:0
    SignalLINR_PECP2_RdyForSleep: service-kind=ANY-STANDARDIZED, invalidation-policy{data-element=SignalLINR_PECP2_RdyForSleep, handle-invalid=DONT-INVALIDATE}  # None
      data SignalLINR_PECP2_RdyForSleep: category=VALUE, type=ADTSBoolean, init-value=SignalLINR_PECP2_RdyForSleepValue:0
    SignalLINR_PECP_RdyForSleep: service-kind=ANY-STANDARDIZED, invalidation-policy{data-element=SignalLINR_PECP_RdyForSleep, handle-invalid=DONT-INVALIDATE}  # None
      data SignalLINR_PECP_RdyForSleep: category=VALUE, type=ADTSBoolean, init-value=SignalLINR_PECP_RdyForSleepValue:0
    SignalLINR_SPP2_RdyForSleep: service-kind=ANY-STANDARDIZED, invalidation-policy{data-element=SignalLINR_SPP2_RdyForSleep, handle-invalid=DONT-INVALIDATE}  # None
      data SignalLINR_SPP2_RdyForSleep: category=VALUE, type=ADTSBoolean, init-value=SignalLINR_SPP2_RdyForSleepValue:0
    SignalLINR_SPP_RdyForSleep: service-kind=ANY-STANDARDIZED, invalidation-policy{data-element=SignalLINR_SPP_RdyForSleep, handle-invalid=DONT-INVALIDATE}  # None
      data SignalLINR_SPP_RdyForSleep: category=VALUE, type=ADTSBoolean, init-value=SignalLINR_SPP_RdyForSleepValue:0
    VeLINR_I_AHP_CURR: service-kind=ANY-STANDARDIZED, invalidation-policy{data-element=VeLINR_I_AHP_CURR, handle-invalid=KEEP}  # -
      data VeLINR_I_AHP_CURR: category=VALUE, sw-calibration-access=READ-ONLY, type=ADTSAHP_CURR, init-value=VeLINR_I_AHP_CURRValue:51
    VeLINR_I_AirHeatrICns: service-kind=ANY-STANDARDIZED, invalidation-policy{data-element=VeLINR_I_AirHeatrICns, handle-invalid=KEEP}  # -
      data VeLINR_I_AirHeatrICns: category=VALUE, sw-calibration-access=READ-ONLY, type=ADTSAirHeatrICns, init-value=VeLINR_I_AirHeatrICnsValue:63.75
    VeLINR_I_BCP_CURR: service-kind=ANY-STANDARDIZED, invalidation-policy{data-element=VeLINR_I_BCP_CURR, handle-invalid=KEEP}  # -
      data VeLINR_I_BCP_CURR: category=VALUE, sw-calibration-access=READ-ONLY, type=ADTSBCP_CURR, init-value=VeLINR_I_BCP_CURRValue:51
    VeLINR_I_CompElecCurr: service-kind=ANY-STANDARDIZED, invalidation-policy{data-element=VeLINR_I_CompElecCurr, handle-invalid=KEEP}  # -
      data VeLINR_I_CompElecCurr: category=VALUE, sw-calibration-access=READ-ONLY, type=ADTSCompElecCurr, init-value=VeLINR_I_CompElecCurrValue:0
    VeLINR_I_CompElecCurr_800: service-kind=ANY-STANDARDIZED, invalidation-policy{data-element=VeLINR_I_CompElecCurr_800, handle-invalid=KEEP}  # -
      data VeLINR_I_CompElecCurr_800: category=VALUE, sw-calibration-access=READ-ONLY, type=ADTSCompElecCurr_800, init-value=VeLINR_I_CompElecCurr_800Value:0
    VeLINR_I_EOPA_CURR: service-kind=ANY-STANDARDIZED, invalidation-policy{data-element=VeLINR_I_EOPA_CURR, handle-invalid=KEEP}  # -
      data VeLINR_I_EOPA_CURR: category=VALUE, sw-calibration-access=READ-ONLY, type=ADTSEOPA_CURR, init-value=VeLINR_I_EOPA_CURRValue:51
    VeLINR_I_EOPB_CURR: service-kind=ANY-STANDARDIZED, invalidation-policy{data-element=VeLINR_I_EOPB_CURR, handle-invalid=KEEP}  # -
      data VeLINR_I_EOPB_CURR: category=VALUE, sw-calibration-access=READ-ONLY, type=ADTSEOPB_CURR, init-value=VeLINR_I_EOPB_CURRValue:51
    VeLINR_I_HvCooltHeatrICns: service-kind=ANY-STANDARDIZED, invalidation-policy{data-element=VeLINR_I_HvCooltHeatrICns, handle-invalid=KEEP}  # -
      data VeLINR_I_HvCooltHeatrICns: category=VALUE, sw-calibration-access=READ-ONLY, type=ADTSHvCooltHeatrICns, init-value=VeLINR_I_HvCooltHeatrICnsValue:63.75
    VeLINR_I_PECP2_CURR: service-kind=ANY-STANDARDIZED, invalidation-policy{data-element=VeLINR_I_PECP2_CURR, handle-invalid=KEEP}  # -
      data VeLINR_I_PECP2_CURR: category=VALUE, sw-calibration-access=READ-ONLY, type=ADTSPECP2_CURR, init-value=VeLINR_I_PECP2_CURRValue:51
    VeLINR_I_PECP_CURR: service-kind=ANY-STANDARDIZED, invalidation-policy{data-element=VeLINR_I_PECP_CURR, handle-invalid=KEEP}  # -
      data VeLINR_I_PECP_CURR: category=VALUE, sw-calibration-access=READ-ONLY, type=ADTSPECP_CURR, init-value=VeLINR_I_PECP_CURRValue:51
    VeLINR_I_PwrPanelCurrDrawSens1: service-kind=ANY-STANDARDIZED, invalidation-policy{data-element=VeLINR_I_PwrPanelCurrDrawSens1, handle-invalid=KEEP}  # -
      data VeLINR_I_PwrPanelCurrDrawSens1: category=VALUE, sw-calibration-access=READ-ONLY, type=ADTSPwrPanelCurrDrawSens1, init-value=VeLINR_I_PwrPanelCurrDrawSens1Value:0
    VeLINR_I_PwrPanelCurrDrawSens2: service-kind=ANY-STANDARDIZED, invalidation-policy{data-element=VeLINR_I_PwrPanelCurrDrawSens2, handle-invalid=KEEP}  # -
      data VeLINR_I_PwrPanelCurrDrawSens2: category=VALUE, sw-calibration-access=READ-ONLY, type=ADTSPwrPanelCurrDrawSens2, init-value=VeLINR_I_PwrPanelCurrDrawSens2Value:0
    VeLINR_P_CompElecPwr: service-kind=ANY-STANDARDIZED, invalidation-policy{data-element=VeLINR_P_CompElecPwr, handle-invalid=KEEP}  # -
      data VeLINR_P_CompElecPwr: category=VALUE, sw-calibration-access=READ-ONLY, type=ADTSCompElecPwr, init-value=VeLINR_P_CompElecPwrValue:0
    VeLINR_P_CompElecPwr_800: service-kind=ANY-STANDARDIZED, invalidation-policy{data-element=VeLINR_P_CompElecPwr_800, handle-invalid=KEEP}  # -
      data VeLINR_P_CompElecPwr_800: category=VALUE, sw-calibration-access=READ-ONLY, type=ADTSCompElecPwr_800, init-value=VeLINR_P_CompElecPwr_800Value:0
    VeLINR_P_HvHeatrPwrCns: service-kind=ANY-STANDARDIZED, invalidation-policy{data-element=VeLINR_P_HvHeatrPwrCns, handle-invalid=KEEP}  # -
      data VeLINR_P_HvHeatrPwrCns: category=VALUE, sw-calibration-access=READ-ONLY, type=ADTSHvHeatrPwrCns, init-value=VeLINR_P_HvHeatrPwrCnsValue:20460
    VeLINR_P_HvHeatrPwrCnsDes: service-kind=ANY-STANDARDIZED, invalidation-policy{data-element=VeLINR_P_HvHeatrPwrCnsDes, handle-invalid=KEEP}  # -
      data VeLINR_P_HvHeatrPwrCnsDes: category=VALUE, sw-calibration-access=READ-ONLY, type=ADTSHvHeatrPwrCnsDes, init-value=VeLINR_P_HvHeatrPwrCnsDesValue:20460
    VeLINR_Pct_AHP_RPM_ACTL_PERCT: service-kind=ANY-STANDARDIZED, invalidation-policy{data-element=VeLINR_Pct_AHP_RPM_ACTL_PERCT, handle-invalid=KEEP}  # -
      data VeLINR_Pct_AHP_RPM_ACTL_PERCT: category=VALUE, sw-calibration-access=READ-ONLY, type=ADTSAHP_RPM_ACTL_PERCT, init-value=VeLINR_Pct_AHP_RPM_ACTL_PERCTValue:100.3935
    VeLINR_Pct_AHP_RPM_TGT_PERCT: service-kind=ANY-STANDARDIZED, invalidation-policy{data-element=VeLINR_Pct_AHP_RPM_TGT_PERCT, handle-invalid=KEEP}  # -
      data VeLINR_Pct_AHP_RPM_TGT_PERCT: category=VALUE, sw-calibration-access=READ-ONLY, type=ADTSAHP_RPM_TGT_PERCT, init-value=VeLINR_Pct_AHP_RPM_TGT_PERCTValue:100.3935
    VeLINR_Pct_AirHeatrPwrCns: service-kind=ANY-STANDARDIZED, invalidation-policy{data-element=VeLINR_Pct_AirHeatrPwrCns, handle-invalid=KEEP}  # -
      data VeLINR_Pct_AirHeatrPwrCns: category=VALUE, sw-calibration-access=READ-ONLY, type=ADTSAirHeatrPwrCns, init-value=VeLINR_Pct_AirHeatrPwrCnsValue:255
    VeLINR_Pct_BCP_RPM_ACTUAL: service-kind=ANY-STANDARDIZED, invalidation-policy{data-element=VeLINR_Pct_BCP_RPM_ACTUAL, handle-invalid=KEEP}  # -
      data VeLINR_Pct_BCP_RPM_ACTUAL: category=VALUE, sw-calibration-access=READ-ONLY, type=ADTSBCP_RPM_ACTUAL, init-value=VeLINR_Pct_BCP_RPM_ACTUALValue:100.3935
    VeLINR_Pct_BCP_RPM_TARGET: service-kind=ANY-STANDARDIZED, invalidation-policy{data-element=VeLINR_Pct_BCP_RPM_TARGET, handle-invalid=KEEP}  # -
      data VeLINR_Pct_BCP_RPM_TARGET: category=VALUE, sw-calibration-access=READ-ONLY, type=ADTSBCP_RPM_TARGET, init-value=VeLINR_Pct_BCP_RPM_TARGETValue:100.3935
    VeLINR_Pct_BHV_PosAct: service-kind=ANY-STANDARDIZED, invalidation-policy{data-element=VeLINR_Pct_BHV_PosAct, handle-invalid=KEEP}  # -
      data VeLINR_Pct_BHV_PosAct: category=VALUE, sw-calibration-access=READ-ONLY, type=ADTSBHV_PosAct, init-value=VeLINR_Pct_BHV_PosActValue:0
    VeLINR_Pct_CEXV_PosAct: service-kind=ANY-STANDARDIZED, invalidation-policy{data-element=VeLINR_Pct_CEXV_PosAct, handle-invalid=KEEP}  # -
      data VeLINR_Pct_CEXV_PosAct: category=VALUE, sw-calibration-access=READ-ONLY, type=ADTSCEXV_PosAct, init-value=VeLINR_Pct_CEXV_PosActValue:0
    VeLINR_Pct_CPV_PosAct: service-kind=ANY-STANDARDIZED, invalidation-policy{data-element=VeLINR_Pct_CPV_PosAct, handle-invalid=KEEP}  # -
      data VeLINR_Pct_CPV_PosAct: category=VALUE, sw-calibration-access=READ-ONLY, type=ADTSCPV_PosAct, init-value=VeLINR_Pct_CPV_PosActValue:0
    VeLINR_Pct_EEXV_PosAct: service-kind=ANY-STANDARDIZED, invalidation-policy{data-element=VeLINR_Pct_EEXV_PosAct, handle-invalid=KEEP}  # -
      data VeLINR_Pct_EEXV_PosAct: category=VALUE, sw-calibration-access=READ-ONLY, type=ADTSEEXV_PosAct, init-value=VeLINR_Pct_EEXV_PosActValue:0
    VeLINR_Pct_EXVM_PosAct: service-kind=ANY-STANDARDIZED, invalidation-policy{data-element=VeLINR_Pct_EXVM_PosAct, handle-invalid=KEEP}  # -
      data VeLINR_Pct_EXVM_PosAct: category=VALUE, sw-calibration-access=READ-ONLY, type=ADTSEXVM_PosAct, init-value=VeLINR_Pct_EXVM_PosActValue:0
    VeLINR_Pct_HTLBV_PosAct: service-kind=ANY-STANDARDIZED, invalidation-policy{data-element=VeLINR_Pct_HTLBV_PosAct, handle-invalid=KEEP}  # -
      data VeLINR_Pct_HTLBV_PosAct: category=VALUE, sw-calibration-access=READ-ONLY, type=ADTSHTLBV_PosAct, init-value=VeLINR_Pct_HTLBV_PosActValue:0
    VeLINR_Pct_LTRBV_PosAct: service-kind=ANY-STANDARDIZED, invalidation-policy{data-element=VeLINR_Pct_LTRBV_PosAct, handle-invalid=KEEP}  # -
      data VeLINR_Pct_LTRBV_PosAct: category=VALUE, sw-calibration-access=READ-ONLY, type=ADTSLTRBV_PosAct, init-value=VeLINR_Pct_LTRBV_PosActValue:0
    VeLINR_Pct_OEXV_PosAct: service-kind=ANY-STANDARDIZED, invalidation-policy{data-element=VeLINR_Pct_OEXV_PosAct, handle-invalid=KEEP}  # -
      data VeLINR_Pct_OEXV_PosAct: category=VALUE, sw-calibration-access=READ-ONLY, type=ADTSOEXV_PosAct, init-value=VeLINR_Pct_OEXV_PosActValue:0
    VeLINR_Pct_PECP2_RPM_ACTL_PERCT: service-kind=ANY-STANDARDIZED, invalidation-policy{data-element=VeLINR_Pct_PECP2_RPM_ACTL_PERCT, handle-invalid=KEEP}  # -
      data VeLINR_Pct_PECP2_RPM_ACTL_PERCT: category=VALUE, sw-calibration-access=READ-ONLY, type=ADTSPECP2_RPM_ACTL_PERCT, init-value=VeLINR_Pct_PECP2_RPM_ACTL_PERCTValue:100.3935
    VeLINR_Pct_PECP2_RPM_TGT_PERCT: service-kind=ANY-STANDARDIZED, invalidation-policy{data-element=VeLINR_Pct_PECP2_RPM_TGT_PERCT, handle-invalid=KEEP}  # -
      data VeLINR_Pct_PECP2_RPM_TGT_PERCT: category=VALUE, sw-calibration-access=READ-ONLY, type=ADTSPECP2_RPM_TGT_PERCT, init-value=VeLINR_Pct_PECP2_RPM_TGT_PERCTValue:100.3935
    VeLINR_Pct_PECP_RPM_ACTL_PERCT: service-kind=ANY-STANDARDIZED, invalidation-policy{data-element=VeLINR_Pct_PECP_RPM_ACTL_PERCT, handle-invalid=KEEP}  # -
      data VeLINR_Pct_PECP_RPM_ACTL_PERCT: category=VALUE, sw-calibration-access=READ-ONLY, type=ADTSPECP_RPM_ACTL_PERCT, init-value=VeLINR_Pct_PECP_RPM_ACTL_PERCTValue:100.3935
    VeLINR_Pct_PECP_RPM_TGT_PERCT: service-kind=ANY-STANDARDIZED, invalidation-policy{data-element=VeLINR_Pct_PECP_RPM_TGT_PERCT, handle-invalid=KEEP}  # -
      data VeLINR_Pct_PECP_RPM_TGT_PERCT: category=VALUE, sw-calibration-access=READ-ONLY, type=ADTSPECP_RPM_TGT_PERCT, init-value=VeLINR_Pct_PECP_RPM_TGT_PERCTValue:100.3935
    VeLINR_T_AHP_TEMP: service-kind=ANY-STANDARDIZED, invalidation-policy{data-element=VeLINR_T_AHP_TEMP, handle-invalid=KEEP}  # -
      data VeLINR_T_AHP_TEMP: category=VALUE, sw-calibration-access=READ-ONLY, type=ADTSAHP_TEMP, init-value=VeLINR_T_AHP_TEMPValue:205
    VeLINR_T_AirHeatrCoreTemp: service-kind=ANY-STANDARDIZED, invalidation-policy{data-element=VeLINR_T_AirHeatrCoreTemp, handle-invalid=KEEP}  # -
      data VeLINR_T_AirHeatrCoreTemp: category=VALUE, sw-calibration-access=READ-ONLY, type=ADTSAirHeatrCoreTemp, init-value=VeLINR_T_AirHeatrCoreTempValue:215
    VeLINR_T_AirHeatrPCBTemp: service-kind=ANY-STANDARDIZED, invalidation-policy{data-element=VeLINR_T_AirHeatrPCBTemp, handle-invalid=KEEP}  # -
      data VeLINR_T_AirHeatrPCBTemp: category=VALUE, sw-calibration-access=READ-ONLY, type=ADTSAirHeatrPCBTemp, init-value=VeLINR_T_AirHeatrPCBTempValue:215
    VeLINR_T_BCP_TEMP: service-kind=ANY-STANDARDIZED, invalidation-policy{data-element=VeLINR_T_BCP_TEMP, handle-invalid=KEEP}  # -
      data VeLINR_T_BCP_TEMP: category=VALUE, sw-calibration-access=READ-ONLY, type=ADTSBCP_TEMP, init-value=VeLINR_T_BCP_TEMPValue:205
    VeLINR_T_CEXV_Board_Temp: service-kind=ANY-STANDARDIZED, invalidation-policy{data-element=VeLINR_T_CEXV_Board_Temp, handle-invalid=KEEP}  # -
      data VeLINR_T_CEXV_Board_Temp: category=VALUE, sw-calibration-access=READ-ONLY, type=ADTSCEXV_Board_Temp, init-value=VeLINR_T_CEXV_Board_TempValue:-40
    VeLINR_T_CompBoardTemp: service-kind=ANY-STANDARDIZED, invalidation-policy{data-element=VeLINR_T_CompBoardTemp, handle-invalid=KEEP}  # -
      data VeLINR_T_CompBoardTemp: category=VALUE, sw-calibration-access=READ-ONLY, type=ADTSCompBoardTemp, init-value=VeLINR_T_CompBoardTempValue:-40
    VeLINR_T_CompBoardTemp_800: service-kind=ANY-STANDARDIZED, invalidation-policy{data-element=VeLINR_T_CompBoardTemp_800, handle-invalid=KEEP}  # -
      data VeLINR_T_CompBoardTemp_800: category=VALUE, sw-calibration-access=READ-ONLY, type=ADTSCompBoardTemp_800, init-value=VeLINR_T_CompBoardTemp_800Value:-40
    VeLINR_T_CompIGBTTemp: service-kind=ANY-STANDARDIZED, invalidation-policy{data-element=VeLINR_T_CompIGBTTemp, handle-invalid=KEEP}  # -
      data VeLINR_T_CompIGBTTemp: category=VALUE, sw-calibration-access=READ-ONLY, type=ADTSCompIGBTTemp, init-value=VeLINR_T_CompIGBTTempValue:-40
    VeLINR_T_CompIGBTTemp_800: service-kind=ANY-STANDARDIZED, invalidation-policy{data-element=VeLINR_T_CompIGBTTemp_800, handle-invalid=KEEP}  # -
      data VeLINR_T_CompIGBTTemp_800: category=VALUE, sw-calibration-access=READ-ONLY, type=ADTSCompIGBTTemp_800, init-value=VeLINR_T_CompIGBTTemp_800Value:-40
    VeLINR_T_EEXV_Board_Temp: service-kind=ANY-STANDARDIZED, invalidation-policy{data-element=VeLINR_T_EEXV_Board_Temp, handle-invalid=KEEP}  # -
      data VeLINR_T_EEXV_Board_Temp: category=VALUE, sw-calibration-access=READ-ONLY, type=ADTSEEXV_Board_Temp, init-value=VeLINR_T_EEXV_Board_TempValue:-40
    VeLINR_T_EOPA_OIL_TEMP: service-kind=ANY-STANDARDIZED, invalidation-policy{data-element=VeLINR_T_EOPA_OIL_TEMP, handle-invalid=KEEP}  # -
      data VeLINR_T_EOPA_OIL_TEMP: category=VALUE, sw-calibration-access=READ-ONLY, type=ADTSEOPA_OIL_TEMP, init-value=VeLINR_T_EOPA_OIL_TEMPValue:205
    VeLINR_T_EOPA_TEMP: service-kind=ANY-STANDARDIZED, invalidation-policy{data-element=VeLINR_T_EOPA_TEMP, handle-invalid=KEEP}  # -
      data VeLINR_T_EOPA_TEMP: category=VALUE, sw-calibration-access=READ-ONLY, type=ADTSEOPA_TEMP, init-value=VeLINR_T_EOPA_TEMPValue:205
    VeLINR_T_EOPB_OIL_TEMP: service-kind=ANY-STANDARDIZED, invalidation-policy{data-element=VeLINR_T_EOPB_OIL_TEMP, handle-invalid=KEEP}  # -
      data VeLINR_T_EOPB_OIL_TEMP: category=VALUE, sw-calibration-access=READ-ONLY, type=ADTSEOPB_OIL_TEMP, init-value=VeLINR_T_EOPB_OIL_TEMPValue:205
    VeLINR_T_EOPB_TEMP: service-kind=ANY-STANDARDIZED, invalidation-policy{data-element=VeLINR_T_EOPB_TEMP, handle-invalid=KEEP}  # -
      data VeLINR_T_EOPB_TEMP: category=VALUE, sw-calibration-access=READ-ONLY, type=ADTSEOPB_TEMP, init-value=VeLINR_T_EOPB_TEMPValue:205
    VeLINR_T_EXVM_Board_Temp: service-kind=ANY-STANDARDIZED, invalidation-policy{data-element=VeLINR_T_EXVM_Board_Temp, handle-invalid=KEEP}  # -
      data VeLINR_T_EXVM_Board_Temp: category=VALUE, sw-calibration-access=READ-ONLY, type=ADTSEXVM_Board_Temp, init-value=VeLINR_T_EXVM_Board_TempValue:-40
    VeLINR_T_HvCltWtrHtrWtrTInIntk: service-kind=ANY-STANDARDIZED, invalidation-policy{data-element=VeLINR_T_HvCltWtrHtrWtrTInIntk, handle-invalid=KEEP}  # -
      data VeLINR_T_HvCltWtrHtrWtrTInIntk: category=VALUE, sw-calibration-access=READ-ONLY, type=ADTSHvCltWtrHtrWtrTInIntk, init-value=VeLINR_T_HvCltWtrHtrWtrTInIntkValue:215
    VeLINR_T_HvWtrHeatrWtrT: service-kind=ANY-STANDARDIZED, invalidation-policy{data-element=VeLINR_T_HvWtrHeatrWtrT, handle-invalid=KEEP}  # -
      data VeLINR_T_HvWtrHeatrWtrT: category=VALUE, sw-calibration-access=READ-ONLY, type=ADTSHvWtrHeatrWtrT, init-value=VeLINR_T_HvWtrHeatrWtrTValue:215
    VeLINR_T_OEXV_Board_Temp: service-kind=ANY-STANDARDIZED, invalidation-policy{data-element=VeLINR_T_OEXV_Board_Temp, handle-invalid=KEEP}  # -
      data VeLINR_T_OEXV_Board_Temp: category=VALUE, sw-calibration-access=READ-ONLY, type=ADTSOEXV_Board_Temp, init-value=VeLINR_T_OEXV_Board_TempValue:-40
    VeLINR_T_PECP2_TEMP: service-kind=ANY-STANDARDIZED, invalidation-policy{data-element=VeLINR_T_PECP2_TEMP, handle-invalid=KEEP}  # -
      data VeLINR_T_PECP2_TEMP: category=VALUE, sw-calibration-access=READ-ONLY, type=ADTSPECP2_TEMP, init-value=VeLINR_T_PECP2_TEMPValue:205
    VeLINR_T_PECP_TEMP: service-kind=ANY-STANDARDIZED, invalidation-policy{data-element=VeLINR_T_PECP_TEMP, handle-invalid=KEEP}  # -
      data VeLINR_T_PECP_TEMP: category=VALUE, sw-calibration-access=READ-ONLY, type=ADTSPECP_TEMP, init-value=VeLINR_T_PECP_TEMPValue:205
    VeLINR_U_AHP_VLTG: service-kind=ANY-STANDARDIZED, invalidation-policy{data-element=VeLINR_U_AHP_VLTG, handle-invalid=KEEP}  # -
      data VeLINR_U_AHP_VLTG: category=VALUE, sw-calibration-access=READ-ONLY, type=ADTSAHP_VLTG, init-value=VeLINR_U_AHP_VLTGValue:25.5
    VeLINR_U_AirHeatrHVmeas: service-kind=ANY-STANDARDIZED, invalidation-policy{data-element=VeLINR_U_AirHeatrHVmeas, handle-invalid=KEEP}  # -
      data VeLINR_U_AirHeatrHVmeas: category=VALUE, sw-calibration-access=READ-ONLY, type=ADTSAirHeatrHVmeas, init-value=VeLINR_U_AirHeatrHVmeasValue:1023
    VeLINR_U_BCP_VLTG: service-kind=ANY-STANDARDIZED, invalidation-policy{data-element=VeLINR_U_BCP_VLTG, handle-invalid=KEEP}  # -
      data VeLINR_U_BCP_VLTG: category=VALUE, sw-calibration-access=READ-ONLY, type=ADTSBCP_VLTG, init-value=VeLINR_U_BCP_VLTGValue:25.5
    VeLINR_U_BHV_MotorVolt: service-kind=ANY-STANDARDIZED, invalidation-policy{data-element=VeLINR_U_BHV_MotorVolt, handle-invalid=DONT-INVALIDATE}  # -
      data VeLINR_U_BHV_MotorVolt: category=VALUE, sw-calibration-access=READ-ONLY, type=ADTSBHV_MotorVolt, init-value=VeLINR_U_BHV_MotorVoltValue:0
    VeLINR_U_CEXV_SupplyVolt: service-kind=ANY-STANDARDIZED, invalidation-policy{data-element=VeLINR_U_CEXV_SupplyVolt, handle-invalid=KEEP}  # -
      data VeLINR_U_CEXV_SupplyVolt: category=VALUE, sw-calibration-access=READ-ONLY, type=ADTSCEXV_SupplyVolt, init-value=VeLINR_U_CEXV_SupplyVoltValue:0
    VeLINR_U_CPV_MotorVolt: service-kind=ANY-STANDARDIZED, invalidation-policy{data-element=VeLINR_U_CPV_MotorVolt, handle-invalid=DONT-INVALIDATE}  # -
      data VeLINR_U_CPV_MotorVolt: category=VALUE, sw-calibration-access=READ-ONLY, type=ADTSCPV_MotorVolt, init-value=VeLINR_U_CPV_MotorVoltValue:0
    VeLINR_U_CompHVInput: service-kind=ANY-STANDARDIZED, invalidation-policy{data-element=VeLINR_U_CompHVInput, handle-invalid=KEEP}  # -
      data VeLINR_U_CompHVInput: category=VALUE, sw-calibration-access=READ-ONLY, type=ADTSCompHVInput, init-value=VeLINR_U_CompHVInputValue:0
    VeLINR_U_CompHVInput_800: service-kind=ANY-STANDARDIZED, invalidation-policy{data-element=VeLINR_U_CompHVInput_800, handle-invalid=KEEP}  # -
      data VeLINR_U_CompHVInput_800: category=VALUE, sw-calibration-access=READ-ONLY, type=ADTSCompHVInput_800, init-value=VeLINR_U_CompHVInput_800Value:0
    VeLINR_U_EEXV_SupplyVolt: service-kind=ANY-STANDARDIZED, invalidation-policy{data-element=VeLINR_U_EEXV_SupplyVolt, handle-invalid=KEEP}  # -
      data VeLINR_U_EEXV_SupplyVolt: category=VALUE, sw-calibration-access=READ-ONLY, type=ADTSEEXV_SupplyVolt, init-value=VeLINR_U_EEXV_SupplyVoltValue:0
    VeLINR_U_EOPA_VLTG: service-kind=ANY-STANDARDIZED, invalidation-policy{data-element=VeLINR_U_EOPA_VLTG, handle-invalid=KEEP}  # -
      data VeLINR_U_EOPA_VLTG: category=VALUE, sw-calibration-access=READ-ONLY, type=ADTSEOPA_VLTG, init-value=VeLINR_U_EOPA_VLTGValue:25.5
    VeLINR_U_EOPB_VLTG: service-kind=ANY-STANDARDIZED, invalidation-policy{data-element=VeLINR_U_EOPB_VLTG, handle-invalid=KEEP}  # -
      data VeLINR_U_EOPB_VLTG: category=VALUE, sw-calibration-access=READ-ONLY, type=ADTSEOPB_VLTG, init-value=VeLINR_U_EOPB_VLTGValue:25.5
    VeLINR_U_EXVM_SupplyVolt: service-kind=ANY-STANDARDIZED, invalidation-policy{data-element=VeLINR_U_EXVM_SupplyVolt, handle-invalid=KEEP}  # -
      data VeLINR_U_EXVM_SupplyVolt: category=VALUE, sw-calibration-access=READ-ONLY, type=ADTSEXVM_SupplyVolt, init-value=VeLINR_U_EXVM_SupplyVoltValue:0
    VeLINR_U_HTLBV_MotorVolt: service-kind=ANY-STANDARDIZED, invalidation-policy{data-element=VeLINR_U_HTLBV_MotorVolt, handle-invalid=KEEP}  # -
      data VeLINR_U_HTLBV_MotorVolt: category=VALUE, sw-calibration-access=READ-ONLY, type=ADTSHTLBV_MotorVolt, init-value=VeLINR_U_HTLBV_MotorVoltValue:0
    VeLINR_U_HvCooltHVmeas: service-kind=ANY-STANDARDIZED, invalidation-policy{data-element=VeLINR_U_HvCooltHVmeas, handle-invalid=KEEP}  # -
      data VeLINR_U_HvCooltHVmeas: category=VALUE, sw-calibration-access=READ-ONLY, type=ADTSHvCooltHVmeas, init-value=VeLINR_U_HvCooltHVmeasValue:1023
    VeLINR_U_LTRBV_MotorVolt: service-kind=ANY-STANDARDIZED, invalidation-policy{data-element=VeLINR_U_LTRBV_MotorVolt, handle-invalid=KEEP}  # -
      data VeLINR_U_LTRBV_MotorVolt: category=VALUE, sw-calibration-access=READ-ONLY, type=ADTSLTRBV_MotorVolt, init-value=VeLINR_U_LTRBV_MotorVoltValue:0
    VeLINR_U_OEXV_SupplyVolt: service-kind=ANY-STANDARDIZED, invalidation-policy{data-element=VeLINR_U_OEXV_SupplyVolt, handle-invalid=KEEP}  # -
      data VeLINR_U_OEXV_SupplyVolt: category=VALUE, sw-calibration-access=READ-ONLY, type=ADTSOEXV_SupplyVolt, init-value=VeLINR_U_OEXV_SupplyVoltValue:0
    VeLINR_U_PECP2_VLTG: service-kind=ANY-STANDARDIZED, invalidation-policy{data-element=VeLINR_U_PECP2_VLTG, handle-invalid=KEEP}  # -
      data VeLINR_U_PECP2_VLTG: category=VALUE, sw-calibration-access=READ-ONLY, type=ADTSPECP2_VLTG, init-value=VeLINR_U_PECP2_VLTGValue:25.5
    VeLINR_U_PECP_VLTG: service-kind=ANY-STANDARDIZED, invalidation-policy{data-element=VeLINR_U_PECP_VLTG, handle-invalid=KEEP}  # -
      data VeLINR_U_PECP_VLTG: category=VALUE, sw-calibration-access=READ-ONLY, type=ADTSPECP_VLTG, init-value=VeLINR_U_PECP_VLTGValue:25.5
    VeLINR_b_AAD_CalActv: service-kind=ANY-STANDARDIZED, invalidation-policy{data-element=VeLINR_b_AAD_CalActv, handle-invalid=DONT-INVALIDATE}  # -
      data VeLINR_b_AAD_CalActv: category=VALUE, sw-calibration-access=READ-ONLY, type=ADTSBoolean, init-value=VeLINR_b_AAD_CalActvValue:0
    VeLINR_b_AAD_CalActvTO: service-kind=ANY-STANDARDIZED, invalidation-policy{data-element=VeLINR_b_AAD_CalActvTO, handle-invalid=DONT-INVALIDATE}  # - Time Out
      data VeLINR_b_AAD_CalActvTO: category=VALUE, sw-calibration-access=READ-ONLY, type=ADTSBoolean, init-value=VeLINR_b_AAD_CalActvTOValue:0
    VeLINR_b_AAD_CalStat: service-kind=ANY-STANDARDIZED, invalidation-policy{data-element=VeLINR_b_AAD_CalStat, handle-invalid=DONT-INVALIDATE}  # -
      data VeLINR_b_AAD_CalStat: category=VALUE, sw-calibration-access=READ-ONLY, type=ADTSBoolean, init-value=VeLINR_b_AAD_CalStatValue:0
    VeLINR_b_AAD_CalStatTO: service-kind=ANY-STANDARDIZED, invalidation-policy{data-element=VeLINR_b_AAD_CalStatTO, handle-invalid=DONT-INVALIDATE}  # - Time Out
      data VeLINR_b_AAD_CalStatTO: category=VALUE, sw-calibration-access=READ-ONLY, type=ADTSBoolean, init-value=VeLINR_b_AAD_CalStatTOValue:0
    VeLINR_b_AAD_CurrPosTO: service-kind=ANY-STANDARDIZED, invalidation-policy{data-element=VeLINR_b_AAD_CurrPosTO, handle-invalid=DONT-INVALIDATE}  # - Time Out
      data VeLINR_b_AAD_CurrPosTO: category=VALUE, sw-calibration-access=READ-ONLY, type=ADTSBoolean, init-value=VeLINR_b_AAD_CurrPosTOValue:0
    VeLINR_b_AAD_ErrMechBreak: service-kind=ANY-STANDARDIZED, invalidation-policy{data-element=VeLINR_b_AAD_ErrMechBreak, handle-invalid=DONT-INVALIDATE}  # -
      data VeLINR_b_AAD_ErrMechBreak: category=VALUE, sw-calibration-access=READ-ONLY, type=ADTSBoolean, init-value=VeLINR_b_AAD_ErrMechBreakValue:0
    VeLINR_b_AAD_ErrMechBreakTO: service-kind=ANY-STANDARDIZED, invalidation-policy{data-element=VeLINR_b_AAD_ErrMechBreakTO, handle-invalid=DONT-INVALIDATE}  # - Time Out
      data VeLINR_b_AAD_ErrMechBreakTO: category=VALUE, sw-calibration-access=READ-ONLY, type=ADTSBoolean, init-value=VeLINR_b_AAD_ErrMechBreakTOValue:0
    VeLINR_b_AAD_ErrMechStuck: service-kind=ANY-STANDARDIZED, invalidation-policy{data-element=VeLINR_b_AAD_ErrMechStuck, handle-invalid=DONT-INVALIDATE}  # -
      data VeLINR_b_AAD_ErrMechStuck: category=VALUE, sw-calibration-access=READ-ONLY, type=ADTSBoolean, init-value=VeLINR_b_AAD_ErrMechStuckValue:0
    VeLINR_b_AAD_ErrMechStuckTO: service-kind=ANY-STANDARDIZED, invalidation-policy{data-element=VeLINR_b_AAD_ErrMechStuckTO, handle-invalid=DONT-INVALIDATE}  # - Time Out
      data VeLINR_b_AAD_ErrMechStuckTO: category=VALUE, sw-calibration-access=READ-ONLY, type=ADTSBoolean, init-value=VeLINR_b_AAD_ErrMechStuckTOValue:0
    VeLINR_b_AAD_ErrOvrTemp: service-kind=ANY-STANDARDIZED, invalidation-policy{data-element=VeLINR_b_AAD_ErrOvrTemp, handle-invalid=DONT-INVALIDATE}  # -
      data VeLINR_b_AAD_ErrOvrTemp: category=VALUE, sw-calibration-access=READ-ONLY, type=ADTSBoolean, init-value=VeLINR_b_AAD_ErrOvrTempValue:0
    VeLINR_b_AAD_ErrOvrTempTO: service-kind=ANY-STANDARDIZED, invalidation-policy{data-element=VeLINR_b_AAD_ErrOvrTempTO, handle-invalid=DONT-INVALIDATE}  # - Time Out
      data VeLINR_b_AAD_ErrOvrTempTO: category=VALUE, sw-calibration-access=READ-ONLY, type=ADTSBoolean, init-value=VeLINR_b_AAD_ErrOvrTempTOValue:0
    VeLINR_b_AAD_ErrOvrVolt: service-kind=ANY-STANDARDIZED, invalidation-policy{data-element=VeLINR_b_AAD_ErrOvrVolt, handle-invalid=DONT-INVALIDATE}  # -
      data VeLINR_b_AAD_ErrOvrVolt: category=VALUE, sw-calibration-access=READ-ONLY, type=ADTSBoolean, init-value=VeLINR_b_AAD_ErrOvrVoltValue:0
    VeLINR_b_AAD_ErrOvrVoltTO: service-kind=ANY-STANDARDIZED, invalidation-policy{data-element=VeLINR_b_AAD_ErrOvrVoltTO, handle-invalid=DONT-INVALIDATE}  # - Time Out
      data VeLINR_b_AAD_ErrOvrVoltTO: category=VALUE, sw-calibration-access=READ-ONLY, type=ADTSBoolean, init-value=VeLINR_b_AAD_ErrOvrVoltTOValue:0
    VeLINR_b_AAD_ErrUnVolt: service-kind=ANY-STANDARDIZED, invalidation-policy{data-element=VeLINR_b_AAD_ErrUnVolt, handle-invalid=DONT-INVALIDATE}  # -
      data VeLINR_b_AAD_ErrUnVolt: category=VALUE, sw-calibration-access=READ-ONLY, type=ADTSBoolean, init-value=VeLINR_b_AAD_ErrUnVoltValue:0
    VeLINR_b_AAD_ErrUnVoltTO: service-kind=ANY-STANDARDIZED, invalidation-policy{data-element=VeLINR_b_AAD_ErrUnVoltTO, handle-invalid=DONT-INVALIDATE}  # - Time Out
      data VeLINR_b_AAD_ErrUnVoltTO: category=VALUE, sw-calibration-access=READ-ONLY, type=ADTSBoolean, init-value=VeLINR_b_AAD_ErrUnVoltTOValue:0
    VeLINR_b_AGS2_BoostStat: service-kind=ANY-STANDARDIZED, invalidation-policy{data-element=VeLINR_b_AGS2_BoostStat, handle-invalid=DONT-INVALIDATE}  # -
      data VeLINR_b_AGS2_BoostStat: category=VALUE, sw-calibration-access=READ-ONLY, type=ADTSBoolean, init-value=VeLINR_b_AGS2_BoostStatValue:0
    VeLINR_b_AGS2_BoostStatTO: service-kind=ANY-STANDARDIZED, invalidation-policy{data-element=VeLINR_b_AGS2_BoostStatTO, handle-invalid=DONT-INVALIDATE}  # - Time Out
      data VeLINR_b_AGS2_BoostStatTO: category=VALUE, sw-calibration-access=READ-ONLY, type=ADTSBoolean, init-value=VeLINR_b_AGS2_BoostStatTOValue:0
    VeLINR_b_AGS2_CalActv: service-kind=ANY-STANDARDIZED, invalidation-policy{data-element=VeLINR_b_AGS2_CalActv, handle-invalid=DONT-INVALIDATE}  # -
      data VeLINR_b_AGS2_CalActv: category=VALUE, sw-calibration-access=READ-ONLY, type=ADTSBoolean, init-value=VeLINR_b_AGS2_CalActvValue:0
    VeLINR_b_AGS2_CalActvTO: service-kind=ANY-STANDARDIZED, invalidation-policy{data-element=VeLINR_b_AGS2_CalActvTO, handle-invalid=DONT-INVALIDATE}  # - Time Out
      data VeLINR_b_AGS2_CalActvTO: category=VALUE, sw-calibration-access=READ-ONLY, type=ADTSBoolean, init-value=VeLINR_b_AGS2_CalActvTOValue:0
    VeLINR_b_AGS2_CalStat: service-kind=ANY-STANDARDIZED, invalidation-policy{data-element=VeLINR_b_AGS2_CalStat, handle-invalid=DONT-INVALIDATE}  # -
      data VeLINR_b_AGS2_CalStat: category=VALUE, sw-calibration-access=READ-ONLY, type=ADTSBoolean, init-value=VeLINR_b_AGS2_CalStatValue:0
    VeLINR_b_AGS2_CalStatTO: service-kind=ANY-STANDARDIZED, invalidation-policy{data-element=VeLINR_b_AGS2_CalStatTO, handle-invalid=DONT-INVALIDATE}  # - Time Out
      data VeLINR_b_AGS2_CalStatTO: category=VALUE, sw-calibration-access=READ-ONLY, type=ADTSBoolean, init-value=VeLINR_b_AGS2_CalStatTOValue:0
    VeLINR_b_AGS2_CurrPosTO: service-kind=ANY-STANDARDIZED, invalidation-policy{data-element=VeLINR_b_AGS2_CurrPosTO, handle-invalid=DONT-INVALIDATE}  # - Time Out
      data VeLINR_b_AGS2_CurrPosTO: category=VALUE, sw-calibration-access=READ-ONLY, type=ADTSBoolean, init-value=VeLINR_b_AGS2_CurrPosTOValue:0
    VeLINR_b_AGS2_ErrLIN_TO: service-kind=ANY-STANDARDIZED, invalidation-policy{data-element=VeLINR_b_AGS2_ErrLIN_TO, handle-invalid=DONT-INVALIDATE}  # - Time Out
      data VeLINR_b_AGS2_ErrLIN_TO: category=VALUE, sw-calibration-access=READ-ONLY, type=ADTSBoolean, init-value=VeLINR_b_AGS2_ErrLIN_TOValue:0
    VeLINR_b_AGS2_ErrMechBreak: service-kind=ANY-STANDARDIZED, invalidation-policy{data-element=VeLINR_b_AGS2_ErrMechBreak, handle-invalid=DONT-INVALIDATE}  # -
      data VeLINR_b_AGS2_ErrMechBreak: category=VALUE, sw-calibration-access=READ-ONLY, type=ADTSBoolean, init-value=VeLINR_b_AGS2_ErrMechBreakValue:0
    VeLINR_b_AGS2_ErrMechBreakTO: service-kind=ANY-STANDARDIZED, invalidation-policy{data-element=VeLINR_b_AGS2_ErrMechBreakTO, handle-invalid=DONT-INVALIDATE}  # - Time Out
      data VeLINR_b_AGS2_ErrMechBreakTO: category=VALUE, sw-calibration-access=READ-ONLY, type=ADTSBoolean, init-value=VeLINR_b_AGS2_ErrMechBreakTOValue:0
    VeLINR_b_AGS2_ErrMechStuck: service-kind=ANY-STANDARDIZED, invalidation-policy{data-element=VeLINR_b_AGS2_ErrMechStuck, handle-invalid=DONT-INVALIDATE}  # -
      data VeLINR_b_AGS2_ErrMechStuck: category=VALUE, sw-calibration-access=READ-ONLY, type=ADTSBoolean, init-value=VeLINR_b_AGS2_ErrMechStuckValue:0
    VeLINR_b_AGS2_ErrMechStuckTO: service-kind=ANY-STANDARDIZED, invalidation-policy{data-element=VeLINR_b_AGS2_ErrMechStuckTO, handle-invalid=DONT-INVALIDATE}  # - Time Out
      data VeLINR_b_AGS2_ErrMechStuckTO: category=VALUE, sw-calibration-access=READ-ONLY, type=ADTSBoolean, init-value=VeLINR_b_AGS2_ErrMechStuckTOValue:0
    VeLINR_b_AGS2_ErrOvrTemp: service-kind=ANY-STANDARDIZED, invalidation-policy{data-element=VeLINR_b_AGS2_ErrOvrTemp, handle-invalid=DONT-INVALIDATE}  # -
      data VeLINR_b_AGS2_ErrOvrTemp: category=VALUE, sw-calibration-access=READ-ONLY, type=ADTSBoolean, init-value=VeLINR_b_AGS2_ErrOvrTempValue:0
    VeLINR_b_AGS2_ErrOvrTempTO: service-kind=ANY-STANDARDIZED, invalidation-policy{data-element=VeLINR_b_AGS2_ErrOvrTempTO, handle-invalid=DONT-INVALIDATE}  # - Time Out
      data VeLINR_b_AGS2_ErrOvrTempTO: category=VALUE, sw-calibration-access=READ-ONLY, type=ADTSBoolean, init-value=VeLINR_b_AGS2_ErrOvrTempTOValue:0
    VeLINR_b_AGS2_ErrOvrVolt: service-kind=ANY-STANDARDIZED, invalidation-policy{data-element=VeLINR_b_AGS2_ErrOvrVolt, handle-invalid=DONT-INVALIDATE}  # -
      data VeLINR_b_AGS2_ErrOvrVolt: category=VALUE, sw-calibration-access=READ-ONLY, type=ADTSBoolean, init-value=VeLINR_b_AGS2_ErrOvrVoltValue:0
    VeLINR_b_AGS2_ErrOvrVoltTO: service-kind=ANY-STANDARDIZED, invalidation-policy{data-element=VeLINR_b_AGS2_ErrOvrVoltTO, handle-invalid=DONT-INVALIDATE}  # - Time Out
      data VeLINR_b_AGS2_ErrOvrVoltTO: category=VALUE, sw-calibration-access=READ-ONLY, type=ADTSBoolean, init-value=VeLINR_b_AGS2_ErrOvrVoltTOValue:0
    VeLINR_b_AGS2_ErrUnVolt: service-kind=ANY-STANDARDIZED, invalidation-policy{data-element=VeLINR_b_AGS2_ErrUnVolt, handle-invalid=DONT-INVALIDATE}  # -
      data VeLINR_b_AGS2_ErrUnVolt: category=VALUE, sw-calibration-access=READ-ONLY, type=ADTSBoolean, init-value=VeLINR_b_AGS2_ErrUnVoltValue:0
    VeLINR_b_AGS2_ErrUnVoltTO: service-kind=ANY-STANDARDIZED, invalidation-policy{data-element=VeLINR_b_AGS2_ErrUnVoltTO, handle-invalid=DONT-INVALIDATE}  # - Time Out
      data VeLINR_b_AGS2_ErrUnVoltTO: category=VALUE, sw-calibration-access=READ-ONLY, type=ADTSBoolean, init-value=VeLINR_b_AGS2_ErrUnVoltTOValue:0
    VeLINR_b_AGS_BoostStat: service-kind=ANY-STANDARDIZED, invalidation-policy{data-element=VeLINR_b_AGS_BoostStat, handle-invalid=DONT-INVALIDATE}  # -
      data VeLINR_b_AGS_BoostStat: category=VALUE, sw-calibration-access=READ-ONLY, type=ADTSBoolean, init-value=VeLINR_b_AGS_BoostStatValue:0
    VeLINR_b_AGS_BoostStatTO: service-kind=ANY-STANDARDIZED, invalidation-policy{data-element=VeLINR_b_AGS_BoostStatTO, handle-invalid=DONT-INVALIDATE}  # - Time Out
      data VeLINR_b_AGS_BoostStatTO: category=VALUE, sw-calibration-access=READ-ONLY, type=ADTSBoolean, init-value=VeLINR_b_AGS_BoostStatTOValue:0
    VeLINR_b_AGS_CalActv: service-kind=ANY-STANDARDIZED, invalidation-policy{data-element=VeLINR_b_AGS_CalActv, handle-invalid=DONT-INVALIDATE}  # -
      data VeLINR_b_AGS_CalActv: category=VALUE, sw-calibration-access=READ-ONLY, type=ADTSBoolean, init-value=VeLINR_b_AGS_CalActvValue:0
    VeLINR_b_AGS_CalActvTO: service-kind=ANY-STANDARDIZED, invalidation-policy{data-element=VeLINR_b_AGS_CalActvTO, handle-invalid=DONT-INVALIDATE}  # - Time Out
      data VeLINR_b_AGS_CalActvTO: category=VALUE, sw-calibration-access=READ-ONLY, type=ADTSBoolean, init-value=VeLINR_b_AGS_CalActvTOValue:0
    VeLINR_b_AGS_CalStat: service-kind=ANY-STANDARDIZED, invalidation-policy{data-element=VeLINR_b_AGS_CalStat, handle-invalid=DONT-INVALIDATE}  # -
      data VeLINR_b_AGS_CalStat: category=VALUE, sw-calibration-access=READ-ONLY, type=ADTSBoolean, init-value=VeLINR_b_AGS_CalStatValue:0
    VeLINR_b_AGS_CalStatTO: service-kind=ANY-STANDARDIZED, invalidation-policy{data-element=VeLINR_b_AGS_CalStatTO, handle-invalid=DONT-INVALIDATE}  # - Time Out
      data VeLINR_b_AGS_CalStatTO: category=VALUE, sw-calibration-access=READ-ONLY, type=ADTSBoolean, init-value=VeLINR_b_AGS_CalStatTOValue:0
    VeLINR_b_AGS_CurrPosTO: service-kind=ANY-STANDARDIZED, invalidation-policy{data-element=VeLINR_b_AGS_CurrPosTO, handle-invalid=DONT-INVALIDATE}  # - Time Out
      data VeLINR_b_AGS_CurrPosTO: category=VALUE, sw-calibration-access=READ-ONLY, type=ADTSBoolean, init-value=VeLINR_b_AGS_CurrPosTOValue:0
    VeLINR_b_AGS_ErrLIN_TO: service-kind=ANY-STANDARDIZED, invalidation-policy{data-element=VeLINR_b_AGS_ErrLIN_TO, handle-invalid=DONT-INVALIDATE}  # - Time Out
      data VeLINR_b_AGS_ErrLIN_TO: category=VALUE, sw-calibration-access=READ-ONLY, type=ADTSBoolean, init-value=VeLINR_b_AGS_ErrLIN_TOValue:0
    VeLINR_b_AGS_ErrMechBreak: service-kind=ANY-STANDARDIZED, invalidation-policy{data-element=VeLINR_b_AGS_ErrMechBreak, handle-invalid=DONT-INVALIDATE}  # -
      data VeLINR_b_AGS_ErrMechBreak: category=VALUE, sw-calibration-access=READ-ONLY, type=ADTSBoolean, init-value=VeLINR_b_AGS_ErrMechBreakValue:0
    VeLINR_b_AGS_ErrMechBreakTO: service-kind=ANY-STANDARDIZED, invalidation-policy{data-element=VeLINR_b_AGS_ErrMechBreakTO, handle-invalid=DONT-INVALIDATE}  # - Time Out
      data VeLINR_b_AGS_ErrMechBreakTO: category=VALUE, sw-calibration-access=READ-ONLY, type=ADTSBoolean, init-value=VeLINR_b_AGS_ErrMechBreakTOValue:0
    VeLINR_b_AGS_ErrMechStuck: service-kind=ANY-STANDARDIZED, invalidation-policy{data-element=VeLINR_b_AGS_ErrMechStuck, handle-invalid=DONT-INVALIDATE}  # -
      data VeLINR_b_AGS_ErrMechStuck: category=VALUE, sw-calibration-access=READ-ONLY, type=ADTSBoolean, init-value=VeLINR_b_AGS_ErrMechStuckValue:0
    VeLINR_b_AGS_ErrMechStuckTO: service-kind=ANY-STANDARDIZED, invalidation-policy{data-element=VeLINR_b_AGS_ErrMechStuckTO, handle-invalid=DONT-INVALIDATE}  # - Time Out
      data VeLINR_b_AGS_ErrMechStuckTO: category=VALUE, sw-calibration-access=READ-ONLY, type=ADTSBoolean, init-value=VeLINR_b_AGS_ErrMechStuckTOValue:0
    VeLINR_b_AGS_ErrOvrTemp: service-kind=ANY-STANDARDIZED, invalidation-policy{data-element=VeLINR_b_AGS_ErrOvrTemp, handle-invalid=DONT-INVALIDATE}  # -
      data VeLINR_b_AGS_ErrOvrTemp: category=VALUE, sw-calibration-access=READ-ONLY, type=ADTSBoolean, init-value=VeLINR_b_AGS_ErrOvrTempValue:0
    VeLINR_b_AGS_ErrOvrTempTO: service-kind=ANY-STANDARDIZED, invalidation-policy{data-element=VeLINR_b_AGS_ErrOvrTempTO, handle-invalid=DONT-INVALIDATE}  # - Time Out
      data VeLINR_b_AGS_ErrOvrTempTO: category=VALUE, sw-calibration-access=READ-ONLY, type=ADTSBoolean, init-value=VeLINR_b_AGS_ErrOvrTempTOValue:0
    VeLINR_b_AGS_ErrOvrVolt: service-kind=ANY-STANDARDIZED, invalidation-policy{data-element=VeLINR_b_AGS_ErrOvrVolt, handle-invalid=DONT-INVALIDATE}  # -
      data VeLINR_b_AGS_ErrOvrVolt: category=VALUE, sw-calibration-access=READ-ONLY, type=ADTSBoolean, init-value=VeLINR_b_AGS_ErrOvrVoltValue:0
    VeLINR_b_AGS_ErrOvrVoltTO: service-kind=ANY-STANDARDIZED, invalidation-policy{data-element=VeLINR_b_AGS_ErrOvrVoltTO, handle-invalid=DONT-INVALIDATE}  # - Time Out
      data VeLINR_b_AGS_ErrOvrVoltTO: category=VALUE, sw-calibration-access=READ-ONLY, type=ADTSBoolean, init-value=VeLINR_b_AGS_ErrOvrVoltTOValue:0
    VeLINR_b_AGS_ErrUnVolt: service-kind=ANY-STANDARDIZED, invalidation-policy{data-element=VeLINR_b_AGS_ErrUnVolt, handle-invalid=DONT-INVALIDATE}  # -
      data VeLINR_b_AGS_ErrUnVolt: category=VALUE, sw-calibration-access=READ-ONLY, type=ADTSBoolean, init-value=VeLINR_b_AGS_ErrUnVoltValue:0
    VeLINR_b_AGS_ErrUnVoltTO: service-kind=ANY-STANDARDIZED, invalidation-policy{data-element=VeLINR_b_AGS_ErrUnVoltTO, handle-invalid=DONT-INVALIDATE}  # - Time Out
      data VeLINR_b_AGS_ErrUnVoltTO: category=VALUE, sw-calibration-access=READ-ONLY, type=ADTSBoolean, init-value=VeLINR_b_AGS_ErrUnVoltTOValue:0
    VeLINR_b_AHP_AIR_PRE_ERR_TO: service-kind=ANY-STANDARDIZED, invalidation-policy{data-element=VeLINR_b_AHP_AIR_PRE_ERR_TO, handle-invalid=DONT-INVALIDATE}  # - Time Out
      data VeLINR_b_AHP_AIR_PRE_ERR_TO: category=VALUE, sw-calibration-access=READ-ONLY, type=ADTSBoolean, init-value=VeLINR_b_AHP_AIR_PRE_ERR_TOValue:0
    VeLINR_b_AHP_CURR_TO: service-kind=ANY-STANDARDIZED, invalidation-policy{data-element=VeLINR_b_AHP_CURR_TO, handle-invalid=DONT-INVALIDATE}  # - Time Out
      data VeLINR_b_AHP_CURR_TO: category=VALUE, sw-calibration-access=READ-ONLY, type=ADTSBoolean, init-value=VeLINR_b_AHP_CURR_TOValue:0
    VeLINR_b_AHP_DBLK_ACTV_TO: service-kind=ANY-STANDARDIZED, invalidation-policy{data-element=VeLINR_b_AHP_DBLK_ACTV_TO, handle-invalid=DONT-INVALIDATE}  # - Time Out
      data VeLINR_b_AHP_DBLK_ACTV_TO: category=VALUE, sw-calibration-access=READ-ONLY, type=ADTSBoolean, init-value=VeLINR_b_AHP_DBLK_ACTV_TOValue:0
    VeLINR_b_AHP_DR_RN_ERR_TO: service-kind=ANY-STANDARDIZED, invalidation-policy{data-element=VeLINR_b_AHP_DR_RN_ERR_TO, handle-invalid=DONT-INVALIDATE}  # - Time Out
      data VeLINR_b_AHP_DR_RN_ERR_TO: category=VALUE, sw-calibration-access=READ-ONLY, type=ADTSBoolean, init-value=VeLINR_b_AHP_DR_RN_ERR_TOValue:0
    VeLINR_b_AHP_FL_SAFE_ACTVTD_TO: service-kind=ANY-STANDARDIZED, invalidation-policy{data-element=VeLINR_b_AHP_FL_SAFE_ACTVTD_TO, handle-invalid=DONT-INVALIDATE}  # - Time Out
      data VeLINR_b_AHP_FL_SAFE_ACTVTD_TO: category=VALUE, sw-calibration-access=READ-ONLY, type=ADTSBoolean, init-value=VeLINR_b_AHP_FL_SAFE_ACTVTD_TOValue:0
    VeLINR_b_AHP_LMP_HM_AN_ON_TO: service-kind=ANY-STANDARDIZED, invalidation-policy{data-element=VeLINR_b_AHP_LMP_HM_AN_ON_TO, handle-invalid=DONT-INVALIDATE}  # - Time Out
      data VeLINR_b_AHP_LMP_HM_AN_ON_TO: category=VALUE, sw-calibration-access=READ-ONLY, type=ADTSBoolean, init-value=VeLINR_b_AHP_LMP_HM_AN_ON_TOValue:0
    VeLINR_b_AHP_MONTRNG_RPM_TO: service-kind=ANY-STANDARDIZED, invalidation-policy{data-element=VeLINR_b_AHP_MONTRNG_RPM_TO, handle-invalid=DONT-INVALIDATE}  # - Time Out
      data VeLINR_b_AHP_MONTRNG_RPM_TO: category=VALUE, sw-calibration-access=READ-ONLY, type=ADTSBoolean, init-value=VeLINR_b_AHP_MONTRNG_RPM_TOValue:0
    VeLINR_b_AHP_NODE_ERR_TO: service-kind=ANY-STANDARDIZED, invalidation-policy{data-element=VeLINR_b_AHP_NODE_ERR_TO, handle-invalid=DONT-INVALIDATE}  # - Time Out
      data VeLINR_b_AHP_NODE_ERR_TO: category=VALUE, sw-calibration-access=READ-ONLY, type=ADTSBoolean, init-value=VeLINR_b_AHP_NODE_ERR_TOValue:0
    VeLINR_b_AHP_OVR_CUR_ERR_TO: service-kind=ANY-STANDARDIZED, invalidation-policy{data-element=VeLINR_b_AHP_OVR_CUR_ERR_TO, handle-invalid=DONT-INVALIDATE}  # - Time Out
      data VeLINR_b_AHP_OVR_CUR_ERR_TO: category=VALUE, sw-calibration-access=READ-ONLY, type=ADTSBoolean, init-value=VeLINR_b_AHP_OVR_CUR_ERR_TOValue:0
    VeLINR_b_AHP_OVR_TMP_ERR_TO: service-kind=ANY-STANDARDIZED, invalidation-policy{data-element=VeLINR_b_AHP_OVR_TMP_ERR_TO, handle-invalid=DONT-INVALIDATE}  # - Time Out
      data VeLINR_b_AHP_OVR_TMP_ERR_TO: category=VALUE, sw-calibration-access=READ-ONLY, type=ADTSBoolean, init-value=VeLINR_b_AHP_OVR_TMP_ERR_TOValue:0
    VeLINR_b_AHP_POST_RUN_STAT_TO: service-kind=ANY-STANDARDIZED, invalidation-policy{data-element=VeLINR_b_AHP_POST_RUN_STAT_TO, handle-invalid=DONT-INVALIDATE}  # - Time Out
      data VeLINR_b_AHP_POST_RUN_STAT_TO: category=VALUE, sw-calibration-access=READ-ONLY, type=ADTSBoolean, init-value=VeLINR_b_AHP_POST_RUN_STAT_TOValue:0
    VeLINR_b_AHP_RPM_ACTL_PERCT_TO: service-kind=ANY-STANDARDIZED, invalidation-policy{data-element=VeLINR_b_AHP_RPM_ACTL_PERCT_TO, handle-invalid=DONT-INVALIDATE}  # - Time Out
      data VeLINR_b_AHP_RPM_ACTL_PERCT_TO: category=VALUE, sw-calibration-access=READ-ONLY, type=ADTSBoolean, init-value=VeLINR_b_AHP_RPM_ACTL_PERCT_TOValue:0
    VeLINR_b_AHP_RPM_TGT_PERCT_TO: service-kind=ANY-STANDARDIZED, invalidation-policy{data-element=VeLINR_b_AHP_RPM_TGT_PERCT_TO, handle-invalid=DONT-INVALIDATE}  # - Time Out
      data VeLINR_b_AHP_RPM_TGT_PERCT_TO: category=VALUE, sw-calibration-access=READ-ONLY, type=ADTSBoolean, init-value=VeLINR_b_AHP_RPM_TGT_PERCT_TOValue:0
    VeLINR_b_AHP_SUPPLIER_TO: service-kind=ANY-STANDARDIZED, invalidation-policy{data-element=VeLINR_b_AHP_SUPPLIER_TO, handle-invalid=DONT-INVALIDATE}  # - Time Out
      data VeLINR_b_AHP_SUPPLIER_TO: category=VALUE, sw-calibration-access=READ-ONLY, type=ADTSBoolean, init-value=VeLINR_b_AHP_SUPPLIER_TOValue:0
    VeLINR_b_AHP_TEMP_TO: service-kind=ANY-STANDARDIZED, invalidation-policy{data-element=VeLINR_b_AHP_TEMP_TO, handle-invalid=DONT-INVALIDATE}  # - Time Out
      data VeLINR_b_AHP_TEMP_TO: category=VALUE, sw-calibration-access=READ-ONLY, type=ADTSBoolean, init-value=VeLINR_b_AHP_TEMP_TOValue:0
    VeLINR_b_AHP_VERSION_TO: service-kind=ANY-STANDARDIZED, invalidation-policy{data-element=VeLINR_b_AHP_VERSION_TO, handle-invalid=DONT-INVALIDATE}  # - Time Out
      data VeLINR_b_AHP_VERSION_TO: category=VALUE, sw-calibration-access=READ-ONLY, type=ADTSBoolean, init-value=VeLINR_b_AHP_VERSION_TOValue:0
    VeLINR_b_AHP_VLTG_ERR_TO: service-kind=ANY-STANDARDIZED, invalidation-policy{data-element=VeLINR_b_AHP_VLTG_ERR_TO, handle-invalid=DONT-INVALIDATE}  # - Time Out
      data VeLINR_b_AHP_VLTG_ERR_TO: category=VALUE, sw-calibration-access=READ-ONLY, type=ADTSBoolean, init-value=VeLINR_b_AHP_VLTG_ERR_TOValue:0
    VeLINR_b_AHP_VLTG_TO: service-kind=ANY-STANDARDIZED, invalidation-policy{data-element=VeLINR_b_AHP_VLTG_TO, handle-invalid=DONT-INVALIDATE}  # - Time Out
      data VeLINR_b_AHP_VLTG_TO: category=VALUE, sw-calibration-access=READ-ONLY, type=ADTSBoolean, init-value=VeLINR_b_AHP_VLTG_TOValue:0
    VeLINR_b_AirHeatrCoreTempTO: service-kind=ANY-STANDARDIZED, invalidation-policy{data-element=VeLINR_b_AirHeatrCoreTempTO, handle-invalid=DONT-INVALIDATE}  # - Time Out
      data VeLINR_b_AirHeatrCoreTempTO: category=VALUE, sw-calibration-access=READ-ONLY, type=ADTSBoolean, init-value=VeLINR_b_AirHeatrCoreTempTOValue:0
    VeLINR_b_AirHeatrDmgHVISnsrFltTO: service-kind=ANY-STANDARDIZED, invalidation-policy{data-element=VeLINR_b_AirHeatrDmgHVISnsrFltTO, handle-invalid=DONT-INVALIDATE}  # - Time Out
      data VeLINR_b_AirHeatrDmgHVISnsrFltTO: category=VALUE, sw-calibration-access=READ-ONLY, type=ADTSBoolean, init-value=VeLINR_b_AirHeatrDmgHVISnsrFltTOValue:0
    VeLINR_b_AirHeatrDmgIntHwProtnTO: service-kind=ANY-STANDARDIZED, invalidation-policy{data-element=VeLINR_b_AirHeatrDmgIntHwProtnTO, handle-invalid=DONT-INVALIDATE}  # - Time Out
      data VeLINR_b_AirHeatrDmgIntHwProtnTO: category=VALUE, sw-calibration-access=READ-ONLY, type=ADTSBoolean, init-value=VeLINR_b_AirHeatrDmgIntHwProtnTOValue:0
    VeLINR_b_AirHeatrDmgMemErrTO: service-kind=ANY-STANDARDIZED, invalidation-policy{data-element=VeLINR_b_AirHeatrDmgMemErrTO, handle-invalid=DONT-INVALIDATE}  # - Time Out
      data VeLINR_b_AirHeatrDmgMemErrTO: category=VALUE, sw-calibration-access=READ-ONLY, type=ADTSBoolean, init-value=VeLINR_b_AirHeatrDmgMemErrTOValue:0
    VeLINR_b_AirHeatrHVmeasTO: service-kind=ANY-STANDARDIZED, invalidation-policy{data-element=VeLINR_b_AirHeatrHVmeasTO, handle-invalid=DONT-INVALIDATE}  # - Time Out
      data VeLINR_b_AirHeatrHVmeasTO: category=VALUE, sw-calibration-access=READ-ONLY, type=ADTSBoolean, init-value=VeLINR_b_AirHeatrHVmeasTOValue:0
    VeLINR_b_AirHeatrICnsTO: service-kind=ANY-STANDARDIZED, invalidation-policy{data-element=VeLINR_b_AirHeatrICnsTO, handle-invalid=DONT-INVALIDATE}  # - Time Out
      data VeLINR_b_AirHeatrICnsTO: category=VALUE, sw-calibration-access=READ-ONLY, type=ADTSBoolean, init-value=VeLINR_b_AirHeatrICnsTOValue:0
    VeLINR_b_AirHeatrPCBTempTO: service-kind=ANY-STANDARDIZED, invalidation-policy{data-element=VeLINR_b_AirHeatrPCBTempTO, handle-invalid=DONT-INVALIDATE}  # - Time Out
      data VeLINR_b_AirHeatrPCBTempTO: category=VALUE, sw-calibration-access=READ-ONLY, type=ADTSBoolean, init-value=VeLINR_b_AirHeatrPCBTempTOValue:0
    VeLINR_b_AirHeatrPwrCnsTO: service-kind=ANY-STANDARDIZED, invalidation-policy{data-element=VeLINR_b_AirHeatrPwrCnsTO, handle-invalid=DONT-INVALIDATE}  # - Time Out
      data VeLINR_b_AirHeatrPwrCnsTO: category=VALUE, sw-calibration-access=READ-ONLY, type=ADTSBoolean, init-value=VeLINR_b_AirHeatrPwrCnsTOValue:0
    VeLINR_b_AirHeatrStsTO: service-kind=ANY-STANDARDIZED, invalidation-policy{data-element=VeLINR_b_AirHeatrStsTO, handle-invalid=DONT-INVALIDATE}  # - Time Out
      data VeLINR_b_AirHeatrStsTO: category=VALUE, sw-calibration-access=READ-ONLY, type=ADTSBoolean, init-value=VeLINR_b_AirHeatrStsTOValue:0
    VeLINR_b_AirHeatrWarnFltInComTO: service-kind=ANY-STANDARDIZED, invalidation-policy{data-element=VeLINR_b_AirHeatrWarnFltInComTO, handle-invalid=DONT-INVALIDATE}  # - Time Out
      data VeLINR_b_AirHeatrWarnFltInComTO: category=VALUE, sw-calibration-access=READ-ONLY, type=ADTSBoolean, init-value=VeLINR_b_AirHeatrWarnFltInComTOValue:0
    VeLINR_b_AirHeatrWarnHvOutOfRngTO: service-kind=ANY-STANDARDIZED, invalidation-policy{data-element=VeLINR_b_AirHeatrWarnHvOutOfRngTO, handle-invalid=DONT-INVALIDATE}  # - Time Out
      data VeLINR_b_AirHeatrWarnHvOutOfRngTO: category=VALUE, sw-calibration-access=READ-ONLY, type=ADTSBoolean, init-value=VeLINR_b_AirHeatrWarnHvOutOfRngTOValue:0
    VeLINR_b_AirHeatrWarnPCBOvrTmpTO: service-kind=ANY-STANDARDIZED, invalidation-policy{data-element=VeLINR_b_AirHeatrWarnPCBOvrTmpTO, handle-invalid=DONT-INVALIDATE}  # - Time Out
      data VeLINR_b_AirHeatrWarnPCBOvrTmpTO: category=VALUE, sw-calibration-access=READ-ONLY, type=ADTSBoolean, init-value=VeLINR_b_AirHeatrWarnPCBOvrTmpTOValue:0
    VeLINR_b_AirHtrDmgCirDrvrShoOpnTO: service-kind=ANY-STANDARDIZED, invalidation-policy{data-element=VeLINR_b_AirHtrDmgCirDrvrShoOpnTO, handle-invalid=DONT-INVALIDATE}  # - Time Out
      data VeLINR_b_AirHtrDmgCirDrvrShoOpnTO: category=VALUE, sw-calibration-access=READ-ONLY, type=ADTSBoolean, init-value=VeLINR_b_AirHtrDmgCirDrvrShoOpnTOValue:0
    VeLINR_b_AirHtrDmgHtrCorTS_FltTO: service-kind=ANY-STANDARDIZED, invalidation-policy{data-element=VeLINR_b_AirHtrDmgHtrCorTS_FltTO, handle-invalid=DONT-INVALIDATE}  # - Time Out
      data VeLINR_b_AirHtrDmgHtrCorTS_FltTO: category=VALUE, sw-calibration-access=READ-ONLY, type=ADTSBoolean, init-value=VeLINR_b_AirHtrDmgHtrCorTS_FltTOValue:0
    VeLINR_b_AirHtrDmgPCBTmpSnsrFltTO: service-kind=ANY-STANDARDIZED, invalidation-policy{data-element=VeLINR_b_AirHtrDmgPCBTmpSnsrFltTO, handle-invalid=DONT-INVALIDATE}  # - Time Out
      data VeLINR_b_AirHtrDmgPCBTmpSnsrFltTO: category=VALUE, sw-calibration-access=READ-ONLY, type=ADTSBoolean, init-value=VeLINR_b_AirHtrDmgPCBTmpSnsrFltTOValue:0
    VeLINR_b_AirHtrWarnICnsOutOfRngTO: service-kind=ANY-STANDARDIZED, invalidation-policy{data-element=VeLINR_b_AirHtrWarnICnsOutOfRngTO, handle-invalid=DONT-INVALIDATE}  # - Time Out
      data VeLINR_b_AirHtrWarnICnsOutOfRngTO: category=VALUE, sw-calibration-access=READ-ONLY, type=ADTSBoolean, init-value=VeLINR_b_AirHtrWarnICnsOutOfRngTOValue:0
    VeLINR_b_AirHtrWarnTmpOvrheatgTO: service-kind=ANY-STANDARDIZED, invalidation-policy{data-element=VeLINR_b_AirHtrWarnTmpOvrheatgTO, handle-invalid=DONT-INVALIDATE}  # - Time Out
      data VeLINR_b_AirHtrWarnTmpOvrheatgTO: category=VALUE, sw-calibration-access=READ-ONLY, type=ADTSBoolean, init-value=VeLINR_b_AirHtrWarnTmpOvrheatgTOValue:0
    VeLINR_b_AirHtrWarnULoOutOfRngTO: service-kind=ANY-STANDARDIZED, invalidation-policy{data-element=VeLINR_b_AirHtrWarnULoOutOfRngTO, handle-invalid=DONT-INVALIDATE}  # - Time Out
      data VeLINR_b_AirHtrWarnULoOutOfRngTO: category=VALUE, sw-calibration-access=READ-ONLY, type=ADTSBoolean, init-value=VeLINR_b_AirHtrWarnULoOutOfRngTOValue:0
    VeLINR_b_AirHtrWrnHtrCorOvrTmpTO: service-kind=ANY-STANDARDIZED, invalidation-policy{data-element=VeLINR_b_AirHtrWrnHtrCorOvrTmpTO, handle-invalid=DONT-INVALIDATE}  # - Time Out
      data VeLINR_b_AirHtrWrnHtrCorOvrTmpTO: category=VALUE, sw-calibration-access=READ-ONLY, type=ADTSBoolean, init-value=VeLINR_b_AirHtrWrnHtrCorOvrTmpTOValue:0
    VeLINR_b_Ambient_TempTO: service-kind=ANY-STANDARDIZED, invalidation-policy{data-element=VeLINR_b_Ambient_TempTO, handle-invalid=DONT-INVALIDATE}  # - Time Out
      data VeLINR_b_Ambient_TempTO: category=VALUE, sw-calibration-access=READ-ONLY, type=ADTSBoolean, init-value=VeLINR_b_Ambient_TempTOValue:0
    VeLINR_b_BCP_AIR_PRE_ERR_TO: service-kind=ANY-STANDARDIZED, invalidation-policy{data-element=VeLINR_b_BCP_AIR_PRE_ERR_TO, handle-invalid=DONT-INVALIDATE}  # - Time Out
      data VeLINR_b_BCP_AIR_PRE_ERR_TO: category=VALUE, sw-calibration-access=READ-ONLY, type=ADTSBoolean, init-value=VeLINR_b_BCP_AIR_PRE_ERR_TOValue:0
    VeLINR_b_BCP_CURR_TO: service-kind=ANY-STANDARDIZED, invalidation-policy{data-element=VeLINR_b_BCP_CURR_TO, handle-invalid=DONT-INVALIDATE}  # - Time Out
      data VeLINR_b_BCP_CURR_TO: category=VALUE, sw-calibration-access=READ-ONLY, type=ADTSBoolean, init-value=VeLINR_b_BCP_CURR_TOValue:0
    VeLINR_b_BCP_DBLK_ACTV_TO: service-kind=ANY-STANDARDIZED, invalidation-policy{data-element=VeLINR_b_BCP_DBLK_ACTV_TO, handle-invalid=DONT-INVALIDATE}  # - Time Out
      data VeLINR_b_BCP_DBLK_ACTV_TO: category=VALUE, sw-calibration-access=READ-ONLY, type=ADTSBoolean, init-value=VeLINR_b_BCP_DBLK_ACTV_TOValue:0
    VeLINR_b_BCP_DR_RN_ERR_TO: service-kind=ANY-STANDARDIZED, invalidation-policy{data-element=VeLINR_b_BCP_DR_RN_ERR_TO, handle-invalid=DONT-INVALIDATE}  # - Time Out
      data VeLINR_b_BCP_DR_RN_ERR_TO: category=VALUE, sw-calibration-access=READ-ONLY, type=ADTSBoolean, init-value=VeLINR_b_BCP_DR_RN_ERR_TOValue:0
    VeLINR_b_BCP_FL_SAFE_ACTVTD_TO: service-kind=ANY-STANDARDIZED, invalidation-policy{data-element=VeLINR_b_BCP_FL_SAFE_ACTVTD_TO, handle-invalid=DONT-INVALIDATE}  # - Time Out
      data VeLINR_b_BCP_FL_SAFE_ACTVTD_TO: category=VALUE, sw-calibration-access=READ-ONLY, type=ADTSBoolean, init-value=VeLINR_b_BCP_FL_SAFE_ACTVTD_TOValue:0
    VeLINR_b_BCP_LMP_HM_AN_ON_TO: service-kind=ANY-STANDARDIZED, invalidation-policy{data-element=VeLINR_b_BCP_LMP_HM_AN_ON_TO, handle-invalid=DONT-INVALIDATE}  # - Time Out
      data VeLINR_b_BCP_LMP_HM_AN_ON_TO: category=VALUE, sw-calibration-access=READ-ONLY, type=ADTSBoolean, init-value=VeLINR_b_BCP_LMP_HM_AN_ON_TOValue:0
    VeLINR_b_BCP_MONTRNG_RPM_TO: service-kind=ANY-STANDARDIZED, invalidation-policy{data-element=VeLINR_b_BCP_MONTRNG_RPM_TO, handle-invalid=DONT-INVALIDATE}  # - Time Out
      data VeLINR_b_BCP_MONTRNG_RPM_TO: category=VALUE, sw-calibration-access=READ-ONLY, type=ADTSBoolean, init-value=VeLINR_b_BCP_MONTRNG_RPM_TOValue:0
    VeLINR_b_BCP_NODE_ERR_TO: service-kind=ANY-STANDARDIZED, invalidation-policy{data-element=VeLINR_b_BCP_NODE_ERR_TO, handle-invalid=DONT-INVALIDATE}  # - Time Out
      data VeLINR_b_BCP_NODE_ERR_TO: category=VALUE, sw-calibration-access=READ-ONLY, type=ADTSBoolean, init-value=VeLINR_b_BCP_NODE_ERR_TOValue:0
    VeLINR_b_BCP_OVR_CUR_ERR_TO: service-kind=ANY-STANDARDIZED, invalidation-policy{data-element=VeLINR_b_BCP_OVR_CUR_ERR_TO, handle-invalid=DONT-INVALIDATE}  # - Time Out
      data VeLINR_b_BCP_OVR_CUR_ERR_TO: category=VALUE, sw-calibration-access=READ-ONLY, type=ADTSBoolean, init-value=VeLINR_b_BCP_OVR_CUR_ERR_TOValue:0
    VeLINR_b_BCP_OVR_TMP_ERR_TO: service-kind=ANY-STANDARDIZED, invalidation-policy{data-element=VeLINR_b_BCP_OVR_TMP_ERR_TO, handle-invalid=DONT-INVALIDATE}  # - Time Out
      data VeLINR_b_BCP_OVR_TMP_ERR_TO: category=VALUE, sw-calibration-access=READ-ONLY, type=ADTSBoolean, init-value=VeLINR_b_BCP_OVR_TMP_ERR_TOValue:0
    VeLINR_b_BCP_POST_RUN_STAT_TO: service-kind=ANY-STANDARDIZED, invalidation-policy{data-element=VeLINR_b_BCP_POST_RUN_STAT_TO, handle-invalid=DONT-INVALIDATE}  # - Time Out
      data VeLINR_b_BCP_POST_RUN_STAT_TO: category=VALUE, sw-calibration-access=READ-ONLY, type=ADTSBoolean, init-value=VeLINR_b_BCP_POST_RUN_STAT_TOValue:0
    VeLINR_b_BCP_RPM_ACTUAL_TO: service-kind=ANY-STANDARDIZED, invalidation-policy{data-element=VeLINR_b_BCP_RPM_ACTUAL_TO, handle-invalid=DONT-INVALIDATE}  # - Time Out
      data VeLINR_b_BCP_RPM_ACTUAL_TO: category=VALUE, sw-calibration-access=READ-ONLY, type=ADTSBoolean, init-value=VeLINR_b_BCP_RPM_ACTUAL_TOValue:0
    VeLINR_b_BCP_RPM_TARGET_TO: service-kind=ANY-STANDARDIZED, invalidation-policy{data-element=VeLINR_b_BCP_RPM_TARGET_TO, handle-invalid=DONT-INVALIDATE}  # - Time Out
      data VeLINR_b_BCP_RPM_TARGET_TO: category=VALUE, sw-calibration-access=READ-ONLY, type=ADTSBoolean, init-value=VeLINR_b_BCP_RPM_TARGET_TOValue:0
    VeLINR_b_BCP_SUPPLIER_TO: service-kind=ANY-STANDARDIZED, invalidation-policy{data-element=VeLINR_b_BCP_SUPPLIER_TO, handle-invalid=DONT-INVALIDATE}  # - Time Out
      data VeLINR_b_BCP_SUPPLIER_TO: category=VALUE, sw-calibration-access=READ-ONLY, type=ADTSBoolean, init-value=VeLINR_b_BCP_SUPPLIER_TOValue:0
    VeLINR_b_BCP_TEMP_TO: service-kind=ANY-STANDARDIZED, invalidation-policy{data-element=VeLINR_b_BCP_TEMP_TO, handle-invalid=DONT-INVALIDATE}  # - Time Out
      data VeLINR_b_BCP_TEMP_TO: category=VALUE, sw-calibration-access=READ-ONLY, type=ADTSBoolean, init-value=VeLINR_b_BCP_TEMP_TOValue:0
    VeLINR_b_BCP_VERSION_TO: service-kind=ANY-STANDARDIZED, invalidation-policy{data-element=VeLINR_b_BCP_VERSION_TO, handle-invalid=DONT-INVALIDATE}  # - Time Out
      data VeLINR_b_BCP_VERSION_TO: category=VALUE, sw-calibration-access=READ-ONLY, type=ADTSBoolean, init-value=VeLINR_b_BCP_VERSION_TOValue:0
    VeLINR_b_BCP_VLTG_ERR_TO: service-kind=ANY-STANDARDIZED, invalidation-policy{data-element=VeLINR_b_BCP_VLTG_ERR_TO, handle-invalid=DONT-INVALIDATE}  # - Time Out
      data VeLINR_b_BCP_VLTG_ERR_TO: category=VALUE, sw-calibration-access=READ-ONLY, type=ADTSBoolean, init-value=VeLINR_b_BCP_VLTG_ERR_TOValue:0
    VeLINR_b_BCP_VLTG_TO: service-kind=ANY-STANDARDIZED, invalidation-policy{data-element=VeLINR_b_BCP_VLTG_TO, handle-invalid=DONT-INVALIDATE}  # - Time Out
      data VeLINR_b_BCP_VLTG_TO: category=VALUE, sw-calibration-access=READ-ONLY, type=ADTSBoolean, init-value=VeLINR_b_BCP_VLTG_TOValue:0
    VeLINR_b_BHV_CalStatTO: service-kind=ANY-STANDARDIZED, invalidation-policy{data-element=VeLINR_b_BHV_CalStatTO, handle-invalid=DONT-INVALIDATE}  # - Time Out
      data VeLINR_b_BHV_CalStatTO: category=VALUE, sw-calibration-access=READ-ONLY, type=ADTSBoolean, init-value=VeLINR_b_BHV_CalStatTOValue:0
    VeLINR_b_BHV_ERR_TO: service-kind=ANY-STANDARDIZED, invalidation-policy{data-element=VeLINR_b_BHV_ERR_TO, handle-invalid=DONT-INVALIDATE}  # - Time Out
      data VeLINR_b_BHV_ERR_TO: category=VALUE, sw-calibration-access=READ-ONLY, type=ADTSBoolean, init-value=VeLINR_b_BHV_ERR_TOValue:0
    VeLINR_b_BHV_MotorVoltTO: service-kind=ANY-STANDARDIZED, invalidation-policy{data-element=VeLINR_b_BHV_MotorVoltTO, handle-invalid=DONT-INVALIDATE}  # - Time Out
      data VeLINR_b_BHV_MotorVoltTO: category=VALUE, sw-calibration-access=READ-ONLY, type=ADTSBoolean, init-value=VeLINR_b_BHV_MotorVoltTOValue:0
    VeLINR_b_BHV_PosActTO: service-kind=ANY-STANDARDIZED, invalidation-policy{data-element=VeLINR_b_BHV_PosActTO, handle-invalid=DONT-INVALIDATE}  # - Time Out
      data VeLINR_b_BHV_PosActTO: category=VALUE, sw-calibration-access=READ-ONLY, type=ADTSBoolean, init-value=VeLINR_b_BHV_PosActTOValue:0
    VeLINR_b_BHV_StsTO: service-kind=ANY-STANDARDIZED, invalidation-policy{data-element=VeLINR_b_BHV_StsTO, handle-invalid=DONT-INVALIDATE}  # - Time Out
      data VeLINR_b_BHV_StsTO: category=VALUE, sw-calibration-access=READ-ONLY, type=ADTSBoolean, init-value=VeLINR_b_BHV_StsTOValue:0
    VeLINR_b_Below_60V_TO: service-kind=ANY-STANDARDIZED, invalidation-policy{data-element=VeLINR_b_Below_60V_TO, handle-invalid=DONT-INVALIDATE}  # - Time Out
      data VeLINR_b_Below_60V_TO: category=VALUE, sw-calibration-access=READ-ONLY, type=ADTSBoolean, init-value=VeLINR_b_Below_60V_TOValue:0
    VeLINR_b_CEXV_Board_TempTO: service-kind=ANY-STANDARDIZED, invalidation-policy{data-element=VeLINR_b_CEXV_Board_TempTO, handle-invalid=DONT-INVALIDATE}  # - Time Out
      data VeLINR_b_CEXV_Board_TempTO: category=VALUE, sw-calibration-access=READ-ONLY, type=ADTSBoolean, init-value=VeLINR_b_CEXV_Board_TempTOValue:0
    VeLINR_b_CEXV_CalRq: service-kind=ANY-STANDARDIZED, invalidation-policy{data-element=VeLINR_b_CEXV_CalRq, handle-invalid=DONT-INVALIDATE}  # -
      data VeLINR_b_CEXV_CalRq: category=VALUE, sw-calibration-access=READ-ONLY, type=ADTSBoolean, init-value=VeLINR_b_CEXV_CalRqValue:0
    VeLINR_b_CEXV_CalRqTO: service-kind=ANY-STANDARDIZED, invalidation-policy{data-element=VeLINR_b_CEXV_CalRqTO, handle-invalid=DONT-INVALIDATE}  # - Time Out
      data VeLINR_b_CEXV_CalRqTO: category=VALUE, sw-calibration-access=READ-ONLY, type=ADTSBoolean, init-value=VeLINR_b_CEXV_CalRqTOValue:0
    VeLINR_b_CEXV_CalStatTO: service-kind=ANY-STANDARDIZED, invalidation-policy{data-element=VeLINR_b_CEXV_CalStatTO, handle-invalid=DONT-INVALIDATE}  # - Time Out
      data VeLINR_b_CEXV_CalStatTO: category=VALUE, sw-calibration-access=READ-ONLY, type=ADTSBoolean, init-value=VeLINR_b_CEXV_CalStatTOValue:0
    VeLINR_b_CEXV_ERR_TO: service-kind=ANY-STANDARDIZED, invalidation-policy{data-element=VeLINR_b_CEXV_ERR_TO, handle-invalid=DONT-INVALIDATE}  # - Time Out
      data VeLINR_b_CEXV_ERR_TO: category=VALUE, sw-calibration-access=READ-ONLY, type=ADTSBoolean, init-value=VeLINR_b_CEXV_ERR_TOValue:0
    VeLINR_b_CEXV_PosActTO: service-kind=ANY-STANDARDIZED, invalidation-policy{data-element=VeLINR_b_CEXV_PosActTO, handle-invalid=DONT-INVALIDATE}  # - Time Out
      data VeLINR_b_CEXV_PosActTO: category=VALUE, sw-calibration-access=READ-ONLY, type=ADTSBoolean, init-value=VeLINR_b_CEXV_PosActTOValue:0
    VeLINR_b_CEXV_Refrigerant_PressTO: service-kind=ANY-STANDARDIZED, invalidation-policy{data-element=VeLINR_b_CEXV_Refrigerant_PressTO, handle-invalid=DONT-INVALIDATE}  # - Time Out
      data VeLINR_b_CEXV_Refrigerant_PressTO: category=VALUE, sw-calibration-access=READ-ONLY, type=ADTSBoolean, init-value=VeLINR_b_CEXV_Refrigerant_PressTOValue:0
    VeLINR_b_CEXV_Refrigerant_TempTO: service-kind=ANY-STANDARDIZED, invalidation-policy{data-element=VeLINR_b_CEXV_Refrigerant_TempTO, handle-invalid=DONT-INVALIDATE}  # - Time Out
      data VeLINR_b_CEXV_Refrigerant_TempTO: category=VALUE, sw-calibration-access=READ-ONLY, type=ADTSBoolean, init-value=VeLINR_b_CEXV_Refrigerant_TempTOValue:0
    VeLINR_b_CEXV_StsTO: service-kind=ANY-STANDARDIZED, invalidation-policy{data-element=VeLINR_b_CEXV_StsTO, handle-invalid=DONT-INVALIDATE}  # - Time Out
      data VeLINR_b_CEXV_StsTO: category=VALUE, sw-calibration-access=READ-ONLY, type=ADTSBoolean, init-value=VeLINR_b_CEXV_StsTOValue:0
    VeLINR_b_CEXV_SupplyVoltTO: service-kind=ANY-STANDARDIZED, invalidation-policy{data-element=VeLINR_b_CEXV_SupplyVoltTO, handle-invalid=DONT-INVALIDATE}  # - Time Out
      data VeLINR_b_CEXV_SupplyVoltTO: category=VALUE, sw-calibration-access=READ-ONLY, type=ADTSBoolean, init-value=VeLINR_b_CEXV_SupplyVoltTOValue:0
    VeLINR_b_CPIM_IND1_FailStsTO: service-kind=ANY-STANDARDIZED, invalidation-policy{data-element=VeLINR_b_CPIM_IND1_FailStsTO, handle-invalid=DONT-INVALIDATE}  # - Time Out
      data VeLINR_b_CPIM_IND1_FailStsTO: category=VALUE, sw-calibration-access=READ-ONLY, type=ADTSBoolean, init-value=VeLINR_b_CPIM_IND1_FailStsTOValue:0
    VeLINR_b_CPIM_IND1_FdbkTO: service-kind=ANY-STANDARDIZED, invalidation-policy{data-element=VeLINR_b_CPIM_IND1_FdbkTO, handle-invalid=DONT-INVALIDATE}  # - Time Out
      data VeLINR_b_CPIM_IND1_FdbkTO: category=VALUE, sw-calibration-access=READ-ONLY, type=ADTSBoolean, init-value=VeLINR_b_CPIM_IND1_FdbkTOValue:0
    VeLINR_b_CPIM_IND2_FailStsTO: service-kind=ANY-STANDARDIZED, invalidation-policy{data-element=VeLINR_b_CPIM_IND2_FailStsTO, handle-invalid=DONT-INVALIDATE}  # - Time Out
      data VeLINR_b_CPIM_IND2_FailStsTO: category=VALUE, sw-calibration-access=READ-ONLY, type=ADTSBoolean, init-value=VeLINR_b_CPIM_IND2_FailStsTOValue:0
    VeLINR_b_CPIM_IND2_FdbkTO: service-kind=ANY-STANDARDIZED, invalidation-policy{data-element=VeLINR_b_CPIM_IND2_FdbkTO, handle-invalid=DONT-INVALIDATE}  # - Time Out
      data VeLINR_b_CPIM_IND2_FdbkTO: category=VALUE, sw-calibration-access=READ-ONLY, type=ADTSBoolean, init-value=VeLINR_b_CPIM_IND2_FdbkTOValue:0
    VeLINR_b_CPIM_IND3_FailStsTO: service-kind=ANY-STANDARDIZED, invalidation-policy{data-element=VeLINR_b_CPIM_IND3_FailStsTO, handle-invalid=DONT-INVALIDATE}  # - Time Out
      data VeLINR_b_CPIM_IND3_FailStsTO: category=VALUE, sw-calibration-access=READ-ONLY, type=ADTSBoolean, init-value=VeLINR_b_CPIM_IND3_FailStsTOValue:0
    VeLINR_b_CPIM_IND3_FdbkTO: service-kind=ANY-STANDARDIZED, invalidation-policy{data-element=VeLINR_b_CPIM_IND3_FdbkTO, handle-invalid=DONT-INVALIDATE}  # - Time Out
      data VeLINR_b_CPIM_IND3_FdbkTO: category=VALUE, sw-calibration-access=READ-ONLY, type=ADTSBoolean, init-value=VeLINR_b_CPIM_IND3_FdbkTOValue:0
    VeLINR_b_CPIM_IND4_FailStsTO: service-kind=ANY-STANDARDIZED, invalidation-policy{data-element=VeLINR_b_CPIM_IND4_FailStsTO, handle-invalid=DONT-INVALIDATE}  # - Time Out
      data VeLINR_b_CPIM_IND4_FailStsTO: category=VALUE, sw-calibration-access=READ-ONLY, type=ADTSBoolean, init-value=VeLINR_b_CPIM_IND4_FailStsTOValue:0
    VeLINR_b_CPIM_IND4_FdbkTO: service-kind=ANY-STANDARDIZED, invalidation-policy{data-element=VeLINR_b_CPIM_IND4_FdbkTO, handle-invalid=DONT-INVALIDATE}  # - Time Out
      data VeLINR_b_CPIM_IND4_FdbkTO: category=VALUE, sw-calibration-access=READ-ONLY, type=ADTSBoolean, init-value=VeLINR_b_CPIM_IND4_FdbkTOValue:0
    VeLINR_b_CPIM_IND5_FailStsTO: service-kind=ANY-STANDARDIZED, invalidation-policy{data-element=VeLINR_b_CPIM_IND5_FailStsTO, handle-invalid=DONT-INVALIDATE}  # - Time Out
      data VeLINR_b_CPIM_IND5_FailStsTO: category=VALUE, sw-calibration-access=READ-ONLY, type=ADTSBoolean, init-value=VeLINR_b_CPIM_IND5_FailStsTOValue:0
    VeLINR_b_CPIM_IND5_FdbkTO: service-kind=ANY-STANDARDIZED, invalidation-policy{data-element=VeLINR_b_CPIM_IND5_FdbkTO, handle-invalid=DONT-INVALIDATE}  # - Time Out
      data VeLINR_b_CPIM_IND5_FdbkTO: category=VALUE, sw-calibration-access=READ-ONLY, type=ADTSBoolean, init-value=VeLINR_b_CPIM_IND5_FdbkTOValue:0
    VeLINR_b_CPIM_IND_Color_FdbkTO: service-kind=ANY-STANDARDIZED, invalidation-policy{data-element=VeLINR_b_CPIM_IND_Color_FdbkTO, handle-invalid=DONT-INVALIDATE}  # - Time Out
      data VeLINR_b_CPIM_IND_Color_FdbkTO: category=VALUE, sw-calibration-access=READ-ONLY, type=ADTSBoolean, init-value=VeLINR_b_CPIM_IND_Color_FdbkTOValue:0
    VeLINR_b_CPIM_LIN_ChecksumError: service-kind=ANY-STANDARDIZED, invalidation-policy{data-element=VeLINR_b_CPIM_LIN_ChecksumError, handle-invalid=DONT-INVALIDATE}  # -
      data VeLINR_b_CPIM_LIN_ChecksumError: category=VALUE, sw-calibration-access=READ-ONLY, type=ADTSBoolean, init-value=VeLINR_b_CPIM_LIN_ChecksumErrorValue:0
    VeLINR_b_CPIM_LIN_ChecksumErrorTO: service-kind=ANY-STANDARDIZED, invalidation-policy{data-element=VeLINR_b_CPIM_LIN_ChecksumErrorTO, handle-invalid=DONT-INVALIDATE}  # - Time Out
      data VeLINR_b_CPIM_LIN_ChecksumErrorTO: category=VALUE, sw-calibration-access=READ-ONLY, type=ADTSBoolean, init-value=VeLINR_b_CPIM_LIN_ChecksumErrorTOValue:0
    VeLINR_b_CPIM_LIN_Data_Error: service-kind=ANY-STANDARDIZED, invalidation-policy{data-element=VeLINR_b_CPIM_LIN_Data_Error, handle-invalid=DONT-INVALIDATE}  # -
      data VeLINR_b_CPIM_LIN_Data_Error: category=VALUE, sw-calibration-access=READ-ONLY, type=ADTSBoolean, init-value=VeLINR_b_CPIM_LIN_Data_ErrorValue:0
    VeLINR_b_CPIM_LIN_Data_ErrorTO: service-kind=ANY-STANDARDIZED, invalidation-policy{data-element=VeLINR_b_CPIM_LIN_Data_ErrorTO, handle-invalid=DONT-INVALIDATE}  # - Time Out
      data VeLINR_b_CPIM_LIN_Data_ErrorTO: category=VALUE, sw-calibration-access=READ-ONLY, type=ADTSBoolean, init-value=VeLINR_b_CPIM_LIN_Data_ErrorTOValue:0
    VeLINR_b_CPIM_LIN_Parity_Error: service-kind=ANY-STANDARDIZED, invalidation-policy{data-element=VeLINR_b_CPIM_LIN_Parity_Error, handle-invalid=DONT-INVALIDATE}  # -
      data VeLINR_b_CPIM_LIN_Parity_Error: category=VALUE, sw-calibration-access=READ-ONLY, type=ADTSBoolean, init-value=VeLINR_b_CPIM_LIN_Parity_ErrorValue:0
    VeLINR_b_CPIM_LIN_Parity_ErrorTO: service-kind=ANY-STANDARDIZED, invalidation-policy{data-element=VeLINR_b_CPIM_LIN_Parity_ErrorTO, handle-invalid=DONT-INVALIDATE}  # - Time Out
      data VeLINR_b_CPIM_LIN_Parity_ErrorTO: category=VALUE, sw-calibration-access=READ-ONLY, type=ADTSBoolean, init-value=VeLINR_b_CPIM_LIN_Parity_ErrorTOValue:0
    VeLINR_b_CPIM_Over_Temperature: service-kind=ANY-STANDARDIZED, invalidation-policy{data-element=VeLINR_b_CPIM_Over_Temperature, handle-invalid=DONT-INVALIDATE}  # -
      data VeLINR_b_CPIM_Over_Temperature: category=VALUE, sw-calibration-access=READ-ONLY, type=ADTSBoolean, init-value=VeLINR_b_CPIM_Over_TemperatureValue:0
    VeLINR_b_CPIM_Over_TemperatureTO: service-kind=ANY-STANDARDIZED, invalidation-policy{data-element=VeLINR_b_CPIM_Over_TemperatureTO, handle-invalid=DONT-INVALIDATE}  # - Time Out
      data VeLINR_b_CPIM_Over_TemperatureTO: category=VALUE, sw-calibration-access=READ-ONLY, type=ADTSBoolean, init-value=VeLINR_b_CPIM_Over_TemperatureTOValue:0
    VeLINR_b_CPIM_Undervoltage: service-kind=ANY-STANDARDIZED, invalidation-policy{data-element=VeLINR_b_CPIM_Undervoltage, handle-invalid=DONT-INVALIDATE}  # -
      data VeLINR_b_CPIM_Undervoltage: category=VALUE, sw-calibration-access=READ-ONLY, type=ADTSBoolean, init-value=VeLINR_b_CPIM_UndervoltageValue:0
    VeLINR_b_CPIM_UndervoltageTO: service-kind=ANY-STANDARDIZED, invalidation-policy{data-element=VeLINR_b_CPIM_UndervoltageTO, handle-invalid=DONT-INVALIDATE}  # - Time Out
      data VeLINR_b_CPIM_UndervoltageTO: category=VALUE, sw-calibration-access=READ-ONLY, type=ADTSBoolean, init-value=VeLINR_b_CPIM_UndervoltageTOValue:0
    VeLINR_b_CPV_CalStatTO: service-kind=ANY-STANDARDIZED, invalidation-policy{data-element=VeLINR_b_CPV_CalStatTO, handle-invalid=DONT-INVALIDATE}  # - Time Out
      data VeLINR_b_CPV_CalStatTO: category=VALUE, sw-calibration-access=READ-ONLY, type=ADTSBoolean, init-value=VeLINR_b_CPV_CalStatTOValue:0
    VeLINR_b_CPV_ERR_TO: service-kind=ANY-STANDARDIZED, invalidation-policy{data-element=VeLINR_b_CPV_ERR_TO, handle-invalid=DONT-INVALIDATE}  # - Time Out
      data VeLINR_b_CPV_ERR_TO: category=VALUE, sw-calibration-access=READ-ONLY, type=ADTSBoolean, init-value=VeLINR_b_CPV_ERR_TOValue:0
    VeLINR_b_CPV_MotorVoltTO: service-kind=ANY-STANDARDIZED, invalidation-policy{data-element=VeLINR_b_CPV_MotorVoltTO, handle-invalid=DONT-INVALIDATE}  # - Time Out
      data VeLINR_b_CPV_MotorVoltTO: category=VALUE, sw-calibration-access=READ-ONLY, type=ADTSBoolean, init-value=VeLINR_b_CPV_MotorVoltTOValue:0
    VeLINR_b_CPV_PosActTO: service-kind=ANY-STANDARDIZED, invalidation-policy{data-element=VeLINR_b_CPV_PosActTO, handle-invalid=DONT-INVALIDATE}  # - Time Out
      data VeLINR_b_CPV_PosActTO: category=VALUE, sw-calibration-access=READ-ONLY, type=ADTSBoolean, init-value=VeLINR_b_CPV_PosActTOValue:0
    VeLINR_b_CPV_StsTO: service-kind=ANY-STANDARDIZED, invalidation-policy{data-element=VeLINR_b_CPV_StsTO, handle-invalid=DONT-INVALIDATE}  # - Time Out
      data VeLINR_b_CPV_StsTO: category=VALUE, sw-calibration-access=READ-ONLY, type=ADTSBoolean, init-value=VeLINR_b_CPV_StsTOValue:0
    VeLINR_b_ChrgPortButton_Sts: service-kind=ANY-STANDARDIZED, invalidation-policy{data-element=VeLINR_b_ChrgPortButton_Sts, handle-invalid=DONT-INVALIDATE}  # -
      data VeLINR_b_ChrgPortButton_Sts: category=VALUE, sw-calibration-access=READ-ONLY, type=ADTSBoolean, init-value=VeLINR_b_ChrgPortButton_StsValue:0
    VeLINR_b_ChrgPortButton_StsTO: service-kind=ANY-STANDARDIZED, invalidation-policy{data-element=VeLINR_b_ChrgPortButton_StsTO, handle-invalid=DONT-INVALIDATE}  # - Time Out
      data VeLINR_b_ChrgPortButton_StsTO: category=VALUE, sw-calibration-access=READ-ONLY, type=ADTSBoolean, init-value=VeLINR_b_ChrgPortButton_StsTOValue:0
    VeLINR_b_ChrgPortDoor_StsTO: service-kind=ANY-STANDARDIZED, invalidation-policy{data-element=VeLINR_b_ChrgPortDoor_StsTO, handle-invalid=DONT-INVALIDATE}  # - Time Out
      data VeLINR_b_ChrgPortDoor_StsTO: category=VALUE, sw-calibration-access=READ-ONLY, type=ADTSBoolean, init-value=VeLINR_b_ChrgPortDoor_StsTOValue:0
    VeLINR_b_ChrgPortLock_FailStsTO: service-kind=ANY-STANDARDIZED, invalidation-policy{data-element=VeLINR_b_ChrgPortLock_FailStsTO, handle-invalid=DONT-INVALIDATE}  # - Time Out
      data VeLINR_b_ChrgPortLock_FailStsTO: category=VALUE, sw-calibration-access=READ-ONLY, type=ADTSBoolean, init-value=VeLINR_b_ChrgPortLock_FailStsTOValue:0
    VeLINR_b_ChrgPortLock_Sts: service-kind=ANY-STANDARDIZED, invalidation-policy{data-element=VeLINR_b_ChrgPortLock_Sts, handle-invalid=DONT-INVALIDATE}  # -
      data VeLINR_b_ChrgPortLock_Sts: category=VALUE, sw-calibration-access=READ-ONLY, type=ADTSBoolean, init-value=VeLINR_b_ChrgPortLock_StsValue:0
    VeLINR_b_ChrgPortLock_StsTO: service-kind=ANY-STANDARDIZED, invalidation-policy{data-element=VeLINR_b_ChrgPortLock_StsTO, handle-invalid=DONT-INVALIDATE}  # - Time Out
      data VeLINR_b_ChrgPortLock_StsTO: category=VALUE, sw-calibration-access=READ-ONLY, type=ADTSBoolean, init-value=VeLINR_b_ChrgPortLock_StsTOValue:0
    VeLINR_b_Chrg_Inlet_TempTO: service-kind=ANY-STANDARDIZED, invalidation-policy{data-element=VeLINR_b_Chrg_Inlet_TempTO, handle-invalid=DONT-INVALIDATE}  # - Time Out
      data VeLINR_b_Chrg_Inlet_TempTO: category=VALUE, sw-calibration-access=READ-ONLY, type=ADTSBoolean, init-value=VeLINR_b_Chrg_Inlet_TempTOValue:0
    VeLINR_b_CompBoardTempTO: service-kind=ANY-STANDARDIZED, invalidation-policy{data-element=VeLINR_b_CompBoardTempTO, handle-invalid=DONT-INVALIDATE}  # - Time Out
      data VeLINR_b_CompBoardTempTO: category=VALUE, sw-calibration-access=READ-ONLY, type=ADTSBoolean, init-value=VeLINR_b_CompBoardTempTOValue:0
    VeLINR_b_CompBoardTemp_800TO: service-kind=ANY-STANDARDIZED, invalidation-policy{data-element=VeLINR_b_CompBoardTemp_800TO, handle-invalid=DONT-INVALIDATE}  # - Time Out
      data VeLINR_b_CompBoardTemp_800TO: category=VALUE, sw-calibration-access=READ-ONLY, type=ADTSBoolean, init-value=VeLINR_b_CompBoardTemp_800TOValue:0
    VeLINR_b_CompElecCurrTO: service-kind=ANY-STANDARDIZED, invalidation-policy{data-element=VeLINR_b_CompElecCurrTO, handle-invalid=DONT-INVALIDATE}  # - Time Out
      data VeLINR_b_CompElecCurrTO: category=VALUE, sw-calibration-access=READ-ONLY, type=ADTSBoolean, init-value=VeLINR_b_CompElecCurrTOValue:0
    VeLINR_b_CompElecCurr_800TO: service-kind=ANY-STANDARDIZED, invalidation-policy{data-element=VeLINR_b_CompElecCurr_800TO, handle-invalid=DONT-INVALIDATE}  # - Time Out
      data VeLINR_b_CompElecCurr_800TO: category=VALUE, sw-calibration-access=READ-ONLY, type=ADTSBoolean, init-value=VeLINR_b_CompElecCurr_800TOValue:0
    VeLINR_b_CompElecPwrTO: service-kind=ANY-STANDARDIZED, invalidation-policy{data-element=VeLINR_b_CompElecPwrTO, handle-invalid=DONT-INVALIDATE}  # - Time Out
      data VeLINR_b_CompElecPwrTO: category=VALUE, sw-calibration-access=READ-ONLY, type=ADTSBoolean, init-value=VeLINR_b_CompElecPwrTOValue:0
    VeLINR_b_CompElecPwr_800TO: service-kind=ANY-STANDARDIZED, invalidation-policy{data-element=VeLINR_b_CompElecPwr_800TO, handle-invalid=DONT-INVALIDATE}  # - Time Out
      data VeLINR_b_CompElecPwr_800TO: category=VALUE, sw-calibration-access=READ-ONLY, type=ADTSBoolean, init-value=VeLINR_b_CompElecPwr_800TOValue:0
    VeLINR_b_CompFaultStatTO: service-kind=ANY-STANDARDIZED, invalidation-policy{data-element=VeLINR_b_CompFaultStatTO, handle-invalid=DONT-INVALIDATE}  # - Time Out
      data VeLINR_b_CompFaultStatTO: category=VALUE, sw-calibration-access=READ-ONLY, type=ADTSBoolean, init-value=VeLINR_b_CompFaultStatTOValue:0
    VeLINR_b_CompFaultStat_800TO: service-kind=ANY-STANDARDIZED, invalidation-policy{data-element=VeLINR_b_CompFaultStat_800TO, handle-invalid=DONT-INVALIDATE}  # - Time Out
      data VeLINR_b_CompFaultStat_800TO: category=VALUE, sw-calibration-access=READ-ONLY, type=ADTSBoolean, init-value=VeLINR_b_CompFaultStat_800TOValue:0
    VeLINR_b_CompHVInputTO: service-kind=ANY-STANDARDIZED, invalidation-policy{data-element=VeLINR_b_CompHVInputTO, handle-invalid=DONT-INVALIDATE}  # - Time Out
      data VeLINR_b_CompHVInputTO: category=VALUE, sw-calibration-access=READ-ONLY, type=ADTSBoolean, init-value=VeLINR_b_CompHVInputTOValue:0
    VeLINR_b_CompHVInput_800TO: service-kind=ANY-STANDARDIZED, invalidation-policy{data-element=VeLINR_b_CompHVInput_800TO, handle-invalid=DONT-INVALIDATE}  # - Time Out
      data VeLINR_b_CompHVInput_800TO: category=VALUE, sw-calibration-access=READ-ONLY, type=ADTSBoolean, init-value=VeLINR_b_CompHVInput_800TOValue:0
    VeLINR_b_CompIGBTTempTO: service-kind=ANY-STANDARDIZED, invalidation-policy{data-element=VeLINR_b_CompIGBTTempTO, handle-invalid=DONT-INVALIDATE}  # - Time Out
      data VeLINR_b_CompIGBTTempTO: category=VALUE, sw-calibration-access=READ-ONLY, type=ADTSBoolean, init-value=VeLINR_b_CompIGBTTempTOValue:0
    VeLINR_b_CompIGBTTemp_800TO: service-kind=ANY-STANDARDIZED, invalidation-policy{data-element=VeLINR_b_CompIGBTTemp_800TO, handle-invalid=DONT-INVALIDATE}  # - Time Out
      data VeLINR_b_CompIGBTTemp_800TO: category=VALUE, sw-calibration-access=READ-ONLY, type=ADTSBoolean, init-value=VeLINR_b_CompIGBTTemp_800TOValue:0
    VeLINR_b_CompSpdIncrReq: service-kind=ANY-STANDARDIZED, invalidation-policy{data-element=VeLINR_b_CompSpdIncrReq, handle-invalid=DONT-INVALIDATE}  # -
      data VeLINR_b_CompSpdIncrReq: category=VALUE, sw-calibration-access=READ-ONLY, type=ADTSBoolean, init-value=VeLINR_b_CompSpdIncrReqValue:0
    VeLINR_b_CompSpdIncrReqTO: service-kind=ANY-STANDARDIZED, invalidation-policy{data-element=VeLINR_b_CompSpdIncrReqTO, handle-invalid=DONT-INVALIDATE}  # - Time Out
      data VeLINR_b_CompSpdIncrReqTO: category=VALUE, sw-calibration-access=READ-ONLY, type=ADTSBoolean, init-value=VeLINR_b_CompSpdIncrReqTOValue:0
    VeLINR_b_CompSpdIncrReq_800: service-kind=ANY-STANDARDIZED, invalidation-policy{data-element=VeLINR_b_CompSpdIncrReq_800, handle-invalid=DONT-INVALIDATE}  # -
      data VeLINR_b_CompSpdIncrReq_800: category=VALUE, sw-calibration-access=READ-ONLY, type=ADTSBoolean, init-value=VeLINR_b_CompSpdIncrReq_800Value:0
    VeLINR_b_CompSpdIncrReq_800TO: service-kind=ANY-STANDARDIZED, invalidation-policy{data-element=VeLINR_b_CompSpdIncrReq_800TO, handle-invalid=DONT-INVALIDATE}  # - Time Out
      data VeLINR_b_CompSpdIncrReq_800TO: category=VALUE, sw-calibration-access=READ-ONLY, type=ADTSBoolean, init-value=VeLINR_b_CompSpdIncrReq_800TOValue:0
    VeLINR_b_CompStatTO: service-kind=ANY-STANDARDIZED, invalidation-policy{data-element=VeLINR_b_CompStatTO, handle-invalid=DONT-INVALIDATE}  # - Time Out
      data VeLINR_b_CompStatTO: category=VALUE, sw-calibration-access=READ-ONLY, type=ADTSBoolean, init-value=VeLINR_b_CompStatTOValue:0
    VeLINR_b_CompStat_800TO: service-kind=ANY-STANDARDIZED, invalidation-policy{data-element=VeLINR_b_CompStat_800TO, handle-invalid=DONT-INVALIDATE}  # - Time Out
      data VeLINR_b_CompStat_800TO: category=VALUE, sw-calibration-access=READ-ONLY, type=ADTSBoolean, init-value=VeLINR_b_CompStat_800TOValue:0
    VeLINR_b_CompressorSpdTO: service-kind=ANY-STANDARDIZED, invalidation-policy{data-element=VeLINR_b_CompressorSpdTO, handle-invalid=DONT-INVALIDATE}  # - Time Out
      data VeLINR_b_CompressorSpdTO: category=VALUE, sw-calibration-access=READ-ONLY, type=ADTSBoolean, init-value=VeLINR_b_CompressorSpdTOValue:0
    VeLINR_b_CompressorSpd_800TO: service-kind=ANY-STANDARDIZED, invalidation-policy{data-element=VeLINR_b_CompressorSpd_800TO, handle-invalid=DONT-INVALIDATE}  # - Time Out
      data VeLINR_b_CompressorSpd_800TO: category=VALUE, sw-calibration-access=READ-ONLY, type=ADTSBoolean, init-value=VeLINR_b_CompressorSpd_800TOValue:0
    VeLINR_b_CoolVal_ActuatPosTrgtTO: service-kind=ANY-STANDARDIZED, invalidation-policy{data-element=VeLINR_b_CoolVal_ActuatPosTrgtTO, handle-invalid=DONT-INVALIDATE}  # - Time Out
      data VeLINR_b_CoolVal_ActuatPosTrgtTO: category=VALUE, sw-calibration-access=READ-ONLY, type=ADTSBoolean, init-value=VeLINR_b_CoolVal_ActuatPosTrgtTOValue:0
    VeLINR_b_CoolantVal_ActuPosActTO: service-kind=ANY-STANDARDIZED, invalidation-policy{data-element=VeLINR_b_CoolantVal_ActuPosActTO, handle-invalid=DONT-INVALIDATE}  # - Time Out
      data VeLINR_b_CoolantVal_ActuPosActTO: category=VALUE, sw-calibration-access=READ-ONLY, type=ADTSBoolean, init-value=VeLINR_b_CoolantVal_ActuPosActTOValue:0
    VeLINR_b_CoolantVal_EcuVoltageTO: service-kind=ANY-STANDARDIZED, invalidation-policy{data-element=VeLINR_b_CoolantVal_EcuVoltageTO, handle-invalid=DONT-INVALIDATE}  # - Time Out
      data VeLINR_b_CoolantVal_EcuVoltageTO: category=VALUE, sw-calibration-access=READ-ONLY, type=ADTSBoolean, init-value=VeLINR_b_CoolantVal_EcuVoltageTOValue:0
    VeLINR_b_CoolantVal_ResponseErr: service-kind=ANY-STANDARDIZED, invalidation-policy{data-element=VeLINR_b_CoolantVal_ResponseErr, handle-invalid=DONT-INVALIDATE}  # -
      data VeLINR_b_CoolantVal_ResponseErr: category=VALUE, sw-calibration-access=READ-ONLY, type=ADTSBoolean, init-value=VeLINR_b_CoolantVal_ResponseErrValue:0
    VeLINR_b_CoolantVal_ResponseErrTO: service-kind=ANY-STANDARDIZED, invalidation-policy{data-element=VeLINR_b_CoolantVal_ResponseErrTO, handle-invalid=DONT-INVALIDATE}  # - Time Out
      data VeLINR_b_CoolantVal_ResponseErrTO: category=VALUE, sw-calibration-access=READ-ONLY, type=ADTSBoolean, init-value=VeLINR_b_CoolantVal_ResponseErrTOValue:0
    VeLINR_b_CoolantVal_SelfCalReq: service-kind=ANY-STANDARDIZED, invalidation-policy{data-element=VeLINR_b_CoolantVal_SelfCalReq, handle-invalid=DONT-INVALIDATE}  # -
      data VeLINR_b_CoolantVal_SelfCalReq: category=VALUE, sw-calibration-access=READ-ONLY, type=ADTSBoolean, init-value=VeLINR_b_CoolantVal_SelfCalReqValue:0
    VeLINR_b_CoolantVal_SelfCalReqTO: service-kind=ANY-STANDARDIZED, invalidation-policy{data-element=VeLINR_b_CoolantVal_SelfCalReqTO, handle-invalid=DONT-INVALIDATE}  # - Time Out
      data VeLINR_b_CoolantVal_SelfCalReqTO: category=VALUE, sw-calibration-access=READ-ONLY, type=ADTSBoolean, init-value=VeLINR_b_CoolantVal_SelfCalReqTOValue:0
    VeLINR_b_CoolantVal_SystemStateTO: service-kind=ANY-STANDARDIZED, invalidation-policy{data-element=VeLINR_b_CoolantVal_SystemStateTO, handle-invalid=DONT-INVALIDATE}  # - Time Out
      data VeLINR_b_CoolantVal_SystemStateTO: category=VALUE, sw-calibration-access=READ-ONLY, type=ADTSBoolean, init-value=VeLINR_b_CoolantVal_SystemStateTOValue:0
    VeLINR_b_CoolantValve_EcuTempTO: service-kind=ANY-STANDARDIZED, invalidation-policy{data-element=VeLINR_b_CoolantValve_EcuTempTO, handle-invalid=DONT-INVALIDATE}  # - Time Out
      data VeLINR_b_CoolantValve_EcuTempTO: category=VALUE, sw-calibration-access=READ-ONLY, type=ADTSBoolean, init-value=VeLINR_b_CoolantValve_EcuTempTOValue:0
    VeLINR_b_CoolantValve_ErrLinComTO: service-kind=ANY-STANDARDIZED, invalidation-policy{data-element=VeLINR_b_CoolantValve_ErrLinComTO, handle-invalid=DONT-INVALIDATE}  # - Time Out
      data VeLINR_b_CoolantValve_ErrLinComTO: category=VALUE, sw-calibration-access=READ-ONLY, type=ADTSBoolean, init-value=VeLINR_b_CoolantValve_ErrLinComTOValue:0
    VeLINR_b_CoolantValve_ErrPosTO: service-kind=ANY-STANDARDIZED, invalidation-policy{data-element=VeLINR_b_CoolantValve_ErrPosTO, handle-invalid=DONT-INVALIDATE}  # - Time Out
      data VeLINR_b_CoolantValve_ErrPosTO: category=VALUE, sw-calibration-access=READ-ONLY, type=ADTSBoolean, init-value=VeLINR_b_CoolantValve_ErrPosTOValue:0
    VeLINR_b_CoolantValve_Err_EcuTO: service-kind=ANY-STANDARDIZED, invalidation-policy{data-element=VeLINR_b_CoolantValve_Err_EcuTO, handle-invalid=DONT-INVALIDATE}  # - Time Out
      data VeLINR_b_CoolantValve_Err_EcuTO: category=VALUE, sw-calibration-access=READ-ONLY, type=ADTSBoolean, init-value=VeLINR_b_CoolantValve_Err_EcuTOValue:0
    VeLINR_b_CoolantValve_Err_MotorTO: service-kind=ANY-STANDARDIZED, invalidation-policy{data-element=VeLINR_b_CoolantValve_Err_MotorTO, handle-invalid=DONT-INVALIDATE}  # - Time Out
      data VeLINR_b_CoolantValve_Err_MotorTO: category=VALUE, sw-calibration-access=READ-ONLY, type=ADTSBoolean, init-value=VeLINR_b_CoolantValve_Err_MotorTOValue:0
    VeLINR_b_CoolantValve_Err_VoltTO: service-kind=ANY-STANDARDIZED, invalidation-policy{data-element=VeLINR_b_CoolantValve_Err_VoltTO, handle-invalid=DONT-INVALIDATE}  # - Time Out
      data VeLINR_b_CoolantValve_Err_VoltTO: category=VALUE, sw-calibration-access=READ-ONLY, type=ADTSBoolean, init-value=VeLINR_b_CoolantValve_Err_VoltTOValue:0
    VeLINR_b_DriveMdReqTO: service-kind=ANY-STANDARDIZED, invalidation-policy{data-element=VeLINR_b_DriveMdReqTO, handle-invalid=DONT-INVALIDATE}  # - Time Out
      data VeLINR_b_DriveMdReqTO: category=VALUE, sw-calibration-access=READ-ONLY, type=ADTSBoolean, init-value=VeLINR_b_DriveMdReqTOValue:0
    VeLINR_b_ECH_InterlockStatTO: service-kind=ANY-STANDARDIZED, invalidation-policy{data-element=VeLINR_b_ECH_InterlockStatTO, handle-invalid=DONT-INVALIDATE}  # - Time Out
      data VeLINR_b_ECH_InterlockStatTO: category=VALUE, sw-calibration-access=READ-ONLY, type=ADTSBoolean, init-value=VeLINR_b_ECH_InterlockStatTOValue:0
    VeLINR_b_EEXV_Board_TempTO: service-kind=ANY-STANDARDIZED, invalidation-policy{data-element=VeLINR_b_EEXV_Board_TempTO, handle-invalid=DONT-INVALIDATE}  # - Time Out
      data VeLINR_b_EEXV_Board_TempTO: category=VALUE, sw-calibration-access=READ-ONLY, type=ADTSBoolean, init-value=VeLINR_b_EEXV_Board_TempTOValue:0
    VeLINR_b_EEXV_CalRq: service-kind=ANY-STANDARDIZED, invalidation-policy{data-element=VeLINR_b_EEXV_CalRq, handle-invalid=DONT-INVALIDATE}  # -
      data VeLINR_b_EEXV_CalRq: category=VALUE, sw-calibration-access=READ-ONLY, type=ADTSBoolean, init-value=VeLINR_b_EEXV_CalRqValue:0
    VeLINR_b_EEXV_CalRqTO: service-kind=ANY-STANDARDIZED, invalidation-policy{data-element=VeLINR_b_EEXV_CalRqTO, handle-invalid=DONT-INVALIDATE}  # - Time Out
      data VeLINR_b_EEXV_CalRqTO: category=VALUE, sw-calibration-access=READ-ONLY, type=ADTSBoolean, init-value=VeLINR_b_EEXV_CalRqTOValue:0
    VeLINR_b_EEXV_CalStatTO: service-kind=ANY-STANDARDIZED, invalidation-policy{data-element=VeLINR_b_EEXV_CalStatTO, handle-invalid=DONT-INVALIDATE}  # - Time Out
      data VeLINR_b_EEXV_CalStatTO: category=VALUE, sw-calibration-access=READ-ONLY, type=ADTSBoolean, init-value=VeLINR_b_EEXV_CalStatTOValue:0
