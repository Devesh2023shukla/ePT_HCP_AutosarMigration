[part 1 of 3: package /STLASharedInterfaces/IFCOEs/IFPlatform_Can]
AUTOSAR XML (schema 4-3-0)
package /STLASharedInterfaces/IFCOEs/IFPlatform_Can
  1752 x sender receiver interface:
    SendCANR_ABSFailSts_FD16: service-kind=ANY-STANDARDIZED, invalidation-policy{data-element=SendCANR_ABSFailSts_FD16, handle-invalid=DONT-INVALIDATE}
      data SendCANR_ABSFailSts_FD16: category=VALUE, sw-calibration-access=READ-ONLY, type=ADTSBoolean, init-value=SendCANR_ABSFailSts_FD16Value:0
    VeRxPDU_TELEMATIC_FD_19_FD3_E2E_Sts
      data E2ECheckSts: type=ADTSUint8
      data OpRetVal: type=ADTSUint8
      invalidation-policys:
        data-element=VeRxPDU_TELEMATIC_FD_19_FD3_E2E_Sts/E2ECheckSts, handle-invalid=DONT-INVALIDATE
        data-element=VeRxPDU_TELEMATIC_FD_19_FD3_E2E_Sts/OpRetVal, handle-invalid=DONT-INVALIDATE
    VeRxPDU_TELEMATIC_FD_15_FD3_E2E_Sts
      data E2ECheckSts: type=ADTSUint8
      data OpRetVal: type=ADTSUint8
      invalidation-policys:
        data-element=VeRxPDU_TELEMATIC_FD_15_FD3_E2E_Sts/E2ECheckSts, handle-invalid=DONT-INVALIDATE
        data-element=VeRxPDU_TELEMATIC_FD_15_FD3_E2E_Sts/OpRetVal, handle-invalid=DONT-INVALIDATE
    VeRxPDU_RFHUB_FD_3_FD3_E2E_Sts
      data E2ECheckSts: type=ADTSUint8
      data OpRetVal: type=ADTSUint8
      invalidation-policys:
        data-element=VeRxPDU_RFHUB_FD_3_FD3_E2E_Sts/E2ECheckSts, handle-invalid=DONT-INVALIDATE
        data-element=VeRxPDU_RFHUB_FD_3_FD3_E2E_Sts/OpRetVal, handle-invalid=DONT-INVALIDATE
    VeRxPDU_IPC_VEHICLE_SETUP2_FD3_E2E_Sts
      data E2ECheckSts: type=ADTSUint8
      data OpRetVal: type=ADTSUint8
      invalidation-policys:
        data-element=VeRxPDU_IPC_VEHICLE_SETUP2_FD3_E2E_Sts/E2ECheckSts, handle-invalid=DONT-INVALIDATE
        data-element=VeRxPDU_IPC_VEHICLE_SETUP2_FD3_E2E_Sts/OpRetVal, handle-invalid=DONT-INVALIDATE
    VeRxPDU_IBS3_DATA_2_FD3_E2E_Sts
      data E2ECheckSts: type=ADTSUint8
      data OpRetVal: type=ADTSUint8
      invalidation-policys:
        data-element=VeRxPDU_IBS3_DATA_2_FD3_E2E_Sts/E2ECheckSts, handle-invalid=DONT-INVALIDATE
        data-element=VeRxPDU_IBS3_DATA_2_FD3_E2E_Sts/OpRetVal, handle-invalid=DONT-INVALIDATE
    VeRxPDU_IBS3_DATA_1_FD3_E2E_Sts
      data E2ECheckSts: type=ADTSUint8
      data OpRetVal: type=ADTSUint8
      invalidation-policys:
        data-element=VeRxPDU_IBS3_DATA_1_FD3_E2E_Sts/E2ECheckSts, handle-invalid=DONT-INVALIDATE
        data-element=VeRxPDU_IBS3_DATA_1_FD3_E2E_Sts/OpRetVal, handle-invalid=DONT-INVALIDATE
    VeRxPDU_ENGINE_HYBD_FD_3_FD3_E2E_Sts
      data E2ECheckSts: type=ADTSUint8
      data OpRetVal: type=ADTSUint8
      invalidation-policys:
        data-element=VeRxPDU_ENGINE_HYBD_FD_3_FD3_E2E_Sts/E2ECheckSts, handle-invalid=DONT-INVALIDATE
        data-element=VeRxPDU_ENGINE_HYBD_FD_3_FD3_E2E_Sts/OpRetVal, handle-invalid=DONT-INVALIDATE
    VeRxPDU_ENGINE_FD_8_FD3_E2E_Sts
      data E2ECheckSts: type=ADTSUint8
      data OpRetVal: type=ADTSUint8
      invalidation-policys:
        data-element=VeRxPDU_ENGINE_FD_8_FD3_E2E_Sts/E2ECheckSts, handle-invalid=DONT-INVALIDATE
        data-element=VeRxPDU_ENGINE_FD_8_FD3_E2E_Sts/OpRetVal, handle-invalid=DONT-INVALIDATE
    VeRxPDU_ENGINE_FD_2_FD3_E2E_Sts
      data E2ECheckSts: type=ADTSUint8
      data OpRetVal: type=ADTSUint8
      invalidation-policys:
        data-element=VeRxPDU_ENGINE_FD_2_FD3_E2E_Sts/E2ECheckSts, handle-invalid=DONT-INVALIDATE
        data-element=VeRxPDU_ENGINE_FD_2_FD3_E2E_Sts/OpRetVal, handle-invalid=DONT-INVALIDATE
    VeRxPDU_BRAKE_FD_7_FD3_E2E_Sts
      data E2ECheckSts: type=ADTSUint8
      data OpRetVal: type=ADTSUint8
      invalidation-policys:
        data-element=VeRxPDU_BRAKE_FD_7_FD3_E2E_Sts/E2ECheckSts, handle-invalid=DONT-INVALIDATE
        data-element=VeRxPDU_BRAKE_FD_7_FD3_E2E_Sts/OpRetVal, handle-invalid=DONT-INVALIDATE
    VeRxPDU_BRAKE_FD_6_FD3_E2E_Sts
      data E2ECheckSts: type=ADTSUint8
      data OpRetVal: type=ADTSUint8
      invalidation-policys:
        data-element=VeRxPDU_BRAKE_FD_6_FD3_E2E_Sts/E2ECheckSts, handle-invalid=DONT-INVALIDATE
        data-element=VeRxPDU_BRAKE_FD_6_FD3_E2E_Sts/OpRetVal, handle-invalid=DONT-INVALIDATE
    VeRxPDU_BRAKE_FD_5_FD3_E2E_Sts
      data E2ECheckSts: type=ADTSUint8
      data OpRetVal: type=ADTSUint8
      invalidation-policys:
        data-element=VeRxPDU_BRAKE_FD_5_FD3_E2E_Sts/E2ECheckSts, handle-invalid=DONT-INVALIDATE
        data-element=VeRxPDU_BRAKE_FD_5_FD3_E2E_Sts/OpRetVal, handle-invalid=DONT-INVALIDATE
    VeRxPDU_BRAKE_FD_4_FD3_E2E_Sts
      data E2ECheckSts: type=ADTSUint8
      data OpRetVal: type=ADTSUint8
      invalidation-policys:
        data-element=VeRxPDU_BRAKE_FD_4_FD3_E2E_Sts/E2ECheckSts, handle-invalid=DONT-INVALIDATE
        data-element=VeRxPDU_BRAKE_FD_4_FD3_E2E_Sts/OpRetVal, handle-invalid=DONT-INVALIDATE
    VeRxPDU_BRAKE_FD_3_FD3_E2E_Sts
      data E2ECheckSts: type=ADTSUint8
      data OpRetVal: type=ADTSUint8
      invalidation-policys:
        data-element=VeRxPDU_BRAKE_FD_3_FD3_E2E_Sts/E2ECheckSts, handle-invalid=DONT-INVALIDATE
        data-element=VeRxPDU_BRAKE_FD_3_FD3_E2E_Sts/OpRetVal, handle-invalid=DONT-INVALIDATE
    VeRxPDU_BRAKE_FD_2_FD3_E2E_Sts
      data E2ECheckSts: type=ADTSUint8
      data OpRetVal: type=ADTSUint8
      invalidation-policys:
        data-element=VeRxPDU_BRAKE_FD_2_FD3_E2E_Sts/E2ECheckSts, handle-invalid=DONT-INVALIDATE
        data-element=VeRxPDU_BRAKE_FD_2_FD3_E2E_Sts/OpRetVal, handle-invalid=DONT-INVALIDATE
    VeRxPDU_BRAKE_FD_1_FD3_E2E_Sts
      data E2ECheckSts: type=ADTSUint8
      data OpRetVal: type=ADTSUint8
      invalidation-policys:
        data-element=VeRxPDU_BRAKE_FD_1_FD3_E2E_Sts/E2ECheckSts, handle-invalid=DONT-INVALIDATE
        data-element=VeRxPDU_BRAKE_FD_1_FD3_E2E_Sts/OpRetVal, handle-invalid=DONT-INVALIDATE
    VeRxPDU_BCM_FD_9_FD3_E2E_Sts
      data E2ECheckSts: type=ADTSUint8
      data OpRetVal: type=ADTSUint8
      invalidation-policys:
        data-element=VeRxPDU_BCM_FD_9_FD3_E2E_Sts/E2ECheckSts, handle-invalid=DONT-INVALIDATE
        data-element=VeRxPDU_BCM_FD_9_FD3_E2E_Sts/OpRetVal, handle-invalid=DONT-INVALIDATE
    VeRxPDU_BCM_FD_4_FD3_E2E_Sts
      data E2ECheckSts: type=ADTSUint8
      data OpRetVal: type=ADTSUint8
      invalidation-policys:
        data-element=VeRxPDU_BCM_FD_4_FD3_E2E_Sts/E2ECheckSts, handle-invalid=DONT-INVALIDATE
        data-element=VeRxPDU_BCM_FD_4_FD3_E2E_Sts/OpRetVal, handle-invalid=DONT-INVALIDATE
    VeRxPDU_BCM_FD_2_FD3_E2E_Sts
      data E2ECheckSts: type=ADTSUint8
      data OpRetVal: type=ADTSUint8
      invalidation-policys:
        data-element=VeRxPDU_BCM_FD_2_FD3_E2E_Sts/E2ECheckSts, handle-invalid=DONT-INVALIDATE
        data-element=VeRxPDU_BCM_FD_2_FD3_E2E_Sts/OpRetVal, handle-invalid=DONT-INVALIDATE
    VeRxPDU_BCM_FD_18_FD3_E2E_Sts
      data E2ECheckSts: type=ADTSUint8
      data OpRetVal: type=ADTSUint8
      invalidation-policys:
        data-element=VeRxPDU_BCM_FD_18_FD3_E2E_Sts/E2ECheckSts, handle-invalid=DONT-INVALIDATE
        data-element=VeRxPDU_BCM_FD_18_FD3_E2E_Sts/OpRetVal, handle-invalid=DONT-INVALIDATE
    VeRxPDU_BCM_FD_13_FD3_E2E_Sts
      data E2ECheckSts: type=ADTSUint8
      data OpRetVal: type=ADTSUint8
      invalidation-policys:
        data-element=VeRxPDU_BCM_FD_13_FD3_E2E_Sts/E2ECheckSts, handle-invalid=DONT-INVALIDATE
        data-element=VeRxPDU_BCM_FD_13_FD3_E2E_Sts/OpRetVal, handle-invalid=DONT-INVALIDATE
    VeRxPDU_BCM_FD_10_FD3_E2E_Sts
      data E2ECheckSts: type=ADTSUint8
      data OpRetVal: type=ADTSUint8
      invalidation-policys:
        data-element=VeRxPDU_BCM_FD_10_FD3_E2E_Sts/E2ECheckSts, handle-invalid=DONT-INVALIDATE
        data-element=VeRxPDU_BCM_FD_10_FD3_E2E_Sts/OpRetVal, handle-invalid=DONT-INVALIDATE
    VeRxPDU_ADAS_FD_INFO2_FD3_E2E_Sts
      data E2ECheckSts: type=ADTSUint8
      data OpRetVal: type=ADTSUint8
      invalidation-policys:
        data-element=VeRxPDU_ADAS_FD_INFO2_FD3_E2E_Sts/E2ECheckSts, handle-invalid=DONT-INVALIDATE
        data-element=VeRxPDU_ADAS_FD_INFO2_FD3_E2E_Sts/OpRetVal, handle-invalid=DONT-INVALIDATE
    VeRxPDU_ADAS_FD_INFO_FD3_E2E_Sts
      data E2ECheckSts: type=ADTSUint8
      data OpRetVal: type=ADTSUint8
      invalidation-policys:
        data-element=VeRxPDU_ADAS_FD_INFO_FD3_E2E_Sts/E2ECheckSts, handle-invalid=DONT-INVALIDATE
        data-element=VeRxPDU_ADAS_FD_INFO_FD3_E2E_Sts/OpRetVal, handle-invalid=DONT-INVALIDATE
    VeRxPDU_MCPB_OBD_DTC_FD5_E2E_Sts
      data E2ECheckSts: type=ADTSUint8
      data OpRetVal: type=ADTSUint8
      invalidation-policys:
        data-element=VeRxPDU_MCPB_OBD_DTC_FD5_E2E_Sts/E2ECheckSts, handle-invalid=DONT-INVALIDATE
        data-element=VeRxPDU_MCPB_OBD_DTC_FD5_E2E_Sts/OpRetVal, handle-invalid=DONT-INVALIDATE
    VeRxPDU_MCPB_PROPULSION_FD5_E2E_Sts
      data E2ECheckSts: type=ADTSUint8
      data OpRetVal: type=ADTSUint8
      invalidation-policys:
        data-element=VeRxPDU_MCPB_PROPULSION_FD5_E2E_Sts/E2ECheckSts, handle-invalid=DONT-INVALIDATE
        data-element=VeRxPDU_MCPB_PROPULSION_FD5_E2E_Sts/OpRetVal, handle-invalid=DONT-INVALIDATE
    VeRxPDU_OBCM_VDCM_FD5_E2E_Sts
      data E2ECheckSts: type=ADTSUint8
      data OpRetVal: type=ADTSUint8
      invalidation-policys:
        data-element=VeRxPDU_OBCM_VDCM_FD5_E2E_Sts/E2ECheckSts, handle-invalid=DONT-INVALIDATE
        data-element=VeRxPDU_OBCM_VDCM_FD5_E2E_Sts/OpRetVal, handle-invalid=DONT-INVALIDATE
    VeRxPDU_OBCM_VDCM2_FD5_E2E_Sts
      data E2ECheckSts: type=ADTSUint8
      data OpRetVal: type=ADTSUint8
      invalidation-policys:
        data-element=VeRxPDU_OBCM_VDCM2_FD5_E2E_Sts/E2ECheckSts, handle-invalid=DONT-INVALIDATE
        data-element=VeRxPDU_OBCM_VDCM2_FD5_E2E_Sts/OpRetVal, handle-invalid=DONT-INVALIDATE
    VeRxPDU_PARK_DATA_FD5_E2E_Sts
      data E2ECheckSts: type=ADTSUint8
      data OpRetVal: type=ADTSUint8
      invalidation-policys:
        data-element=VeRxPDU_PARK_DATA_FD5_E2E_Sts/E2ECheckSts, handle-invalid=DONT-INVALIDATE
        data-element=VeRxPDU_PARK_DATA_FD5_E2E_Sts/OpRetVal, handle-invalid=DONT-INVALIDATE
    VeRxPDU_SGCP_OBD_DTC_FD5_E2E_Sts
      data E2ECheckSts: type=ADTSUint8
      data OpRetVal: type=ADTSUint8
      invalidation-policys:
        data-element=VeRxPDU_SGCP_OBD_DTC_FD5_E2E_Sts/E2ECheckSts, handle-invalid=DONT-INVALIDATE
        data-element=VeRxPDU_SGCP_OBD_DTC_FD5_E2E_Sts/OpRetVal, handle-invalid=DONT-INVALIDATE
    VeRxPDU_SGCP_PROPULSION_FD5_E2E_Sts
      data E2ECheckSts: type=ADTSUint8
      data OpRetVal: type=ADTSUint8
      invalidation-policys:
        data-element=VeRxPDU_SGCP_PROPULSION_FD5_E2E_Sts/E2ECheckSts, handle-invalid=DONT-INVALIDATE
        data-element=VeRxPDU_SGCP_PROPULSION_FD5_E2E_Sts/OpRetVal, handle-invalid=DONT-INVALIDATE
    VeRxPDU_MCPA_PROPULSION_FD5_E2E_Sts
      data E2ECheckSts: type=ADTSUint8
      data OpRetVal: type=ADTSUint8
      invalidation-policys:
        data-element=VeRxPDU_MCPA_PROPULSION_FD5_E2E_Sts/E2ECheckSts, handle-invalid=DONT-INVALIDATE
        data-element=VeRxPDU_MCPA_PROPULSION_FD5_E2E_Sts/OpRetVal, handle-invalid=DONT-INVALIDATE
    VeRxPDU_MCPA_OBD_DTC_FD5_E2E_Sts
      data E2ECheckSts: type=ADTSUint8
      data OpRetVal: type=ADTSUint8
      invalidation-policys:
        data-element=VeRxPDU_MCPA_OBD_DTC_FD5_E2E_Sts/E2ECheckSts, handle-invalid=DONT-INVALIDATE
        data-element=VeRxPDU_MCPA_OBD_DTC_FD5_E2E_Sts/OpRetVal, handle-invalid=DONT-INVALIDATE
    VeRxPDU_HV_CHARGER1_FD5_E2E_Sts
      data E2ECheckSts: type=ADTSUint8
      data OpRetVal: type=ADTSUint8
      invalidation-policys:
        data-element=VeRxPDU_HV_CHARGER1_FD5_E2E_Sts/E2ECheckSts, handle-invalid=DONT-INVALIDATE
        data-element=VeRxPDU_HV_CHARGER1_FD5_E2E_Sts/OpRetVal, handle-invalid=DONT-INVALIDATE
    VeRxPDU_ENGINE_HYBD_FD_4_FD5_E2E_Sts
      data E2ECheckSts: type=ADTSUint8
      data OpRetVal: type=ADTSUint8
      invalidation-policys:
        data-element=VeRxPDU_ENGINE_HYBD_FD_4_FD5_E2E_Sts/E2ECheckSts, handle-invalid=DONT-INVALIDATE
        data-element=VeRxPDU_ENGINE_HYBD_FD_4_FD5_E2E_Sts/OpRetVal, handle-invalid=DONT-INVALIDATE
    VeRxPDU_ENGINE_HYBD_FD_3_FD5_E2E_Sts
      data E2ECheckSts: type=ADTSUint8
      data OpRetVal: type=ADTSUint8
      invalidation-policys:
        data-element=VeRxPDU_ENGINE_HYBD_FD_3_FD5_E2E_Sts/E2ECheckSts, handle-invalid=DONT-INVALIDATE
        data-element=VeRxPDU_ENGINE_HYBD_FD_3_FD5_E2E_Sts/OpRetVal, handle-invalid=DONT-INVALIDATE
    VeRxPDU_ENGINE_HYBD_FD_1_FD5_E2E_Sts
      data E2ECheckSts: type=ADTSUint8
      data OpRetVal: type=ADTSUint8
      invalidation-policys:
        data-element=VeRxPDU_ENGINE_HYBD_FD_1_FD5_E2E_Sts/E2ECheckSts, handle-invalid=DONT-INVALIDATE
        data-element=VeRxPDU_ENGINE_HYBD_FD_1_FD5_E2E_Sts/OpRetVal, handle-invalid=DONT-INVALIDATE
    VeRxPDU_ENGINE_FD_LHOM_FD5_E2E_Sts
      data E2ECheckSts: type=ADTSUint8
      data OpRetVal: type=ADTSUint8
      invalidation-policys:
        data-element=VeRxPDU_ENGINE_FD_LHOM_FD5_E2E_Sts/E2ECheckSts, handle-invalid=DONT-INVALIDATE
        data-element=VeRxPDU_ENGINE_FD_LHOM_FD5_E2E_Sts/OpRetVal, handle-invalid=DONT-INVALIDATE
    VeRxPDU_ENGINE_FD_5_FD5_E2E_Sts
      data E2ECheckSts: type=ADTSUint8
      data OpRetVal: type=ADTSUint8
      invalidation-policys:
        data-element=VeRxPDU_ENGINE_FD_5_FD5_E2E_Sts/E2ECheckSts, handle-invalid=DONT-INVALIDATE
        data-element=VeRxPDU_ENGINE_FD_5_FD5_E2E_Sts/OpRetVal, handle-invalid=DONT-INVALIDATE
    VeRxPDU_ENGINE_FD_2_FD5_E2E_Sts
      data E2ECheckSts: type=ADTSUint8
      data OpRetVal: type=ADTSUint8
      invalidation-policys:
        data-element=VeRxPDU_ENGINE_FD_2_FD5_E2E_Sts/E2ECheckSts, handle-invalid=DONT-INVALIDATE
        data-element=VeRxPDU_ENGINE_FD_2_FD5_E2E_Sts/OpRetVal, handle-invalid=DONT-INVALIDATE
    VeRxPDU_ENGINE_FD_1_FD5_E2E_Sts
      data E2ECheckSts: type=ADTSUint8
      data OpRetVal: type=ADTSUint8
      invalidation-policys:
        data-element=VeRxPDU_ENGINE_FD_1_FD5_E2E_Sts/E2ECheckSts, handle-invalid=DONT-INVALIDATE
        data-element=VeRxPDU_ENGINE_FD_1_FD5_E2E_Sts/OpRetVal, handle-invalid=DONT-INVALIDATE
    VeRxPDU_BATTERY_HV_VLIMITS_FD5_E2E_Sts
      data E2ECheckSts: type=ADTSUint8
      data OpRetVal: type=ADTSUint8
      invalidation-policys:
        data-element=VeRxPDU_BATTERY_HV_VLIMITS_FD5_E2E_Sts/E2ECheckSts, handle-invalid=DONT-INVALIDATE
        data-element=VeRxPDU_BATTERY_HV_VLIMITS_FD5_E2E_Sts/OpRetVal, handle-invalid=DONT-INVALIDATE
    VeRxPDU_BATTERY_HV_STATUS1_FD5_E2E_Sts
      data E2ECheckSts: type=ADTSUint8
      data OpRetVal: type=ADTSUint8
      invalidation-policys:
        data-element=VeRxPDU_BATTERY_HV_STATUS1_FD5_E2E_Sts/E2ECheckSts, handle-invalid=DONT-INVALIDATE
        data-element=VeRxPDU_BATTERY_HV_STATUS1_FD5_E2E_Sts/OpRetVal, handle-invalid=DONT-INVALIDATE
    VeRxPDU_BATTERY_HV_POWERLIMITS_FD5_E2E_Sts
      data E2ECheckSts: type=ADTSUint8
      data OpRetVal: type=ADTSUint8
      invalidation-policys:
        data-element=VeRxPDU_BATTERY_HV_POWERLIMITS_FD5_E2E_Sts/E2ECheckSts, handle-invalid=DONT-INVALIDATE
        data-element=VeRxPDU_BATTERY_HV_POWERLIMITS_FD5_E2E_Sts/OpRetVal, handle-invalid=DONT-INVALIDATE
    VeRxPDU_APM_VDCM_FD5_E2E_Sts
      data E2ECheckSts: type=ADTSUint8
      data OpRetVal: type=ADTSUint8
      invalidation-policys:
        data-element=VeRxPDU_APM_VDCM_FD5_E2E_Sts/E2ECheckSts, handle-invalid=DONT-INVALIDATE
        data-element=VeRxPDU_APM_VDCM_FD5_E2E_Sts/OpRetVal, handle-invalid=DONT-INVALIDATE
    VeRxPDU_RPF_FD_2_FD11_E2E_Sts
      data E2ECheckSts: type=ADTSUint8
      data OpRetVal: type=ADTSUint8
      invalidation-policys:
        data-element=VeRxPDU_RPF_FD_2_FD11_E2E_Sts/E2ECheckSts, handle-invalid=DONT-INVALIDATE
        data-element=VeRxPDU_RPF_FD_2_FD11_E2E_Sts/OpRetVal, handle-invalid=DONT-INVALIDATE
    VeRxPDU_RPF_FD_1_FD11_E2E_Sts
      data E2ECheckSts: type=ADTSUint8
      data OpRetVal: type=ADTSUint8
      invalidation-policys:
        data-element=VeRxPDU_RPF_FD_1_FD11_E2E_Sts/E2ECheckSts, handle-invalid=DONT-INVALIDATE
        data-element=VeRxPDU_RPF_FD_1_FD11_E2E_Sts/OpRetVal, handle-invalid=DONT-INVALIDATE
    VeRxPDU_OBCM_VDCM2_FD11_E2E_Sts
      data E2ECheckSts: type=ADTSUint8
      data OpRetVal: type=ADTSUint8
      invalidation-policys:
        data-element=VeRxPDU_OBCM_VDCM2_FD11_E2E_Sts/E2ECheckSts, handle-invalid=DONT-INVALIDATE
        data-element=VeRxPDU_OBCM_VDCM2_FD11_E2E_Sts/OpRetVal, handle-invalid=DONT-INVALIDATE
    VeRxPDU_OBCM_VDCM_FD11_E2E_Sts
      data E2ECheckSts: type=ADTSUint8
      data OpRetVal: type=ADTSUint8
      invalidation-policys:
        data-element=VeRxPDU_OBCM_VDCM_FD11_E2E_Sts/E2ECheckSts, handle-invalid=DONT-INVALIDATE
        data-element=VeRxPDU_OBCM_VDCM_FD11_E2E_Sts/OpRetVal, handle-invalid=DONT-INVALIDATE
    VeRxPDU_IDCM_ISO15118_STATUS1_FD11_E2E_Sts
      data E2ECheckSts: type=ADTSUint8
      data OpRetVal: type=ADTSUint8
      invalidation-policys:
        data-element=VeRxPDU_IDCM_ISO15118_STATUS1_FD11_E2E_Sts/E2ECheckSts, handle-invalid=DONT-INVALIDATE
        data-element=VeRxPDU_IDCM_ISO15118_STATUS1_FD11_E2E_Sts/OpRetVal, handle-invalid=DONT-INVALIDATE
    VeRxPDU_HV_CHARGER2_FD11_E2E_Sts
      data E2ECheckSts: type=ADTSUint8
      data OpRetVal: type=ADTSUint8
      invalidation-policys:
        data-element=VeRxPDU_HV_CHARGER2_FD11_E2E_Sts/E2ECheckSts, handle-invalid=DONT-INVALIDATE
        data-element=VeRxPDU_HV_CHARGER2_FD11_E2E_Sts/OpRetVal, handle-invalid=DONT-INVALIDATE
    VeRxPDU_HV_CHARGER1_FD11_E2E_Sts
      data E2ECheckSts: type=ADTSUint8
      data OpRetVal: type=ADTSUint8
      invalidation-policys:
        data-element=VeRxPDU_HV_CHARGER1_FD11_E2E_Sts/E2ECheckSts, handle-invalid=DONT-INVALIDATE
        data-element=VeRxPDU_HV_CHARGER1_FD11_E2E_Sts/OpRetVal, handle-invalid=DONT-INVALIDATE
    VeRxPDU_BATTERY_HV_VLIMITS_FD11_E2E_Sts
      data E2ECheckSts: type=ADTSUint8
      data OpRetVal: type=ADTSUint8
      invalidation-policys:
        data-element=VeRxPDU_BATTERY_HV_VLIMITS_FD11_E2E_Sts/E2ECheckSts, handle-invalid=DONT-INVALIDATE
        data-element=VeRxPDU_BATTERY_HV_VLIMITS_FD11_E2E_Sts/OpRetVal, handle-invalid=DONT-INVALIDATE
    VeRxPDU_BATTERY_HV_STATUS1_FD11_E2E_Sts
      data E2ECheckSts: type=ADTSUint8
      data OpRetVal: type=ADTSUint8
      invalidation-policys:
        data-element=VeRxPDU_BATTERY_HV_STATUS1_FD11_E2E_Sts/E2ECheckSts, handle-invalid=DONT-INVALIDATE
        data-element=VeRxPDU_BATTERY_HV_STATUS1_FD11_E2E_Sts/OpRetVal, handle-invalid=DONT-INVALIDATE
    VeRxPDU_BATTERY_HV_POWERLIMITS_FD11_E2E_Sts
      data E2ECheckSts: type=ADTSUint8
      data OpRetVal: type=ADTSUint8
      invalidation-policys:
        data-element=VeRxPDU_BATTERY_HV_POWERLIMITS_FD11_E2E_Sts/E2ECheckSts, handle-invalid=DONT-INVALIDATE
        data-element=VeRxPDU_BATTERY_HV_POWERLIMITS_FD11_E2E_Sts/OpRetVal, handle-invalid=DONT-INVALIDATE
    VeRxPDU_APM_VDCM_FD11_E2E_Sts
      data E2ECheckSts: type=ADTSUint8
      data OpRetVal: type=ADTSUint8
      invalidation-policys:
        data-element=VeRxPDU_APM_VDCM_FD11_E2E_Sts/E2ECheckSts, handle-invalid=DONT-INVALIDATE
        data-element=VeRxPDU_APM_VDCM_FD11_E2E_Sts/OpRetVal, handle-invalid=DONT-INVALIDATE
    VeRxPDU_ORC_FD_3_FD14_E2E_Sts
      data E2ECheckSts: type=ADTSUint8
      data OpRetVal: type=ADTSUint8
      invalidation-policys:
        data-element=VeRxPDU_ORC_FD_3_FD14_E2E_Sts/E2ECheckSts, handle-invalid=DONT-INVALIDATE
        data-element=VeRxPDU_ORC_FD_3_FD14_E2E_Sts/OpRetVal, handle-invalid=DONT-INVALIDATE
    VeRxPDU_ORC_FD_1_FD14_E2E_Sts
      data E2ECheckSts: type=ADTSUint8
      data OpRetVal: type=ADTSUint8
      invalidation-policys:
        data-element=VeRxPDU_ORC_FD_1_FD14_E2E_Sts/E2ECheckSts, handle-invalid=DONT-INVALIDATE
        data-element=VeRxPDU_ORC_FD_1_FD14_E2E_Sts/OpRetVal, handle-invalid=DONT-INVALIDATE
    VeRxPDU_IMPACT_INFO_FD14_E2E_Sts
      data E2ECheckSts: type=ADTSUint8
      data OpRetVal: type=ADTSUint8
      invalidation-policys:
        data-element=VeRxPDU_IMPACT_INFO_FD14_E2E_Sts/E2ECheckSts, handle-invalid=DONT-INVALIDATE
        data-element=VeRxPDU_IMPACT_INFO_FD14_E2E_Sts/OpRetVal, handle-invalid=DONT-INVALIDATE
    VeRxPDU_BRAKE_FD_7_FD14_E2E_Sts
      data E2ECheckSts: type=ADTSUint8
      data OpRetVal: type=ADTSUint8
      invalidation-policys:
        data-element=VeRxPDU_BRAKE_FD_7_FD14_E2E_Sts/E2ECheckSts, handle-invalid=DONT-INVALIDATE
        data-element=VeRxPDU_BRAKE_FD_7_FD14_E2E_Sts/OpRetVal, handle-invalid=DONT-INVALIDATE
    VeRxPDU_BRAKE_FD_6_FD14_E2E_Sts
      data E2ECheckSts: type=ADTSUint8
      data OpRetVal: type=ADTSUint8
      invalidation-policys:
        data-element=VeRxPDU_BRAKE_FD_6_FD14_E2E_Sts/E2ECheckSts, handle-invalid=DONT-INVALIDATE
        data-element=VeRxPDU_BRAKE_FD_6_FD14_E2E_Sts/OpRetVal, handle-invalid=DONT-INVALIDATE
    VeRxPDU_BRAKE_FD_5_FD14_E2E_Sts
      data E2ECheckSts: type=ADTSUint8
      data OpRetVal: type=ADTSUint8
      invalidation-policys:
        data-element=VeRxPDU_BRAKE_FD_5_FD14_E2E_Sts/E2ECheckSts, handle-invalid=DONT-INVALIDATE
        data-element=VeRxPDU_BRAKE_FD_5_FD14_E2E_Sts/OpRetVal, handle-invalid=DONT-INVALIDATE
    VeRxPDU_BRAKE_FD_4_FD14_E2E_Sts
      data E2ECheckSts: type=ADTSUint8
      data OpRetVal: type=ADTSUint8
      invalidation-policys:
        data-element=VeRxPDU_BRAKE_FD_4_FD14_E2E_Sts/E2ECheckSts, handle-invalid=DONT-INVALIDATE
        data-element=VeRxPDU_BRAKE_FD_4_FD14_E2E_Sts/OpRetVal, handle-invalid=DONT-INVALIDATE
    VeRxPDU_BRAKE_FD_3_FD14_E2E_Sts
      data E2ECheckSts: type=ADTSUint8
      data OpRetVal: type=ADTSUint8
      invalidation-policys:
        data-element=VeRxPDU_BRAKE_FD_3_FD14_E2E_Sts/E2ECheckSts, handle-invalid=DONT-INVALIDATE
        data-element=VeRxPDU_BRAKE_FD_3_FD14_E2E_Sts/OpRetVal, handle-invalid=DONT-INVALIDATE
    VeRxPDU_BRAKE_FD_2_FD14_E2E_Sts
      data E2ECheckSts: type=ADTSUint8
      data OpRetVal: type=ADTSUint8
      invalidation-policys:
        data-element=VeRxPDU_BRAKE_FD_2_FD14_E2E_Sts/E2ECheckSts, handle-invalid=DONT-INVALIDATE
        data-element=VeRxPDU_BRAKE_FD_2_FD14_E2E_Sts/OpRetVal, handle-invalid=DONT-INVALIDATE
    VeRxPDU_BRAKE_FD_1_FD14_E2E_Sts
      data E2ECheckSts: type=ADTSUint8
      data OpRetVal: type=ADTSUint8
      invalidation-policys:
        data-element=VeRxPDU_BRAKE_FD_1_FD14_E2E_Sts/E2ECheckSts, handle-invalid=DONT-INVALIDATE
        data-element=VeRxPDU_BRAKE_FD_1_FD14_E2E_Sts/OpRetVal, handle-invalid=DONT-INVALIDATE
    VeRxPDU_ADAS_FD_INFO_FD14_E2E_Sts
      data E2ECheckSts: type=ADTSUint8
      data OpRetVal: type=ADTSUint8
      invalidation-policys:
        data-element=VeRxPDU_ADAS_FD_INFO_FD14_E2E_Sts/E2ECheckSts, handle-invalid=DONT-INVALIDATE
        data-element=VeRxPDU_ADAS_FD_INFO_FD14_E2E_Sts/OpRetVal, handle-invalid=DONT-INVALIDATE
    VeRxPDU_ADAS_FD_HMI_FD14_E2E_Sts
      data E2ECheckSts: type=ADTSUint8
      data OpRetVal: type=ADTSUint8
      invalidation-policys:
        data-element=VeRxPDU_ADAS_FD_HMI_FD14_E2E_Sts/E2ECheckSts, handle-invalid=DONT-INVALIDATE
        data-element=VeRxPDU_ADAS_FD_HMI_FD14_E2E_Sts/OpRetVal, handle-invalid=DONT-INVALIDATE
    VeRxPDU_SGCP_PROPULSION_FD16_E2E_Sts
      data E2ECheckSts: type=ADTSUint8
      data OpRetVal: type=ADTSUint8
      invalidation-policys:
        data-element=VeRxPDU_SGCP_PROPULSION_FD16_E2E_Sts/E2ECheckSts, handle-invalid=DONT-INVALIDATE
        data-element=VeRxPDU_SGCP_PROPULSION_FD16_E2E_Sts/OpRetVal, handle-invalid=DONT-INVALIDATE
    VeRxPDU_SGCP_OBD_DTC_FD16_E2E_Sts
      data E2ECheckSts: type=ADTSUint8
      data OpRetVal: type=ADTSUint8
      invalidation-policys:
        data-element=VeRxPDU_SGCP_OBD_DTC_FD16_E2E_Sts/E2ECheckSts, handle-invalid=DONT-INVALIDATE
        data-element=VeRxPDU_SGCP_OBD_DTC_FD16_E2E_Sts/OpRetVal, handle-invalid=DONT-INVALIDATE
    VeRxPDU_PARK_DATA_FD16_E2E_Sts
      data E2ECheckSts: type=ADTSUint8
      data OpRetVal: type=ADTSUint8
      invalidation-policys:
        data-element=VeRxPDU_PARK_DATA_FD16_E2E_Sts/E2ECheckSts, handle-invalid=DONT-INVALIDATE
        data-element=VeRxPDU_PARK_DATA_FD16_E2E_Sts/OpRetVal, handle-invalid=DONT-INVALIDATE
    VeRxPDU_OBD_CONTENT_FRAME_FD16_E2E_Sts
      data E2ECheckSts: type=ADTSUint8
      data OpRetVal: type=ADTSUint8
      invalidation-policys:
        data-element=VeRxPDU_OBD_CONTENT_FRAME_FD16_E2E_Sts/E2ECheckSts, handle-invalid=DONT-INVALIDATE
        data-element=VeRxPDU_OBD_CONTENT_FRAME_FD16_E2E_Sts/OpRetVal, handle-invalid=DONT-INVALIDATE
    VeRxPDU_MCPB_PROPULSION_FD16_E2E_Sts
      data E2ECheckSts: type=ADTSUint8
      data OpRetVal: type=ADTSUint8
      invalidation-policys:
        data-element=VeRxPDU_MCPB_PROPULSION_FD16_E2E_Sts/E2ECheckSts, handle-invalid=DONT-INVALIDATE
        data-element=VeRxPDU_MCPB_PROPULSION_FD16_E2E_Sts/OpRetVal, handle-invalid=DONT-INVALIDATE
    VeRxPDU_MCPB_OBD_DTC_FD16_E2E_Sts
      data E2ECheckSts: type=ADTSUint8
      data OpRetVal: type=ADTSUint8
      invalidation-policys:
        data-element=VeRxPDU_MCPB_OBD_DTC_FD16_E2E_Sts/E2ECheckSts, handle-invalid=DONT-INVALIDATE
        data-element=VeRxPDU_MCPB_OBD_DTC_FD16_E2E_Sts/OpRetVal, handle-invalid=DONT-INVALIDATE
    VeRxPDU_MCPA_PROPULSION_FD16_E2E_Sts
      data E2ECheckSts: type=ADTSUint8
      data OpRetVal: type=ADTSUint8
      invalidation-policys:
        data-element=VeRxPDU_MCPA_PROPULSION_FD16_E2E_Sts/E2ECheckSts, handle-invalid=DONT-INVALIDATE
        data-element=VeRxPDU_MCPA_PROPULSION_FD16_E2E_Sts/OpRetVal, handle-invalid=DONT-INVALIDATE
    VeRxPDU_MCPA_OBD_DTC_FD16_E2E_Sts
      data E2ECheckSts: type=ADTSUint8
      data OpRetVal: type=ADTSUint8
      invalidation-policys:
        data-element=VeRxPDU_MCPA_OBD_DTC_FD16_E2E_Sts/E2ECheckSts, handle-invalid=DONT-INVALIDATE
        data-element=VeRxPDU_MCPA_OBD_DTC_FD16_E2E_Sts/OpRetVal, handle-invalid=DONT-INVALIDATE
    VeRxPDU_ENGINE_HYBD_FD_4_FD16_E2E_Sts
      data E2ECheckSts: type=ADTSUint8
      data OpRetVal: type=ADTSUint8
      invalidation-policys:
        data-element=VeRxPDU_ENGINE_HYBD_FD_4_FD16_E2E_Sts/E2ECheckSts, handle-invalid=DONT-INVALIDATE
        data-element=VeRxPDU_ENGINE_HYBD_FD_4_FD16_E2E_Sts/OpRetVal, handle-invalid=DONT-INVALIDATE
    VeRxPDU_ENGINE_HYBD_FD_3_FD16_E2E_Sts
      data E2ECheckSts: type=ADTSUint8
      data OpRetVal: type=ADTSUint8
      invalidation-policys:
        data-element=VeRxPDU_ENGINE_HYBD_FD_3_FD16_E2E_Sts/E2ECheckSts, handle-invalid=DONT-INVALIDATE
        data-element=VeRxPDU_ENGINE_HYBD_FD_3_FD16_E2E_Sts/OpRetVal, handle-invalid=DONT-INVALIDATE
    VeRxPDU_ENGINE_HYBD_FD_1_FD16_E2E_Sts
      data E2ECheckSts: type=ADTSUint8
      data OpRetVal: type=ADTSUint8
      invalidation-policys:
        data-element=VeRxPDU_ENGINE_HYBD_FD_1_FD16_E2E_Sts/E2ECheckSts, handle-invalid=DONT-INVALIDATE
        data-element=VeRxPDU_ENGINE_HYBD_FD_1_FD16_E2E_Sts/OpRetVal, handle-invalid=DONT-INVALIDATE
    VeRxPDU_ENGINE_FD_8_FD16_E2E_Sts
      data E2ECheckSts: type=ADTSUint8
      data OpRetVal: type=ADTSUint8
      invalidation-policys:
        data-element=VeRxPDU_ENGINE_FD_8_FD16_E2E_Sts/E2ECheckSts, handle-invalid=DONT-INVALIDATE
        data-element=VeRxPDU_ENGINE_FD_8_FD16_E2E_Sts/OpRetVal, handle-invalid=DONT-INVALIDATE
    VeRxPDU_ENGINE_FD_7_FD16_E2E_Sts
      data E2ECheckSts: type=ADTSUint8
      data OpRetVal: type=ADTSUint8
      invalidation-policys:
        data-element=VeRxPDU_ENGINE_FD_7_FD16_E2E_Sts/E2ECheckSts, handle-invalid=DONT-INVALIDATE
        data-element=VeRxPDU_ENGINE_FD_7_FD16_E2E_Sts/OpRetVal, handle-invalid=DONT-INVALIDATE
    VeRxPDU_ENGINE_FD_6_FD16_E2E_Sts
      data E2ECheckSts: type=ADTSUint8
      data OpRetVal: type=ADTSUint8
      invalidation-policys:
        data-element=VeRxPDU_ENGINE_FD_6_FD16_E2E_Sts/E2ECheckSts, handle-invalid=DONT-INVALIDATE
        data-element=VeRxPDU_ENGINE_FD_6_FD16_E2E_Sts/OpRetVal, handle-invalid=DONT-INVALIDATE
    VeRxPDU_ENGINE_FD_5_FD16_E2E_Sts
      data E2ECheckSts: type=ADTSUint8
      data OpRetVal: type=ADTSUint8
      invalidation-policys:
        data-element=VeRxPDU_ENGINE_FD_5_FD16_E2E_Sts/E2ECheckSts, handle-invalid=DONT-INVALIDATE
        data-element=VeRxPDU_ENGINE_FD_5_FD16_E2E_Sts/OpRetVal, handle-invalid=DONT-INVALIDATE
    VeRxPDU_ENGINE_FD_3_FD16_E2E_Sts
      data E2ECheckSts: type=ADTSUint8
      data OpRetVal: type=ADTSUint8
      invalidation-policys:
        data-element=VeRxPDU_ENGINE_FD_3_FD16_E2E_Sts/E2ECheckSts, handle-invalid=DONT-INVALIDATE
        data-element=VeRxPDU_ENGINE_FD_3_FD16_E2E_Sts/OpRetVal, handle-invalid=DONT-INVALIDATE
    VeRxPDU_ENGINE_FD_2_FD16_E2E_Sts
      data E2ECheckSts: type=ADTSUint8
      data OpRetVal: type=ADTSUint8
      invalidation-policys:
        data-element=VeRxPDU_ENGINE_FD_2_FD16_E2E_Sts/E2ECheckSts, handle-invalid=DONT-INVALIDATE
        data-element=VeRxPDU_ENGINE_FD_2_FD16_E2E_Sts/OpRetVal, handle-invalid=DONT-INVALIDATE
    VeRxPDU_ENGINE_FD_1_FD16_E2E_Sts
      data E2ECheckSts: type=ADTSUint8
      data OpRetVal: type=ADTSUint8
      invalidation-policys:
        data-element=VeRxPDU_ENGINE_FD_1_FD16_E2E_Sts/E2ECheckSts, handle-invalid=DONT-INVALIDATE
        data-element=VeRxPDU_ENGINE_FD_1_FD16_E2E_Sts/OpRetVal, handle-invalid=DONT-INVALIDATE
    VeRxPDU_ELSDM_FD_1_FD16_E2E_Sts
      data E2ECheckSts: type=ADTSUint8
      data OpRetVal: type=ADTSUint8
      invalidation-policys:
        data-element=VeRxPDU_ELSDM_FD_1_FD16_E2E_Sts/E2ECheckSts, handle-invalid=DONT-INVALIDATE
        data-element=VeRxPDU_ELSDM_FD_1_FD16_E2E_Sts/OpRetVal, handle-invalid=DONT-INVALIDATE
    VeRxPDU_AGSM_FD_2_FD16_E2E_Sts
      data E2ECheckSts: type=ADTSUint8
      data OpRetVal: type=ADTSUint8
      invalidation-policys:
        data-element=VeRxPDU_AGSM_FD_2_FD16_E2E_Sts/E2ECheckSts, handle-invalid=DONT-INVALIDATE
        data-element=VeRxPDU_AGSM_FD_2_FD16_E2E_Sts/OpRetVal, handle-invalid=DONT-INVALIDATE
    SendCANR_ABSFailSts_FD16Vld: service-kind=ANY-STANDARDIZED, invalidation-policy{data-element=SendCANR_ABSFailSts_FD16Vld, handle-invalid=DONT-INVALIDATE}  # Valid
      data SendCANR_ABSFailSts_FD16Vld: category=VALUE, sw-calibration-access=READ-ONLY, type=ADTSBoolean, init-value=SendCANR_ABSFailSts_FD16VldValue:1
    SendCANR_ABSFailSts_FD5: service-kind=ANY-STANDARDIZED, invalidation-policy{data-element=SendCANR_ABSFailSts_FD5, handle-invalid=DONT-INVALIDATE}
      data SendCANR_ABSFailSts_FD5: category=VALUE, sw-calibration-access=READ-ONLY, type=ADTSBoolean, init-value=SendCANR_ABSFailSts_FD5Value:0
    SendCANR_ABSFailSts_FD5Vld: service-kind=ANY-STANDARDIZED, invalidation-policy{data-element=SendCANR_ABSFailSts_FD5Vld, handle-invalid=DONT-INVALIDATE}  # Valid
      data SendCANR_ABSFailSts_FD5Vld: category=VALUE, sw-calibration-access=READ-ONLY, type=ADTSBoolean, init-value=SendCANR_ABSFailSts_FD5VldValue:1
    SendCANR_APM_CtrlSts_Fbk_FD3: service-kind=ANY-STANDARDIZED, invalidation-policy{data-element=SendCANR_APM_CtrlSts_Fbk_FD3, handle-invalid=KEEP}
      data SendCANR_APM_CtrlSts_Fbk_FD3: category=VALUE, sw-calibration-access=READ-ONLY, type=ADTSAPM_CtrlSts_Fbk_FD3, init-value=SendCANR_APM_CtrlSts_Fbk_FD3Value:0
    SendCANR_APM_CtrlSts_Fbk_FD3Vld: service-kind=ANY-STANDARDIZED, invalidation-policy{data-element=SendCANR_APM_CtrlSts_Fbk_FD3Vld, handle-invalid=DONT-INVALIDATE}  # Valid
      data SendCANR_APM_CtrlSts_Fbk_FD3Vld: category=VALUE, sw-calibration-access=READ-ONLY, type=ADTSBoolean, init-value=SendCANR_APM_CtrlSts_Fbk_FD3VldValue:1
    SendCANR_APM_FailureReason_FD3: service-kind=ANY-STANDARDIZED, invalidation-policy{data-element=SendCANR_APM_FailureReason_FD3, handle-invalid=KEEP}
      data SendCANR_APM_FailureReason_FD3: category=VALUE, sw-calibration-access=READ-ONLY, type=ADTSAPM_FailureReason_FD3, init-value=SendCANR_APM_FailureReason_FD3Value:0
    SendCANR_APM_FailureReason_FD3Vld: service-kind=ANY-STANDARDIZED, invalidation-policy{data-element=SendCANR_APM_FailureReason_FD3Vld, handle-invalid=DONT-INVALIDATE}  # Valid
      data SendCANR_APM_FailureReason_FD3Vld: category=VALUE, sw-calibration-access=READ-ONLY, type=ADTSBoolean, init-value=SendCANR_APM_FailureReason_FD3VldValue:1
    SendCANR_APM_OutputPower_FD3: service-kind=ANY-STANDARDIZED, invalidation-policy{data-element=SendCANR_APM_OutputPower_FD3, handle-invalid=KEEP}
      data SendCANR_APM_OutputPower_FD3: category=VALUE, sw-calibration-access=READ-ONLY, type=ADTSAPM_OutputPower_FD3, init-value=SendCANR_APM_OutputPower_FD3Value:0
    SendCANR_APM_OutputPower_FD3Vld: service-kind=ANY-STANDARDIZED, invalidation-policy{data-element=SendCANR_APM_OutputPower_FD3Vld, handle-invalid=DONT-INVALIDATE}  # Valid
      data SendCANR_APM_OutputPower_FD3Vld: category=VALUE, sw-calibration-access=READ-ONLY, type=ADTSBoolean, init-value=SendCANR_APM_OutputPower_FD3VldValue:1
    SendCANR_AirflowRequest: service-kind=ANY-STANDARDIZED, invalidation-policy{data-element=SendCANR_AirflowRequest, handle-invalid=KEEP}
      data SendCANR_AirflowRequest: category=VALUE, sw-calibration-access=READ-ONLY, type=ADTSAirflowRequest, init-value=SendCANR_AirflowRequestValue:0
    SendCANR_AirflowRequestVld: service-kind=ANY-STANDARDIZED, invalidation-policy{data-element=SendCANR_AirflowRequestVld, handle-invalid=DONT-INVALIDATE}  # Valid
      data SendCANR_AirflowRequestVld: category=VALUE, sw-calibration-access=READ-ONLY, type=ADTSBoolean, init-value=SendCANR_AirflowRequestVldValue:1
    SendCANR_AllowClimateSchd1_Sts: service-kind=ANY-STANDARDIZED, invalidation-policy{data-element=SendCANR_AllowClimateSchd1_Sts, handle-invalid=KEEP}
      data SendCANR_AllowClimateSchd1_Sts: category=VALUE, sw-calibration-access=READ-ONLY, type=ADTSAllowClimateSchd1_Sts, init-value=SendCANR_AllowClimateSchd1_StsValue:0
    SendCANR_AllowClimateSchd1_StsVld: service-kind=ANY-STANDARDIZED, invalidation-policy{data-element=SendCANR_AllowClimateSchd1_StsVld, handle-invalid=DONT-INVALIDATE}  # Valid
      data SendCANR_AllowClimateSchd1_StsVld: category=VALUE, sw-calibration-access=READ-ONLY, type=ADTSBoolean, init-value=SendCANR_AllowClimateSchd1_StsVldValue:1
    SendCANR_AllowClimateSchd2_Sts: service-kind=ANY-STANDARDIZED, invalidation-policy{data-element=SendCANR_AllowClimateSchd2_Sts, handle-invalid=KEEP}
      data SendCANR_AllowClimateSchd2_Sts: category=VALUE, sw-calibration-access=READ-ONLY, type=ADTSAllowClimateSchd2_Sts, init-value=SendCANR_AllowClimateSchd2_StsValue:0
    SendCANR_AllowClimateSchd2_StsVld: service-kind=ANY-STANDARDIZED, invalidation-policy{data-element=SendCANR_AllowClimateSchd2_StsVld, handle-invalid=DONT-INVALIDATE}  # Valid
      data SendCANR_AllowClimateSchd2_StsVld: category=VALUE, sw-calibration-access=READ-ONLY, type=ADTSBoolean, init-value=SendCANR_AllowClimateSchd2_StsVldValue:1
    SendCANR_BPCM_HV_SOC_FD3: service-kind=ANY-STANDARDIZED, invalidation-policy{data-element=SendCANR_BPCM_HV_SOC_FD3, handle-invalid=KEEP}
      data SendCANR_BPCM_HV_SOC_FD3: category=VALUE, sw-calibration-access=READ-ONLY, type=ADTSBPCM_HV_SOC_FD3, init-value=SendCANR_BPCM_HV_SOC_FD3Value:0
    SendCANR_BPCM_HV_SOC_FD3Vld: service-kind=ANY-STANDARDIZED, invalidation-policy{data-element=SendCANR_BPCM_HV_SOC_FD3Vld, handle-invalid=DONT-INVALIDATE}  # Valid
      data SendCANR_BPCM_HV_SOC_FD3Vld: category=VALUE, sw-calibration-access=READ-ONLY, type=ADTSBoolean, init-value=SendCANR_BPCM_HV_SOC_FD3VldValue:1
    SendCANR_BPCM_HV_Temp_Avg: service-kind=ANY-STANDARDIZED, invalidation-policy{data-element=SendCANR_BPCM_HV_Temp_Avg, handle-invalid=KEEP}
      data SendCANR_BPCM_HV_Temp_Avg: category=VALUE, sw-calibration-access=READ-ONLY, type=ADTSBPCM_HV_Temp_Avg, init-value=SendCANR_BPCM_HV_Temp_AvgValue:-40
    SendCANR_BPCM_HV_Temp_AvgVld: service-kind=ANY-STANDARDIZED, invalidation-policy{data-element=SendCANR_BPCM_HV_Temp_AvgVld, handle-invalid=DONT-INVALIDATE}  # Valid
      data SendCANR_BPCM_HV_Temp_AvgVld: category=VALUE, sw-calibration-access=READ-ONLY, type=ADTSBoolean, init-value=SendCANR_BPCM_HV_Temp_AvgVldValue:1
    SendCANR_BattVoltDeviationErr: service-kind=ANY-STANDARDIZED, invalidation-policy{data-element=SendCANR_BattVoltDeviationErr, handle-invalid=DONT-INVALIDATE}
      data SendCANR_BattVoltDeviationErr: category=VALUE, sw-calibration-access=READ-ONLY, type=ADTSBoolean, init-value=SendCANR_BattVoltDeviationErrValue:0
    SendCANR_BattVoltDeviationErrVld: service-kind=ANY-STANDARDIZED, invalidation-policy{data-element=SendCANR_BattVoltDeviationErrVld, handle-invalid=DONT-INVALIDATE}  # Valid
      data SendCANR_BattVoltDeviationErrVld: category=VALUE, sw-calibration-access=READ-ONLY, type=ADTSBoolean, init-value=SendCANR_BattVoltDeviationErrVldValue:1
    SendCANR_Battery_Volt_1_FD11: service-kind=ANY-STANDARDIZED, invalidation-policy{data-element=SendCANR_Battery_Volt_1_FD11, handle-invalid=KEEP}
      data SendCANR_Battery_Volt_1_FD11: category=VALUE, sw-calibration-access=READ-ONLY, type=ADTSBattery_Volt_1_FD11, init-value=SendCANR_Battery_Volt_1_FD11Value:5
    SendCANR_Battery_Volt_1_FD11Vld: service-kind=ANY-STANDARDIZED, invalidation-policy{data-element=SendCANR_Battery_Volt_1_FD11Vld, handle-invalid=DONT-INVALIDATE}  # Valid
      data SendCANR_Battery_Volt_1_FD11Vld: category=VALUE, sw-calibration-access=READ-ONLY, type=ADTSBoolean, init-value=SendCANR_Battery_Volt_1_FD11VldValue:1
    SendCANR_Battery_Volt_1_FD5: service-kind=ANY-STANDARDIZED, invalidation-policy{data-element=SendCANR_Battery_Volt_1_FD5, handle-invalid=KEEP}
      data SendCANR_Battery_Volt_1_FD5: category=VALUE, sw-calibration-access=READ-ONLY, type=ADTSBattery_Volt_1_FD5, init-value=SendCANR_Battery_Volt_1_FD5Value:5
    SendCANR_Battery_Volt_1_FD5Vld: service-kind=ANY-STANDARDIZED, invalidation-policy{data-element=SendCANR_Battery_Volt_1_FD5Vld, handle-invalid=DONT-INVALIDATE}  # Valid
      data SendCANR_Battery_Volt_1_FD5Vld: category=VALUE, sw-calibration-access=READ-ONLY, type=ADTSBoolean, init-value=SendCANR_Battery_Volt_1_FD5VldValue:1
    SendCANR_CHAdeMOProtocol: service-kind=ANY-STANDARDIZED, invalidation-policy{data-element=SendCANR_CHAdeMOProtocol, handle-invalid=KEEP}
      data SendCANR_CHAdeMOProtocol: category=VALUE, sw-calibration-access=READ-ONLY, type=ADTSCHAdeMOProtocol, init-value=SendCANR_CHAdeMOProtocolValue:0
    SendCANR_CHAdeMOProtocolVld: service-kind=ANY-STANDARDIZED, invalidation-policy{data-element=SendCANR_CHAdeMOProtocolVld, handle-invalid=DONT-INVALIDATE}  # Valid
      data SendCANR_CHAdeMOProtocolVld: category=VALUE, sw-calibration-access=READ-ONLY, type=ADTSBoolean, init-value=SendCANR_CHAdeMOProtocolVldValue:1
    SendCANR_CRC_BCM10_FD16: service-kind=ANY-STANDARDIZED, invalidation-policy{data-element=SendCANR_CRC_BCM10_FD16, handle-invalid=DONT-INVALIDATE}
      data SendCANR_CRC_BCM10_FD16: category=VALUE, sw-calibration-access=READ-ONLY, type=ADTSCRC_BCM10_FD16, init-value=SendCANR_CRC_BCM10_FD16Value:0
    SendCANR_CRC_BCM10_FD16Vld: service-kind=ANY-STANDARDIZED, invalidation-policy{data-element=SendCANR_CRC_BCM10_FD16Vld, handle-invalid=DONT-INVALIDATE}  # Valid
      data SendCANR_CRC_BCM10_FD16Vld: category=VALUE, sw-calibration-access=READ-ONLY, type=ADTSBoolean, init-value=SendCANR_CRC_BCM10_FD16VldValue:1
    SendCANR_CRC_HVBATTERY2: service-kind=ANY-STANDARDIZED, invalidation-policy{data-element=SendCANR_CRC_HVBATTERY2, handle-invalid=DONT-INVALIDATE}
      data SendCANR_CRC_HVBATTERY2: category=VALUE, sw-calibration-access=READ-ONLY, type=ADTSCRC_HVBATTERY2, init-value=SendCANR_CRC_HVBATTERY2Value:0
    SendCANR_CRC_HVBATTERY2Vld: service-kind=ANY-STANDARDIZED, invalidation-policy{data-element=SendCANR_CRC_HVBATTERY2Vld, handle-invalid=DONT-INVALIDATE}  # Valid
      data SendCANR_CRC_HVBATTERY2Vld: category=VALUE, sw-calibration-access=READ-ONLY, type=ADTSBoolean, init-value=SendCANR_CRC_HVBATTERY2VldValue:1
    SendCANR_CRC_HYBD_THRML_CMD_FD5: service-kind=ANY-STANDARDIZED, invalidation-policy{data-element=SendCANR_CRC_HYBD_THRML_CMD_FD5, handle-invalid=DONT-INVALIDATE}
      data SendCANR_CRC_HYBD_THRML_CMD_FD5: category=VALUE, sw-calibration-access=READ-ONLY, type=ADTSCRC_HYBD_THRML_CMD_FD5, init-value=SendCANR_CRC_HYBD_THRML_CMD_FD5Value:0
    SendCANR_CRC_HYBD_THRML_CMD_FD5Vld: service-kind=ANY-STANDARDIZED, invalidation-policy{data-element=SendCANR_CRC_HYBD_THRML_CMD_FD5Vld, handle-invalid=DONT-INVALIDATE}  # Valid
      data SendCANR_CRC_HYBD_THRML_CMD_FD5Vld: category=VALUE, sw-calibration-access=READ-ONLY, type=ADTSBoolean, init-value=SendCANR_CRC_HYBD_THRML_CMD_FD5VldValue:1
    SendCANR_CRC_HYBRID_DISPLAY2: service-kind=ANY-STANDARDIZED, invalidation-policy{data-element=SendCANR_CRC_HYBRID_DISPLAY2, handle-invalid=DONT-INVALIDATE}
      data SendCANR_CRC_HYBRID_DISPLAY2: category=VALUE, sw-calibration-access=READ-ONLY, type=ADTSCRC_HYBRID_DISPLAY2, init-value=SendCANR_CRC_HYBRID_DISPLAY2Value:0
    SendCANR_CRC_HYBRID_DISPLAY2Vld: service-kind=ANY-STANDARDIZED, invalidation-policy{data-element=SendCANR_CRC_HYBRID_DISPLAY2Vld, handle-invalid=DONT-INVALIDATE}  # Valid
      data SendCANR_CRC_HYBRID_DISPLAY2Vld: category=VALUE, sw-calibration-access=READ-ONLY, type=ADTSBoolean, init-value=SendCANR_CRC_HYBRID_DISPLAY2VldValue:1
    SendCANR_CRC_HYBRID_SYSTEM_EPT1: service-kind=ANY-STANDARDIZED, invalidation-policy{data-element=SendCANR_CRC_HYBRID_SYSTEM_EPT1, handle-invalid=DONT-INVALIDATE}
      data SendCANR_CRC_HYBRID_SYSTEM_EPT1: category=VALUE, sw-calibration-access=READ-ONLY, type=ADTSCRC_HYBRID_SYSTEM_EPT1, init-value=SendCANR_CRC_HYBRID_SYSTEM_EPT1Value:0
    SendCANR_CRC_HYBRID_SYSTEM_EPT1Vld: service-kind=ANY-STANDARDIZED, invalidation-policy{data-element=SendCANR_CRC_HYBRID_SYSTEM_EPT1Vld, handle-invalid=DONT-INVALIDATE}  # Valid
      data SendCANR_CRC_HYBRID_SYSTEM_EPT1Vld: category=VALUE, sw-calibration-access=READ-ONLY, type=ADTSBoolean, init-value=SendCANR_CRC_HYBRID_SYSTEM_EPT1VldValue:1
    SendCANR_CRC_HYB_THRM_CMND_FD16: service-kind=ANY-STANDARDIZED, invalidation-policy{data-element=SendCANR_CRC_HYB_THRM_CMND_FD16, handle-invalid=DONT-INVALIDATE}
      data SendCANR_CRC_HYB_THRM_CMND_FD16: category=VALUE, sw-calibration-access=READ-ONLY, type=ADTSCRC_HYB_THRM_CMND_FD16, init-value=SendCANR_CRC_HYB_THRM_CMND_FD16Value:0
    SendCANR_CRC_HYB_THRM_CMND_FD16Vld: service-kind=ANY-STANDARDIZED, invalidation-policy{data-element=SendCANR_CRC_HYB_THRM_CMND_FD16Vld, handle-invalid=DONT-INVALIDATE}  # Valid
      data SendCANR_CRC_HYB_THRM_CMND_FD16Vld: category=VALUE, sw-calibration-access=READ-ONLY, type=ADTSBoolean, init-value=SendCANR_CRC_HYB_THRM_CMND_FD16VldValue:1
    SendCANR_CRC_MCPA_STATUS_FD11: service-kind=ANY-STANDARDIZED, invalidation-policy{data-element=SendCANR_CRC_MCPA_STATUS_FD11, handle-invalid=DONT-INVALIDATE}
      data SendCANR_CRC_MCPA_STATUS_FD11: category=VALUE, sw-calibration-access=READ-ONLY, type=ADTSCRC_MCPA_STATUS_FD11, init-value=SendCANR_CRC_MCPA_STATUS_FD11Value:0
    SendCANR_CRC_MCPA_STATUS_FD11Vld: service-kind=ANY-STANDARDIZED, invalidation-policy{data-element=SendCANR_CRC_MCPA_STATUS_FD11Vld, handle-invalid=DONT-INVALIDATE}  # Valid
      data SendCANR_CRC_MCPA_STATUS_FD11Vld: category=VALUE, sw-calibration-access=READ-ONLY, type=ADTSBoolean, init-value=SendCANR_CRC_MCPA_STATUS_FD11VldValue:1
    SendCANR_CRC_MCPB_STATUS_FD11: service-kind=ANY-STANDARDIZED, invalidation-policy{data-element=SendCANR_CRC_MCPB_STATUS_FD11, handle-invalid=DONT-INVALIDATE}
      data SendCANR_CRC_MCPB_STATUS_FD11: category=VALUE, sw-calibration-access=READ-ONLY, type=ADTSCRC_MCPB_STATUS_FD11, init-value=SendCANR_CRC_MCPB_STATUS_FD11Value:0
    SendCANR_CRC_MCPB_STATUS_FD11Vld: service-kind=ANY-STANDARDIZED, invalidation-policy{data-element=SendCANR_CRC_MCPB_STATUS_FD11Vld, handle-invalid=DONT-INVALIDATE}  # Valid
      data SendCANR_CRC_MCPB_STATUS_FD11Vld: category=VALUE, sw-calibration-access=READ-ONLY, type=ADTSBoolean, init-value=SendCANR_CRC_MCPB_STATUS_FD11VldValue:1
    SendCANR_CabinConditioningSts: service-kind=ANY-STANDARDIZED, invalidation-policy{data-element=SendCANR_CabinConditioningSts, handle-invalid=KEEP}
      data SendCANR_CabinConditioningSts: category=VALUE, sw-calibration-access=READ-ONLY, type=ADTSCabinConditioningSts, init-value=SendCANR_CabinConditioningStsValue:0
    SendCANR_CabinConditioningStsVld: service-kind=ANY-STANDARDIZED, invalidation-policy{data-element=SendCANR_CabinConditioningStsVld, handle-invalid=DONT-INVALIDATE}  # Valid
      data SendCANR_CabinConditioningStsVld: category=VALUE, sw-calibration-access=READ-ONLY, type=ADTSBoolean, init-value=SendCANR_CabinConditioningStsVldValue:1
    SendCANR_CbnPreconditionReqSts: service-kind=ANY-STANDARDIZED, invalidation-policy{data-element=SendCANR_CbnPreconditionReqSts, handle-invalid=KEEP}
      data SendCANR_CbnPreconditionReqSts: category=VALUE, sw-calibration-access=READ-ONLY, type=ADTSCbnPreconditionReqSts, init-value=SendCANR_CbnPreconditionReqStsValue:0
    SendCANR_CbnPreconditionReqStsVld: service-kind=ANY-STANDARDIZED, invalidation-policy{data-element=SendCANR_CbnPreconditionReqStsVld, handle-invalid=DONT-INVALIDATE}  # Valid
      data SendCANR_CbnPreconditionReqStsVld: category=VALUE, sw-calibration-access=READ-ONLY, type=ADTSBoolean, init-value=SendCANR_CbnPreconditionReqStsVldValue:1
    SendCANR_CdMExtFunMinBattVolt: service-kind=ANY-STANDARDIZED, invalidation-policy{data-element=SendCANR_CdMExtFunMinBattVolt, handle-invalid=KEEP}
      data SendCANR_CdMExtFunMinBattVolt: category=VALUE, sw-calibration-access=READ-ONLY, type=ADTSCdMExtFunMinBattVolt, init-value=SendCANR_CdMExtFunMinBattVoltValue:0
    SendCANR_CdMExtFunMinBattVoltVld: service-kind=ANY-STANDARDIZED, invalidation-policy{data-element=SendCANR_CdMExtFunMinBattVoltVld, handle-invalid=DONT-INVALIDATE}  # Valid
      data SendCANR_CdMExtFunMinBattVoltVld: category=VALUE, sw-calibration-access=READ-ONLY, type=ADTSBoolean, init-value=SendCANR_CdMExtFunMinBattVoltVldValue:1
    SendCANR_CdMExtFunVehDynCtrlCmp: service-kind=ANY-STANDARDIZED, invalidation-policy{data-element=SendCANR_CdMExtFunVehDynCtrlCmp, handle-invalid=DONT-INVALIDATE}
      data SendCANR_CdMExtFunVehDynCtrlCmp: category=VALUE, sw-calibration-access=READ-ONLY, type=ADTSBoolean, init-value=SendCANR_CdMExtFunVehDynCtrlCmpValue:0
    SendCANR_CdMExtFunVehDynCtrlCmpVld: service-kind=ANY-STANDARDIZED, invalidation-policy{data-element=SendCANR_CdMExtFunVehDynCtrlCmpVld, handle-invalid=DONT-INVALIDATE}  # Valid
      data SendCANR_CdMExtFunVehDynCtrlCmpVld: category=VALUE, sw-calibration-access=READ-ONLY, type=ADTSBoolean, init-value=SendCANR_CdMExtFunVehDynCtrlCmpVldValue:1
    SendCANR_CdM_Chrgcurrentreqext: service-kind=ANY-STANDARDIZED, invalidation-policy{data-element=SendCANR_CdM_Chrgcurrentreqext, handle-invalid=DONT-INVALIDATE}
      data SendCANR_CdM_Chrgcurrentreqext: category=VALUE, sw-calibration-access=READ-ONLY, type=ADTSCdM_Chrgcurrentreqext, init-value=SendCANR_CdM_ChrgcurrentreqextValue:0
    SendCANR_CdM_ChrgcurrentreqextVld: service-kind=ANY-STANDARDIZED, invalidation-policy{data-element=SendCANR_CdM_ChrgcurrentreqextVld, handle-invalid=DONT-INVALIDATE}  # Valid
      data SendCANR_CdM_ChrgcurrentreqextVld: category=VALUE, sw-calibration-access=READ-ONLY, type=ADTSBoolean, init-value=SendCANR_CdM_ChrgcurrentreqextVldValue:1
    SendCANR_CdM_ExtFunVehHCCntrCmp: service-kind=ANY-STANDARDIZED, invalidation-policy{data-element=SendCANR_CdM_ExtFunVehHCCntrCmp, handle-invalid=DONT-INVALIDATE}
      data SendCANR_CdM_ExtFunVehHCCntrCmp: category=VALUE, sw-calibration-access=READ-ONLY, type=ADTSBoolean, init-value=SendCANR_CdM_ExtFunVehHCCntrCmpValue:0
    SendCANR_CdM_ExtFunVehHCCntrCmpVld: service-kind=ANY-STANDARDIZED, invalidation-policy{data-element=SendCANR_CdM_ExtFunVehHCCntrCmpVld, handle-invalid=DONT-INVALIDATE}  # Valid
      data SendCANR_CdM_ExtFunVehHCCntrCmpVld: category=VALUE, sw-calibration-access=READ-ONLY, type=ADTSBoolean, init-value=SendCANR_CdM_ExtFunVehHCCntrCmpVldValue:1
    SendCANR_CdM_Reminedbattcpcity: service-kind=ANY-STANDARDIZED, invalidation-policy{data-element=SendCANR_CdM_Reminedbattcpcity, handle-invalid=KEEP}
      data SendCANR_CdM_Reminedbattcpcity: category=VALUE, sw-calibration-access=READ-ONLY, type=ADTSCdM_Reminedbattcpcity, init-value=SendCANR_CdM_ReminedbattcpcityValue:0
    SendCANR_CdM_ReminedbattcpcityVld: service-kind=ANY-STANDARDIZED, invalidation-policy{data-element=SendCANR_CdM_ReminedbattcpcityVld, handle-invalid=DONT-INVALIDATE}  # Valid
      data SendCANR_CdM_ReminedbattcpcityVld: category=VALUE, sw-calibration-access=READ-ONLY, type=ADTSBoolean, init-value=SendCANR_CdM_ReminedbattcpcityVldValue:1
    SendCANR_ChargeScheduleType2Sts: service-kind=ANY-STANDARDIZED, invalidation-policy{data-element=SendCANR_ChargeScheduleType2Sts, handle-invalid=DONT-INVALIDATE}
      data SendCANR_ChargeScheduleType2Sts: category=VALUE, sw-calibration-access=READ-ONLY, type=ADTSChargeScheduleType2Sts, init-value=SendCANR_ChargeScheduleType2StsValue:0
    SendCANR_ChargeScheduleType2StsVld: service-kind=ANY-STANDARDIZED, invalidation-policy{data-element=SendCANR_ChargeScheduleType2StsVld, handle-invalid=DONT-INVALIDATE}  # Valid
      data SendCANR_ChargeScheduleType2StsVld: category=VALUE, sw-calibration-access=READ-ONLY, type=ADTSBoolean, init-value=SendCANR_ChargeScheduleType2StsVldValue:1
    SendCANR_ChargeUntilFull1_Sts: service-kind=ANY-STANDARDIZED, invalidation-policy{data-element=SendCANR_ChargeUntilFull1_Sts, handle-invalid=DONT-INVALIDATE}
      data SendCANR_ChargeUntilFull1_Sts: category=VALUE, sw-calibration-access=READ-ONLY, type=ADTSBoolean, init-value=SendCANR_ChargeUntilFull1_StsValue:0
    SendCANR_ChargeUntilFull1_StsVld: service-kind=ANY-STANDARDIZED, invalidation-policy{data-element=SendCANR_ChargeUntilFull1_StsVld, handle-invalid=DONT-INVALIDATE}  # Valid
      data SendCANR_ChargeUntilFull1_StsVld: category=VALUE, sw-calibration-access=READ-ONLY, type=ADTSBoolean, init-value=SendCANR_ChargeUntilFull1_StsVldValue:1
    SendCANR_ChargeUntilFull2_Sts: service-kind=ANY-STANDARDIZED, invalidation-policy{data-element=SendCANR_ChargeUntilFull2_Sts, handle-invalid=DONT-INVALIDATE}
      data SendCANR_ChargeUntilFull2_Sts: category=VALUE, sw-calibration-access=READ-ONLY, type=ADTSBoolean, init-value=SendCANR_ChargeUntilFull2_StsValue:0
    SendCANR_ChargeUntilFull2_StsVld: service-kind=ANY-STANDARDIZED, invalidation-policy{data-element=SendCANR_ChargeUntilFull2_StsVld, handle-invalid=DONT-INVALIDATE}  # Valid
      data SendCANR_ChargeUntilFull2_StsVld: category=VALUE, sw-calibration-access=READ-ONLY, type=ADTSBoolean, init-value=SendCANR_ChargeUntilFull2_StsVldValue:1
    SendCANR_ChargedCurrentMin: service-kind=ANY-STANDARDIZED, invalidation-policy{data-element=SendCANR_ChargedCurrentMin, handle-invalid=DONT-INVALIDATE}
      data SendCANR_ChargedCurrentMin: category=VALUE, sw-calibration-access=READ-ONLY, type=ADTSChargedCurrentMin, init-value=SendCANR_ChargedCurrentMinValue:0
    SendCANR_ChargedCurrentMinVld: service-kind=ANY-STANDARDIZED, invalidation-policy{data-element=SendCANR_ChargedCurrentMinVld, handle-invalid=DONT-INVALIDATE}  # Valid
      data SendCANR_ChargedCurrentMinVld: category=VALUE, sw-calibration-access=READ-ONLY, type=ADTSBoolean, init-value=SendCANR_ChargedCurrentMinVldValue:1
    SendCANR_Chargeport_Lock_Status: service-kind=ANY-STANDARDIZED, invalidation-policy{data-element=SendCANR_Chargeport_Lock_Status, handle-invalid=DONT-INVALIDATE}
      data SendCANR_Chargeport_Lock_Status: category=VALUE, sw-calibration-access=READ-ONLY, type=ADTSChargeport_Lock_Status, init-value=SendCANR_Chargeport_Lock_StatusValue:0
    SendCANR_Chargeport_Lock_StatusVld: service-kind=ANY-STANDARDIZED, invalidation-policy{data-element=SendCANR_Chargeport_Lock_StatusVld, handle-invalid=DONT-INVALIDATE}  # Valid
      data SendCANR_Chargeport_Lock_StatusVld: category=VALUE, sw-calibration-access=READ-ONLY, type=ADTSBoolean, init-value=SendCANR_Chargeport_Lock_StatusVldValue:1
    SendCANR_Chrg_Schedule_Type1Sts: service-kind=ANY-STANDARDIZED, invalidation-policy{data-element=SendCANR_Chrg_Schedule_Type1Sts, handle-invalid=DONT-INVALIDATE}
      data SendCANR_Chrg_Schedule_Type1Sts: category=VALUE, sw-calibration-access=READ-ONLY, type=ADTSChrg_Schedule_Type1Sts, init-value=SendCANR_Chrg_Schedule_Type1StsValue:0
    SendCANR_Chrg_Schedule_Type1StsVld: service-kind=ANY-STANDARDIZED, invalidation-policy{data-element=SendCANR_Chrg_Schedule_Type1StsVld, handle-invalid=DONT-INVALIDATE}  # Valid
      data SendCANR_Chrg_Schedule_Type1StsVld: category=VALUE, sw-calibration-access=READ-ONLY, type=ADTSBoolean, init-value=SendCANR_Chrg_Schedule_Type1StsVldValue:1
    SendCANR_ChrgdRefrncCnstnt: service-kind=ANY-STANDARDIZED, invalidation-policy{data-element=SendCANR_ChrgdRefrncCnstnt, handle-invalid=DONT-INVALIDATE}
      data SendCANR_ChrgdRefrncCnstnt: category=VALUE, sw-calibration-access=READ-ONLY, type=ADTSChrgdRefrncCnstnt, init-value=SendCANR_ChrgdRefrncCnstntValue:0
    SendCANR_ChrgdRefrncCnstntVld: service-kind=ANY-STANDARDIZED, invalidation-policy{data-element=SendCANR_ChrgdRefrncCnstntVld, handle-invalid=DONT-INVALIDATE}  # Valid
      data SendCANR_ChrgdRefrncCnstntVld: category=VALUE, sw-calibration-access=READ-ONLY, type=ADTSBoolean, init-value=SendCANR_ChrgdRefrncCnstntVldValue:1
    SendCANR_ClimSchd1Dprtr_Min_Sts: service-kind=ANY-STANDARDIZED, invalidation-policy{data-element=SendCANR_ClimSchd1Dprtr_Min_Sts, handle-invalid=KEEP}
      data SendCANR_ClimSchd1Dprtr_Min_Sts: category=VALUE, sw-calibration-access=READ-ONLY, type=ADTSClimSchd1Dprtr_Min_Sts, init-value=SendCANR_ClimSchd1Dprtr_Min_StsValue:0
    SendCANR_ClimSchd1Dprtr_Min_StsVld: service-kind=ANY-STANDARDIZED, invalidation-policy{data-element=SendCANR_ClimSchd1Dprtr_Min_StsVld, handle-invalid=DONT-INVALIDATE}  # Valid
      data SendCANR_ClimSchd1Dprtr_Min_StsVld: category=VALUE, sw-calibration-access=READ-ONLY, type=ADTSBoolean, init-value=SendCANR_ClimSchd1Dprtr_Min_StsVldValue:1
    SendCANR_ClimatSchd2DprtrMinSts: service-kind=ANY-STANDARDIZED, invalidation-policy{data-element=SendCANR_ClimatSchd2DprtrMinSts, handle-invalid=KEEP}
      data SendCANR_ClimatSchd2DprtrMinSts: category=VALUE, sw-calibration-access=READ-ONLY, type=ADTSClimatSchd2DprtrMinSts, init-value=SendCANR_ClimatSchd2DprtrMinStsValue:0
    SendCANR_ClimatSchd2DprtrMinStsVld: service-kind=ANY-STANDARDIZED, invalidation-policy{data-element=SendCANR_ClimatSchd2DprtrMinStsVld, handle-invalid=DONT-INVALIDATE}  # Valid
      data SendCANR_ClimatSchd2DprtrMinStsVld: category=VALUE, sw-calibration-access=READ-ONLY, type=ADTSBoolean, init-value=SendCANR_ClimatSchd2DprtrMinStsVldValue:1
    SendCANR_ClimateSchd1DprtrHrSts: service-kind=ANY-STANDARDIZED, invalidation-policy{data-element=SendCANR_ClimateSchd1DprtrHrSts, handle-invalid=KEEP}
      data SendCANR_ClimateSchd1DprtrHrSts: category=VALUE, sw-calibration-access=READ-ONLY, type=ADTSClimateSchd1DprtrHrSts, init-value=SendCANR_ClimateSchd1DprtrHrStsValue:0
    SendCANR_ClimateSchd1DprtrHrStsVld: service-kind=ANY-STANDARDIZED, invalidation-policy{data-element=SendCANR_ClimateSchd1DprtrHrStsVld, handle-invalid=DONT-INVALIDATE}  # Valid
      data SendCANR_ClimateSchd1DprtrHrStsVld: category=VALUE, sw-calibration-access=READ-ONLY, type=ADTSBoolean, init-value=SendCANR_ClimateSchd1DprtrHrStsVldValue:1
    SendCANR_ClimateSchd1_Day_Sts: service-kind=ANY-STANDARDIZED, invalidation-policy{data-element=SendCANR_ClimateSchd1_Day_Sts, handle-invalid=KEEP}
      data SendCANR_ClimateSchd1_Day_Sts: category=VALUE, sw-calibration-access=READ-ONLY, type=ADTSClimateSchd1_Day_Sts, init-value=SendCANR_ClimateSchd1_Day_StsValue:0
    SendCANR_ClimateSchd1_Day_StsVld: service-kind=ANY-STANDARDIZED, invalidation-policy{data-element=SendCANR_ClimateSchd1_Day_StsVld, handle-invalid=DONT-INVALIDATE}  # Valid
      data SendCANR_ClimateSchd1_Day_StsVld: category=VALUE, sw-calibration-access=READ-ONLY, type=ADTSBoolean, init-value=SendCANR_ClimateSchd1_Day_StsVldValue:1
    SendCANR_ClimateSchd2DprtrHrSts: service-kind=ANY-STANDARDIZED, invalidation-policy{data-element=SendCANR_ClimateSchd2DprtrHrSts, handle-invalid=KEEP}
      data SendCANR_ClimateSchd2DprtrHrSts: category=VALUE, sw-calibration-access=READ-ONLY, type=ADTSClimateSchd2DprtrHrSts, init-value=SendCANR_ClimateSchd2DprtrHrStsValue:0
    SendCANR_ClimateSchd2DprtrHrStsVld: service-kind=ANY-STANDARDIZED, invalidation-policy{data-element=SendCANR_ClimateSchd2DprtrHrStsVld, handle-invalid=DONT-INVALIDATE}  # Valid
      data SendCANR_ClimateSchd2DprtrHrStsVld: category=VALUE, sw-calibration-access=READ-ONLY, type=ADTSBoolean, init-value=SendCANR_ClimateSchd2DprtrHrStsVldValue:1
    SendCANR_ClimateSchd2_Day_Sts: service-kind=ANY-STANDARDIZED, invalidation-policy{data-element=SendCANR_ClimateSchd2_Day_Sts, handle-invalid=KEEP}
      data SendCANR_ClimateSchd2_Day_Sts: category=VALUE, sw-calibration-access=READ-ONLY, type=ADTSClimateSchd2_Day_Sts, init-value=SendCANR_ClimateSchd2_Day_StsValue:0
    SendCANR_ClimateSchd2_Day_StsVld: service-kind=ANY-STANDARDIZED, invalidation-policy{data-element=SendCANR_ClimateSchd2_Day_StsVld, handle-invalid=DONT-INVALIDATE}  # Valid
      data SendCANR_ClimateSchd2_Day_StsVld: category=VALUE, sw-calibration-access=READ-ONLY, type=ADTSBoolean, init-value=SendCANR_ClimateSchd2_Day_StsVldValue:1
    SendCANR_Climate_Cabin_Temp1Sts: service-kind=ANY-STANDARDIZED, invalidation-policy{data-element=SendCANR_Climate_Cabin_Temp1Sts, handle-invalid=KEEP}
      data SendCANR_Climate_Cabin_Temp1Sts: category=VALUE, sw-calibration-access=READ-ONLY, type=ADTSClimate_Cabin_Temp1Sts, init-value=SendCANR_Climate_Cabin_Temp1StsValue:22
    SendCANR_Climate_Cabin_Temp1StsVld: service-kind=ANY-STANDARDIZED, invalidation-policy{data-element=SendCANR_Climate_Cabin_Temp1StsVld, handle-invalid=DONT-INVALIDATE}  # Valid
      data SendCANR_Climate_Cabin_Temp1StsVld: category=VALUE, sw-calibration-access=READ-ONLY, type=ADTSBoolean, init-value=SendCANR_Climate_Cabin_Temp1StsVldValue:1
    SendCANR_Climate_Cabin_Temp2Sts: service-kind=ANY-STANDARDIZED, invalidation-policy{data-element=SendCANR_Climate_Cabin_Temp2Sts, handle-invalid=KEEP}
      data SendCANR_Climate_Cabin_Temp2Sts: category=VALUE, sw-calibration-access=READ-ONLY, type=ADTSClimate_Cabin_Temp2Sts, init-value=SendCANR_Climate_Cabin_Temp2StsValue:22
    SendCANR_Climate_Cabin_Temp2StsVld: service-kind=ANY-STANDARDIZED, invalidation-policy{data-element=SendCANR_Climate_Cabin_Temp2StsVld, handle-invalid=DONT-INVALIDATE}  # Valid
      data SendCANR_Climate_Cabin_Temp2StsVld: category=VALUE, sw-calibration-access=READ-ONLY, type=ADTSBoolean, init-value=SendCANR_Climate_Cabin_Temp2StsVldValue:1
    SendCANR_ClrLgsDiagInfo_FD11: service-kind=ANY-STANDARDIZED, invalidation-policy{data-element=SendCANR_ClrLgsDiagInfo_FD11, handle-invalid=DONT-INVALIDATE}
      data SendCANR_ClrLgsDiagInfo_FD11: category=VALUE, sw-calibration-access=READ-ONLY, type=ADTSBoolean, init-value=SendCANR_ClrLgsDiagInfo_FD11Value:0
    SendCANR_ClrLgsDiagInfo_FD11Vld: service-kind=ANY-STANDARDIZED, invalidation-policy{data-element=SendCANR_ClrLgsDiagInfo_FD11Vld, handle-invalid=DONT-INVALIDATE}  # Valid
      data SendCANR_ClrLgsDiagInfo_FD11Vld: category=VALUE, sw-calibration-access=READ-ONLY, type=ADTSBoolean, init-value=SendCANR_ClrLgsDiagInfo_FD11VldValue:1
    SendCANR_ClrLgsDiagInfo_FD5: service-kind=ANY-STANDARDIZED, invalidation-policy{data-element=SendCANR_ClrLgsDiagInfo_FD5, handle-invalid=DONT-INVALIDATE}
      data SendCANR_ClrLgsDiagInfo_FD5: category=VALUE, sw-calibration-access=READ-ONLY, type=ADTSBoolean, init-value=SendCANR_ClrLgsDiagInfo_FD5Value:0
    SendCANR_ClrLgsDiagInfo_FD5Vld: service-kind=ANY-STANDARDIZED, invalidation-policy{data-element=SendCANR_ClrLgsDiagInfo_FD5Vld, handle-invalid=DONT-INVALIDATE}  # Valid
      data SendCANR_ClrLgsDiagInfo_FD5Vld: category=VALUE, sw-calibration-access=READ-ONLY, type=ADTSBoolean, init-value=SendCANR_ClrLgsDiagInfo_FD5VldValue:1
    SendCANR_CmdIgnSts_FD11: service-kind=ANY-STANDARDIZED, invalidation-policy{data-element=SendCANR_CmdIgnSts_FD11, handle-invalid=KEEP}
      data SendCANR_CmdIgnSts_FD11: category=VALUE, sw-calibration-access=READ-ONLY, type=ADTSCmdIgnSts_FD11, init-value=SendCANR_CmdIgnSts_FD11Value:0
    SendCANR_CmdIgnSts_FD11Vld: service-kind=ANY-STANDARDIZED, invalidation-policy{data-element=SendCANR_CmdIgnSts_FD11Vld, handle-invalid=DONT-INVALIDATE}  # Valid
      data SendCANR_CmdIgnSts_FD11Vld: category=VALUE, sw-calibration-access=READ-ONLY, type=ADTSBoolean, init-value=SendCANR_CmdIgnSts_FD11VldValue:1
    SendCANR_CmdIgnSts_FD16: service-kind=ANY-STANDARDIZED, invalidation-policy{data-element=SendCANR_CmdIgnSts_FD16, handle-invalid=KEEP}
      data SendCANR_CmdIgnSts_FD16: category=VALUE, sw-calibration-access=READ-ONLY, type=ADTSCmdIgnSts_FD16, init-value=SendCANR_CmdIgnSts_FD16Value:0
    SendCANR_CmdIgnSts_FD16Vld: service-kind=ANY-STANDARDIZED, invalidation-policy{data-element=SendCANR_CmdIgnSts_FD16Vld, handle-invalid=DONT-INVALIDATE}  # Valid
      data SendCANR_CmdIgnSts_FD16Vld: category=VALUE, sw-calibration-access=READ-ONLY, type=ADTSBoolean, init-value=SendCANR_CmdIgnSts_FD16VldValue:1
    SendCANR_CompressorState: service-kind=ANY-STANDARDIZED, invalidation-policy{data-element=SendCANR_CompressorState, handle-invalid=KEEP}
      data SendCANR_CompressorState: category=VALUE, sw-calibration-access=READ-ONLY, type=ADTSCompressorState, init-value=SendCANR_CompressorStateValue:0
    SendCANR_CompressorStateVld: service-kind=ANY-STANDARDIZED, invalidation-policy{data-element=SendCANR_CompressorStateVld, handle-invalid=DONT-INVALIDATE}  # Valid
      data SendCANR_CompressorStateVld: category=VALUE, sw-calibration-access=READ-ONLY, type=ADTSBoolean, init-value=SendCANR_CompressorStateVldValue:1
    SendCANR_Cooperative_Status: service-kind=ANY-STANDARDIZED, invalidation-policy{data-element=SendCANR_Cooperative_Status, handle-invalid=DONT-INVALIDATE}
      data SendCANR_Cooperative_Status: category=VALUE, sw-calibration-access=READ-ONLY, type=ADTSCooperative_Status, init-value=SendCANR_Cooperative_StatusValue:0
    SendCANR_Cooperative_StatusVld: service-kind=ANY-STANDARDIZED, invalidation-policy{data-element=SendCANR_Cooperative_StatusVld, handle-invalid=DONT-INVALIDATE}  # Valid
      data SendCANR_Cooperative_StatusVld: category=VALUE, sw-calibration-access=READ-ONLY, type=ADTSBoolean, init-value=SendCANR_Cooperative_StatusVldValue:1
    SendCANR_CrCanNMStFD03EVCU2FD11: service-kind=ANY-STANDARDIZED, invalidation-policy{data-element=SendCANR_CrCanNMStFD03EVCU2FD11, handle-invalid=DONT-INVALIDATE}
      data SendCANR_CrCanNMStFD03EVCU2FD11: category=VALUE, sw-calibration-access=READ-ONLY, type=ADTSCrCanNMStFD03EVCU2FD11, init-value=SendCANR_CrCanNMStFD03EVCU2FD11Value:0
    SendCANR_CrCanNMStFD03EVCU2FD11Vld: service-kind=ANY-STANDARDIZED, invalidation-policy{data-element=SendCANR_CrCanNMStFD03EVCU2FD11Vld, handle-invalid=DONT-INVALIDATE}  # Valid
      data SendCANR_CrCanNMStFD03EVCU2FD11Vld: category=VALUE, sw-calibration-access=READ-ONLY, type=ADTSBoolean, init-value=SendCANR_CrCanNMStFD03EVCU2FD11VldValue:1
    SendCANR_CrCanNMStFD05EVCU2FD11: service-kind=ANY-STANDARDIZED, invalidation-policy{data-element=SendCANR_CrCanNMStFD05EVCU2FD11, handle-invalid=DONT-INVALIDATE}
      data SendCANR_CrCanNMStFD05EVCU2FD11: category=VALUE, sw-calibration-access=READ-ONLY, type=ADTSCrCanNMStFD05EVCU2FD11, init-value=SendCANR_CrCanNMStFD05EVCU2FD11Value:0
    SendCANR_CrCanNMStFD05EVCU2FD11Vld: service-kind=ANY-STANDARDIZED, invalidation-policy{data-element=SendCANR_CrCanNMStFD05EVCU2FD11Vld, handle-invalid=DONT-INVALIDATE}  # Valid
      data SendCANR_CrCanNMStFD05EVCU2FD11Vld: category=VALUE, sw-calibration-access=READ-ONLY, type=ADTSBoolean, init-value=SendCANR_CrCanNMStFD05EVCU2FD11VldValue:1
    SendCANR_CrCanNMStFD11EVCU2FD11: service-kind=ANY-STANDARDIZED, invalidation-policy{data-element=SendCANR_CrCanNMStFD11EVCU2FD11, handle-invalid=DONT-INVALIDATE}
      data SendCANR_CrCanNMStFD11EVCU2FD11: category=VALUE, sw-calibration-access=READ-ONLY, type=ADTSCrCanNMStFD11EVCU2FD11, init-value=SendCANR_CrCanNMStFD11EVCU2FD11Value:0
    SendCANR_CrCanNMStFD11EVCU2FD11Vld: service-kind=ANY-STANDARDIZED, invalidation-policy{data-element=SendCANR_CrCanNMStFD11EVCU2FD11Vld, handle-invalid=DONT-INVALIDATE}  # Valid
      data SendCANR_CrCanNMStFD11EVCU2FD11Vld: category=VALUE, sw-calibration-access=READ-ONLY, type=ADTSBoolean, init-value=SendCANR_CrCanNMStFD11EVCU2FD11VldValue:1
    SendCANR_CrCanNMStFD16EVCU2FD11: service-kind=ANY-STANDARDIZED, invalidation-policy{data-element=SendCANR_CrCanNMStFD16EVCU2FD11, handle-invalid=DONT-INVALIDATE}
      data SendCANR_CrCanNMStFD16EVCU2FD11: category=VALUE, sw-calibration-access=READ-ONLY, type=ADTSCrCanNMStFD16EVCU2FD11, init-value=SendCANR_CrCanNMStFD16EVCU2FD11Value:0
    SendCANR_CrCanNMStFD16EVCU2FD11Vld: service-kind=ANY-STANDARDIZED, invalidation-policy{data-element=SendCANR_CrCanNMStFD16EVCU2FD11Vld, handle-invalid=DONT-INVALIDATE}  # Valid
      data SendCANR_CrCanNMStFD16EVCU2FD11Vld: category=VALUE, sw-calibration-access=READ-ONLY, type=ADTSBoolean, init-value=SendCANR_CrCanNMStFD16EVCU2FD11VldValue:1
    SendCANR_CurCanNMStFD03EVCU2FD3: service-kind=ANY-STANDARDIZED, invalidation-policy{data-element=SendCANR_CurCanNMStFD03EVCU2FD3, handle-invalid=DONT-INVALIDATE}
      data SendCANR_CurCanNMStFD03EVCU2FD3: category=VALUE, sw-calibration-access=READ-ONLY, type=ADTSCurCanNMStFD03EVCU2FD3, init-value=SendCANR_CurCanNMStFD03EVCU2FD3Value:0
    SendCANR_CurCanNMStFD03EVCU2FD3Vld: service-kind=ANY-STANDARDIZED, invalidation-policy{data-element=SendCANR_CurCanNMStFD03EVCU2FD3Vld, handle-invalid=DONT-INVALIDATE}  # Valid
      data SendCANR_CurCanNMStFD03EVCU2FD3Vld: category=VALUE, sw-calibration-access=READ-ONLY, type=ADTSBoolean, init-value=SendCANR_CurCanNMStFD03EVCU2FD3VldValue:1
    SendCANR_CurCanNMStFD05EVCU2FD3: service-kind=ANY-STANDARDIZED, invalidation-policy{data-element=SendCANR_CurCanNMStFD05EVCU2FD3, handle-invalid=DONT-INVALIDATE}
      data SendCANR_CurCanNMStFD05EVCU2FD3: category=VALUE, sw-calibration-access=READ-ONLY, type=ADTSCurCanNMStFD05EVCU2FD3, init-value=SendCANR_CurCanNMStFD05EVCU2FD3Value:0
    SendCANR_CurCanNMStFD05EVCU2FD3Vld: service-kind=ANY-STANDARDIZED, invalidation-policy{data-element=SendCANR_CurCanNMStFD05EVCU2FD3Vld, handle-invalid=DONT-INVALIDATE}  # Valid
      data SendCANR_CurCanNMStFD05EVCU2FD3Vld: category=VALUE, sw-calibration-access=READ-ONLY, type=ADTSBoolean, init-value=SendCANR_CurCanNMStFD05EVCU2FD3VldValue:1
    SendCANR_CurCanNMStFD11EVCU2FD3: service-kind=ANY-STANDARDIZED, invalidation-policy{data-element=SendCANR_CurCanNMStFD11EVCU2FD3, handle-invalid=DONT-INVALIDATE}
      data SendCANR_CurCanNMStFD11EVCU2FD3: category=VALUE, sw-calibration-access=READ-ONLY, type=ADTSCurCanNMStFD11EVCU2FD3, init-value=SendCANR_CurCanNMStFD11EVCU2FD3Value:0
    SendCANR_CurCanNMStFD11EVCU2FD3Vld: service-kind=ANY-STANDARDIZED, invalidation-policy{data-element=SendCANR_CurCanNMStFD11EVCU2FD3Vld, handle-invalid=DONT-INVALIDATE}  # Valid
      data SendCANR_CurCanNMStFD11EVCU2FD3Vld: category=VALUE, sw-calibration-access=READ-ONLY, type=ADTSBoolean, init-value=SendCANR_CurCanNMStFD11EVCU2FD3VldValue:1
    SendCANR_CurCanNMStFD16EVCU2FD3: service-kind=ANY-STANDARDIZED, invalidation-policy{data-element=SendCANR_CurCanNMStFD16EVCU2FD3, handle-invalid=DONT-INVALIDATE}
      data SendCANR_CurCanNMStFD16EVCU2FD3: category=VALUE, sw-calibration-access=READ-ONLY, type=ADTSCurCanNMStFD16EVCU2FD3, init-value=SendCANR_CurCanNMStFD16EVCU2FD3Value:0
    SendCANR_CurCanNMStFD16EVCU2FD3Vld: service-kind=ANY-STANDARDIZED, invalidation-policy{data-element=SendCANR_CurCanNMStFD16EVCU2FD3Vld, handle-invalid=DONT-INVALIDATE}  # Valid
      data SendCANR_CurCanNMStFD16EVCU2FD3Vld: category=VALUE, sw-calibration-access=READ-ONLY, type=ADTSBoolean, init-value=SendCANR_CurCanNMStFD16EVCU2FD3VldValue:1
    SendCANR_CurFailStFD03EVCU2FD11: service-kind=ANY-STANDARDIZED, invalidation-policy{data-element=SendCANR_CurFailStFD03EVCU2FD11, handle-invalid=DONT-INVALIDATE}
      data SendCANR_CurFailStFD03EVCU2FD11: category=VALUE, sw-calibration-access=READ-ONLY, type=ADTSBoolean, init-value=SendCANR_CurFailStFD03EVCU2FD11Value:0
    SendCANR_CurFailStFD03EVCU2FD11Vld: service-kind=ANY-STANDARDIZED, invalidation-policy{data-element=SendCANR_CurFailStFD03EVCU2FD11Vld, handle-invalid=DONT-INVALIDATE}  # Valid
      data SendCANR_CurFailStFD03EVCU2FD11Vld: category=VALUE, sw-calibration-access=READ-ONLY, type=ADTSBoolean, init-value=SendCANR_CurFailStFD03EVCU2FD11VldValue:1
    SendCANR_CurFailStFD05EVCU2FD11: service-kind=ANY-STANDARDIZED, invalidation-policy{data-element=SendCANR_CurFailStFD05EVCU2FD11, handle-invalid=DONT-INVALIDATE}
      data SendCANR_CurFailStFD05EVCU2FD11: category=VALUE, sw-calibration-access=READ-ONLY, type=ADTSBoolean, init-value=SendCANR_CurFailStFD05EVCU2FD11Value:0
    SendCANR_CurFailStFD05EVCU2FD11Vld: service-kind=ANY-STANDARDIZED, invalidation-policy{data-element=SendCANR_CurFailStFD05EVCU2FD11Vld, handle-invalid=DONT-INVALIDATE}  # Valid
      data SendCANR_CurFailStFD05EVCU2FD11Vld: category=VALUE, sw-calibration-access=READ-ONLY, type=ADTSBoolean, init-value=SendCANR_CurFailStFD05EVCU2FD11VldValue:1
    SendCANR_CurFailStFD11EVCU2FD11: service-kind=ANY-STANDARDIZED, invalidation-policy{data-element=SendCANR_CurFailStFD11EVCU2FD11, handle-invalid=DONT-INVALIDATE}
      data SendCANR_CurFailStFD11EVCU2FD11: category=VALUE, sw-calibration-access=READ-ONLY, type=ADTSBoolean, init-value=SendCANR_CurFailStFD11EVCU2FD11Value:0
    SendCANR_CurFailStFD11EVCU2FD11Vld: service-kind=ANY-STANDARDIZED, invalidation-policy{data-element=SendCANR_CurFailStFD11EVCU2FD11Vld, handle-invalid=DONT-INVALIDATE}  # Valid
      data SendCANR_CurFailStFD11EVCU2FD11Vld: category=VALUE, sw-calibration-access=READ-ONLY, type=ADTSBoolean, init-value=SendCANR_CurFailStFD11EVCU2FD11VldValue:1
    SendCANR_CurFailStFD16EVCU2FD11: service-kind=ANY-STANDARDIZED, invalidation-policy{data-element=SendCANR_CurFailStFD16EVCU2FD11, handle-invalid=DONT-INVALIDATE}
      data SendCANR_CurFailStFD16EVCU2FD11: category=VALUE, sw-calibration-access=READ-ONLY, type=ADTSBoolean, init-value=SendCANR_CurFailStFD16EVCU2FD11Value:0
    SendCANR_CurFailStFD16EVCU2FD11Vld: service-kind=ANY-STANDARDIZED, invalidation-policy{data-element=SendCANR_CurFailStFD16EVCU2FD11Vld, handle-invalid=DONT-INVALIDATE}  # Valid
      data SendCANR_CurFailStFD16EVCU2FD11Vld: category=VALUE, sw-calibration-access=READ-ONLY, type=ADTSBoolean, init-value=SendCANR_CurFailStFD16EVCU2FD11VldValue:1
    SendCANR_CurFailStsFD03EVCU2FD3: service-kind=ANY-STANDARDIZED, invalidation-policy{data-element=SendCANR_CurFailStsFD03EVCU2FD3, handle-invalid=DONT-INVALIDATE}
      data SendCANR_CurFailStsFD03EVCU2FD3: category=VALUE, sw-calibration-access=READ-ONLY, type=ADTSBoolean, init-value=SendCANR_CurFailStsFD03EVCU2FD3Value:0
    SendCANR_CurFailStsFD03EVCU2FD3Vld: service-kind=ANY-STANDARDIZED, invalidation-policy{data-element=SendCANR_CurFailStsFD03EVCU2FD3Vld, handle-invalid=DONT-INVALIDATE}  # Valid
      data SendCANR_CurFailStsFD03EVCU2FD3Vld: category=VALUE, sw-calibration-access=READ-ONLY, type=ADTSBoolean, init-value=SendCANR_CurFailStsFD03EVCU2FD3VldValue:1
    SendCANR_CurFailStsFD05EVCU2FD3: service-kind=ANY-STANDARDIZED, invalidation-policy{data-element=SendCANR_CurFailStsFD05EVCU2FD3, handle-invalid=DONT-INVALIDATE}
      data SendCANR_CurFailStsFD05EVCU2FD3: category=VALUE, sw-calibration-access=READ-ONLY, type=ADTSBoolean, init-value=SendCANR_CurFailStsFD05EVCU2FD3Value:0
    SendCANR_CurFailStsFD05EVCU2FD3Vld: service-kind=ANY-STANDARDIZED, invalidation-policy{data-element=SendCANR_CurFailStsFD05EVCU2FD3Vld, handle-invalid=DONT-INVALIDATE}  # Valid
      data SendCANR_CurFailStsFD05EVCU2FD3Vld: category=VALUE, sw-calibration-access=READ-ONLY, type=ADTSBoolean, init-value=SendCANR_CurFailStsFD05EVCU2FD3VldValue:1
    SendCANR_CurFailStsFD11EVCU2FD3: service-kind=ANY-STANDARDIZED, invalidation-policy{data-element=SendCANR_CurFailStsFD11EVCU2FD3, handle-invalid=DONT-INVALIDATE}
      data SendCANR_CurFailStsFD11EVCU2FD3: category=VALUE, sw-calibration-access=READ-ONLY, type=ADTSBoolean, init-value=SendCANR_CurFailStsFD11EVCU2FD3Value:0
    SendCANR_CurFailStsFD11EVCU2FD3Vld: service-kind=ANY-STANDARDIZED, invalidation-policy{data-element=SendCANR_CurFailStsFD11EVCU2FD3Vld, handle-invalid=DONT-INVALIDATE}  # Valid
      data SendCANR_CurFailStsFD11EVCU2FD3Vld: category=VALUE, sw-calibration-access=READ-ONLY, type=ADTSBoolean, init-value=SendCANR_CurFailStsFD11EVCU2FD3VldValue:1
    SendCANR_CurFailStsFD16EVCU2FD3: service-kind=ANY-STANDARDIZED, invalidation-policy{data-element=SendCANR_CurFailStsFD16EVCU2FD3, handle-invalid=DONT-INVALIDATE}
      data SendCANR_CurFailStsFD16EVCU2FD3: category=VALUE, sw-calibration-access=READ-ONLY, type=ADTSBoolean, init-value=SendCANR_CurFailStsFD16EVCU2FD3Value:0
    SendCANR_CurFailStsFD16EVCU2FD3Vld: service-kind=ANY-STANDARDIZED, invalidation-policy{data-element=SendCANR_CurFailStsFD16EVCU2FD3Vld, handle-invalid=DONT-INVALIDATE}  # Valid
      data SendCANR_CurFailStsFD16EVCU2FD3Vld: category=VALUE, sw-calibration-access=READ-ONLY, type=ADTSBoolean, init-value=SendCANR_CurFailStsFD16EVCU2FD3VldValue:1
    SendCANR_DES_FD03_EVCU2_FD11: service-kind=ANY-STANDARDIZED, invalidation-policy{data-element=SendCANR_DES_FD03_EVCU2_FD11, handle-invalid=DONT-INVALIDATE}
      data SendCANR_DES_FD03_EVCU2_FD11: category=VALUE, sw-calibration-access=READ-ONLY, type=ADTSDES_FD03_EVCU2_FD11, init-value=SendCANR_DES_FD03_EVCU2_FD11Value:0
    SendCANR_DES_FD03_EVCU2_FD11Vld: service-kind=ANY-STANDARDIZED, invalidation-policy{data-element=SendCANR_DES_FD03_EVCU2_FD11Vld, handle-invalid=DONT-INVALIDATE}  # Valid
      data SendCANR_DES_FD03_EVCU2_FD11Vld: category=VALUE, sw-calibration-access=READ-ONLY, type=ADTSBoolean, init-value=SendCANR_DES_FD03_EVCU2_FD11VldValue:1
    SendCANR_DES_FD03_EVCU2_FD3: service-kind=ANY-STANDARDIZED, invalidation-policy{data-element=SendCANR_DES_FD03_EVCU2_FD3, handle-invalid=DONT-INVALIDATE}
      data SendCANR_DES_FD03_EVCU2_FD3: category=VALUE, sw-calibration-access=READ-ONLY, type=ADTSDES_FD03_EVCU2_FD3, init-value=SendCANR_DES_FD03_EVCU2_FD3Value:0
    SendCANR_DES_FD03_EVCU2_FD3Vld: service-kind=ANY-STANDARDIZED, invalidation-policy{data-element=SendCANR_DES_FD03_EVCU2_FD3Vld, handle-invalid=DONT-INVALIDATE}  # Valid
      data SendCANR_DES_FD03_EVCU2_FD3Vld: category=VALUE, sw-calibration-access=READ-ONLY, type=ADTSBoolean, init-value=SendCANR_DES_FD03_EVCU2_FD3VldValue:1
    SendCANR_DES_FD05_EVCU2_FD11: service-kind=ANY-STANDARDIZED, invalidation-policy{data-element=SendCANR_DES_FD05_EVCU2_FD11, handle-invalid=DONT-INVALIDATE}
      data SendCANR_DES_FD05_EVCU2_FD11: category=VALUE, sw-calibration-access=READ-ONLY, type=ADTSDES_FD05_EVCU2_FD11, init-value=SendCANR_DES_FD05_EVCU2_FD11Value:0
    SendCANR_DES_FD05_EVCU2_FD11Vld: service-kind=ANY-STANDARDIZED, invalidation-policy{data-element=SendCANR_DES_FD05_EVCU2_FD11Vld, handle-invalid=DONT-INVALIDATE}  # Valid
      data SendCANR_DES_FD05_EVCU2_FD11Vld: category=VALUE, sw-calibration-access=READ-ONLY, type=ADTSBoolean, init-value=SendCANR_DES_FD05_EVCU2_FD11VldValue:1
    SendCANR_DES_FD05_EVCU2_FD3: service-kind=ANY-STANDARDIZED, invalidation-policy{data-element=SendCANR_DES_FD05_EVCU2_FD3, handle-invalid=DONT-INVALIDATE}
      data SendCANR_DES_FD05_EVCU2_FD3: category=VALUE, sw-calibration-access=READ-ONLY, type=ADTSDES_FD05_EVCU2_FD3, init-value=SendCANR_DES_FD05_EVCU2_FD3Value:0
    SendCANR_DES_FD05_EVCU2_FD3Vld: service-kind=ANY-STANDARDIZED, invalidation-policy{data-element=SendCANR_DES_FD05_EVCU2_FD3Vld, handle-invalid=DONT-INVALIDATE}  # Valid
      data SendCANR_DES_FD05_EVCU2_FD3Vld: category=VALUE, sw-calibration-access=READ-ONLY, type=ADTSBoolean, init-value=SendCANR_DES_FD05_EVCU2_FD3VldValue:1
    SendCANR_DES_FD11_EVCU2_FD11: service-kind=ANY-STANDARDIZED, invalidation-policy{data-element=SendCANR_DES_FD11_EVCU2_FD11, handle-invalid=DONT-INVALIDATE}
      data SendCANR_DES_FD11_EVCU2_FD11: category=VALUE, sw-calibration-access=READ-ONLY, type=ADTSDES_FD11_EVCU2_FD11, init-value=SendCANR_DES_FD11_EVCU2_FD11Value:0
    SendCANR_DES_FD11_EVCU2_FD11Vld: service-kind=ANY-STANDARDIZED, invalidation-policy{data-element=SendCANR_DES_FD11_EVCU2_FD11Vld, handle-invalid=DONT-INVALIDATE}  # Valid
      data SendCANR_DES_FD11_EVCU2_FD11Vld: category=VALUE, sw-calibration-access=READ-ONLY, type=ADTSBoolean, init-value=SendCANR_DES_FD11_EVCU2_FD11VldValue:1
    SendCANR_DES_FD11_EVCU2_FD3: service-kind=ANY-STANDARDIZED, invalidation-policy{data-element=SendCANR_DES_FD11_EVCU2_FD3, handle-invalid=DONT-INVALIDATE}
      data SendCANR_DES_FD11_EVCU2_FD3: category=VALUE, sw-calibration-access=READ-ONLY, type=ADTSDES_FD11_EVCU2_FD3, init-value=SendCANR_DES_FD11_EVCU2_FD3Value:0
    SendCANR_DES_FD11_EVCU2_FD3Vld: service-kind=ANY-STANDARDIZED, invalidation-policy{data-element=SendCANR_DES_FD11_EVCU2_FD3Vld, handle-invalid=DONT-INVALIDATE}  # Valid
      data SendCANR_DES_FD11_EVCU2_FD3Vld: category=VALUE, sw-calibration-access=READ-ONLY, type=ADTSBoolean, init-value=SendCANR_DES_FD11_EVCU2_FD3VldValue:1
    SendCANR_DES_FD16_EVCU2_FD11: service-kind=ANY-STANDARDIZED, invalidation-policy{data-element=SendCANR_DES_FD16_EVCU2_FD11, handle-invalid=DONT-INVALIDATE}
      data SendCANR_DES_FD16_EVCU2_FD11: category=VALUE, sw-calibration-access=READ-ONLY, type=ADTSDES_FD16_EVCU2_FD11, init-value=SendCANR_DES_FD16_EVCU2_FD11Value:0
    SendCANR_DES_FD16_EVCU2_FD11Vld: service-kind=ANY-STANDARDIZED, invalidation-policy{data-element=SendCANR_DES_FD16_EVCU2_FD11Vld, handle-invalid=DONT-INVALIDATE}  # Valid
      data SendCANR_DES_FD16_EVCU2_FD11Vld: category=VALUE, sw-calibration-access=READ-ONLY, type=ADTSBoolean, init-value=SendCANR_DES_FD16_EVCU2_FD11VldValue:1
    SendCANR_DES_FD16_EVCU2_FD3: service-kind=ANY-STANDARDIZED, invalidation-policy{data-element=SendCANR_DES_FD16_EVCU2_FD3, handle-invalid=DONT-INVALIDATE}
      data SendCANR_DES_FD16_EVCU2_FD3: category=VALUE, sw-calibration-access=READ-ONLY, type=ADTSDES_FD16_EVCU2_FD3, init-value=SendCANR_DES_FD16_EVCU2_FD3Value:0
    SendCANR_DES_FD16_EVCU2_FD3Vld: service-kind=ANY-STANDARDIZED, invalidation-policy{data-element=SendCANR_DES_FD16_EVCU2_FD3Vld, handle-invalid=DONT-INVALIDATE}  # Valid
      data SendCANR_DES_FD16_EVCU2_FD3Vld: category=VALUE, sw-calibration-access=READ-ONLY, type=ADTSBoolean, init-value=SendCANR_DES_FD16_EVCU2_FD3VldValue:1
    SendCANR_Digit_01_EVCU2: service-kind=ANY-STANDARDIZED, invalidation-policy{data-element=SendCANR_Digit_01_EVCU2, handle-invalid=DONT-INVALIDATE}
      data SendCANR_Digit_01_EVCU2: category=VALUE, sw-calibration-access=READ-ONLY, type=ADTSDigit_01_EVCU2, init-value=SendCANR_Digit_01_EVCU2Value:0
    SendCANR_Digit_01_EVCU2Vld: service-kind=ANY-STANDARDIZED, invalidation-policy{data-element=SendCANR_Digit_01_EVCU2Vld, handle-invalid=DONT-INVALIDATE}  # Valid
      data SendCANR_Digit_01_EVCU2Vld: category=VALUE, sw-calibration-access=READ-ONLY, type=ADTSBoolean, init-value=SendCANR_Digit_01_EVCU2VldValue:1
    SendCANR_Digit_02_EVCU2: service-kind=ANY-STANDARDIZED, invalidation-policy{data-element=SendCANR_Digit_02_EVCU2, handle-invalid=DONT-INVALIDATE}
      data SendCANR_Digit_02_EVCU2: category=VALUE, sw-calibration-access=READ-ONLY, type=ADTSDigit_02_EVCU2, init-value=SendCANR_Digit_02_EVCU2Value:0
    SendCANR_Digit_02_EVCU2Vld: service-kind=ANY-STANDARDIZED, invalidation-policy{data-element=SendCANR_Digit_02_EVCU2Vld, handle-invalid=DONT-INVALIDATE}  # Valid
      data SendCANR_Digit_02_EVCU2Vld: category=VALUE, sw-calibration-access=READ-ONLY, type=ADTSBoolean, init-value=SendCANR_Digit_02_EVCU2VldValue:1
    SendCANR_Digit_03_EVCU2: service-kind=ANY-STANDARDIZED, invalidation-policy{data-element=SendCANR_Digit_03_EVCU2, handle-invalid=DONT-INVALIDATE}
      data SendCANR_Digit_03_EVCU2: category=VALUE, sw-calibration-access=READ-ONLY, type=ADTSDigit_03_EVCU2, init-value=SendCANR_Digit_03_EVCU2Value:0
    SendCANR_Digit_03_EVCU2Vld: service-kind=ANY-STANDARDIZED, invalidation-policy{data-element=SendCANR_Digit_03_EVCU2Vld, handle-invalid=DONT-INVALIDATE}  # Valid
      data SendCANR_Digit_03_EVCU2Vld: category=VALUE, sw-calibration-access=READ-ONLY, type=ADTSBoolean, init-value=SendCANR_Digit_03_EVCU2VldValue:1
    SendCANR_Digit_04_EVCU2: service-kind=ANY-STANDARDIZED, invalidation-policy{data-element=SendCANR_Digit_04_EVCU2, handle-invalid=DONT-INVALIDATE}
      data SendCANR_Digit_04_EVCU2: category=VALUE, sw-calibration-access=READ-ONLY, type=ADTSDigit_04_EVCU2, init-value=SendCANR_Digit_04_EVCU2Value:0
    SendCANR_Digit_04_EVCU2Vld: service-kind=ANY-STANDARDIZED, invalidation-policy{data-element=SendCANR_Digit_04_EVCU2Vld, handle-invalid=DONT-INVALIDATE}  # Valid
      data SendCANR_Digit_04_EVCU2Vld: category=VALUE, sw-calibration-access=READ-ONLY, type=ADTSBoolean, init-value=SendCANR_Digit_04_EVCU2VldValue:1
    SendCANR_Digit_05_EVCU2: service-kind=ANY-STANDARDIZED, invalidation-policy{data-element=SendCANR_Digit_05_EVCU2, handle-invalid=DONT-INVALIDATE}
      data SendCANR_Digit_05_EVCU2: category=VALUE, sw-calibration-access=READ-ONLY, type=ADTSDigit_05_EVCU2, init-value=SendCANR_Digit_05_EVCU2Value:0
    SendCANR_Digit_05_EVCU2Vld: service-kind=ANY-STANDARDIZED, invalidation-policy{data-element=SendCANR_Digit_05_EVCU2Vld, handle-invalid=DONT-INVALIDATE}  # Valid
      data SendCANR_Digit_05_EVCU2Vld: category=VALUE, sw-calibration-access=READ-ONLY, type=ADTSBoolean, init-value=SendCANR_Digit_05_EVCU2VldValue:1
    SendCANR_Digit_06_EVCU2: service-kind=ANY-STANDARDIZED, invalidation-policy{data-element=SendCANR_Digit_06_EVCU2, handle-invalid=DONT-INVALIDATE}
      data SendCANR_Digit_06_EVCU2: category=VALUE, sw-calibration-access=READ-ONLY, type=ADTSDigit_06_EVCU2, init-value=SendCANR_Digit_06_EVCU2Value:0
    SendCANR_Digit_06_EVCU2Vld: service-kind=ANY-STANDARDIZED, invalidation-policy{data-element=SendCANR_Digit_06_EVCU2Vld, handle-invalid=DONT-INVALIDATE}  # Valid
      data SendCANR_Digit_06_EVCU2Vld: category=VALUE, sw-calibration-access=READ-ONLY, type=ADTSBoolean, init-value=SendCANR_Digit_06_EVCU2VldValue:1
    SendCANR_Digit_07_EVCU2: service-kind=ANY-STANDARDIZED, invalidation-policy{data-element=SendCANR_Digit_07_EVCU2, handle-invalid=DONT-INVALIDATE}
      data SendCANR_Digit_07_EVCU2: category=VALUE, sw-calibration-access=READ-ONLY, type=ADTSDigit_07_EVCU2, init-value=SendCANR_Digit_07_EVCU2Value:0
    SendCANR_Digit_07_EVCU2Vld: service-kind=ANY-STANDARDIZED, invalidation-policy{data-element=SendCANR_Digit_07_EVCU2Vld, handle-invalid=DONT-INVALIDATE}  # Valid
      data SendCANR_Digit_07_EVCU2Vld: category=VALUE, sw-calibration-access=READ-ONLY, type=ADTSBoolean, init-value=SendCANR_Digit_07_EVCU2VldValue:1
    SendCANR_Digit_08_EVCU2: service-kind=ANY-STANDARDIZED, invalidation-policy{data-element=SendCANR_Digit_08_EVCU2, handle-invalid=DONT-INVALIDATE}
      data SendCANR_Digit_08_EVCU2: category=VALUE, sw-calibration-access=READ-ONLY, type=ADTSDigit_08_EVCU2, init-value=SendCANR_Digit_08_EVCU2Value:0
    SendCANR_Digit_08_EVCU2Vld: service-kind=ANY-STANDARDIZED, invalidation-policy{data-element=SendCANR_Digit_08_EVCU2Vld, handle-invalid=DONT-INVALIDATE}  # Valid
      data SendCANR_Digit_08_EVCU2Vld: category=VALUE, sw-calibration-access=READ-ONLY, type=ADTSBoolean, init-value=SendCANR_Digit_08_EVCU2VldValue:1
    SendCANR_Digit_09_EVCU2: service-kind=ANY-STANDARDIZED, invalidation-policy{data-element=SendCANR_Digit_09_EVCU2, handle-invalid=DONT-INVALIDATE}
      data SendCANR_Digit_09_EVCU2: category=VALUE, sw-calibration-access=READ-ONLY, type=ADTSDigit_09_EVCU2, init-value=SendCANR_Digit_09_EVCU2Value:0
    SendCANR_Digit_09_EVCU2Vld: service-kind=ANY-STANDARDIZED, invalidation-policy{data-element=SendCANR_Digit_09_EVCU2Vld, handle-invalid=DONT-INVALIDATE}  # Valid
      data SendCANR_Digit_09_EVCU2Vld: category=VALUE, sw-calibration-access=READ-ONLY, type=ADTSBoolean, init-value=SendCANR_Digit_09_EVCU2VldValue:1
    SendCANR_Digit_10_EVCU2: service-kind=ANY-STANDARDIZED, invalidation-policy{data-element=SendCANR_Digit_10_EVCU2, handle-invalid=DONT-INVALIDATE}
      data SendCANR_Digit_10_EVCU2: category=VALUE, sw-calibration-access=READ-ONLY, type=ADTSDigit_10_EVCU2, init-value=SendCANR_Digit_10_EVCU2Value:0
    SendCANR_Digit_10_EVCU2Vld: service-kind=ANY-STANDARDIZED, invalidation-policy{data-element=SendCANR_Digit_10_EVCU2Vld, handle-invalid=DONT-INVALIDATE}  # Valid
      data SendCANR_Digit_10_EVCU2Vld: category=VALUE, sw-calibration-access=READ-ONLY, type=ADTSBoolean, init-value=SendCANR_Digit_10_EVCU2VldValue:1
    SendCANR_Digit_11_EVCU2: service-kind=ANY-STANDARDIZED, invalidation-policy{data-element=SendCANR_Digit_11_EVCU2, handle-invalid=DONT-INVALIDATE}
      data SendCANR_Digit_11_EVCU2: category=VALUE, sw-calibration-access=READ-ONLY, type=ADTSDigit_11_EVCU2, init-value=SendCANR_Digit_11_EVCU2Value:0
    SendCANR_Digit_11_EVCU2Vld: service-kind=ANY-STANDARDIZED, invalidation-policy{data-element=SendCANR_Digit_11_EVCU2Vld, handle-invalid=DONT-INVALIDATE}  # Valid
      data SendCANR_Digit_11_EVCU2Vld: category=VALUE, sw-calibration-access=READ-ONLY, type=ADTSBoolean, init-value=SendCANR_Digit_11_EVCU2VldValue:1
    SendCANR_DischrgingSysStatusFD3: service-kind=ANY-STANDARDIZED, invalidation-policy{data-element=SendCANR_DischrgingSysStatusFD3, handle-invalid=KEEP}
      data SendCANR_DischrgingSysStatusFD3: category=VALUE, sw-calibration-access=READ-ONLY, type=ADTSDischrgingSysStatusFD3, init-value=SendCANR_DischrgingSysStatusFD3Value:0
    SendCANR_DischrgingSysStatusFD3Vld: service-kind=ANY-STANDARDIZED, invalidation-policy{data-element=SendCANR_DischrgingSysStatusFD3Vld, handle-invalid=DONT-INVALIDATE}  # Valid
      data SendCANR_DischrgingSysStatusFD3Vld: category=VALUE, sw-calibration-access=READ-ONLY, type=ADTSBoolean, init-value=SendCANR_DischrgingSysStatusFD3VldValue:1
    SendCANR_DischrgngSysStatusFD11: service-kind=ANY-STANDARDIZED, invalidation-policy{data-element=SendCANR_DischrgngSysStatusFD11, handle-invalid=KEEP}
      data SendCANR_DischrgngSysStatusFD11: category=VALUE, sw-calibration-access=READ-ONLY, type=ADTSDischrgngSysStatusFD11, init-value=SendCANR_DischrgngSysStatusFD11Value:0
    SendCANR_DischrgngSysStatusFD11Vld: service-kind=ANY-STANDARDIZED, invalidation-policy{data-element=SendCANR_DischrgngSysStatusFD11Vld, handle-invalid=DONT-INVALIDATE}  # Valid
      data SendCANR_DischrgngSysStatusFD11Vld: category=VALUE, sw-calibration-access=READ-ONLY, type=ADTSBoolean, init-value=SendCANR_DischrgngSysStatusFD11VldValue:1
    SendCANR_DisplaySOC: service-kind=ANY-STANDARDIZED, invalidation-policy{data-element=SendCANR_DisplaySOC, handle-invalid=DONT-INVALIDATE}
      data SendCANR_DisplaySOC: category=VALUE, sw-calibration-access=READ-ONLY, type=ADTSDisplaySOC, init-value=SendCANR_DisplaySOCValue:0
    SendCANR_DisplaySOC_Vld: service-kind=ANY-STANDARDIZED, invalidation-policy{data-element=SendCANR_DisplaySOC_Vld, handle-invalid=DONT-INVALIDATE}  # Valid
      data SendCANR_DisplaySOC_Vld: category=VALUE, sw-calibration-access=READ-ONLY, type=ADTSBoolean, init-value=SendCANR_DisplaySOC_VldValue:1
    SendCANR_DriveReady_PT_FD11: service-kind=ANY-STANDARDIZED, invalidation-policy{data-element=SendCANR_DriveReady_PT_FD11, handle-invalid=DONT-INVALIDATE}
      data SendCANR_DriveReady_PT_FD11: category=VALUE, sw-calibration-access=READ-ONLY, type=ADTSBoolean, init-value=SendCANR_DriveReady_PT_FD11Value:0
    SendCANR_DriveReady_PT_FD11Vld: service-kind=ANY-STANDARDIZED, invalidation-policy{data-element=SendCANR_DriveReady_PT_FD11Vld, handle-invalid=DONT-INVALIDATE}  # Valid
      data SendCANR_DriveReady_PT_FD11Vld: category=VALUE, sw-calibration-access=READ-ONLY, type=ADTSBoolean, init-value=SendCANR_DriveReady_PT_FD11VldValue:1
    SendCANR_EOL_FD03_EVCU2_FD11: service-kind=ANY-STANDARDIZED, invalidation-policy{data-element=SendCANR_EOL_FD03_EVCU2_FD11, handle-invalid=DONT-INVALIDATE}
      data SendCANR_EOL_FD03_EVCU2_FD11: category=VALUE, sw-calibration-access=READ-ONLY, type=ADTSBoolean, init-value=SendCANR_EOL_FD03_EVCU2_FD11Value:0
    SendCANR_EOL_FD03_EVCU2_FD11Vld: service-kind=ANY-STANDARDIZED, invalidation-policy{data-element=SendCANR_EOL_FD03_EVCU2_FD11Vld, handle-invalid=DONT-INVALIDATE}  # Valid
      data SendCANR_EOL_FD03_EVCU2_FD11Vld: category=VALUE, sw-calibration-access=READ-ONLY, type=ADTSBoolean, init-value=SendCANR_EOL_FD03_EVCU2_FD11VldValue:1
    SendCANR_EOL_FD03_EVCU2_FD3: service-kind=ANY-STANDARDIZED, invalidation-policy{data-element=SendCANR_EOL_FD03_EVCU2_FD3, handle-invalid=DONT-INVALIDATE}
      data SendCANR_EOL_FD03_EVCU2_FD3: category=VALUE, sw-calibration-access=READ-ONLY, type=ADTSBoolean, init-value=SendCANR_EOL_FD03_EVCU2_FD3Value:0
    SendCANR_EOL_FD03_EVCU2_FD3Vld: service-kind=ANY-STANDARDIZED, invalidation-policy{data-element=SendCANR_EOL_FD03_EVCU2_FD3Vld, handle-invalid=DONT-INVALIDATE}  # Valid
      data SendCANR_EOL_FD03_EVCU2_FD3Vld: category=VALUE, sw-calibration-access=READ-ONLY, type=ADTSBoolean, init-value=SendCANR_EOL_FD03_EVCU2_FD3VldValue:1
    SendCANR_EOL_FD05_EVCU2_FD11: service-kind=ANY-STANDARDIZED, invalidation-policy{data-element=SendCANR_EOL_FD05_EVCU2_FD11, handle-invalid=DONT-INVALIDATE}
      data SendCANR_EOL_FD05_EVCU2_FD11: category=VALUE, sw-calibration-access=READ-ONLY, type=ADTSBoolean, init-value=SendCANR_EOL_FD05_EVCU2_FD11Value:0
    SendCANR_EOL_FD05_EVCU2_FD11Vld: service-kind=ANY-STANDARDIZED, invalidation-policy{data-element=SendCANR_EOL_FD05_EVCU2_FD11Vld, handle-invalid=DONT-INVALIDATE}  # Valid
      data SendCANR_EOL_FD05_EVCU2_FD11Vld: category=VALUE, sw-calibration-access=READ-ONLY, type=ADTSBoolean, init-value=SendCANR_EOL_FD05_EVCU2_FD11VldValue:1
    SendCANR_EOL_FD05_EVCU2_FD3: service-kind=ANY-STANDARDIZED, invalidation-policy{data-element=SendCANR_EOL_FD05_EVCU2_FD3, handle-invalid=DONT-INVALIDATE}
      data SendCANR_EOL_FD05_EVCU2_FD3: category=VALUE, sw-calibration-access=READ-ONLY, type=ADTSBoolean, init-value=SendCANR_EOL_FD05_EVCU2_FD3Value:0
    SendCANR_EOL_FD05_EVCU2_FD3Vld: service-kind=ANY-STANDARDIZED, invalidation-policy{data-element=SendCANR_EOL_FD05_EVCU2_FD3Vld, handle-invalid=DONT-INVALIDATE}  # Valid
      data SendCANR_EOL_FD05_EVCU2_FD3Vld: category=VALUE, sw-calibration-access=READ-ONLY, type=ADTSBoolean, init-value=SendCANR_EOL_FD05_EVCU2_FD3VldValue:1
    SendCANR_EOL_FD11_EVCU2_FD11: service-kind=ANY-STANDARDIZED, invalidation-policy{data-element=SendCANR_EOL_FD11_EVCU2_FD11, handle-invalid=DONT-INVALIDATE}
      data SendCANR_EOL_FD11_EVCU2_FD11: category=VALUE, sw-calibration-access=READ-ONLY, type=ADTSBoolean, init-value=SendCANR_EOL_FD11_EVCU2_FD11Value:0
    SendCANR_EOL_FD11_EVCU2_FD11Vld: service-kind=ANY-STANDARDIZED, invalidation-policy{data-element=SendCANR_EOL_FD11_EVCU2_FD11Vld, handle-invalid=DONT-INVALIDATE}  # Valid
      data SendCANR_EOL_FD11_EVCU2_FD11Vld: category=VALUE, sw-calibration-access=READ-ONLY, type=ADTSBoolean, init-value=SendCANR_EOL_FD11_EVCU2_FD11VldValue:1
    SendCANR_EOL_FD11_EVCU2_FD3: service-kind=ANY-STANDARDIZED, invalidation-policy{data-element=SendCANR_EOL_FD11_EVCU2_FD3, handle-invalid=DONT-INVALIDATE}
      data SendCANR_EOL_FD11_EVCU2_FD3: category=VALUE, sw-calibration-access=READ-ONLY, type=ADTSBoolean, init-value=SendCANR_EOL_FD11_EVCU2_FD3Value:0
    SendCANR_EOL_FD11_EVCU2_FD3Vld: service-kind=ANY-STANDARDIZED, invalidation-policy{data-element=SendCANR_EOL_FD11_EVCU2_FD3Vld, handle-invalid=DONT-INVALIDATE}  # Valid
      data SendCANR_EOL_FD11_EVCU2_FD3Vld: category=VALUE, sw-calibration-access=READ-ONLY, type=ADTSBoolean, init-value=SendCANR_EOL_FD11_EVCU2_FD3VldValue:1
    SendCANR_EOL_FD16_EVCU2_FD11: service-kind=ANY-STANDARDIZED, invalidation-policy{data-element=SendCANR_EOL_FD16_EVCU2_FD11, handle-invalid=DONT-INVALIDATE}
      data SendCANR_EOL_FD16_EVCU2_FD11: category=VALUE, sw-calibration-access=READ-ONLY, type=ADTSBoolean, init-value=SendCANR_EOL_FD16_EVCU2_FD11Value:0
    SendCANR_EOL_FD16_EVCU2_FD11Vld: service-kind=ANY-STANDARDIZED, invalidation-policy{data-element=SendCANR_EOL_FD16_EVCU2_FD11Vld, handle-invalid=DONT-INVALIDATE}  # Valid
      data SendCANR_EOL_FD16_EVCU2_FD11Vld: category=VALUE, sw-calibration-access=READ-ONLY, type=ADTSBoolean, init-value=SendCANR_EOL_FD16_EVCU2_FD11VldValue:1
    SendCANR_EOL_FD16_EVCU2_FD3: service-kind=ANY-STANDARDIZED, invalidation-policy{data-element=SendCANR_EOL_FD16_EVCU2_FD3, handle-invalid=DONT-INVALIDATE}
      data SendCANR_EOL_FD16_EVCU2_FD3: category=VALUE, sw-calibration-access=READ-ONLY, type=ADTSBoolean, init-value=SendCANR_EOL_FD16_EVCU2_FD3Value:0
    SendCANR_EOL_FD16_EVCU2_FD3Vld: service-kind=ANY-STANDARDIZED, invalidation-policy{data-element=SendCANR_EOL_FD16_EVCU2_FD3Vld, handle-invalid=DONT-INVALIDATE}  # Valid
      data SendCANR_EOL_FD16_EVCU2_FD3Vld: category=VALUE, sw-calibration-access=READ-ONLY, type=ADTSBoolean, init-value=SendCANR_EOL_FD16_EVCU2_FD3VldValue:1
    SendCANR_EOPA_OIL_FlwRate_FD16: service-kind=ANY-STANDARDIZED, invalidation-policy{data-element=SendCANR_EOPA_OIL_FlwRate_FD16, handle-invalid=KEEP}
      data SendCANR_EOPA_OIL_FlwRate_FD16: category=VALUE, sw-calibration-access=READ-ONLY, type=ADTSEOPA_OIL_FlwRate_FD16, init-value=SendCANR_EOPA_OIL_FlwRate_FD16Value:0
    SendCANR_EOPA_OIL_FlwRate_FD16Vld: service-kind=ANY-STANDARDIZED, invalidation-policy{data-element=SendCANR_EOPA_OIL_FlwRate_FD16Vld, handle-invalid=DONT-INVALIDATE}  # Valid
      data SendCANR_EOPA_OIL_FlwRate_FD16Vld: category=VALUE, sw-calibration-access=READ-ONLY, type=ADTSBoolean, init-value=SendCANR_EOPA_OIL_FlwRate_FD16VldValue:1
    SendCANR_EOPA_OIL_FlwRate_FD5: service-kind=ANY-STANDARDIZED, invalidation-policy{data-element=SendCANR_EOPA_OIL_FlwRate_FD5, handle-invalid=KEEP}
      data SendCANR_EOPA_OIL_FlwRate_FD5: category=VALUE, sw-calibration-access=READ-ONLY, type=ADTSEOPA_OIL_FlwRate_FD5, init-value=SendCANR_EOPA_OIL_FlwRate_FD5Value:0
    SendCANR_EOPA_OIL_FlwRate_FD5Vld: service-kind=ANY-STANDARDIZED, invalidation-policy{data-element=SendCANR_EOPA_OIL_FlwRate_FD5Vld, handle-invalid=DONT-INVALIDATE}  # Valid
      data SendCANR_EOPA_OIL_FlwRate_FD5Vld: category=VALUE, sw-calibration-access=READ-ONLY, type=ADTSBoolean, init-value=SendCANR_EOPA_OIL_FlwRate_FD5VldValue:1
    SendCANR_EOPA_OIL_TEMP_FD16: service-kind=ANY-STANDARDIZED, invalidation-policy{data-element=SendCANR_EOPA_OIL_TEMP_FD16, handle-invalid=KEEP}
      data SendCANR_EOPA_OIL_TEMP_FD16: category=VALUE, sw-calibration-access=READ-ONLY, type=ADTSEOPA_OIL_TEMP_FD16, init-value=SendCANR_EOPA_OIL_TEMP_FD16Value:-50
    SendCANR_EOPA_OIL_TEMP_FD16Vld: service-kind=ANY-STANDARDIZED, invalidation-policy{data-element=SendCANR_EOPA_OIL_TEMP_FD16Vld, handle-invalid=DONT-INVALIDATE}  # Valid
      data SendCANR_EOPA_OIL_TEMP_FD16Vld: category=VALUE, sw-calibration-access=READ-ONLY, type=ADTSBoolean, init-value=SendCANR_EOPA_OIL_TEMP_FD16VldValue:1
    SendCANR_EOPA_OIL_TEMP_FD5: service-kind=ANY-STANDARDIZED, invalidation-policy{data-element=SendCANR_EOPA_OIL_TEMP_FD5, handle-invalid=KEEP}
      data SendCANR_EOPA_OIL_TEMP_FD5: category=VALUE, sw-calibration-access=READ-ONLY, type=ADTSEOPA_OIL_TEMP_FD5, init-value=SendCANR_EOPA_OIL_TEMP_FD5Value:-50
    SendCANR_EOPA_OIL_TEMP_FD5Vld: service-kind=ANY-STANDARDIZED, invalidation-policy{data-element=SendCANR_EOPA_OIL_TEMP_FD5Vld, handle-invalid=DONT-INVALIDATE}  # Valid
      data SendCANR_EOPA_OIL_TEMP_FD5Vld: category=VALUE, sw-calibration-access=READ-ONLY, type=ADTSBoolean, init-value=SendCANR_EOPA_OIL_TEMP_FD5VldValue:1
    SendCANR_EOPB_OIL_FlwRate_FD16: service-kind=ANY-STANDARDIZED, invalidation-policy{data-element=SendCANR_EOPB_OIL_FlwRate_FD16, handle-invalid=KEEP}
      data SendCANR_EOPB_OIL_FlwRate_FD16: category=VALUE, sw-calibration-access=READ-ONLY, type=ADTSEOPB_OIL_FlwRate_FD16, init-value=SendCANR_EOPB_OIL_FlwRate_FD16Value:0
    SendCANR_EOPB_OIL_FlwRate_FD16Vld: service-kind=ANY-STANDARDIZED, invalidation-policy{data-element=SendCANR_EOPB_OIL_FlwRate_FD16Vld, handle-invalid=DONT-INVALIDATE}  # Valid
      data SendCANR_EOPB_OIL_FlwRate_FD16Vld: category=VALUE, sw-calibration-access=READ-ONLY, type=ADTSBoolean, init-value=SendCANR_EOPB_OIL_FlwRate_FD16VldValue:1
    SendCANR_EOPB_OIL_FlwRate_FD5: service-kind=ANY-STANDARDIZED, invalidation-policy{data-element=SendCANR_EOPB_OIL_FlwRate_FD5, handle-invalid=KEEP}
      data SendCANR_EOPB_OIL_FlwRate_FD5: category=VALUE, sw-calibration-access=READ-ONLY, type=ADTSEOPB_OIL_FlwRate_FD5, init-value=SendCANR_EOPB_OIL_FlwRate_FD5Value:0
    SendCANR_EOPB_OIL_FlwRate_FD5Vld: service-kind=ANY-STANDARDIZED, invalidation-policy{data-element=SendCANR_EOPB_OIL_FlwRate_FD5Vld, handle-invalid=DONT-INVALIDATE}  # Valid
      data SendCANR_EOPB_OIL_FlwRate_FD5Vld: category=VALUE, sw-calibration-access=READ-ONLY, type=ADTSBoolean, init-value=SendCANR_EOPB_OIL_FlwRate_FD5VldValue:1
    SendCANR_EOPB_OIL_TEMP_FD16: service-kind=ANY-STANDARDIZED, invalidation-policy{data-element=SendCANR_EOPB_OIL_TEMP_FD16, handle-invalid=KEEP}
      data SendCANR_EOPB_OIL_TEMP_FD16: category=VALUE, sw-calibration-access=READ-ONLY, type=ADTSEOPB_OIL_TEMP_FD16, init-value=SendCANR_EOPB_OIL_TEMP_FD16Value:-50
    SendCANR_EOPB_OIL_TEMP_FD16Vld: service-kind=ANY-STANDARDIZED, invalidation-policy{data-element=SendCANR_EOPB_OIL_TEMP_FD16Vld, handle-invalid=DONT-INVALIDATE}  # Valid
      data SendCANR_EOPB_OIL_TEMP_FD16Vld: category=VALUE, sw-calibration-access=READ-ONLY, type=ADTSBoolean, init-value=SendCANR_EOPB_OIL_TEMP_FD16VldValue:1
    SendCANR_EOPB_OIL_TEMP_FD5: service-kind=ANY-STANDARDIZED, invalidation-policy{data-element=SendCANR_EOPB_OIL_TEMP_FD5, handle-invalid=KEEP}
      data SendCANR_EOPB_OIL_TEMP_FD5: category=VALUE, sw-calibration-access=READ-ONLY, type=ADTSEOPB_OIL_TEMP_FD5, init-value=SendCANR_EOPB_OIL_TEMP_FD5Value:-50
    SendCANR_EOPB_OIL_TEMP_FD5Vld: service-kind=ANY-STANDARDIZED, invalidation-policy{data-element=SendCANR_EOPB_OIL_TEMP_FD5Vld, handle-invalid=DONT-INVALIDATE}  # Valid
      data SendCANR_EOPB_OIL_TEMP_FD5Vld: category=VALUE, sw-calibration-access=READ-ONLY, type=ADTSBoolean, init-value=SendCANR_EOPB_OIL_TEMP_FD5VldValue:1
    SendCANR_EPBSts_FD11: service-kind=ANY-STANDARDIZED, invalidation-policy{data-element=SendCANR_EPBSts_FD11, handle-invalid=KEEP}
      data SendCANR_EPBSts_FD11: category=VALUE, sw-calibration-access=READ-ONLY, type=ADTSEPBSts_FD11, init-value=SendCANR_EPBSts_FD11Value:0
    SendCANR_EPBSts_FD11Vld: service-kind=ANY-STANDARDIZED, invalidation-policy{data-element=SendCANR_EPBSts_FD11Vld, handle-invalid=DONT-INVALIDATE}  # Valid
      data SendCANR_EPBSts_FD11Vld: category=VALUE, sw-calibration-access=READ-ONLY, type=ADTSBoolean, init-value=SendCANR_EPBSts_FD11VldValue:1
    SendCANR_EPBSts_FD16: service-kind=ANY-STANDARDIZED, invalidation-policy{data-element=SendCANR_EPBSts_FD16, handle-invalid=KEEP}
      data SendCANR_EPBSts_FD16: category=VALUE, sw-calibration-access=READ-ONLY, type=ADTSEPBSts_FD16, init-value=SendCANR_EPBSts_FD16Value:0
    SendCANR_EPBSts_FD16Vld: service-kind=ANY-STANDARDIZED, invalidation-policy{data-element=SendCANR_EPBSts_FD16Vld, handle-invalid=DONT-INVALIDATE}  # Valid
      data SendCANR_EPBSts_FD16Vld: category=VALUE, sw-calibration-access=READ-ONLY, type=ADTSBoolean, init-value=SendCANR_EPBSts_FD16VldValue:1
    SendCANR_EPBSts_FD5: service-kind=ANY-STANDARDIZED, invalidation-policy{data-element=SendCANR_EPBSts_FD5, handle-invalid=KEEP}
      data SendCANR_EPBSts_FD5: category=VALUE, sw-calibration-access=READ-ONLY, type=ADTSEPBSts_FD5, init-value=SendCANR_EPBSts_FD5Value:0
    SendCANR_EPBSts_FD5Vld: service-kind=ANY-STANDARDIZED, invalidation-policy{data-element=SendCANR_EPBSts_FD5Vld, handle-invalid=DONT-INVALIDATE}  # Valid
      data SendCANR_EPBSts_FD5Vld: category=VALUE, sw-calibration-access=READ-ONLY, type=ADTSBoolean, init-value=SendCANR_EPBSts_FD5VldValue:1
    SendCANR_ESCFailSts: service-kind=ANY-STANDARDIZED, invalidation-policy{data-element=SendCANR_ESCFailSts, handle-invalid=DONT-INVALIDATE}
      data SendCANR_ESCFailSts: category=VALUE, sw-calibration-access=READ-ONLY, type=ADTSBoolean, init-value=SendCANR_ESCFailStsValue:0
    SendCANR_ESCFailStsVld: service-kind=ANY-STANDARDIZED, invalidation-policy{data-element=SendCANR_ESCFailStsVld, handle-invalid=DONT-INVALIDATE}  # Valid
      data SendCANR_ESCFailStsVld: category=VALUE, sw-calibration-access=READ-ONLY, type=ADTSBoolean, init-value=SendCANR_ESCFailStsVldValue:1
    SendCANR_ESCFailSts_FD5: service-kind=ANY-STANDARDIZED, invalidation-policy{data-element=SendCANR_ESCFailSts_FD5, handle-invalid=DONT-INVALIDATE}
      data SendCANR_ESCFailSts_FD5: category=VALUE, sw-calibration-access=READ-ONLY, type=ADTSBoolean, init-value=SendCANR_ESCFailSts_FD5Value:0
    SendCANR_ESCFailSts_FD5Vld: service-kind=ANY-STANDARDIZED, invalidation-policy{data-element=SendCANR_ESCFailSts_FD5Vld, handle-invalid=DONT-INVALIDATE}  # Valid
      data SendCANR_ESCFailSts_FD5Vld: category=VALUE, sw-calibration-access=READ-ONLY, type=ADTSBoolean, init-value=SendCANR_ESCFailSts_FD5VldValue:1
    SendCANR_EVCU_CP3Cmd: service-kind=ANY-STANDARDIZED, invalidation-policy{data-element=SendCANR_EVCU_CP3Cmd, handle-invalid=DONT-INVALIDATE}
      data SendCANR_EVCU_CP3Cmd: category=VALUE, sw-calibration-access=READ-ONLY, type=ADTSBoolean, init-value=SendCANR_EVCU_CP3CmdValue:0
    SendCANR_EVCU_CP3CmdVld: service-kind=ANY-STANDARDIZED, invalidation-policy{data-element=SendCANR_EVCU_CP3CmdVld, handle-invalid=DONT-INVALIDATE}  # Valid
      data SendCANR_EVCU_CP3CmdVld: category=VALUE, sw-calibration-access=READ-ONLY, type=ADTSBoolean, init-value=SendCANR_EVCU_CP3CmdVldValue:1
    SendCANR_EVContactorSts: service-kind=ANY-STANDARDIZED, invalidation-policy{data-element=SendCANR_EVContactorSts, handle-invalid=DONT-INVALIDATE}
      data SendCANR_EVContactorSts: category=VALUE, sw-calibration-access=READ-ONLY, type=ADTSBoolean, init-value=SendCANR_EVContactorStsValue:0
    SendCANR_EVContactorStsVld: service-kind=ANY-STANDARDIZED, invalidation-policy{data-element=SendCANR_EVContactorStsVld, handle-invalid=DONT-INVALIDATE}  # Valid
      data SendCANR_EVContactorStsVld: category=VALUE, sw-calibration-access=READ-ONLY, type=ADTSBoolean, init-value=SendCANR_EVContactorStsVldValue:1
    SendCANR_EVMaxCurrent_FD5: service-kind=ANY-STANDARDIZED, invalidation-policy{data-element=SendCANR_EVMaxCurrent_FD5, handle-invalid=KEEP}
      data SendCANR_EVMaxCurrent_FD5: category=VALUE, sw-calibration-access=READ-ONLY, type=ADTSEVMaxCurrent_FD5, init-value=SendCANR_EVMaxCurrent_FD5Value:0
    SendCANR_EVMaxCurrent_FD5Vld: service-kind=ANY-STANDARDIZED, invalidation-policy{data-element=SendCANR_EVMaxCurrent_FD5Vld, handle-invalid=DONT-INVALIDATE}  # Valid
      data SendCANR_EVMaxCurrent_FD5Vld: category=VALUE, sw-calibration-access=READ-ONLY, type=ADTSBoolean, init-value=SendCANR_EVMaxCurrent_FD5VldValue:1
    SendCANR_EVMaxVoltage_FD5: service-kind=ANY-STANDARDIZED, invalidation-policy{data-element=SendCANR_EVMaxVoltage_FD5, handle-invalid=KEEP}
      data SendCANR_EVMaxVoltage_FD5: category=VALUE, sw-calibration-access=READ-ONLY, type=ADTSEVMaxVoltage_FD5, init-value=SendCANR_EVMaxVoltage_FD5Value:0
    SendCANR_EVMaxVoltage_FD5Vld: service-kind=ANY-STANDARDIZED, invalidation-policy{data-element=SendCANR_EVMaxVoltage_FD5Vld, handle-invalid=DONT-INVALIDATE}  # Valid
      data SendCANR_EVMaxVoltage_FD5Vld: category=VALUE, sw-calibration-access=READ-ONLY, type=ADTSBoolean, init-value=SendCANR_EVMaxVoltage_FD5VldValue:1
    SendCANR_EVMinCurrent_FD5: service-kind=ANY-STANDARDIZED, invalidation-policy{data-element=SendCANR_EVMinCurrent_FD5, handle-invalid=KEEP}
      data SendCANR_EVMinCurrent_FD5: category=VALUE, sw-calibration-access=READ-ONLY, type=ADTSEVMinCurrent_FD5, init-value=SendCANR_EVMinCurrent_FD5Value:0
    SendCANR_EVMinCurrent_FD5Vld: service-kind=ANY-STANDARDIZED, invalidation-policy{data-element=SendCANR_EVMinCurrent_FD5Vld, handle-invalid=DONT-INVALIDATE}  # Valid
      data SendCANR_EVMinCurrent_FD5Vld: category=VALUE, sw-calibration-access=READ-ONLY, type=ADTSBoolean, init-value=SendCANR_EVMinCurrent_FD5VldValue:1
    SendCANR_EVSE_Power: service-kind=ANY-STANDARDIZED, invalidation-policy{data-element=SendCANR_EVSE_Power, handle-invalid=KEEP}
      data SendCANR_EVSE_Power: category=VALUE, sw-calibration-access=READ-ONLY, type=ADTSEVSE_Power, init-value=SendCANR_EVSE_PowerValue:0
    SendCANR_EVSE_PowerVld: service-kind=ANY-STANDARDIZED, invalidation-policy{data-element=SendCANR_EVSE_PowerVld, handle-invalid=DONT-INVALIDATE}  # Valid
      data SendCANR_EVSE_PowerVld: category=VALUE, sw-calibration-access=READ-ONLY, type=ADTSBoolean, init-value=SendCANR_EVSE_PowerVldValue:1
    SendCANR_EV_Charge_Current: service-kind=ANY-STANDARDIZED, invalidation-policy{data-element=SendCANR_EV_Charge_Current, handle-invalid=KEEP}
      data SendCANR_EV_Charge_Current: category=VALUE, sw-calibration-access=READ-ONLY, type=ADTSEV_Charge_Current, init-value=SendCANR_EV_Charge_CurrentValue:0
    SendCANR_EV_Charge_CurrentVld: service-kind=ANY-STANDARDIZED, invalidation-policy{data-element=SendCANR_EV_Charge_CurrentVld, handle-invalid=DONT-INVALIDATE}  # Valid
      data SendCANR_EV_Charge_CurrentVld: category=VALUE, sw-calibration-access=READ-ONLY, type=ADTSBoolean, init-value=SendCANR_EV_Charge_CurrentVldValue:1
    SendCANR_Eamount_FD5: service-kind=ANY-STANDARDIZED, invalidation-policy{data-element=SendCANR_Eamount_FD5, handle-invalid=KEEP}
      data SendCANR_Eamount_FD5: category=VALUE, sw-calibration-access=READ-ONLY, type=ADTSEamount_FD5, init-value=SendCANR_Eamount_FD5Value:0
    SendCANR_Eamount_FD5Vld: service-kind=ANY-STANDARDIZED, invalidation-policy{data-element=SendCANR_Eamount_FD5Vld, handle-invalid=DONT-INVALIDATE}  # Valid
      data SendCANR_Eamount_FD5Vld: category=VALUE, sw-calibration-access=READ-ONLY, type=ADTSBoolean, init-value=SendCANR_Eamount_FD5VldValue:1
    SendCANR_ElecClntHtrInletTemp: service-kind=ANY-STANDARDIZED, invalidation-policy{data-element=SendCANR_ElecClntHtrInletTemp, handle-invalid=KEEP}
      data SendCANR_ElecClntHtrInletTemp: category=VALUE, sw-calibration-access=READ-ONLY, type=ADTSElecClntHtrInletTemp, init-value=SendCANR_ElecClntHtrInletTempValue:-40
    SendCANR_ElecClntHtrInletTempVld: service-kind=ANY-STANDARDIZED, invalidation-policy{data-element=SendCANR_ElecClntHtrInletTempVld, handle-invalid=DONT-INVALIDATE}  # Valid
      data SendCANR_ElecClntHtrInletTempVld: category=VALUE, sw-calibration-access=READ-ONLY, type=ADTSBoolean, init-value=SendCANR_ElecClntHtrInletTempVldValue:1
    SendCANR_ElecCoolantHtrPwr: service-kind=ANY-STANDARDIZED, invalidation-policy{data-element=SendCANR_ElecCoolantHtrPwr, handle-invalid=KEEP}
      data SendCANR_ElecCoolantHtrPwr: category=VALUE, sw-calibration-access=READ-ONLY, type=ADTSElecCoolantHtrPwr, init-value=SendCANR_ElecCoolantHtrPwrValue:0
    SendCANR_ElecCoolantHtrPwrVld: service-kind=ANY-STANDARDIZED, invalidation-policy{data-element=SendCANR_ElecCoolantHtrPwrVld, handle-invalid=DONT-INVALIDATE}  # Valid
      data SendCANR_ElecCoolantHtrPwrVld: category=VALUE, sw-calibration-access=READ-ONLY, type=ADTSBoolean, init-value=SendCANR_ElecCoolantHtrPwrVldValue:1
    SendCANR_Enabl_ClimateSchd2_Sts: service-kind=ANY-STANDARDIZED, invalidation-policy{data-element=SendCANR_Enabl_ClimateSchd2_Sts, handle-invalid=DONT-INVALIDATE}
      data SendCANR_Enabl_ClimateSchd2_Sts: category=VALUE, sw-calibration-access=READ-ONLY, type=ADTSBoolean, init-value=SendCANR_Enabl_ClimateSchd2_StsValue:0
    SendCANR_Enabl_ClimateSchd2_StsVld: service-kind=ANY-STANDARDIZED, invalidation-policy{data-element=SendCANR_Enabl_ClimateSchd2_StsVld, handle-invalid=DONT-INVALIDATE}  # Valid
      data SendCANR_Enabl_ClimateSchd2_StsVld: category=VALUE, sw-calibration-access=READ-ONLY, type=ADTSBoolean, init-value=SendCANR_Enabl_ClimateSchd2_StsVldValue:1
    SendCANR_Enbl_ClimateSchd1_Sts: service-kind=ANY-STANDARDIZED, invalidation-policy{data-element=SendCANR_Enbl_ClimateSchd1_Sts, handle-invalid=DONT-INVALIDATE}
      data SendCANR_Enbl_ClimateSchd1_Sts: category=VALUE, sw-calibration-access=READ-ONLY, type=ADTSBoolean, init-value=SendCANR_Enbl_ClimateSchd1_StsValue:0
    SendCANR_Enbl_ClimateSchd1_StsVld: service-kind=ANY-STANDARDIZED, invalidation-policy{data-element=SendCANR_Enbl_ClimateSchd1_StsVld, handle-invalid=DONT-INVALIDATE}  # Valid
      data SendCANR_Enbl_ClimateSchd1_StsVld: category=VALUE, sw-calibration-access=READ-ONLY, type=ADTSBoolean, init-value=SendCANR_Enbl_ClimateSchd1_StsVldValue:1
    SendCANR_End_Time_Hr1_Sts: service-kind=ANY-STANDARDIZED, invalidation-policy{data-element=SendCANR_End_Time_Hr1_Sts, handle-invalid=KEEP}
      data SendCANR_End_Time_Hr1_Sts: category=VALUE, sw-calibration-access=READ-ONLY, type=ADTSEnd_Time_Hr1_Sts, init-value=SendCANR_End_Time_Hr1_StsValue:0
    SendCANR_End_Time_Hr1_StsVld: service-kind=ANY-STANDARDIZED, invalidation-policy{data-element=SendCANR_End_Time_Hr1_StsVld, handle-invalid=DONT-INVALIDATE}  # Valid
      data SendCANR_End_Time_Hr1_StsVld: category=VALUE, sw-calibration-access=READ-ONLY, type=ADTSBoolean, init-value=SendCANR_End_Time_Hr1_StsVldValue:1
    SendCANR_End_Time_Hr2_Sts: service-kind=ANY-STANDARDIZED, invalidation-policy{data-element=SendCANR_End_Time_Hr2_Sts, handle-invalid=KEEP}
      data SendCANR_End_Time_Hr2_Sts: category=VALUE, sw-calibration-access=READ-ONLY, type=ADTSEnd_Time_Hr2_Sts, init-value=SendCANR_End_Time_Hr2_StsValue:0
    SendCANR_End_Time_Hr2_StsVld: service-kind=ANY-STANDARDIZED, invalidation-policy{data-element=SendCANR_End_Time_Hr2_StsVld, handle-invalid=DONT-INVALIDATE}  # Valid
      data SendCANR_End_Time_Hr2_StsVld: category=VALUE, sw-calibration-access=READ-ONLY, type=ADTSBoolean, init-value=SendCANR_End_Time_Hr2_StsVldValue:1
    SendCANR_End_Time_Min1_Sts: service-kind=ANY-STANDARDIZED, invalidation-policy{data-element=SendCANR_End_Time_Min1_Sts, handle-invalid=KEEP}
      data SendCANR_End_Time_Min1_Sts: category=VALUE, sw-calibration-access=READ-ONLY, type=ADTSEnd_Time_Min1_Sts, init-value=SendCANR_End_Time_Min1_StsValue:0
    SendCANR_End_Time_Min1_StsVld: service-kind=ANY-STANDARDIZED, invalidation-policy{data-element=SendCANR_End_Time_Min1_StsVld, handle-invalid=DONT-INVALIDATE}  # Valid
      data SendCANR_End_Time_Min1_StsVld: category=VALUE, sw-calibration-access=READ-ONLY, type=ADTSBoolean, init-value=SendCANR_End_Time_Min1_StsVldValue:1
    SendCANR_End_Time_Min2_Sts: service-kind=ANY-STANDARDIZED, invalidation-policy{data-element=SendCANR_End_Time_Min2_Sts, handle-invalid=KEEP}
      data SendCANR_End_Time_Min2_Sts: category=VALUE, sw-calibration-access=READ-ONLY, type=ADTSEnd_Time_Min2_Sts, init-value=SendCANR_End_Time_Min2_StsValue:0
    SendCANR_End_Time_Min2_StsVld: service-kind=ANY-STANDARDIZED, invalidation-policy{data-element=SendCANR_End_Time_Min2_StsVld, handle-invalid=DONT-INVALIDATE}  # Valid
      data SendCANR_End_Time_Min2_StsVld: category=VALUE, sw-calibration-access=READ-ONLY, type=ADTSBoolean, init-value=SendCANR_End_Time_Min2_StsVldValue:1
    SendCANR_Energy_to_Battery: service-kind=ANY-STANDARDIZED, invalidation-policy{data-element=SendCANR_Energy_to_Battery, handle-invalid=KEEP}
      data SendCANR_Energy_to_Battery: category=VALUE, sw-calibration-access=READ-ONLY, type=ADTSEnergy_to_Battery, init-value=SendCANR_Energy_to_BatteryValue:0
    SendCANR_Energy_to_BatteryVld: service-kind=ANY-STANDARDIZED, invalidation-policy{data-element=SendCANR_Energy_to_BatteryVld, handle-invalid=DONT-INVALIDATE}  # Valid
      data SendCANR_Energy_to_BatteryVld: category=VALUE, sw-calibration-access=READ-ONLY, type=ADTSBoolean, init-value=SendCANR_Energy_to_BatteryVldValue:1
    SendCANR_EngineSpeed_W_FD11: service-kind=ANY-STANDARDIZED, invalidation-policy{data-element=SendCANR_EngineSpeed_W_FD11, handle-invalid=KEEP}
      data SendCANR_EngineSpeed_W_FD11: category=VALUE, sw-calibration-access=READ-ONLY, type=ADTSEngineSpeed_W_FD11, init-value=SendCANR_EngineSpeed_W_FD11Value:0
    SendCANR_EngineSpeed_W_FD11Vld: service-kind=ANY-STANDARDIZED, invalidation-policy{data-element=SendCANR_EngineSpeed_W_FD11Vld, handle-invalid=DONT-INVALIDATE}  # Valid
      data SendCANR_EngineSpeed_W_FD11Vld: category=VALUE, sw-calibration-access=READ-ONLY, type=ADTSBoolean, init-value=SendCANR_EngineSpeed_W_FD11VldValue:1
    SendCANR_EstRange_Fuel: service-kind=ANY-STANDARDIZED, invalidation-policy{data-element=SendCANR_EstRange_Fuel, handle-invalid=KEEP}
      data SendCANR_EstRange_Fuel: category=VALUE, sw-calibration-access=READ-ONLY, type=ADTSEstRange_Fuel, init-value=SendCANR_EstRange_FuelValue:2047
    SendCANR_EstRange_FuelVld: service-kind=ANY-STANDARDIZED, invalidation-policy{data-element=SendCANR_EstRange_FuelVld, handle-invalid=DONT-INVALIDATE}  # Valid
      data SendCANR_EstRange_FuelVld: category=VALUE, sw-calibration-access=READ-ONLY, type=ADTSBoolean, init-value=SendCANR_EstRange_FuelVldValue:1
    SendCANR_EstRange_Total: service-kind=ANY-STANDARDIZED, invalidation-policy{data-element=SendCANR_EstRange_Total, handle-invalid=KEEP}
      data SendCANR_EstRange_Total: category=VALUE, sw-calibration-access=READ-ONLY, type=ADTSEstRange_Total, init-value=SendCANR_EstRange_TotalValue:2047
    SendCANR_EstRange_TotalVld: service-kind=ANY-STANDARDIZED, invalidation-policy{data-element=SendCANR_EstRange_TotalVld, handle-invalid=DONT-INVALIDATE}  # Valid
      data SendCANR_EstRange_TotalVld: category=VALUE, sw-calibration-access=READ-ONLY, type=ADTSBoolean, init-value=SendCANR_EstRange_TotalVldValue:1
    SendCANR_Est_Range_FullCharge: service-kind=ANY-STANDARDIZED, invalidation-policy{data-element=SendCANR_Est_Range_FullCharge, handle-invalid=KEEP}
      data SendCANR_Est_Range_FullCharge: category=VALUE, sw-calibration-access=READ-ONLY, type=ADTSEst_Range_FullCharge, init-value=SendCANR_Est_Range_FullChargeValue:0
    SendCANR_Est_Range_FullChargeVld: service-kind=ANY-STANDARDIZED, invalidation-policy{data-element=SendCANR_Est_Range_FullChargeVld, handle-invalid=DONT-INVALIDATE}  # Valid
      data SendCANR_Est_Range_FullChargeVld: category=VALUE, sw-calibration-access=READ-ONLY, type=ADTSBoolean, init-value=SendCANR_Est_Range_FullChargeVldValue:1
    SendCANR_ExtTemp_FD11: service-kind=ANY-STANDARDIZED, invalidation-policy{data-element=SendCANR_ExtTemp_FD11, handle-invalid=KEEP}
      data SendCANR_ExtTemp_FD11: category=VALUE, sw-calibration-access=READ-ONLY, type=ADTSExtTemp_FD11, init-value=SendCANR_ExtTemp_FD11Value:-85
    SendCANR_ExtTemp_FD11Vld: service-kind=ANY-STANDARDIZED, invalidation-policy{data-element=SendCANR_ExtTemp_FD11Vld, handle-invalid=DONT-INVALIDATE}  # Valid
      data SendCANR_ExtTemp_FD11Vld: category=VALUE, sw-calibration-access=READ-ONLY, type=ADTSBoolean, init-value=SendCANR_ExtTemp_FD11VldValue:1
    SendCANR_ExtTemp_FD16: service-kind=ANY-STANDARDIZED, invalidation-policy{data-element=SendCANR_ExtTemp_FD16, handle-invalid=KEEP}
      data SendCANR_ExtTemp_FD16: category=VALUE, sw-calibration-access=READ-ONLY, type=ADTSExtTemp_FD16, init-value=SendCANR_ExtTemp_FD16Value:-85
    SendCANR_ExtTemp_FD16Vld: service-kind=ANY-STANDARDIZED, invalidation-policy{data-element=SendCANR_ExtTemp_FD16Vld, handle-invalid=DONT-INVALIDATE}  # Valid
      data SendCANR_ExtTemp_FD16Vld: category=VALUE, sw-calibration-access=READ-ONLY, type=ADTSBoolean, init-value=SendCANR_ExtTemp_FD16VldValue:1
    SendCANR_ExtTemp_FD5: service-kind=ANY-STANDARDIZED, invalidation-policy{data-element=SendCANR_ExtTemp_FD5, handle-invalid=KEEP}
      data SendCANR_ExtTemp_FD5: category=VALUE, sw-calibration-access=READ-ONLY, type=ADTSExtTemp_FD5, init-value=SendCANR_ExtTemp_FD5Value:-85
    SendCANR_ExtTemp_FD5Vld: service-kind=ANY-STANDARDIZED, invalidation-policy{data-element=SendCANR_ExtTemp_FD5Vld, handle-invalid=DONT-INVALIDATE}  # Valid
      data SendCANR_ExtTemp_FD5Vld: category=VALUE, sw-calibration-access=READ-ONLY, type=ADTSBoolean, init-value=SendCANR_ExtTemp_FD5VldValue:1
    SendCANR_ExternTemperatureCFD11: service-kind=ANY-STANDARDIZED, invalidation-policy{data-element=SendCANR_ExternTemperatureCFD11, handle-invalid=KEEP}
      data SendCANR_ExternTemperatureCFD11: category=VALUE, sw-calibration-access=READ-ONLY, type=ADTSExternTemperatureCFD11, init-value=SendCANR_ExternTemperatureCFD11Value:170.5
    SendCANR_ExternTemperatureCFD11Vld: service-kind=ANY-STANDARDIZED, invalidation-policy{data-element=SendCANR_ExternTemperatureCFD11Vld, handle-invalid=DONT-INVALIDATE}  # Valid
      data SendCANR_ExternTemperatureCFD11Vld: category=VALUE, sw-calibration-access=READ-ONLY, type=ADTSBoolean, init-value=SendCANR_ExternTemperatureCFD11VldValue:1
    SendCANR_ExternalChrgTarget1Sts: service-kind=ANY-STANDARDIZED, invalidation-policy{data-element=SendCANR_ExternalChrgTarget1Sts, handle-invalid=DONT-INVALIDATE}
      data SendCANR_ExternalChrgTarget1Sts: category=VALUE, sw-calibration-access=READ-ONLY, type=ADTSExternalChrgTarget1Sts, init-value=SendCANR_ExternalChrgTarget1StsValue:50
    SendCANR_ExternalChrgTarget1StsVld: service-kind=ANY-STANDARDIZED, invalidation-policy{data-element=SendCANR_ExternalChrgTarget1StsVld, handle-invalid=DONT-INVALIDATE}  # Valid
      data SendCANR_ExternalChrgTarget1StsVld: category=VALUE, sw-calibration-access=READ-ONLY, type=ADTSBoolean, init-value=SendCANR_ExternalChrgTarget1StsVldValue:1
    SendCANR_ExternalChrgTarget2Sts: service-kind=ANY-STANDARDIZED, invalidation-policy{data-element=SendCANR_ExternalChrgTarget2Sts, handle-invalid=DONT-INVALIDATE}
      data SendCANR_ExternalChrgTarget2Sts: category=VALUE, sw-calibration-access=READ-ONLY, type=ADTSExternalChrgTarget2Sts, init-value=SendCANR_ExternalChrgTarget2StsValue:125
    SendCANR_ExternalChrgTarget2StsVld: service-kind=ANY-STANDARDIZED, invalidation-policy{data-element=SendCANR_ExternalChrgTarget2StsVld, handle-invalid=DONT-INVALIDATE}  # Valid
      data SendCANR_ExternalChrgTarget2StsVld: category=VALUE, sw-calibration-access=READ-ONLY, type=ADTSBoolean, init-value=SendCANR_ExternalChrgTarget2StsVldValue:1
    SendCANR_FOTA_Status_FD5: service-kind=ANY-STANDARDIZED, invalidation-policy{data-element=SendCANR_FOTA_Status_FD5, handle-invalid=DONT-INVALIDATE}
      data SendCANR_FOTA_Status_FD5: category=VALUE, sw-calibration-access=READ-ONLY, type=ADTSFOTA_Status_FD5, init-value=SendCANR_FOTA_Status_FD5Value:0
    SendCANR_FOTA_Status_FD5Vld: service-kind=ANY-STANDARDIZED, invalidation-policy{data-element=SendCANR_FOTA_Status_FD5Vld, handle-invalid=DONT-INVALIDATE}  # Valid
      data SendCANR_FOTA_Status_FD5Vld: category=VALUE, sw-calibration-access=READ-ONLY, type=ADTSBoolean, init-value=SendCANR_FOTA_Status_FD5VldValue:1
    SendCANR_FRfShVlvSts: service-kind=ANY-STANDARDIZED, invalidation-policy{data-element=SendCANR_FRfShVlvSts, handle-invalid=DONT-INVALIDATE}
      data SendCANR_FRfShVlvSts: category=VALUE, sw-calibration-access=READ-ONLY, type=ADTSBoolean, init-value=SendCANR_FRfShVlvStsValue:0
    SendCANR_FRfShVlvStsVld: service-kind=ANY-STANDARDIZED, invalidation-policy{data-element=SendCANR_FRfShVlvStsVld, handle-invalid=DONT-INVALIDATE}  # Valid
      data SendCANR_FRfShVlvStsVld: category=VALUE, sw-calibration-access=READ-ONLY, type=ADTSBoolean, init-value=SendCANR_FRfShVlvStsVldValue:1
    SendCANR_GPS_Date_Day_FD11: service-kind=ANY-STANDARDIZED, invalidation-policy{data-element=SendCANR_GPS_Date_Day_FD11, handle-invalid=KEEP}
      data SendCANR_GPS_Date_Day_FD11: category=VALUE, sw-calibration-access=READ-ONLY, type=ADTSGPS_Date_Day_FD11, init-value=SendCANR_GPS_Date_Day_FD11Value:255
    SendCANR_GPS_Date_Day_FD11Vld: service-kind=ANY-STANDARDIZED, invalidation-policy{data-element=SendCANR_GPS_Date_Day_FD11Vld, handle-invalid=DONT-INVALIDATE}  # Valid
      data SendCANR_GPS_Date_Day_FD11Vld: category=VALUE, sw-calibration-access=READ-ONLY, type=ADTSBoolean, init-value=SendCANR_GPS_Date_Day_FD11VldValue:1
    SendCANR_GPS_Date_Day_FD16: service-kind=ANY-STANDARDIZED, invalidation-policy{data-element=SendCANR_GPS_Date_Day_FD16, handle-invalid=KEEP}
      data SendCANR_GPS_Date_Day_FD16: category=VALUE, sw-calibration-access=READ-ONLY, type=ADTSGPS_Date_Day_FD16, init-value=SendCANR_GPS_Date_Day_FD16Value:255
    SendCANR_GPS_Date_Day_FD16Vld: service-kind=ANY-STANDARDIZED, invalidation-policy{data-element=SendCANR_GPS_Date_Day_FD16Vld, handle-invalid=DONT-INVALIDATE}  # Valid
      data SendCANR_GPS_Date_Day_FD16Vld: category=VALUE, sw-calibration-access=READ-ONLY, type=ADTSBoolean, init-value=SendCANR_GPS_Date_Day_FD16VldValue:1
    SendCANR_GPS_Date_Day_FD5: service-kind=ANY-STANDARDIZED, invalidation-policy{data-element=SendCANR_GPS_Date_Day_FD5, handle-invalid=KEEP}
      data SendCANR_GPS_Date_Day_FD5: category=VALUE, sw-calibration-access=READ-ONLY, type=ADTSGPS_Date_Day_FD5, init-value=SendCANR_GPS_Date_Day_FD5Value:255
    SendCANR_GPS_Date_Day_FD5Vld: service-kind=ANY-STANDARDIZED, invalidation-policy{data-element=SendCANR_GPS_Date_Day_FD5Vld, handle-invalid=DONT-INVALIDATE}  # Valid
      data SendCANR_GPS_Date_Day_FD5Vld: category=VALUE, sw-calibration-access=READ-ONLY, type=ADTSBoolean, init-value=SendCANR_GPS_Date_Day_FD5VldValue:1
    SendCANR_GPS_Date_Month_FD11: service-kind=ANY-STANDARDIZED, invalidation-policy{data-element=SendCANR_GPS_Date_Month_FD11, handle-invalid=KEEP}
      data SendCANR_GPS_Date_Month_FD11: category=VALUE, sw-calibration-access=READ-ONLY, type=ADTSGPS_Date_Month_FD11, init-value=SendCANR_GPS_Date_Month_FD11Value:255
    SendCANR_GPS_Date_Month_FD11Vld: service-kind=ANY-STANDARDIZED, invalidation-policy{data-element=SendCANR_GPS_Date_Month_FD11Vld, handle-invalid=DONT-INVALIDATE}  # Valid
      data SendCANR_GPS_Date_Month_FD11Vld: category=VALUE, sw-calibration-access=READ-ONLY, type=ADTSBoolean, init-value=SendCANR_GPS_Date_Month_FD11VldValue:1
    SendCANR_GPS_Date_Month_FD16: service-kind=ANY-STANDARDIZED, invalidation-policy{data-element=SendCANR_GPS_Date_Month_FD16, handle-invalid=KEEP}
      data SendCANR_GPS_Date_Month_FD16: category=VALUE, sw-calibration-access=READ-ONLY, type=ADTSGPS_Date_Month_FD16, init-value=SendCANR_GPS_Date_Month_FD16Value:255
    SendCANR_GPS_Date_Month_FD16Vld: service-kind=ANY-STANDARDIZED, invalidation-policy{data-element=SendCANR_GPS_Date_Month_FD16Vld, handle-invalid=DONT-INVALIDATE}  # Valid
      data SendCANR_GPS_Date_Month_FD16Vld: category=VALUE, sw-calibration-access=READ-ONLY, type=ADTSBoolean, init-value=SendCANR_GPS_Date_Month_FD16VldValue:1
    SendCANR_GPS_Date_Month_FD5: service-kind=ANY-STANDARDIZED, invalidation-policy{data-element=SendCANR_GPS_Date_Month_FD5, handle-invalid=KEEP}
      data SendCANR_GPS_Date_Month_FD5: category=VALUE, sw-calibration-access=READ-ONLY, type=ADTSGPS_Date_Month_FD5, init-value=SendCANR_GPS_Date_Month_FD5Value:255
    SendCANR_GPS_Date_Month_FD5Vld: service-kind=ANY-STANDARDIZED, invalidation-policy{data-element=SendCANR_GPS_Date_Month_FD5Vld, handle-invalid=DONT-INVALIDATE}  # Valid
      data SendCANR_GPS_Date_Month_FD5Vld: category=VALUE, sw-calibration-access=READ-ONLY, type=ADTSBoolean, init-value=SendCANR_GPS_Date_Month_FD5VldValue:1
    SendCANR_GPS_Date_Year_FD11: service-kind=ANY-STANDARDIZED, invalidation-policy{data-element=SendCANR_GPS_Date_Year_FD11, handle-invalid=KEEP}
      data SendCANR_GPS_Date_Year_FD11: category=VALUE, sw-calibration-access=READ-ONLY, type=ADTSGPS_Date_Year_FD11, init-value=SendCANR_GPS_Date_Year_FD11Value:65535
    SendCANR_GPS_Date_Year_FD11Vld: service-kind=ANY-STANDARDIZED, invalidation-policy{data-element=SendCANR_GPS_Date_Year_FD11Vld, handle-invalid=DONT-INVALIDATE}  # Valid
      data SendCANR_GPS_Date_Year_FD11Vld: category=VALUE, sw-calibration-access=READ-ONLY, type=ADTSBoolean, init-value=SendCANR_GPS_Date_Year_FD11VldValue:1
    SendCANR_GPS_Date_Year_FD16: service-kind=ANY-STANDARDIZED, invalidation-policy{data-element=SendCANR_GPS_Date_Year_FD16, handle-invalid=KEEP}
      data SendCANR_GPS_Date_Year_FD16: category=VALUE, sw-calibration-access=READ-ONLY, type=ADTSGPS_Date_Year_FD16, init-value=SendCANR_GPS_Date_Year_FD16Value:65535
    SendCANR_GPS_Date_Year_FD16Vld: service-kind=ANY-STANDARDIZED, invalidation-policy{data-element=SendCANR_GPS_Date_Year_FD16Vld, handle-invalid=DONT-INVALIDATE}  # Valid
      data SendCANR_GPS_Date_Year_FD16Vld: category=VALUE, sw-calibration-access=READ-ONLY, type=ADTSBoolean, init-value=SendCANR_GPS_Date_Year_FD16VldValue:1
    SendCANR_GPS_Date_Year_FD5: service-kind=ANY-STANDARDIZED, invalidation-policy{data-element=SendCANR_GPS_Date_Year_FD5, handle-invalid=KEEP}
      data SendCANR_GPS_Date_Year_FD5: category=VALUE, sw-calibration-access=READ-ONLY, type=ADTSGPS_Date_Year_FD5, init-value=SendCANR_GPS_Date_Year_FD5Value:65535
    SendCANR_GPS_Date_Year_FD5Vld: service-kind=ANY-STANDARDIZED, invalidation-policy{data-element=SendCANR_GPS_Date_Year_FD5Vld, handle-invalid=DONT-INVALIDATE}  # Valid
      data SendCANR_GPS_Date_Year_FD5Vld: category=VALUE, sw-calibration-access=READ-ONLY, type=ADTSBoolean, init-value=SendCANR_GPS_Date_Year_FD5VldValue:1
    SendCANR_GPS_UTC_Hour_FD11: service-kind=ANY-STANDARDIZED, invalidation-policy{data-element=SendCANR_GPS_UTC_Hour_FD11, handle-invalid=KEEP}
      data SendCANR_GPS_UTC_Hour_FD11: category=VALUE, sw-calibration-access=READ-ONLY, type=ADTSGPS_UTC_Hour_FD11, init-value=SendCANR_GPS_UTC_Hour_FD11Value:255
    SendCANR_GPS_UTC_Hour_FD11Vld: service-kind=ANY-STANDARDIZED, invalidation-policy{data-element=SendCANR_GPS_UTC_Hour_FD11Vld, handle-invalid=DONT-INVALIDATE}  # Valid
      data SendCANR_GPS_UTC_Hour_FD11Vld: category=VALUE, sw-calibration-access=READ-ONLY, type=ADTSBoolean, init-value=SendCANR_GPS_UTC_Hour_FD11VldValue:1
    SendCANR_GPS_UTC_Hour_FD16: service-kind=ANY-STANDARDIZED, invalidation-policy{data-element=SendCANR_GPS_UTC_Hour_FD16, handle-invalid=KEEP}
      data SendCANR_GPS_UTC_Hour_FD16: category=VALUE, sw-calibration-access=READ-ONLY, type=ADTSGPS_UTC_Hour_FD16, init-value=SendCANR_GPS_UTC_Hour_FD16Value:255
    SendCANR_GPS_UTC_Hour_FD16Vld: service-kind=ANY-STANDARDIZED, invalidation-policy{data-element=SendCANR_GPS_UTC_Hour_FD16Vld, handle-invalid=DONT-INVALIDATE}  # Valid
      data SendCANR_GPS_UTC_Hour_FD16Vld: category=VALUE, sw-calibration-access=READ-ONLY, type=ADTSBoolean, init-value=SendCANR_GPS_UTC_Hour_FD16VldValue:1
    SendCANR_GPS_UTC_Hour_FD5: service-kind=ANY-STANDARDIZED, invalidation-policy{data-element=SendCANR_GPS_UTC_Hour_FD5, handle-invalid=KEEP}
      data SendCANR_GPS_UTC_Hour_FD5: category=VALUE, sw-calibration-access=READ-ONLY, type=ADTSGPS_UTC_Hour_FD5, init-value=SendCANR_GPS_UTC_Hour_FD5Value:255
    SendCANR_GPS_UTC_Hour_FD5Vld: service-kind=ANY-STANDARDIZED, invalidation-policy{data-element=SendCANR_GPS_UTC_Hour_FD5Vld, handle-invalid=DONT-INVALIDATE}  # Valid
      data SendCANR_GPS_UTC_Hour_FD5Vld: category=VALUE, sw-calibration-access=READ-ONLY, type=ADTSBoolean, init-value=SendCANR_GPS_UTC_Hour_FD5VldValue:1
    SendCANR_GPS_UTC_Minute_FD11: service-kind=ANY-STANDARDIZED, invalidation-policy{data-element=SendCANR_GPS_UTC_Minute_FD11, handle-invalid=KEEP}
      data SendCANR_GPS_UTC_Minute_FD11: category=VALUE, sw-calibration-access=READ-ONLY, type=ADTSGPS_UTC_Minute_FD11, init-value=SendCANR_GPS_UTC_Minute_FD11Value:255
    SendCANR_GPS_UTC_Minute_FD11Vld: service-kind=ANY-STANDARDIZED, invalidation-policy{data-element=SendCANR_GPS_UTC_Minute_FD11Vld, handle-invalid=DONT-INVALIDATE}  # Valid
      data SendCANR_GPS_UTC_Minute_FD11Vld: category=VALUE, sw-calibration-access=READ-ONLY, type=ADTSBoolean, init-value=SendCANR_GPS_UTC_Minute_FD11VldValue:1
    SendCANR_GPS_UTC_Minute_FD16: service-kind=ANY-STANDARDIZED, invalidation-policy{data-element=SendCANR_GPS_UTC_Minute_FD16, handle-invalid=KEEP}
      data SendCANR_GPS_UTC_Minute_FD16: category=VALUE, sw-calibration-access=READ-ONLY, type=ADTSGPS_UTC_Minute_FD16, init-value=SendCANR_GPS_UTC_Minute_FD16Value:255
    SendCANR_GPS_UTC_Minute_FD16Vld: service-kind=ANY-STANDARDIZED, invalidation-policy{data-element=SendCANR_GPS_UTC_Minute_FD16Vld, handle-invalid=DONT-INVALIDATE}  # Valid
      data SendCANR_GPS_UTC_Minute_FD16Vld: category=VALUE, sw-calibration-access=READ-ONLY, type=ADTSBoolean, init-value=SendCANR_GPS_UTC_Minute_FD16VldValue:1
    SendCANR_GPS_UTC_Minute_FD5: service-kind=ANY-STANDARDIZED, invalidation-policy{data-element=SendCANR_GPS_UTC_Minute_FD5, handle-invalid=KEEP}
      data SendCANR_GPS_UTC_Minute_FD5: category=VALUE, sw-calibration-access=READ-ONLY, type=ADTSGPS_UTC_Minute_FD5, init-value=SendCANR_GPS_UTC_Minute_FD5Value:255
    SendCANR_GPS_UTC_Minute_FD5Vld: service-kind=ANY-STANDARDIZED, invalidation-policy{data-element=SendCANR_GPS_UTC_Minute_FD5Vld, handle-invalid=DONT-INVALIDATE}  # Valid
      data SendCANR_GPS_UTC_Minute_FD5Vld: category=VALUE, sw-calibration-access=READ-ONLY, type=ADTSBoolean, init-value=SendCANR_GPS_UTC_Minute_FD5VldValue:1
    SendCANR_GPS_UTC_Second_FD11: service-kind=ANY-STANDARDIZED, invalidation-policy{data-element=SendCANR_GPS_UTC_Second_FD11, handle-invalid=KEEP}
      data SendCANR_GPS_UTC_Second_FD11: category=VALUE, sw-calibration-access=READ-ONLY, type=ADTSGPS_UTC_Second_FD11, init-value=SendCANR_GPS_UTC_Second_FD11Value:655.35
    SendCANR_GPS_UTC_Second_FD11Vld: service-kind=ANY-STANDARDIZED, invalidation-policy{data-element=SendCANR_GPS_UTC_Second_FD11Vld, handle-invalid=DONT-INVALIDATE}  # Valid
      data SendCANR_GPS_UTC_Second_FD11Vld: category=VALUE, sw-calibration-access=READ-ONLY, type=ADTSBoolean, init-value=SendCANR_GPS_UTC_Second_FD11VldValue:1
    SendCANR_GPS_UTC_Second_FD16: service-kind=ANY-STANDARDIZED, invalidation-policy{data-element=SendCANR_GPS_UTC_Second_FD16, handle-invalid=KEEP}
      data SendCANR_GPS_UTC_Second_FD16: category=VALUE, sw-calibration-access=READ-ONLY, type=ADTSGPS_UTC_Second_FD16, init-value=SendCANR_GPS_UTC_Second_FD16Value:655.35
    SendCANR_GPS_UTC_Second_FD16Vld: service-kind=ANY-STANDARDIZED, invalidation-policy{data-element=SendCANR_GPS_UTC_Second_FD16Vld, handle-invalid=DONT-INVALIDATE}  # Valid
      data SendCANR_GPS_UTC_Second_FD16Vld: category=VALUE, sw-calibration-access=READ-ONLY, type=ADTSBoolean, init-value=SendCANR_GPS_UTC_Second_FD16VldValue:1
    SendCANR_GPS_UTC_Second_FD5: service-kind=ANY-STANDARDIZED, invalidation-policy{data-element=SendCANR_GPS_UTC_Second_FD5, handle-invalid=KEEP}
      data SendCANR_GPS_UTC_Second_FD5: category=VALUE, sw-calibration-access=READ-ONLY, type=ADTSGPS_UTC_Second_FD5, init-value=SendCANR_GPS_UTC_Second_FD5Value:655.35
    SendCANR_GPS_UTC_Second_FD5Vld: service-kind=ANY-STANDARDIZED, invalidation-policy{data-element=SendCANR_GPS_UTC_Second_FD5Vld, handle-invalid=DONT-INVALIDATE}  # Valid
      data SendCANR_GPS_UTC_Second_FD5Vld: category=VALUE, sw-calibration-access=READ-ONLY, type=ADTSBoolean, init-value=SendCANR_GPS_UTC_Second_FD5VldValue:1
    SendCANR_GearEngagedForDisplay: service-kind=ANY-STANDARDIZED, invalidation-policy{data-element=SendCANR_GearEngagedForDisplay, handle-invalid=KEEP}
      data SendCANR_GearEngagedForDisplay: category=VALUE, sw-calibration-access=READ-ONLY, type=ADTSGearEngagedForDisplay, init-value=SendCANR_GearEngagedForDisplayValue:31
    SendCANR_GearEngagedForDisplayVld: service-kind=ANY-STANDARDIZED, invalidation-policy{data-element=SendCANR_GearEngagedForDisplayVld, handle-invalid=DONT-INVALIDATE}  # Valid
      data SendCANR_GearEngagedForDisplayVld: category=VALUE, sw-calibration-access=READ-ONLY, type=ADTSBoolean, init-value=SendCANR_GearEngagedForDisplayVldValue:1
    SendCANR_GearEngaged_PT_FD11: service-kind=ANY-STANDARDIZED, invalidation-policy{data-element=SendCANR_GearEngaged_PT_FD11, handle-invalid=KEEP}
      data SendCANR_GearEngaged_PT_FD11: category=VALUE, sw-calibration-access=READ-ONLY, type=ADTSGearEngaged_PT_FD11, init-value=SendCANR_GearEngaged_PT_FD11Value:0
    SendCANR_GearEngaged_PT_FD11Vld: service-kind=ANY-STANDARDIZED, invalidation-policy{data-element=SendCANR_GearEngaged_PT_FD11Vld, handle-invalid=DONT-INVALIDATE}  # Valid
      data SendCANR_GearEngaged_PT_FD11Vld: category=VALUE, sw-calibration-access=READ-ONLY, type=ADTSBoolean, init-value=SendCANR_GearEngaged_PT_FD11VldValue:1
    SendCANR_GearEngdForDispPTFD11: service-kind=ANY-STANDARDIZED, invalidation-policy{data-element=SendCANR_GearEngdForDispPTFD11, handle-invalid=KEEP}
      data SendCANR_GearEngdForDispPTFD11: category=VALUE, sw-calibration-access=READ-ONLY, type=ADTSGearEngdForDispPTFD11, init-value=SendCANR_GearEngdForDispPTFD11Value:0
    SendCANR_GearEngdForDispPTFD11Vld: service-kind=ANY-STANDARDIZED, invalidation-policy{data-element=SendCANR_GearEngdForDispPTFD11Vld, handle-invalid=DONT-INVALIDATE}  # Valid
      data SendCANR_GearEngdForDispPTFD11Vld: category=VALUE, sw-calibration-access=READ-ONLY, type=ADTSBoolean, init-value=SendCANR_GearEngdForDispPTFD11VldValue:1
    SendCANR_GenFailStFD03EVCU2FD11: service-kind=ANY-STANDARDIZED, invalidation-policy{data-element=SendCANR_GenFailStFD03EVCU2FD11, handle-invalid=DONT-INVALIDATE}
      data SendCANR_GenFailStFD03EVCU2FD11: category=VALUE, sw-calibration-access=READ-ONLY, type=ADTSBoolean, init-value=SendCANR_GenFailStFD03EVCU2FD11Value:0
    SendCANR_GenFailStFD03EVCU2FD11Vld: service-kind=ANY-STANDARDIZED, invalidation-policy{data-element=SendCANR_GenFailStFD03EVCU2FD11Vld, handle-invalid=DONT-INVALIDATE}  # Valid
      data SendCANR_GenFailStFD03EVCU2FD11Vld: category=VALUE, sw-calibration-access=READ-ONLY, type=ADTSBoolean, init-value=SendCANR_GenFailStFD03EVCU2FD11VldValue:1
    SendCANR_GenFailStFD05EVCU2FD11: service-kind=ANY-STANDARDIZED, invalidation-policy{data-element=SendCANR_GenFailStFD05EVCU2FD11, handle-invalid=DONT-INVALIDATE}
      data SendCANR_GenFailStFD05EVCU2FD11: category=VALUE, sw-calibration-access=READ-ONLY, type=ADTSBoolean, init-value=SendCANR_GenFailStFD05EVCU2FD11Value:0
    SendCANR_GenFailStFD05EVCU2FD11Vld: service-kind=ANY-STANDARDIZED, invalidation-policy{data-element=SendCANR_GenFailStFD05EVCU2FD11Vld, handle-invalid=DONT-INVALIDATE}  # Valid
      data SendCANR_GenFailStFD05EVCU2FD11Vld: category=VALUE, sw-calibration-access=READ-ONLY, type=ADTSBoolean, init-value=SendCANR_GenFailStFD05EVCU2FD11VldValue:1
    SendCANR_GenFailStFD11EVCU2FD11: service-kind=ANY-STANDARDIZED, invalidation-policy{data-element=SendCANR_GenFailStFD11EVCU2FD11, handle-invalid=DONT-INVALIDATE}
      data SendCANR_GenFailStFD11EVCU2FD11: category=VALUE, sw-calibration-access=READ-ONLY, type=ADTSBoolean, init-value=SendCANR_GenFailStFD11EVCU2FD11Value:0
    SendCANR_GenFailStFD11EVCU2FD11Vld: service-kind=ANY-STANDARDIZED, invalidation-policy{data-element=SendCANR_GenFailStFD11EVCU2FD11Vld, handle-invalid=DONT-INVALIDATE}  # Valid
      data SendCANR_GenFailStFD11EVCU2FD11Vld: category=VALUE, sw-calibration-access=READ-ONLY, type=ADTSBoolean, init-value=SendCANR_GenFailStFD11EVCU2FD11VldValue:1
    SendCANR_GenFailStFD16EVCU2FD11: service-kind=ANY-STANDARDIZED, invalidation-policy{data-element=SendCANR_GenFailStFD16EVCU2FD11, handle-invalid=DONT-INVALIDATE}
      data SendCANR_GenFailStFD16EVCU2FD11: category=VALUE, sw-calibration-access=READ-ONLY, type=ADTSBoolean, init-value=SendCANR_GenFailStFD16EVCU2FD11Value:0
    SendCANR_GenFailStFD16EVCU2FD11Vld: service-kind=ANY-STANDARDIZED, invalidation-policy{data-element=SendCANR_GenFailStFD16EVCU2FD11Vld, handle-invalid=DONT-INVALIDATE}  # Valid
      data SendCANR_GenFailStFD16EVCU2FD11Vld: category=VALUE, sw-calibration-access=READ-ONLY, type=ADTSBoolean, init-value=SendCANR_GenFailStFD16EVCU2FD11VldValue:1
    SendCANR_GenFailStsFD03EVCU2FD3: service-kind=ANY-STANDARDIZED, invalidation-policy{data-element=SendCANR_GenFailStsFD03EVCU2FD3, handle-invalid=DONT-INVALIDATE}
      data SendCANR_GenFailStsFD03EVCU2FD3: category=VALUE, sw-calibration-access=READ-ONLY, type=ADTSBoolean, init-value=SendCANR_GenFailStsFD03EVCU2FD3Value:0
    SendCANR_GenFailStsFD03EVCU2FD3Vld: service-kind=ANY-STANDARDIZED, invalidation-policy{data-element=SendCANR_GenFailStsFD03EVCU2FD3Vld, handle-invalid=DONT-INVALIDATE}  # Valid
      data SendCANR_GenFailStsFD03EVCU2FD3Vld: category=VALUE, sw-calibration-access=READ-ONLY, type=ADTSBoolean, init-value=SendCANR_GenFailStsFD03EVCU2FD3VldValue:1
    SendCANR_GenFailStsFD05EVCU2FD3: service-kind=ANY-STANDARDIZED, invalidation-policy{data-element=SendCANR_GenFailStsFD05EVCU2FD3, handle-invalid=DONT-INVALIDATE}
      data SendCANR_GenFailStsFD05EVCU2FD3: category=VALUE, sw-calibration-access=READ-ONLY, type=ADTSBoolean, init-value=SendCANR_GenFailStsFD05EVCU2FD3Value:0
    SendCANR_GenFailStsFD05EVCU2FD3Vld: service-kind=ANY-STANDARDIZED, invalidation-policy{data-element=SendCANR_GenFailStsFD05EVCU2FD3Vld, handle-invalid=DONT-INVALIDATE}  # Valid
      data SendCANR_GenFailStsFD05EVCU2FD3Vld: category=VALUE, sw-calibration-access=READ-ONLY, type=ADTSBoolean, init-value=SendCANR_GenFailStsFD05EVCU2FD3VldValue:1
    SendCANR_GenFailStsFD11EVCU2FD3: service-kind=ANY-STANDARDIZED, invalidation-policy{data-element=SendCANR_GenFailStsFD11EVCU2FD3, handle-invalid=DONT-INVALIDATE}
      data SendCANR_GenFailStsFD11EVCU2FD3: category=VALUE, sw-calibration-access=READ-ONLY, type=ADTSBoolean, init-value=SendCANR_GenFailStsFD11EVCU2FD3Value:0
    SendCANR_GenFailStsFD11EVCU2FD3Vld: service-kind=ANY-STANDARDIZED, invalidation-policy{data-element=SendCANR_GenFailStsFD11EVCU2FD3Vld, handle-invalid=DONT-INVALIDATE}  # Valid
      data SendCANR_GenFailStsFD11EVCU2FD3Vld: category=VALUE, sw-calibration-access=READ-ONLY, type=ADTSBoolean, init-value=SendCANR_GenFailStsFD11EVCU2FD3VldValue:1
    SendCANR_GenFailStsFD16EVCU2FD3: service-kind=ANY-STANDARDIZED, invalidation-policy{data-element=SendCANR_GenFailStsFD16EVCU2FD3, handle-invalid=DONT-INVALIDATE}
      data SendCANR_GenFailStsFD16EVCU2FD3: category=VALUE, sw-calibration-access=READ-ONLY, type=ADTSBoolean, init-value=SendCANR_GenFailStsFD16EVCU2FD3Value:0
    SendCANR_GenFailStsFD16EVCU2FD3Vld: service-kind=ANY-STANDARDIZED, invalidation-policy{data-element=SendCANR_GenFailStsFD16EVCU2FD3Vld, handle-invalid=DONT-INVALIDATE}  # Valid
      data SendCANR_GenFailStsFD16EVCU2FD3Vld: category=VALUE, sw-calibration-access=READ-ONLY, type=ADTSBoolean, init-value=SendCANR_GenFailStsFD16EVCU2FD3VldValue:1
    SendCANR_HCP_ShutdownCommand: service-kind=ANY-STANDARDIZED, invalidation-policy{data-element=SendCANR_HCP_ShutdownCommand, handle-invalid=KEEP}
      data SendCANR_HCP_ShutdownCommand: category=VALUE, sw-calibration-access=READ-ONLY, type=ADTSHCP_ShutdownCommand, init-value=SendCANR_HCP_ShutdownCommandValue:0
    SendCANR_HCP_ShutdownCommandVld: service-kind=ANY-STANDARDIZED, invalidation-policy{data-element=SendCANR_HCP_ShutdownCommandVld, handle-invalid=DONT-INVALIDATE}  # Valid
      data SendCANR_HCP_ShutdownCommandVld: category=VALUE, sw-calibration-access=READ-ONLY, type=ADTSBoolean, init-value=SendCANR_HCP_ShutdownCommandVldValue:1
    SendCANR_HTAuxPmpMontrngRPM: service-kind=ANY-STANDARDIZED, invalidation-policy{data-element=SendCANR_HTAuxPmpMontrngRPM, handle-invalid=KEEP}
      data SendCANR_HTAuxPmpMontrngRPM: category=VALUE, sw-calibration-access=READ-ONLY, type=ADTSHTAuxPmpMontrngRPM, init-value=SendCANR_HTAuxPmpMontrngRPMValue:3
    SendCANR_HTAuxPmpMontrngRPM_Vld: service-kind=ANY-STANDARDIZED, invalidation-policy{data-element=SendCANR_HTAuxPmpMontrngRPM_Vld, handle-invalid=DONT-INVALIDATE}  # Valid
      data SendCANR_HTAuxPmpMontrngRPM_Vld: category=VALUE, sw-calibration-access=READ-ONLY, type=ADTSBoolean, init-value=SendCANR_HTAuxPmpMontrngRPM_VldValue:1
    SendCANR_HTAuxPmpRPMAct: service-kind=ANY-STANDARDIZED, invalidation-policy{data-element=SendCANR_HTAuxPmpRPMAct, handle-invalid=KEEP}
      data SendCANR_HTAuxPmpRPMAct: category=VALUE, sw-calibration-access=READ-ONLY, type=ADTSHTAuxPmpRPMAct, init-value=SendCANR_HTAuxPmpRPMActValue:0
    SendCANR_HTAuxPmpRPMActVld: service-kind=ANY-STANDARDIZED, invalidation-policy{data-element=SendCANR_HTAuxPmpRPMActVld, handle-invalid=DONT-INVALIDATE}  # Valid
      data SendCANR_HTAuxPmpRPMActVld: category=VALUE, sw-calibration-access=READ-ONLY, type=ADTSBoolean, init-value=SendCANR_HTAuxPmpRPMActVldValue:1
    SendCANR_HTShtOffVlvReq: service-kind=ANY-STANDARDIZED, invalidation-policy{data-element=SendCANR_HTShtOffVlvReq, handle-invalid=DONT-INVALIDATE}
      data SendCANR_HTShtOffVlvReq: category=VALUE, sw-calibration-access=READ-ONLY, type=ADTSBoolean, init-value=SendCANR_HTShtOffVlvReqValue:0
    SendCANR_HTShtOffVlvReqVld: service-kind=ANY-STANDARDIZED, invalidation-policy{data-element=SendCANR_HTShtOffVlvReqVld, handle-invalid=DONT-INVALIDATE}  # Valid
      data SendCANR_HTShtOffVlvReqVld: category=VALUE, sw-calibration-access=READ-ONLY, type=ADTSBoolean, init-value=SendCANR_HTShtOffVlvReqVldValue:1
    SendCANR_HVBatCoolantLvlLo_DPT: service-kind=ANY-STANDARDIZED, invalidation-policy{data-element=SendCANR_HVBatCoolantLvlLo_DPT, handle-invalid=KEEP}
      data SendCANR_HVBatCoolantLvlLo_DPT: category=VALUE, sw-calibration-access=READ-ONLY, type=ADTSHVBatCoolantLvlLo_DPT, init-value=SendCANR_HVBatCoolantLvlLo_DPTValue:0
    SendCANR_HVBatCoolantLvlLo_DPT_Vld: service-kind=ANY-STANDARDIZED, invalidation-policy{data-element=SendCANR_HVBatCoolantLvlLo_DPT_Vld, handle-invalid=DONT-INVALIDATE}  # Valid
      data SendCANR_HVBatCoolantLvlLo_DPT_Vld: category=VALUE, sw-calibration-access=READ-ONLY, type=ADTSBoolean, init-value=SendCANR_HVBatCoolantLvlLo_DPT_VldValue:1
    SendCANR_HVBatCritCondT: service-kind=ANY-STANDARDIZED, invalidation-policy{data-element=SendCANR_HVBatCritCondT, handle-invalid=DONT-INVALIDATE}
      data SendCANR_HVBatCritCondT: category=VALUE, sw-calibration-access=READ-ONLY, type=ADTSBoolean, init-value=SendCANR_HVBatCritCondTValue:0
    SendCANR_HVBatCritCondT_Vld: service-kind=ANY-STANDARDIZED, invalidation-policy{data-element=SendCANR_HVBatCritCondT_Vld, handle-invalid=DONT-INVALIDATE}  # Valid
      data SendCANR_HVBatCritCondT_Vld: category=VALUE, sw-calibration-access=READ-ONLY, type=ADTSBoolean, init-value=SendCANR_HVBatCritCondT_VldValue:1
    SendCANR_HVBattRealTimeClkVFD3: service-kind=ANY-STANDARDIZED, invalidation-policy{data-element=SendCANR_HVBattRealTimeClkVFD3, handle-invalid=DONT-INVALIDATE}
      data SendCANR_HVBattRealTimeClkVFD3: category=VALUE, sw-calibration-access=READ-ONLY, type=ADTSBoolean, init-value=SendCANR_HVBattRealTimeClkVFD3Value:0
    SendCANR_HVBattRealTimeClkVFD3Vld: service-kind=ANY-STANDARDIZED, invalidation-policy{data-element=SendCANR_HVBattRealTimeClkVFD3Vld, handle-invalid=DONT-INVALIDATE}  # Valid
      data SendCANR_HVBattRealTimeClkVFD3Vld: category=VALUE, sw-calibration-access=READ-ONLY, type=ADTSBoolean, init-value=SendCANR_HVBattRealTimeClkVFD3VldValue:1
    SendCANR_HVBatteryMILRequest: service-kind=ANY-STANDARDIZED, invalidation-policy{data-element=SendCANR_HVBatteryMILRequest, handle-invalid=DONT-INVALIDATE}
      data SendCANR_HVBatteryMILRequest: category=VALUE, sw-calibration-access=READ-ONLY, type=ADTSBoolean, init-value=SendCANR_HVBatteryMILRequestValue:0
    SendCANR_HVBatteryMILRequestVld: service-kind=ANY-STANDARDIZED, invalidation-policy{data-element=SendCANR_HVBatteryMILRequestVld, handle-invalid=DONT-INVALIDATE}  # Valid
      data SendCANR_HVBatteryMILRequestVld: category=VALUE, sw-calibration-access=READ-ONLY, type=ADTSBoolean, init-value=SendCANR_HVBatteryMILRequestVldValue:1
    SendCANR_HVBattryRealTimeClkFD3: service-kind=ANY-STANDARDIZED, invalidation-policy{data-element=SendCANR_HVBattryRealTimeClkFD3, handle-invalid=KEEP}
      data SendCANR_HVBattryRealTimeClkFD3: category=VALUE, sw-calibration-access=READ-ONLY, type=ADTSHVBattryRealTimeClkFD3, init-value=SendCANR_HVBattryRealTimeClkFD3Value:0
    SendCANR_HVBattryRealTimeClkFD3Vld: service-kind=ANY-STANDARDIZED, invalidation-policy{data-element=SendCANR_HVBattryRealTimeClkFD3Vld, handle-invalid=DONT-INVALIDATE}  # Valid
      data SendCANR_HVBattryRealTimeClkFD3Vld: category=VALUE, sw-calibration-access=READ-ONLY, type=ADTSBoolean, init-value=SendCANR_HVBattryRealTimeClkFD3VldValue:1
    SendCANR_HVCMSBlkChrgnCmpltFD5: service-kind=ANY-STANDARDIZED, invalidation-policy{data-element=SendCANR_HVCMSBlkChrgnCmpltFD5, handle-invalid=DONT-INVALIDATE}
      data SendCANR_HVCMSBlkChrgnCmpltFD5: category=VALUE, sw-calibration-access=READ-ONLY, type=ADTSBoolean, init-value=SendCANR_HVCMSBlkChrgnCmpltFD5Value:0
    SendCANR_HVCMSBlkChrgnCmpltFD5Vld: service-kind=ANY-STANDARDIZED, invalidation-policy{data-element=SendCANR_HVCMSBlkChrgnCmpltFD5Vld, handle-invalid=DONT-INVALIDATE}  # Valid
      data SendCANR_HVCMSBlkChrgnCmpltFD5Vld: category=VALUE, sw-calibration-access=READ-ONLY, type=ADTSBoolean, init-value=SendCANR_HVCMSBlkChrgnCmpltFD5VldValue:1
    SendCANR_HVCMSEVMaxVLimit_FD11: service-kind=ANY-STANDARDIZED, invalidation-policy{data-element=SendCANR_HVCMSEVMaxVLimit_FD11, handle-invalid=KEEP}
      data SendCANR_HVCMSEVMaxVLimit_FD11: category=VALUE, sw-calibration-access=READ-ONLY, type=ADTSHVCMSEVMaxVLimit_FD11, init-value=SendCANR_HVCMSEVMaxVLimit_FD11Value:0
    SendCANR_HVCMSEVMaxVLimit_FD11Vld: service-kind=ANY-STANDARDIZED, invalidation-policy{data-element=SendCANR_HVCMSEVMaxVLimit_FD11Vld, handle-invalid=DONT-INVALIDATE}  # Valid
      data SendCANR_HVCMSEVMaxVLimit_FD11Vld: category=VALUE, sw-calibration-access=READ-ONLY, type=ADTSBoolean, init-value=SendCANR_HVCMSEVMaxVLimit_FD11VldValue:1
    SendCANR_HVCMSProtocolEntry1FD5: service-kind=ANY-STANDARDIZED, invalidation-policy{data-element=SendCANR_HVCMSProtocolEntry1FD5, handle-invalid=KEEP}
      data SendCANR_HVCMSProtocolEntry1FD5: category=VALUE, sw-calibration-access=READ-ONLY, type=ADTSHVCMSProtocolEntry1FD5, init-value=SendCANR_HVCMSProtocolEntry1FD5Value:0
    SendCANR_HVCMSProtocolEntry1FD5Vld: service-kind=ANY-STANDARDIZED, invalidation-policy{data-element=SendCANR_HVCMSProtocolEntry1FD5Vld, handle-invalid=DONT-INVALIDATE}  # Valid
      data SendCANR_HVCMSProtocolEntry1FD5Vld: category=VALUE, sw-calibration-access=READ-ONLY, type=ADTSBoolean, init-value=SendCANR_HVCMSProtocolEntry1FD5VldValue:1
    SendCANR_HVCMSProtocolEntry2FD5: service-kind=ANY-STANDARDIZED, invalidation-policy{data-element=SendCANR_HVCMSProtocolEntry2FD5, handle-invalid=KEEP}
      data SendCANR_HVCMSProtocolEntry2FD5: category=VALUE, sw-calibration-access=READ-ONLY, type=ADTSHVCMSProtocolEntry2FD5, init-value=SendCANR_HVCMSProtocolEntry2FD5Value:0
    SendCANR_HVCMSProtocolEntry2FD5Vld: service-kind=ANY-STANDARDIZED, invalidation-policy{data-element=SendCANR_HVCMSProtocolEntry2FD5Vld, handle-invalid=DONT-INVALIDATE}  # Valid
      data SendCANR_HVCMSProtocolEntry2FD5Vld: category=VALUE, sw-calibration-access=READ-ONLY, type=ADTSBoolean, init-value=SendCANR_HVCMSProtocolEntry2FD5VldValue:1
    SendCANR_HVCMSProtocolEntry3FD5: service-kind=ANY-STANDARDIZED, invalidation-policy{data-element=SendCANR_HVCMSProtocolEntry3FD5, handle-invalid=KEEP}
      data SendCANR_HVCMSProtocolEntry3FD5: category=VALUE, sw-calibration-access=READ-ONLY, type=ADTSHVCMSProtocolEntry3FD5, init-value=SendCANR_HVCMSProtocolEntry3FD5Value:0
    SendCANR_HVCMSProtocolEntry3FD5Vld: service-kind=ANY-STANDARDIZED, invalidation-policy{data-element=SendCANR_HVCMSProtocolEntry3FD5Vld, handle-invalid=DONT-INVALIDATE}  # Valid
      data SendCANR_HVCMSProtocolEntry3FD5Vld: category=VALUE, sw-calibration-access=READ-ONLY, type=ADTSBoolean, init-value=SendCANR_HVCMSProtocolEntry3FD5VldValue:1
    SendCANR_HVCMSReadyToChgStatFD5: service-kind=ANY-STANDARDIZED, invalidation-policy{data-element=SendCANR_HVCMSReadyToChgStatFD5, handle-invalid=DONT-INVALIDATE}
      data SendCANR_HVCMSReadyToChgStatFD5: category=VALUE, sw-calibration-access=READ-ONLY, type=ADTSBoolean, init-value=SendCANR_HVCMSReadyToChgStatFD5Value:0
    SendCANR_HVCMSReadyToChgStatFD5Vld: service-kind=ANY-STANDARDIZED, invalidation-policy{data-element=SendCANR_HVCMSReadyToChgStatFD5Vld, handle-invalid=DONT-INVALIDATE}  # Valid
      data SendCANR_HVCMSReadyToChgStatFD5Vld: category=VALUE, sw-calibration-access=READ-ONLY, type=ADTSBoolean, init-value=SendCANR_HVCMSReadyToChgStatFD5VldValue:1
    SendCANR_HVCMSRemTimToBlkSOCFD5: service-kind=ANY-STANDARDIZED, invalidation-policy{data-element=SendCANR_HVCMSRemTimToBlkSOCFD5, handle-invalid=KEEP}
      data SendCANR_HVCMSRemTimToBlkSOCFD5: category=VALUE, sw-calibration-access=READ-ONLY, type=ADTSHVCMSRemTimToBlkSOCFD5, init-value=SendCANR_HVCMSRemTimToBlkSOCFD5Value:0
    SendCANR_HVCMSRemTimToBlkSOCFD5Vld: service-kind=ANY-STANDARDIZED, invalidation-policy{data-element=SendCANR_HVCMSRemTimToBlkSOCFD5Vld, handle-invalid=DONT-INVALIDATE}  # Valid
      data SendCANR_HVCMSRemTimToBlkSOCFD5Vld: category=VALUE, sw-calibration-access=READ-ONLY, type=ADTSBoolean, init-value=SendCANR_HVCMSRemTimToBlkSOCFD5VldValue:1
    SendCANR_HVCMSRemTimToFulSOCFD5: service-kind=ANY-STANDARDIZED, invalidation-policy{data-element=SendCANR_HVCMSRemTimToFulSOCFD5, handle-invalid=KEEP}
      data SendCANR_HVCMSRemTimToFulSOCFD5: category=VALUE, sw-calibration-access=READ-ONLY, type=ADTSHVCMSRemTimToFulSOCFD5, init-value=SendCANR_HVCMSRemTimToFulSOCFD5Value:0
    SendCANR_HVCMSRemTimToFulSOCFD5Vld: service-kind=ANY-STANDARDIZED, invalidation-policy{data-element=SendCANR_HVCMSRemTimToFulSOCFD5Vld, handle-invalid=DONT-INVALIDATE}  # Valid
      data SendCANR_HVCMSRemTimToFulSOCFD5Vld: category=VALUE, sw-calibration-access=READ-ONLY, type=ADTSBoolean, init-value=SendCANR_HVCMSRemTimToFulSOCFD5VldValue:1
    SendCANR_HVCMSSelectedServIdFD5: service-kind=ANY-STANDARDIZED, invalidation-policy{data-element=SendCANR_HVCMSSelectedServIdFD5, handle-invalid=DONT-INVALIDATE}
      data SendCANR_HVCMSSelectedServIdFD5: category=VALUE, sw-calibration-access=READ-ONLY, type=ADTSHVCMSSelectedServIdFD5, init-value=SendCANR_HVCMSSelectedServIdFD5Value:0
    SendCANR_HVCMSSelectedServIdFD5Vld: service-kind=ANY-STANDARDIZED, invalidation-policy{data-element=SendCANR_HVCMSSelectedServIdFD5Vld, handle-invalid=DONT-INVALIDATE}  # Valid
      data SendCANR_HVCMSSelectedServIdFD5Vld: category=VALUE, sw-calibration-access=READ-ONLY, type=ADTSBoolean, init-value=SendCANR_HVCMSSelectedServIdFD5VldValue:1
    SendCANR_HVCMSServiceCatgoryFD5: service-kind=ANY-STANDARDIZED, invalidation-policy{data-element=SendCANR_HVCMSServiceCatgoryFD5, handle-invalid=KEEP}
      data SendCANR_HVCMSServiceCatgoryFD5: category=VALUE, sw-calibration-access=READ-ONLY, type=ADTSHVCMSServiceCatgoryFD5, init-value=SendCANR_HVCMSServiceCatgoryFD5Value:0
    SendCANR_HVCMSServiceCatgoryFD5Vld: service-kind=ANY-STANDARDIZED, invalidation-policy{data-element=SendCANR_HVCMSServiceCatgoryFD5Vld, handle-invalid=DONT-INVALIDATE}  # Valid
      data SendCANR_HVCMSServiceCatgoryFD5Vld: category=VALUE, sw-calibration-access=READ-ONLY, type=ADTSBoolean, init-value=SendCANR_HVCMSServiceCatgoryFD5VldValue:1
    SendCANR_HVCMSSlfEnrgTrnfTypFD5: service-kind=ANY-STANDARDIZED, invalidation-policy{data-element=SendCANR_HVCMSSlfEnrgTrnfTypFD5, handle-invalid=KEEP}
      data SendCANR_HVCMSSlfEnrgTrnfTypFD5: category=VALUE, sw-calibration-access=READ-ONLY, type=ADTSHVCMSSlfEnrgTrnfTypFD5, init-value=SendCANR_HVCMSSlfEnrgTrnfTypFD5Value:0
    SendCANR_HVCMSSlfEnrgTrnfTypFD5Vld: service-kind=ANY-STANDARDIZED, invalidation-policy{data-element=SendCANR_HVCMSSlfEnrgTrnfTypFD5Vld, handle-invalid=DONT-INVALIDATE}  # Valid
      data SendCANR_HVCMSSlfEnrgTrnfTypFD5Vld: category=VALUE, sw-calibration-access=READ-ONLY, type=ADTSBoolean, init-value=SendCANR_HVCMSSlfEnrgTrnfTypFD5VldValue:1
    SendCANR_HVCMS_BulChrgnCmplFD11: service-kind=ANY-STANDARDIZED, invalidation-policy{data-element=SendCANR_HVCMS_BulChrgnCmplFD11, handle-invalid=DONT-INVALIDATE}
      data SendCANR_HVCMS_BulChrgnCmplFD11: category=VALUE, sw-calibration-access=READ-ONLY, type=ADTSBoolean, init-value=SendCANR_HVCMS_BulChrgnCmplFD11Value:0
    SendCANR_HVCMS_BulChrgnCmplFD11Vld: service-kind=ANY-STANDARDIZED, invalidation-policy{data-element=SendCANR_HVCMS_BulChrgnCmplFD11Vld, handle-invalid=DONT-INVALIDATE}  # Valid
      data SendCANR_HVCMS_BulChrgnCmplFD11Vld: category=VALUE, sw-calibration-access=READ-ONLY, type=ADTSBoolean, init-value=SendCANR_HVCMS_BulChrgnCmplFD11VldValue:1
    SendCANR_HVCMS_ChrgnCmpl_FD11: service-kind=ANY-STANDARDIZED, invalidation-policy{data-element=SendCANR_HVCMS_ChrgnCmpl_FD11, handle-invalid=DONT-INVALIDATE}
      data SendCANR_HVCMS_ChrgnCmpl_FD11: category=VALUE, sw-calibration-access=READ-ONLY, type=ADTSBoolean, init-value=SendCANR_HVCMS_ChrgnCmpl_FD11Value:0
    SendCANR_HVCMS_ChrgnCmpl_FD11Vld: service-kind=ANY-STANDARDIZED, invalidation-policy{data-element=SendCANR_HVCMS_ChrgnCmpl_FD11Vld, handle-invalid=DONT-INVALIDATE}  # Valid
      data SendCANR_HVCMS_ChrgnCmpl_FD11Vld: category=VALUE, sw-calibration-access=READ-ONLY, type=ADTSBoolean, init-value=SendCANR_HVCMS_ChrgnCmpl_FD11VldValue:1
    SendCANR_HVCMS_ChrgnCompltFD5: service-kind=ANY-STANDARDIZED, invalidation-policy{data-element=SendCANR_HVCMS_ChrgnCompltFD5, handle-invalid=DONT-INVALIDATE}
      data SendCANR_HVCMS_ChrgnCompltFD5: category=VALUE, sw-calibration-access=READ-ONLY, type=ADTSBoolean, init-value=SendCANR_HVCMS_ChrgnCompltFD5Value:0
    SendCANR_HVCMS_ChrgnCompltFD5Vld: service-kind=ANY-STANDARDIZED, invalidation-policy{data-element=SendCANR_HVCMS_ChrgnCompltFD5Vld, handle-invalid=DONT-INVALIDATE}  # Valid
      data SendCANR_HVCMS_ChrgnCompltFD5Vld: category=VALUE, sw-calibration-access=READ-ONLY, type=ADTSBoolean, init-value=SendCANR_HVCMS_ChrgnCompltFD5VldValue:1
    SendCANR_HVCMS_EVEgyCap_FD11: service-kind=ANY-STANDARDIZED, invalidation-policy{data-element=SendCANR_HVCMS_EVEgyCap_FD11, handle-invalid=KEEP}
      data SendCANR_HVCMS_EVEgyCap_FD11: category=VALUE, sw-calibration-access=READ-ONLY, type=ADTSHVCMS_EVEgyCap_FD11, init-value=SendCANR_HVCMS_EVEgyCap_FD11Value:0
    SendCANR_HVCMS_EVEgyCap_FD11Vld: service-kind=ANY-STANDARDIZED, invalidation-policy{data-element=SendCANR_HVCMS_EVEgyCap_FD11Vld, handle-invalid=DONT-INVALIDATE}  # Valid
      data SendCANR_HVCMS_EVEgyCap_FD11Vld: category=VALUE, sw-calibration-access=READ-ONLY, type=ADTSBoolean, init-value=SendCANR_HVCMS_EVEgyCap_FD11VldValue:1
    SendCANR_HVCMS_EVEgyReq_FD11: service-kind=ANY-STANDARDIZED, invalidation-policy{data-element=SendCANR_HVCMS_EVEgyReq_FD11, handle-invalid=KEEP}
      data SendCANR_HVCMS_EVEgyReq_FD11: category=VALUE, sw-calibration-access=READ-ONLY, type=ADTSHVCMS_EVEgyReq_FD11, init-value=SendCANR_HVCMS_EVEgyReq_FD11Value:131071
    SendCANR_HVCMS_EVEgyReq_FD11Vld: service-kind=ANY-STANDARDIZED, invalidation-policy{data-element=SendCANR_HVCMS_EVEgyReq_FD11Vld, handle-invalid=DONT-INVALIDATE}  # Valid
      data SendCANR_HVCMS_EVEgyReq_FD11Vld: category=VALUE, sw-calibration-access=READ-ONLY, type=ADTSBoolean, init-value=SendCANR_HVCMS_EVEgyReq_FD11VldValue:1
    SendCANR_HVCMS_EVEnergRquestFD5: service-kind=ANY-STANDARDIZED, invalidation-policy{data-element=SendCANR_HVCMS_EVEnergRquestFD5, handle-invalid=KEEP}
      data SendCANR_HVCMS_EVEnergRquestFD5: category=VALUE, sw-calibration-access=READ-ONLY, type=ADTSHVCMS_EVEnergRquestFD5, init-value=SendCANR_HVCMS_EVEnergRquestFD5Value:131071
    SendCANR_HVCMS_EVEnergRquestFD5Vld: service-kind=ANY-STANDARDIZED, invalidation-policy{data-element=SendCANR_HVCMS_EVEnergRquestFD5Vld, handle-invalid=DONT-INVALIDATE}  # Valid
      data SendCANR_HVCMS_EVEnergRquestFD5Vld: category=VALUE, sw-calibration-access=READ-ONLY, type=ADTSBoolean, init-value=SendCANR_HVCMS_EVEnergRquestFD5VldValue:1
    SendCANR_HVCMS_EVEnrgCapctFD5: service-kind=ANY-STANDARDIZED, invalidation-policy{data-element=SendCANR_HVCMS_EVEnrgCapctFD5, handle-invalid=KEEP}
      data SendCANR_HVCMS_EVEnrgCapctFD5: category=VALUE, sw-calibration-access=READ-ONLY, type=ADTSHVCMS_EVEnrgCapctFD5, init-value=SendCANR_HVCMS_EVEnrgCapctFD5Value:0
    SendCANR_HVCMS_EVEnrgCapctFD5Vld: service-kind=ANY-STANDARDIZED, invalidation-policy{data-element=SendCANR_HVCMS_EVEnrgCapctFD5Vld, handle-invalid=DONT-INVALIDATE}  # Valid
      data SendCANR_HVCMS_EVEnrgCapctFD5Vld: category=VALUE, sw-calibration-access=READ-ONLY, type=ADTSBoolean, init-value=SendCANR_HVCMS_EVEnrgCapctFD5VldValue:1
    SendCANR_HVCMS_EVErrorCode_FD11: service-kind=ANY-STANDARDIZED, invalidation-policy{data-element=SendCANR_HVCMS_EVErrorCode_FD11, handle-invalid=KEEP}
      data SendCANR_HVCMS_EVErrorCode_FD11: category=VALUE, sw-calibration-access=READ-ONLY, type=ADTSHVCMS_EVErrorCode_FD11, init-value=SendCANR_HVCMS_EVErrorCode_FD11Value:0
    SendCANR_HVCMS_EVErrorCode_FD11Vld: service-kind=ANY-STANDARDIZED, invalidation-policy{data-element=SendCANR_HVCMS_EVErrorCode_FD11Vld, handle-invalid=DONT-INVALIDATE}  # Valid
      data SendCANR_HVCMS_EVErrorCode_FD11Vld: category=VALUE, sw-calibration-access=READ-ONLY, type=ADTSBoolean, init-value=SendCANR_HVCMS_EVErrorCode_FD11VldValue:1
    SendCANR_HVCMS_EVErrorCode_FD5: service-kind=ANY-STANDARDIZED, invalidation-policy{data-element=SendCANR_HVCMS_EVErrorCode_FD5, handle-invalid=KEEP}
      data SendCANR_HVCMS_EVErrorCode_FD5: category=VALUE, sw-calibration-access=READ-ONLY, type=ADTSHVCMS_EVErrorCode_FD5, init-value=SendCANR_HVCMS_EVErrorCode_FD5Value:0
    SendCANR_HVCMS_EVErrorCode_FD5Vld: service-kind=ANY-STANDARDIZED, invalidation-policy{data-element=SendCANR_HVCMS_EVErrorCode_FD5Vld, handle-invalid=DONT-INVALIDATE}  # Valid
      data SendCANR_HVCMS_EVErrorCode_FD5Vld: category=VALUE, sw-calibration-access=READ-ONLY, type=ADTSBoolean, init-value=SendCANR_HVCMS_EVErrorCode_FD5VldValue:1
    SendCANR_HVCMS_EVMaxILimit_FD11: service-kind=ANY-STANDARDIZED, invalidation-policy{data-element=SendCANR_HVCMS_EVMaxILimit_FD11, handle-invalid=KEEP}
      data SendCANR_HVCMS_EVMaxILimit_FD11: category=VALUE, sw-calibration-access=READ-ONLY, type=ADTSHVCMS_EVMaxILimit_FD11, init-value=SendCANR_HVCMS_EVMaxILimit_FD11Value:-500
    SendCANR_HVCMS_EVMaxILimit_FD11Vld: service-kind=ANY-STANDARDIZED, invalidation-policy{data-element=SendCANR_HVCMS_EVMaxILimit_FD11Vld, handle-invalid=DONT-INVALIDATE}  # Valid
      data SendCANR_HVCMS_EVMaxILimit_FD11Vld: category=VALUE, sw-calibration-access=READ-ONLY, type=ADTSBoolean, init-value=SendCANR_HVCMS_EVMaxILimit_FD11VldValue:1
    SendCANR_HVCMS_EVMaxPLimit_FD11: service-kind=ANY-STANDARDIZED, invalidation-policy{data-element=SendCANR_HVCMS_EVMaxPLimit_FD11, handle-invalid=KEEP}
      data SendCANR_HVCMS_EVMaxPLimit_FD11: category=VALUE, sw-calibration-access=READ-ONLY, type=ADTSHVCMS_EVMaxPLimit_FD11, init-value=SendCANR_HVCMS_EVMaxPLimit_FD11Value:0
    SendCANR_HVCMS_EVMaxPLimit_FD11Vld: service-kind=ANY-STANDARDIZED, invalidation-policy{data-element=SendCANR_HVCMS_EVMaxPLimit_FD11Vld, handle-invalid=DONT-INVALIDATE}  # Valid
      data SendCANR_HVCMS_EVMaxPLimit_FD11Vld: category=VALUE, sw-calibration-access=READ-ONLY, type=ADTSBoolean, init-value=SendCANR_HVCMS_EVMaxPLimit_FD11VldValue:1
    SendCANR_HVCMS_EVMax_I_LimitFD5: service-kind=ANY-STANDARDIZED, invalidation-policy{data-element=SendCANR_HVCMS_EVMax_I_LimitFD5, handle-invalid=KEEP}
      data SendCANR_HVCMS_EVMax_I_LimitFD5: category=VALUE, sw-calibration-access=READ-ONLY, type=ADTSHVCMS_EVMax_I_LimitFD5, init-value=SendCANR_HVCMS_EVMax_I_LimitFD5Value:-500
    SendCANR_HVCMS_EVMax_I_LimitFD5Vld: service-kind=ANY-STANDARDIZED, invalidation-policy{data-element=SendCANR_HVCMS_EVMax_I_LimitFD5Vld, handle-invalid=DONT-INVALIDATE}  # Valid
      data SendCANR_HVCMS_EVMax_I_LimitFD5Vld: category=VALUE, sw-calibration-access=READ-ONLY, type=ADTSBoolean, init-value=SendCANR_HVCMS_EVMax_I_LimitFD5VldValue:1
    SendCANR_HVCMS_EVMax_P_LimitFD5: service-kind=ANY-STANDARDIZED, invalidation-policy{data-element=SendCANR_HVCMS_EVMax_P_LimitFD5, handle-invalid=KEEP}
      data SendCANR_HVCMS_EVMax_P_LimitFD5: category=VALUE, sw-calibration-access=READ-ONLY, type=ADTSHVCMS_EVMax_P_LimitFD5, init-value=SendCANR_HVCMS_EVMax_P_LimitFD5Value:0
    SendCANR_HVCMS_EVMax_P_LimitFD5Vld: service-kind=ANY-STANDARDIZED, invalidation-policy{data-element=SendCANR_HVCMS_EVMax_P_LimitFD5Vld, handle-invalid=DONT-INVALIDATE}  # Valid
      data SendCANR_HVCMS_EVMax_P_LimitFD5Vld: category=VALUE, sw-calibration-access=READ-ONLY, type=ADTSBoolean, init-value=SendCANR_HVCMS_EVMax_P_LimitFD5VldValue:1
    SendCANR_HVCMS_EVMax_V_LimitFD5: service-kind=ANY-STANDARDIZED, invalidation-policy{data-element=SendCANR_HVCMS_EVMax_V_LimitFD5, handle-invalid=KEEP}
      data SendCANR_HVCMS_EVMax_V_LimitFD5: category=VALUE, sw-calibration-access=READ-ONLY, type=ADTSHVCMS_EVMax_V_LimitFD5, init-value=SendCANR_HVCMS_EVMax_V_LimitFD5Value:0
    SendCANR_HVCMS_EVMax_V_LimitFD5Vld: service-kind=ANY-STANDARDIZED, invalidation-policy{data-element=SendCANR_HVCMS_EVMax_V_LimitFD5Vld, handle-invalid=DONT-INVALIDATE}  # Valid
      data SendCANR_HVCMS_EVMax_V_LimitFD5Vld: category=VALUE, sw-calibration-access=READ-ONLY, type=ADTSBoolean, init-value=SendCANR_HVCMS_EVMax_V_LimitFD5VldValue:1
    SendCANR_HVCMS_EVRESSCdng_FD11: service-kind=ANY-STANDARDIZED, invalidation-policy{data-element=SendCANR_HVCMS_EVRESSCdng_FD11, handle-invalid=DONT-INVALIDATE}
      data SendCANR_HVCMS_EVRESSCdng_FD11: category=VALUE, sw-calibration-access=READ-ONLY, type=ADTSBoolean, init-value=SendCANR_HVCMS_EVRESSCdng_FD11Value:0
    SendCANR_HVCMS_EVRESSCdng_FD11Vld: service-kind=ANY-STANDARDIZED, invalidation-policy{data-element=SendCANR_HVCMS_EVRESSCdng_FD11Vld, handle-invalid=DONT-INVALIDATE}  # Valid
      data SendCANR_HVCMS_EVRESSCdng_FD11Vld: category=VALUE, sw-calibration-access=READ-ONLY, type=ADTSBoolean, init-value=SendCANR_HVCMS_EVRESSCdng_FD11VldValue:1
    SendCANR_HVCMS_EVRESSCndtninFD5: service-kind=ANY-STANDARDIZED, invalidation-policy{data-element=SendCANR_HVCMS_EVRESSCndtninFD5, handle-invalid=DONT-INVALIDATE}
      data SendCANR_HVCMS_EVRESSCndtninFD5: category=VALUE, sw-calibration-access=READ-ONLY, type=ADTSBoolean, init-value=SendCANR_HVCMS_EVRESSCndtninFD5Value:0
    SendCANR_HVCMS_EVRESSCndtninFD5Vld: service-kind=ANY-STANDARDIZED, invalidation-policy{data-element=SendCANR_HVCMS_EVRESSCndtninFD5Vld, handle-invalid=DONT-INVALIDATE}  # Valid
      data SendCANR_HVCMS_EVRESSCndtninFD5Vld: category=VALUE, sw-calibration-access=READ-ONLY, type=ADTSBoolean, init-value=SendCANR_HVCMS_EVRESSCndtninFD5VldValue:1
    SendCANR_HVCMS_EVRESS_SOC_FD11: service-kind=ANY-STANDARDIZED, invalidation-policy{data-element=SendCANR_HVCMS_EVRESS_SOC_FD11, handle-invalid=KEEP}
      data SendCANR_HVCMS_EVRESS_SOC_FD11: category=VALUE, sw-calibration-access=READ-ONLY, type=ADTSHVCMS_EVRESS_SOC_FD11, init-value=SendCANR_HVCMS_EVRESS_SOC_FD11Value:0
    SendCANR_HVCMS_EVRESS_SOC_FD11Vld: service-kind=ANY-STANDARDIZED, invalidation-policy{data-element=SendCANR_HVCMS_EVRESS_SOC_FD11Vld, handle-invalid=DONT-INVALIDATE}  # Valid
      data SendCANR_HVCMS_EVRESS_SOC_FD11Vld: category=VALUE, sw-calibration-access=READ-ONLY, type=ADTSBoolean, init-value=SendCANR_HVCMS_EVRESS_SOC_FD11VldValue:1
    SendCANR_HVCMS_EVRESS_SOC_FD5: service-kind=ANY-STANDARDIZED, invalidation-policy{data-element=SendCANR_HVCMS_EVRESS_SOC_FD5, handle-invalid=KEEP}
      data SendCANR_HVCMS_EVRESS_SOC_FD5: category=VALUE, sw-calibration-access=READ-ONLY, type=ADTSHVCMS_EVRESS_SOC_FD5, init-value=SendCANR_HVCMS_EVRESS_SOC_FD5Value:0
    SendCANR_HVCMS_EVRESS_SOC_FD5Vld: service-kind=ANY-STANDARDIZED, invalidation-policy{data-element=SendCANR_HVCMS_EVRESS_SOC_FD5Vld, handle-invalid=DONT-INVALIDATE}  # Valid
      data SendCANR_HVCMS_EVRESS_SOC_FD5Vld: category=VALUE, sw-calibration-access=READ-ONLY, type=ADTSBoolean, init-value=SendCANR_HVCMS_EVRESS_SOC_FD5VldValue:1
    SendCANR_HVCMS_EVReady_FD11: service-kind=ANY-STANDARDIZED, invalidation-policy{data-element=SendCANR_HVCMS_EVReady_FD11, handle-invalid=DONT-INVALIDATE}
      data SendCANR_HVCMS_EVReady_FD11: category=VALUE, sw-calibration-access=READ-ONLY, type=ADTSBoolean, init-value=SendCANR_HVCMS_EVReady_FD11Value:0
    SendCANR_HVCMS_EVReady_FD11Vld: service-kind=ANY-STANDARDIZED, invalidation-policy{data-element=SendCANR_HVCMS_EVReady_FD11Vld, handle-invalid=DONT-INVALIDATE}  # Valid
      data SendCANR_HVCMS_EVReady_FD11Vld: category=VALUE, sw-calibration-access=READ-ONLY, type=ADTSBoolean, init-value=SendCANR_HVCMS_EVReady_FD11VldValue:1
    SendCANR_HVCMS_EVReady_FD5: service-kind=ANY-STANDARDIZED, invalidation-policy{data-element=SendCANR_HVCMS_EVReady_FD5, handle-invalid=DONT-INVALIDATE}
      data SendCANR_HVCMS_EVReady_FD5: category=VALUE, sw-calibration-access=READ-ONLY, type=ADTSBoolean, init-value=SendCANR_HVCMS_EVReady_FD5Value:0
    SendCANR_HVCMS_EVReady_FD5Vld: service-kind=ANY-STANDARDIZED, invalidation-policy{data-element=SendCANR_HVCMS_EVReady_FD5Vld, handle-invalid=DONT-INVALIDATE}  # Valid
      data SendCANR_HVCMS_EVReady_FD5Vld: category=VALUE, sw-calibration-access=READ-ONLY, type=ADTSBoolean, init-value=SendCANR_HVCMS_EVReady_FD5VldValue:1
    SendCANR_HVCMS_EVTarCurr_FD11: service-kind=ANY-STANDARDIZED, invalidation-policy{data-element=SendCANR_HVCMS_EVTarCurr_FD11, handle-invalid=KEEP}
      data SendCANR_HVCMS_EVTarCurr_FD11: category=VALUE, sw-calibration-access=READ-ONLY, type=ADTSHVCMS_EVTarCurr_FD11, init-value=SendCANR_HVCMS_EVTarCurr_FD11Value:-500
    SendCANR_HVCMS_EVTarCurr_FD11Vld: service-kind=ANY-STANDARDIZED, invalidation-policy{data-element=SendCANR_HVCMS_EVTarCurr_FD11Vld, handle-invalid=DONT-INVALIDATE}  # Valid
      data SendCANR_HVCMS_EVTarCurr_FD11Vld: category=VALUE, sw-calibration-access=READ-ONLY, type=ADTSBoolean, init-value=SendCANR_HVCMS_EVTarCurr_FD11VldValue:1
    SendCANR_HVCMS_EVTarVolt_FD11: service-kind=ANY-STANDARDIZED, invalidation-policy{data-element=SendCANR_HVCMS_EVTarVolt_FD11, handle-invalid=KEEP}
      data SendCANR_HVCMS_EVTarVolt_FD11: category=VALUE, sw-calibration-access=READ-ONLY, type=ADTSHVCMS_EVTarVolt_FD11, init-value=SendCANR_HVCMS_EVTarVolt_FD11Value:0
    SendCANR_HVCMS_EVTarVolt_FD11Vld: service-kind=ANY-STANDARDIZED, invalidation-policy{data-element=SendCANR_HVCMS_EVTarVolt_FD11Vld, handle-invalid=DONT-INVALIDATE}  # Valid
      data SendCANR_HVCMS_EVTarVolt_FD11Vld: category=VALUE, sw-calibration-access=READ-ONLY, type=ADTSBoolean, init-value=SendCANR_HVCMS_EVTarVolt_FD11VldValue:1
    SendCANR_HVCMS_EVTargetCurntFD5: service-kind=ANY-STANDARDIZED, invalidation-policy{data-element=SendCANR_HVCMS_EVTargetCurntFD5, handle-invalid=KEEP}
      data SendCANR_HVCMS_EVTargetCurntFD5: category=VALUE, sw-calibration-access=READ-ONLY, type=ADTSHVCMS_EVTargetCurntFD5, init-value=SendCANR_HVCMS_EVTargetCurntFD5Value:-500
    SendCANR_HVCMS_EVTargetCurntFD5Vld: service-kind=ANY-STANDARDIZED, invalidation-policy{data-element=SendCANR_HVCMS_EVTargetCurntFD5Vld, handle-invalid=DONT-INVALIDATE}  # Valid
      data SendCANR_HVCMS_EVTargetCurntFD5Vld: category=VALUE, sw-calibration-access=READ-ONLY, type=ADTSBoolean, init-value=SendCANR_HVCMS_EVTargetCurntFD5VldValue:1
    SendCANR_HVCMS_EVTargetVoltFD5: service-kind=ANY-STANDARDIZED, invalidation-policy{data-element=SendCANR_HVCMS_EVTargetVoltFD5, handle-invalid=KEEP}
      data SendCANR_HVCMS_EVTargetVoltFD5: category=VALUE, sw-calibration-access=READ-ONLY, type=ADTSHVCMS_EVTargetVoltFD5, init-value=SendCANR_HVCMS_EVTargetVoltFD5Value:0
    SendCANR_HVCMS_EVTargetVoltFD5Vld: service-kind=ANY-STANDARDIZED, invalidation-policy{data-element=SendCANR_HVCMS_EVTargetVoltFD5Vld, handle-invalid=DONT-INVALIDATE}  # Valid
      data SendCANR_HVCMS_EVTargetVoltFD5Vld: category=VALUE, sw-calibration-access=READ-ONLY, type=ADTSBoolean, init-value=SendCANR_HVCMS_EVTargetVoltFD5VldValue:1
    SendCANR_HVCMS_PrtclEntry1_FD11: service-kind=ANY-STANDARDIZED, invalidation-policy{data-element=SendCANR_HVCMS_PrtclEntry1_FD11, handle-invalid=KEEP}
      data SendCANR_HVCMS_PrtclEntry1_FD11: category=VALUE, sw-calibration-access=READ-ONLY, type=ADTSHVCMS_PrtclEntry1_FD11, init-value=SendCANR_HVCMS_PrtclEntry1_FD11Value:0
    SendCANR_HVCMS_PrtclEntry1_FD11Vld: service-kind=ANY-STANDARDIZED, invalidation-policy{data-element=SendCANR_HVCMS_PrtclEntry1_FD11Vld, handle-invalid=DONT-INVALIDATE}  # Valid
      data SendCANR_HVCMS_PrtclEntry1_FD11Vld: category=VALUE, sw-calibration-access=READ-ONLY, type=ADTSBoolean, init-value=SendCANR_HVCMS_PrtclEntry1_FD11VldValue:1
    SendCANR_HVCMS_PrtclEntry2_FD11: service-kind=ANY-STANDARDIZED, invalidation-policy{data-element=SendCANR_HVCMS_PrtclEntry2_FD11, handle-invalid=KEEP}
      data SendCANR_HVCMS_PrtclEntry2_FD11: category=VALUE, sw-calibration-access=READ-ONLY, type=ADTSHVCMS_PrtclEntry2_FD11, init-value=SendCANR_HVCMS_PrtclEntry2_FD11Value:0
    SendCANR_HVCMS_PrtclEntry2_FD11Vld: service-kind=ANY-STANDARDIZED, invalidation-policy{data-element=SendCANR_HVCMS_PrtclEntry2_FD11Vld, handle-invalid=DONT-INVALIDATE}  # Valid
      data SendCANR_HVCMS_PrtclEntry2_FD11Vld: category=VALUE, sw-calibration-access=READ-ONLY, type=ADTSBoolean, init-value=SendCANR_HVCMS_PrtclEntry2_FD11VldValue:1
    SendCANR_HVCMS_PrtclEntry3_FD11: service-kind=ANY-STANDARDIZED, invalidation-policy{data-element=SendCANR_HVCMS_PrtclEntry3_FD11, handle-invalid=KEEP}
      data SendCANR_HVCMS_PrtclEntry3_FD11: category=VALUE, sw-calibration-access=READ-ONLY, type=ADTSHVCMS_PrtclEntry3_FD11, init-value=SendCANR_HVCMS_PrtclEntry3_FD11Value:0
    SendCANR_HVCMS_PrtclEntry3_FD11Vld: service-kind=ANY-STANDARDIZED, invalidation-policy{data-element=SendCANR_HVCMS_PrtclEntry3_FD11Vld, handle-invalid=DONT-INVALIDATE}  # Valid
      data SendCANR_HVCMS_PrtclEntry3_FD11Vld: category=VALUE, sw-calibration-access=READ-ONLY, type=ADTSBoolean, init-value=SendCANR_HVCMS_PrtclEntry3_FD11VldValue:1
    SendCANR_HVCMS_RdyToChrgSt_FD11: service-kind=ANY-STANDARDIZED, invalidation-policy{data-element=SendCANR_HVCMS_RdyToChrgSt_FD11, handle-invalid=DONT-INVALIDATE}
      data SendCANR_HVCMS_RdyToChrgSt_FD11: category=VALUE, sw-calibration-access=READ-ONLY, type=ADTSBoolean, init-value=SendCANR_HVCMS_RdyToChrgSt_FD11Value:0
    SendCANR_HVCMS_RdyToChrgSt_FD11Vld: service-kind=ANY-STANDARDIZED, invalidation-policy{data-element=SendCANR_HVCMS_RdyToChrgSt_FD11Vld, handle-invalid=DONT-INVALIDATE}  # Valid
      data SendCANR_HVCMS_RdyToChrgSt_FD11Vld: category=VALUE, sw-calibration-access=READ-ONLY, type=ADTSBoolean, init-value=SendCANR_HVCMS_RdyToChrgSt_FD11VldValue:1
    SendCANR_HVCMS_RmnTiToBuSOCFD11: service-kind=ANY-STANDARDIZED, invalidation-policy{data-element=SendCANR_HVCMS_RmnTiToBuSOCFD11, handle-invalid=KEEP}
      data SendCANR_HVCMS_RmnTiToBuSOCFD11: category=VALUE, sw-calibration-access=READ-ONLY, type=ADTSHVCMS_RmnTiToBuSOCFD11, init-value=SendCANR_HVCMS_RmnTiToBuSOCFD11Value:0
    SendCANR_HVCMS_RmnTiToBuSOCFD11Vld: service-kind=ANY-STANDARDIZED, invalidation-policy{data-element=SendCANR_HVCMS_RmnTiToBuSOCFD11Vld, handle-invalid=DONT-INVALIDATE}  # Valid
      data SendCANR_HVCMS_RmnTiToBuSOCFD11Vld: category=VALUE, sw-calibration-access=READ-ONLY, type=ADTSBoolean, init-value=SendCANR_HVCMS_RmnTiToBuSOCFD11VldValue:1
    SendCANR_HVCMS_RmnTiToFuSOCFD11: service-kind=ANY-STANDARDIZED, invalidation-policy{data-element=SendCANR_HVCMS_RmnTiToFuSOCFD11, handle-invalid=KEEP}
      data SendCANR_HVCMS_RmnTiToFuSOCFD11: category=VALUE, sw-calibration-access=READ-ONLY, type=ADTSHVCMS_RmnTiToFuSOCFD11, init-value=SendCANR_HVCMS_RmnTiToFuSOCFD11Value:0
    SendCANR_HVCMS_RmnTiToFuSOCFD11Vld: service-kind=ANY-STANDARDIZED, invalidation-policy{data-element=SendCANR_HVCMS_RmnTiToFuSOCFD11Vld, handle-invalid=DONT-INVALIDATE}  # Valid
      data SendCANR_HVCMS_RmnTiToFuSOCFD11Vld: category=VALUE, sw-calibration-access=READ-ONLY, type=ADTSBoolean, init-value=SendCANR_HVCMS_RmnTiToFuSOCFD11VldValue:1
    SendCANR_HVCMS_SelEgyTrfTypFD11: service-kind=ANY-STANDARDIZED, invalidation-policy{data-element=SendCANR_HVCMS_SelEgyTrfTypFD11, handle-invalid=KEEP}
      data SendCANR_HVCMS_SelEgyTrfTypFD11: category=VALUE, sw-calibration-access=READ-ONLY, type=ADTSHVCMS_SelEgyTrfTypFD11, init-value=SendCANR_HVCMS_SelEgyTrfTypFD11Value:0
    SendCANR_HVCMS_SelEgyTrfTypFD11Vld: service-kind=ANY-STANDARDIZED, invalidation-policy{data-element=SendCANR_HVCMS_SelEgyTrfTypFD11Vld, handle-invalid=DONT-INVALIDATE}  # Valid
      data SendCANR_HVCMS_SelEgyTrfTypFD11Vld: category=VALUE, sw-calibration-access=READ-ONLY, type=ADTSBoolean, init-value=SendCANR_HVCMS_SelEgyTrfTypFD11VldValue:1
    SendCANR_HVCMS_SelPmtOptn_FD11: service-kind=ANY-STANDARDIZED, invalidation-policy{data-element=SendCANR_HVCMS_SelPmtOptn_FD11, handle-invalid=KEEP}
      data SendCANR_HVCMS_SelPmtOptn_FD11: category=VALUE, sw-calibration-access=READ-ONLY, type=ADTSHVCMS_SelPmtOptn_FD11, init-value=SendCANR_HVCMS_SelPmtOptn_FD11Value:0
    SendCANR_HVCMS_SelPmtOptn_FD11Vld: service-kind=ANY-STANDARDIZED, invalidation-policy{data-element=SendCANR_HVCMS_SelPmtOptn_FD11Vld, handle-invalid=DONT-INVALIDATE}  # Valid
      data SendCANR_HVCMS_SelPmtOptn_FD11Vld: category=VALUE, sw-calibration-access=READ-ONLY, type=ADTSBoolean, init-value=SendCANR_HVCMS_SelPmtOptn_FD11VldValue:1
    SendCANR_HVCMS_SelServId_FD11: service-kind=ANY-STANDARDIZED, invalidation-policy{data-element=SendCANR_HVCMS_SelServId_FD11, handle-invalid=DONT-INVALIDATE}
      data SendCANR_HVCMS_SelServId_FD11: category=VALUE, sw-calibration-access=READ-ONLY, type=ADTSHVCMS_SelServId_FD11, init-value=SendCANR_HVCMS_SelServId_FD11Value:0
    SendCANR_HVCMS_SelServId_FD11Vld: service-kind=ANY-STANDARDIZED, invalidation-policy{data-element=SendCANR_HVCMS_SelServId_FD11Vld, handle-invalid=DONT-INVALIDATE}  # Valid
      data SendCANR_HVCMS_SelServId_FD11Vld: category=VALUE, sw-calibration-access=READ-ONLY, type=ADTSBoolean, init-value=SendCANR_HVCMS_SelServId_FD11VldValue:1
    SendCANR_HVCMS_SeldPymntOptnFD5: service-kind=ANY-STANDARDIZED, invalidation-policy{data-element=SendCANR_HVCMS_SeldPymntOptnFD5, handle-invalid=KEEP}
      data SendCANR_HVCMS_SeldPymntOptnFD5: category=VALUE, sw-calibration-access=READ-ONLY, type=ADTSHVCMS_SeldPymntOptnFD5, init-value=SendCANR_HVCMS_SeldPymntOptnFD5Value:0
    SendCANR_HVCMS_SeldPymntOptnFD5Vld: service-kind=ANY-STANDARDIZED, invalidation-policy{data-element=SendCANR_HVCMS_SeldPymntOptnFD5Vld, handle-invalid=DONT-INVALIDATE}  # Valid
      data SendCANR_HVCMS_SeldPymntOptnFD5Vld: category=VALUE, sw-calibration-access=READ-ONLY, type=ADTSBoolean, init-value=SendCANR_HVCMS_SeldPymntOptnFD5VldValue:1
    SendCANR_HVCMS_ServCtgy_FD11: service-kind=ANY-STANDARDIZED, invalidation-policy{data-element=SendCANR_HVCMS_ServCtgy_FD11, handle-invalid=KEEP}
      data SendCANR_HVCMS_ServCtgy_FD11: category=VALUE, sw-calibration-access=READ-ONLY, type=ADTSHVCMS_ServCtgy_FD11, init-value=SendCANR_HVCMS_ServCtgy_FD11Value:0
    SendCANR_HVCMS_ServCtgy_FD11Vld: service-kind=ANY-STANDARDIZED, invalidation-policy{data-element=SendCANR_HVCMS_ServCtgy_FD11Vld, handle-invalid=DONT-INVALIDATE}  # Valid
      data SendCANR_HVCMS_ServCtgy_FD11Vld: category=VALUE, sw-calibration-access=READ-ONLY, type=ADTSBoolean, init-value=SendCANR_HVCMS_ServCtgy_FD11VldValue:1
    SendCANR_HVCMS_ServScope_FD11: service-kind=ANY-STANDARDIZED, invalidation-policy{data-element=SendCANR_HVCMS_ServScope_FD11, handle-invalid=KEEP}
      data SendCANR_HVCMS_ServScope_FD11: category=VALUE, sw-calibration-access=READ-ONLY, type=ADTSHVCMS_ServScope_FD11, init-value=SendCANR_HVCMS_ServScope_FD11Value:0
    SendCANR_HVCMS_ServScope_FD11Vld: service-kind=ANY-STANDARDIZED, invalidation-policy{data-element=SendCANR_HVCMS_ServScope_FD11Vld, handle-invalid=DONT-INVALIDATE}  # Valid
      data SendCANR_HVCMS_ServScope_FD11Vld: category=VALUE, sw-calibration-access=READ-ONLY, type=ADTSBoolean, init-value=SendCANR_HVCMS_ServScope_FD11VldValue:1
    SendCANR_HVCMS_ServiceScope_FD5: service-kind=ANY-STANDARDIZED, invalidation-policy{data-element=SendCANR_HVCMS_ServiceScope_FD5, handle-invalid=KEEP}
      data SendCANR_HVCMS_ServiceScope_FD5: category=VALUE, sw-calibration-access=READ-ONLY, type=ADTSHVCMS_ServiceScope_FD5, init-value=SendCANR_HVCMS_ServiceScope_FD5Value:0
    SendCANR_HVCMS_ServiceScope_FD5Vld: service-kind=ANY-STANDARDIZED, invalidation-policy{data-element=SendCANR_HVCMS_ServiceScope_FD5Vld, handle-invalid=DONT-INVALIDATE}  # Valid
      data SendCANR_HVCMS_ServiceScope_FD5Vld: category=VALUE, sw-calibration-access=READ-ONLY, type=ADTSBoolean, init-value=SendCANR_HVCMS_ServiceScope_FD5VldValue:1
    SendCANR_HeaterCoreInletTemp: service-kind=ANY-STANDARDIZED, invalidation-policy{data-element=SendCANR_HeaterCoreInletTemp, handle-invalid=KEEP}
      data SendCANR_HeaterCoreInletTemp: category=VALUE, sw-calibration-access=READ-ONLY, type=ADTSHeaterCoreInletTemp, init-value=SendCANR_HeaterCoreInletTempValue:-40
    SendCANR_HeaterCoreInletTempVld: service-kind=ANY-STANDARDIZED, invalidation-policy{data-element=SendCANR_HeaterCoreInletTempVld, handle-invalid=DONT-INVALIDATE}  # Valid
      data SendCANR_HeaterCoreInletTempVld: category=VALUE, sw-calibration-access=READ-ONLY, type=ADTSBoolean, init-value=SendCANR_HeaterCoreInletTempVldValue:1
    SendCANR_HybridDriveModeSts: service-kind=ANY-STANDARDIZED, invalidation-policy{data-element=SendCANR_HybridDriveModeSts, handle-invalid=KEEP}
      data SendCANR_HybridDriveModeSts: category=VALUE, sw-calibration-access=READ-ONLY, type=ADTSHybridDriveModeSts, init-value=SendCANR_HybridDriveModeStsValue:0
    SendCANR_HybridDriveModeStsVld: service-kind=ANY-STANDARDIZED, invalidation-policy{data-element=SendCANR_HybridDriveModeStsVld, handle-invalid=DONT-INVALIDATE}  # Valid
      data SendCANR_HybridDriveModeStsVld: category=VALUE, sw-calibration-access=READ-ONLY, type=ADTSBoolean, init-value=SendCANR_HybridDriveModeStsVldValue:1
    SendCANR_IMPACTCommand_FD11: service-kind=ANY-STANDARDIZED, invalidation-policy{data-element=SendCANR_IMPACTCommand_FD11, handle-invalid=DONT-INVALIDATE}
      data SendCANR_IMPACTCommand_FD11: category=VALUE, sw-calibration-access=READ-ONLY, type=ADTSBoolean, init-value=SendCANR_IMPACTCommand_FD11Value:0
    SendCANR_IMPACTCommand_FD11Vld: service-kind=ANY-STANDARDIZED, invalidation-policy{data-element=SendCANR_IMPACTCommand_FD11Vld, handle-invalid=DONT-INVALIDATE}  # Valid
      data SendCANR_IMPACTCommand_FD11Vld: category=VALUE, sw-calibration-access=READ-ONLY, type=ADTSBoolean, init-value=SendCANR_IMPACTCommand_FD11VldValue:1
    SendCANR_IMPACTCommand_FD16: service-kind=ANY-STANDARDIZED, invalidation-policy{data-element=SendCANR_IMPACTCommand_FD16, handle-invalid=DONT-INVALIDATE}
      data SendCANR_IMPACTCommand_FD16: category=VALUE, sw-calibration-access=READ-ONLY, type=ADTSBoolean, init-value=SendCANR_IMPACTCommand_FD16Value:0
    SendCANR_IMPACTCommand_FD16Vld: service-kind=ANY-STANDARDIZED, invalidation-policy{data-element=SendCANR_IMPACTCommand_FD16Vld, handle-invalid=DONT-INVALIDATE}  # Valid
      data SendCANR_IMPACTCommand_FD16Vld: category=VALUE, sw-calibration-access=READ-ONLY, type=ADTSBoolean, init-value=SendCANR_IMPACTCommand_FD16VldValue:1
    SendCANR_IMPACTCommand_FD5: service-kind=ANY-STANDARDIZED, invalidation-policy{data-element=SendCANR_IMPACTCommand_FD5, handle-invalid=DONT-INVALIDATE}
      data SendCANR_IMPACTCommand_FD5: category=VALUE, sw-calibration-access=READ-ONLY, type=ADTSBoolean, init-value=SendCANR_IMPACTCommand_FD5Value:0
    SendCANR_IMPACTCommand_FD5Vld: service-kind=ANY-STANDARDIZED, invalidation-policy{data-element=SendCANR_IMPACTCommand_FD5Vld, handle-invalid=DONT-INVALIDATE}  # Valid
      data SendCANR_IMPACTCommand_FD5Vld: category=VALUE, sw-calibration-access=READ-ONLY, type=ADTSBoolean, init-value=SendCANR_IMPACTCommand_FD5VldValue:1
    SendCANR_IMPACTConfirm_FD11: service-kind=ANY-STANDARDIZED, invalidation-policy{data-element=SendCANR_IMPACTConfirm_FD11, handle-invalid=DONT-INVALIDATE}
      data SendCANR_IMPACTConfirm_FD11: category=VALUE, sw-calibration-access=READ-ONLY, type=ADTSBoolean, init-value=SendCANR_IMPACTConfirm_FD11Value:1
    SendCANR_IMPACTConfirm_FD11Vld: service-kind=ANY-STANDARDIZED, invalidation-policy{data-element=SendCANR_IMPACTConfirm_FD11Vld, handle-invalid=DONT-INVALIDATE}  # Valid
      data SendCANR_IMPACTConfirm_FD11Vld: category=VALUE, sw-calibration-access=READ-ONLY, type=ADTSBoolean, init-value=SendCANR_IMPACTConfirm_FD11VldValue:1
    SendCANR_IMPACTConfirm_FD16: service-kind=ANY-STANDARDIZED, invalidation-policy{data-element=SendCANR_IMPACTConfirm_FD16, handle-invalid=DONT-INVALIDATE}
      data SendCANR_IMPACTConfirm_FD16: category=VALUE, sw-calibration-access=READ-ONLY, type=ADTSBoolean, init-value=SendCANR_IMPACTConfirm_FD16Value:1
    SendCANR_IMPACTConfirm_FD16Vld: service-kind=ANY-STANDARDIZED, invalidation-policy{data-element=SendCANR_IMPACTConfirm_FD16Vld, handle-invalid=DONT-INVALIDATE}  # Valid
      data SendCANR_IMPACTConfirm_FD16Vld: category=VALUE, sw-calibration-access=READ-ONLY, type=ADTSBoolean, init-value=SendCANR_IMPACTConfirm_FD16VldValue:1
    SendCANR_IMPACTConfirm_FD5: service-kind=ANY-STANDARDIZED, invalidation-policy{data-element=SendCANR_IMPACTConfirm_FD5, handle-invalid=DONT-INVALIDATE}
      data SendCANR_IMPACTConfirm_FD5: category=VALUE, sw-calibration-access=READ-ONLY, type=ADTSBoolean, init-value=SendCANR_IMPACTConfirm_FD5Value:1
    SendCANR_IMPACTConfirm_FD5Vld: service-kind=ANY-STANDARDIZED, invalidation-policy{data-element=SendCANR_IMPACTConfirm_FD5Vld, handle-invalid=DONT-INVALIDATE}  # Valid
      data SendCANR_IMPACTConfirm_FD5Vld: category=VALUE, sw-calibration-access=READ-ONLY, type=ADTSBoolean, init-value=SendCANR_IMPACTConfirm_FD5VldValue:1
    SendCANR_IgnitionOnCounter_FD11: service-kind=ANY-STANDARDIZED, invalidation-policy{data-element=SendCANR_IgnitionOnCounter_FD11, handle-invalid=DONT-INVALIDATE}
      data SendCANR_IgnitionOnCounter_FD11: category=VALUE, sw-calibration-access=READ-ONLY, type=ADTSIgnitionOnCounter_FD11, init-value=SendCANR_IgnitionOnCounter_FD11Value:0
    SendCANR_IgnitionOnCounter_FD11Vld: service-kind=ANY-STANDARDIZED, invalidation-policy{data-element=SendCANR_IgnitionOnCounter_FD11Vld, handle-invalid=DONT-INVALIDATE}  # Valid
      data SendCANR_IgnitionOnCounter_FD11Vld: category=VALUE, sw-calibration-access=READ-ONLY, type=ADTSBoolean, init-value=SendCANR_IgnitionOnCounter_FD11VldValue:1
    SendCANR_IgnitionOnCounter_FD5: service-kind=ANY-STANDARDIZED, invalidation-policy{data-element=SendCANR_IgnitionOnCounter_FD5, handle-invalid=DONT-INVALIDATE}
      data SendCANR_IgnitionOnCounter_FD5: category=VALUE, sw-calibration-access=READ-ONLY, type=ADTSIgnitionOnCounter_FD5, init-value=SendCANR_IgnitionOnCounter_FD5Value:0
    SendCANR_IgnitionOnCounter_FD5Vld: service-kind=ANY-STANDARDIZED, invalidation-policy{data-element=SendCANR_IgnitionOnCounter_FD5Vld, handle-invalid=DONT-INVALIDATE}  # Valid
      data SendCANR_IgnitionOnCounter_FD5Vld: category=VALUE, sw-calibration-access=READ-ONLY, type=ADTSBoolean, init-value=SendCANR_IgnitionOnCounter_FD5VldValue:1
    SendCANR_ImmediatChrgTarget1Sts: service-kind=ANY-STANDARDIZED, invalidation-policy{data-element=SendCANR_ImmediatChrgTarget1Sts, handle-invalid=DONT-INVALIDATE}
      data SendCANR_ImmediatChrgTarget1Sts: category=VALUE, sw-calibration-access=READ-ONLY, type=ADTSImmediatChrgTarget1Sts, init-value=SendCANR_ImmediatChrgTarget1StsValue:75
    SendCANR_ImmediatChrgTarget1StsVld: service-kind=ANY-STANDARDIZED, invalidation-policy{data-element=SendCANR_ImmediatChrgTarget1StsVld, handle-invalid=DONT-INVALIDATE}  # Valid
      data SendCANR_ImmediatChrgTarget1StsVld: category=VALUE, sw-calibration-access=READ-ONLY, type=ADTSBoolean, init-value=SendCANR_ImmediatChrgTarget1StsVldValue:1
    SendCANR_ImmediatChrgTarget2Sts: service-kind=ANY-STANDARDIZED, invalidation-policy{data-element=SendCANR_ImmediatChrgTarget2Sts, handle-invalid=DONT-INVALIDATE}
      data SendCANR_ImmediatChrgTarget2Sts: category=VALUE, sw-calibration-access=READ-ONLY, type=ADTSImmediatChrgTarget2Sts, init-value=SendCANR_ImmediatChrgTarget2StsValue:75
    SendCANR_ImmediatChrgTarget2StsVld: service-kind=ANY-STANDARDIZED, invalidation-policy{data-element=SendCANR_ImmediatChrgTarget2StsVld, handle-invalid=DONT-INVALIDATE}  # Valid
      data SendCANR_ImmediatChrgTarget2StsVld: category=VALUE, sw-calibration-access=READ-ONLY, type=ADTSBoolean, init-value=SendCANR_ImmediatChrgTarget2StsVldValue:1
    SendCANR_LID_Status_120VSocketA: service-kind=ANY-STANDARDIZED, invalidation-policy{data-element=SendCANR_LID_Status_120VSocketA, handle-invalid=DONT-INVALIDATE}
      data SendCANR_LID_Status_120VSocketA: category=VALUE, sw-calibration-access=READ-ONLY, type=ADTSBoolean, init-value=SendCANR_LID_Status_120VSocketAValue:0
    SendCANR_LID_Status_120VSocketA_Vld: service-kind=ANY-STANDARDIZED, invalidation-policy{data-element=SendCANR_LID_Status_120VSocketA_Vld, handle-invalid=DONT-INVALIDATE}  # Valid
      data SendCANR_LID_Status_120VSocketA_Vld: category=VALUE, sw-calibration-access=READ-ONLY, type=ADTSBoolean, init-value=SendCANR_LID_Status_120VSocketA_VldValue:1
    SendCANR_LID_Status_120VSocketB: service-kind=ANY-STANDARDIZED, invalidation-policy{data-element=SendCANR_LID_Status_120VSocketB, handle-invalid=DONT-INVALIDATE}
      data SendCANR_LID_Status_120VSocketB: category=VALUE, sw-calibration-access=READ-ONLY, type=ADTSBoolean, init-value=SendCANR_LID_Status_120VSocketBValue:0
    SendCANR_LID_Status_120VSocketB_Vld: service-kind=ANY-STANDARDIZED, invalidation-policy{data-element=SendCANR_LID_Status_120VSocketB_Vld, handle-invalid=DONT-INVALIDATE}  # Valid
      data SendCANR_LID_Status_120VSocketB_Vld: category=VALUE, sw-calibration-access=READ-ONLY, type=ADTSBoolean, init-value=SendCANR_LID_Status_120VSocketB_VldValue:1
    SendCANR_LID_Status_240V_Socket: service-kind=ANY-STANDARDIZED, invalidation-policy{data-element=SendCANR_LID_Status_240V_Socket, handle-invalid=DONT-INVALIDATE}
      data SendCANR_LID_Status_240V_Socket: category=VALUE, sw-calibration-access=READ-ONLY, type=ADTSBoolean, init-value=SendCANR_LID_Status_240V_SocketValue:0
    SendCANR_LID_Status_240V_SocketVld: service-kind=ANY-STANDARDIZED, invalidation-policy{data-element=SendCANR_LID_Status_240V_SocketVld, handle-invalid=DONT-INVALIDATE}  # Valid
      data SendCANR_LID_Status_240V_SocketVld: category=VALUE, sw-calibration-access=READ-ONLY, type=ADTSBoolean, init-value=SendCANR_LID_Status_240V_SocketVldValue:1
    SendCANR_LOC_DiagEnable_ePT: service-kind=ANY-STANDARDIZED, invalidation-policy{data-element=SendCANR_LOC_DiagEnable_ePT, handle-invalid=DONT-INVALIDATE}
      data SendCANR_LOC_DiagEnable_ePT: category=VALUE, sw-calibration-access=READ-ONLY, type=ADTSLOC_DiagEnable_ePT, init-value=SendCANR_LOC_DiagEnable_ePTValue:0
    SendCANR_LOC_DiagEnable_ePT_Vld: service-kind=ANY-STANDARDIZED, invalidation-policy{data-element=SendCANR_LOC_DiagEnable_ePT_Vld, handle-invalid=DONT-INVALIDATE}  # Valid
      data SendCANR_LOC_DiagEnable_ePT_Vld: category=VALUE, sw-calibration-access=READ-ONLY, type=ADTSBoolean, init-value=SendCANR_LOC_DiagEnable_ePT_VldValue:1
    SendCANR_LTR_PumpFlowRequest: service-kind=ANY-STANDARDIZED, invalidation-policy{data-element=SendCANR_LTR_PumpFlowRequest, handle-invalid=KEEP}
      data SendCANR_LTR_PumpFlowRequest: category=VALUE, sw-calibration-access=READ-ONLY, type=ADTSLTR_PumpFlowRequest, init-value=SendCANR_LTR_PumpFlowRequestValue:0
    SendCANR_LTR_PumpFlowRequestVld: service-kind=ANY-STANDARDIZED, invalidation-policy{data-element=SendCANR_LTR_PumpFlowRequestVld, handle-invalid=DONT-INVALIDATE}  # Valid
      data SendCANR_LTR_PumpFlowRequestVld: category=VALUE, sw-calibration-access=READ-ONLY, type=ADTSBoolean, init-value=SendCANR_LTR_PumpFlowRequestVldValue:1
    SendCANR_Launch_Hard_Btn_LED: service-kind=ANY-STANDARDIZED, invalidation-policy{data-element=SendCANR_Launch_Hard_Btn_LED, handle-invalid=KEEP}
      data SendCANR_Launch_Hard_Btn_LED: category=VALUE, sw-calibration-access=READ-ONLY, type=ADTSLaunch_Hard_Btn_LED, init-value=SendCANR_Launch_Hard_Btn_LEDValue:0
    SendCANR_Launch_Hard_Btn_LED_Vld: service-kind=ANY-STANDARDIZED, invalidation-policy{data-element=SendCANR_Launch_Hard_Btn_LED_Vld, handle-invalid=DONT-INVALIDATE}  # Valid
      data SendCANR_Launch_Hard_Btn_LED_Vld: category=VALUE, sw-calibration-access=READ-ONLY, type=ADTSBoolean, init-value=SendCANR_Launch_Hard_Btn_LED_VldValue:1
    SendCANR_LidClosingAck: service-kind=ANY-STANDARDIZED, invalidation-policy{data-element=SendCANR_LidClosingAck, handle-invalid=KEEP}
      data SendCANR_LidClosingAck: category=VALUE, sw-calibration-access=READ-ONLY, type=ADTSLidClosingAck, init-value=SendCANR_LidClosingAckValue:0
    SendCANR_LidClosingAckVld: service-kind=ANY-STANDARDIZED, invalidation-policy{data-element=SendCANR_LidClosingAckVld, handle-invalid=DONT-INVALIDATE}  # Valid
      data SendCANR_LidClosingAckVld: category=VALUE, sw-calibration-access=READ-ONLY, type=ADTSBoolean, init-value=SendCANR_LidClosingAckVldValue:1
    SendCANR_LidOpeningAck: service-kind=ANY-STANDARDIZED, invalidation-policy{data-element=SendCANR_LidOpeningAck, handle-invalid=KEEP}
      data SendCANR_LidOpeningAck: category=VALUE, sw-calibration-access=READ-ONLY, type=ADTSLidOpeningAck, init-value=SendCANR_LidOpeningAckValue:0
    SendCANR_LidOpeningAckVld: service-kind=ANY-STANDARDIZED, invalidation-policy{data-element=SendCANR_LidOpeningAckVld, handle-invalid=DONT-INVALIDATE}  # Valid
      data SendCANR_LidOpeningAckVld: category=VALUE, sw-calibration-access=READ-ONLY, type=ADTSBoolean, init-value=SendCANR_LidOpeningAckVldValue:1
    SendCANR_Lv1_EstChargeTime_80: service-kind=ANY-STANDARDIZED, invalidation-policy{data-element=SendCANR_Lv1_EstChargeTime_80, handle-invalid=KEEP}
      data SendCANR_Lv1_EstChargeTime_80: category=VALUE, sw-calibration-access=READ-ONLY, type=ADTSLv1_EstChargeTime_80, init-value=SendCANR_Lv1_EstChargeTime_80Value:0
    SendCANR_Lv1_EstChargeTime_80Vld: service-kind=ANY-STANDARDIZED, invalidation-policy{data-element=SendCANR_Lv1_EstChargeTime_80Vld, handle-invalid=DONT-INVALIDATE}  # Valid
      data SendCANR_Lv1_EstChargeTime_80Vld: category=VALUE, sw-calibration-access=READ-ONLY, type=ADTSBoolean, init-value=SendCANR_Lv1_EstChargeTime_80VldValue:1
    SendCANR_Lv2_EstChargeTime_80: service-kind=ANY-STANDARDIZED, invalidation-policy{data-element=SendCANR_Lv2_EstChargeTime_80, handle-invalid=KEEP}
      data SendCANR_Lv2_EstChargeTime_80: category=VALUE, sw-calibration-access=READ-ONLY, type=ADTSLv2_EstChargeTime_80, init-value=SendCANR_Lv2_EstChargeTime_80Value:0
    SendCANR_Lv2_EstChargeTime_80Vld: service-kind=ANY-STANDARDIZED, invalidation-policy{data-element=SendCANR_Lv2_EstChargeTime_80Vld, handle-invalid=DONT-INVALIDATE}  # Valid
      data SendCANR_Lv2_EstChargeTime_80Vld: category=VALUE, sw-calibration-access=READ-ONLY, type=ADTSBoolean, init-value=SendCANR_Lv2_EstChargeTime_80VldValue:1
