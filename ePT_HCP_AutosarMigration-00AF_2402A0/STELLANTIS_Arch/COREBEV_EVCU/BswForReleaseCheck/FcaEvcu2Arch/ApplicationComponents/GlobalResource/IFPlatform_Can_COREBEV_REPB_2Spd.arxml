[part 2 of 3: package /STLASharedInterfaces/IFCOEs/IFPlatform_Can]
AUTOSAR XML (schema 4-3-0)
package /STLASharedInterfaces/IFCOEs/IFPlatform_Can  (continued)
  1752 x sender receiver interface:  (continued)
    SendCANR_MCPA_DC_Current_P_FD11: service-kind=ANY-STANDARDIZED, invalidation-policy{data-element=SendCANR_MCPA_DC_Current_P_FD11, handle-invalid=DONT-INVALIDATE}
      data SendCANR_MCPA_DC_Current_P_FD11: category=VALUE, sw-calibration-access=READ-ONLY, type=ADTSMCPA_DC_Current_P_FD11, init-value=SendCANR_MCPA_DC_Current_P_FD11Value:0
    SendCANR_MCPA_DC_Current_P_FD11Vld: service-kind=ANY-STANDARDIZED, invalidation-policy{data-element=SendCANR_MCPA_DC_Current_P_FD11Vld, handle-invalid=DONT-INVALIDATE}  # Valid
      data SendCANR_MCPA_DC_Current_P_FD11Vld: category=VALUE, sw-calibration-access=READ-ONLY, type=ADTSBoolean, init-value=SendCANR_MCPA_DC_Current_P_FD11VldValue:1
    SendCANR_MCPA_Temp_FD11: service-kind=ANY-STANDARDIZED, invalidation-policy{data-element=SendCANR_MCPA_Temp_FD11, handle-invalid=KEEP}
      data SendCANR_MCPA_Temp_FD11: category=VALUE, sw-calibration-access=READ-ONLY, type=ADTSMCPA_Temp_FD11, init-value=SendCANR_MCPA_Temp_FD11Value:0
    SendCANR_MCPA_Temp_FD11Vld: service-kind=ANY-STANDARDIZED, invalidation-policy{data-element=SendCANR_MCPA_Temp_FD11Vld, handle-invalid=DONT-INVALIDATE}  # Valid
      data SendCANR_MCPA_Temp_FD11Vld: category=VALUE, sw-calibration-access=READ-ONLY, type=ADTSBoolean, init-value=SendCANR_MCPA_Temp_FD11VldValue:1
    SendCANR_MCPA_Temp_FD3: service-kind=ANY-STANDARDIZED, invalidation-policy{data-element=SendCANR_MCPA_Temp_FD3, handle-invalid=KEEP}
      data SendCANR_MCPA_Temp_FD3: category=VALUE, sw-calibration-access=READ-ONLY, type=ADTSMCPA_Temp_FD3, init-value=SendCANR_MCPA_Temp_FD3Value:0
    SendCANR_MCPA_Temp_FD3Vld: service-kind=ANY-STANDARDIZED, invalidation-policy{data-element=SendCANR_MCPA_Temp_FD3Vld, handle-invalid=DONT-INVALIDATE}  # Valid
      data SendCANR_MCPA_Temp_FD3Vld: category=VALUE, sw-calibration-access=READ-ONLY, type=ADTSBoolean, init-value=SendCANR_MCPA_Temp_FD3VldValue:1
    SendCANR_MCPB_DC_Current_P_FD11: service-kind=ANY-STANDARDIZED, invalidation-policy{data-element=SendCANR_MCPB_DC_Current_P_FD11, handle-invalid=DONT-INVALIDATE}
      data SendCANR_MCPB_DC_Current_P_FD11: category=VALUE, sw-calibration-access=READ-ONLY, type=ADTSMCPB_DC_Current_P_FD11, init-value=SendCANR_MCPB_DC_Current_P_FD11Value:0
    SendCANR_MCPB_DC_Current_P_FD11Vld: service-kind=ANY-STANDARDIZED, invalidation-policy{data-element=SendCANR_MCPB_DC_Current_P_FD11Vld, handle-invalid=DONT-INVALIDATE}  # Valid
      data SendCANR_MCPB_DC_Current_P_FD11Vld: category=VALUE, sw-calibration-access=READ-ONLY, type=ADTSBoolean, init-value=SendCANR_MCPB_DC_Current_P_FD11VldValue:1
    SendCANR_MCPB_Temp_FD11: service-kind=ANY-STANDARDIZED, invalidation-policy{data-element=SendCANR_MCPB_Temp_FD11, handle-invalid=KEEP}
      data SendCANR_MCPB_Temp_FD11: category=VALUE, sw-calibration-access=READ-ONLY, type=ADTSMCPB_Temp_FD11, init-value=SendCANR_MCPB_Temp_FD11Value:0
    SendCANR_MCPB_Temp_FD11Vld: service-kind=ANY-STANDARDIZED, invalidation-policy{data-element=SendCANR_MCPB_Temp_FD11Vld, handle-invalid=DONT-INVALIDATE}  # Valid
      data SendCANR_MCPB_Temp_FD11Vld: category=VALUE, sw-calibration-access=READ-ONLY, type=ADTSBoolean, init-value=SendCANR_MCPB_Temp_FD11VldValue:1
    SendCANR_MC_HYBD_THRML_CMD_FD5: service-kind=ANY-STANDARDIZED, invalidation-policy{data-element=SendCANR_MC_HYBD_THRML_CMD_FD5, handle-invalid=DONT-INVALIDATE}
      data SendCANR_MC_HYBD_THRML_CMD_FD5: category=VALUE, sw-calibration-access=READ-ONLY, type=ADTSMC_HYBD_THRML_CMD_FD5, init-value=SendCANR_MC_HYBD_THRML_CMD_FD5Value:0
    SendCANR_MC_HYBD_THRML_CMD_FD5Vld: service-kind=ANY-STANDARDIZED, invalidation-policy{data-element=SendCANR_MC_HYBD_THRML_CMD_FD5Vld, handle-invalid=DONT-INVALIDATE}  # Valid
      data SendCANR_MC_HYBD_THRML_CMD_FD5Vld: category=VALUE, sw-calibration-access=READ-ONLY, type=ADTSBoolean, init-value=SendCANR_MC_HYBD_THRML_CMD_FD5VldValue:1
    SendCANR_MC_HYBD_THRM_CMND_FD16: service-kind=ANY-STANDARDIZED, invalidation-policy{data-element=SendCANR_MC_HYBD_THRM_CMND_FD16, handle-invalid=DONT-INVALIDATE}
      data SendCANR_MC_HYBD_THRM_CMND_FD16: category=VALUE, sw-calibration-access=READ-ONLY, type=ADTSMC_HYBD_THRM_CMND_FD16, init-value=SendCANR_MC_HYBD_THRM_CMND_FD16Value:0
    SendCANR_MC_HYBD_THRM_CMND_FD16Vld: service-kind=ANY-STANDARDIZED, invalidation-policy{data-element=SendCANR_MC_HYBD_THRM_CMND_FD16Vld, handle-invalid=DONT-INVALIDATE}  # Valid
      data SendCANR_MC_HYBD_THRM_CMND_FD16Vld: category=VALUE, sw-calibration-access=READ-ONLY, type=ADTSBoolean, init-value=SendCANR_MC_HYBD_THRM_CMND_FD16VldValue:1
    SendCANR_MC_HYBRID_DISPLAY2: service-kind=ANY-STANDARDIZED, invalidation-policy{data-element=SendCANR_MC_HYBRID_DISPLAY2, handle-invalid=DONT-INVALIDATE}
      data SendCANR_MC_HYBRID_DISPLAY2: category=VALUE, sw-calibration-access=READ-ONLY, type=ADTSMC_HYBRID_DISPLAY2, init-value=SendCANR_MC_HYBRID_DISPLAY2Value:0
    SendCANR_MC_HYBRID_DISPLAY2Vld: service-kind=ANY-STANDARDIZED, invalidation-policy{data-element=SendCANR_MC_HYBRID_DISPLAY2Vld, handle-invalid=DONT-INVALIDATE}  # Valid
      data SendCANR_MC_HYBRID_DISPLAY2Vld: category=VALUE, sw-calibration-access=READ-ONLY, type=ADTSBoolean, init-value=SendCANR_MC_HYBRID_DISPLAY2VldValue:1
    SendCANR_MC_MCPA_STATUS_FD11: service-kind=ANY-STANDARDIZED, invalidation-policy{data-element=SendCANR_MC_MCPA_STATUS_FD11, handle-invalid=DONT-INVALIDATE}
      data SendCANR_MC_MCPA_STATUS_FD11: category=VALUE, sw-calibration-access=READ-ONLY, type=ADTSMC_MCPA_STATUS_FD11, init-value=SendCANR_MC_MCPA_STATUS_FD11Value:0
    SendCANR_MC_MCPA_STATUS_FD11Vld: service-kind=ANY-STANDARDIZED, invalidation-policy{data-element=SendCANR_MC_MCPA_STATUS_FD11Vld, handle-invalid=DONT-INVALIDATE}  # Valid
      data SendCANR_MC_MCPA_STATUS_FD11Vld: category=VALUE, sw-calibration-access=READ-ONLY, type=ADTSBoolean, init-value=SendCANR_MC_MCPA_STATUS_FD11VldValue:1
    SendCANR_MC_MCPB_STATUS_FD11: service-kind=ANY-STANDARDIZED, invalidation-policy{data-element=SendCANR_MC_MCPB_STATUS_FD11, handle-invalid=DONT-INVALIDATE}
      data SendCANR_MC_MCPB_STATUS_FD11: category=VALUE, sw-calibration-access=READ-ONLY, type=ADTSMC_MCPB_STATUS_FD11, init-value=SendCANR_MC_MCPB_STATUS_FD11Value:0
    SendCANR_MC_MCPB_STATUS_FD11Vld: service-kind=ANY-STANDARDIZED, invalidation-policy{data-element=SendCANR_MC_MCPB_STATUS_FD11Vld, handle-invalid=DONT-INVALIDATE}  # Valid
      data SendCANR_MC_MCPB_STATUS_FD11Vld: category=VALUE, sw-calibration-access=READ-ONLY, type=ADTSBoolean, init-value=SendCANR_MC_MCPB_STATUS_FD11VldValue:1
    SendCANR_MaxPwrOutput: service-kind=ANY-STANDARDIZED, invalidation-policy{data-element=SendCANR_MaxPwrOutput, handle-invalid=KEEP}
      data SendCANR_MaxPwrOutput: category=VALUE, sw-calibration-access=READ-ONLY, type=ADTSMaxPwrOutput, init-value=SendCANR_MaxPwrOutputValue:0
    SendCANR_MaxPwrOutputVld: service-kind=ANY-STANDARDIZED, invalidation-policy{data-element=SendCANR_MaxPwrOutputVld, handle-invalid=DONT-INVALIDATE}  # Valid
      data SendCANR_MaxPwrOutputVld: category=VALUE, sw-calibration-access=READ-ONLY, type=ADTSBoolean, init-value=SendCANR_MaxPwrOutputVldValue:1
    SendCANR_MaxTorqueOutput: service-kind=ANY-STANDARDIZED, invalidation-policy{data-element=SendCANR_MaxTorqueOutput, handle-invalid=KEEP}
      data SendCANR_MaxTorqueOutput: category=VALUE, sw-calibration-access=READ-ONLY, type=ADTSMaxTorqueOutput, init-value=SendCANR_MaxTorqueOutputValue:0
    SendCANR_MaxTorqueOutputVld: service-kind=ANY-STANDARDIZED, invalidation-policy{data-element=SendCANR_MaxTorqueOutputVld, handle-invalid=DONT-INVALIDATE}  # Valid
      data SendCANR_MaxTorqueOutputVld: category=VALUE, sw-calibration-access=READ-ONLY, type=ADTSBoolean, init-value=SendCANR_MaxTorqueOutputVldValue:1
    SendCANR_Max_AllwdACOutputCurL1: service-kind=ANY-STANDARDIZED, invalidation-policy{data-element=SendCANR_Max_AllwdACOutputCurL1, handle-invalid=DONT-INVALIDATE}
      data SendCANR_Max_AllwdACOutputCurL1: category=VALUE, sw-calibration-access=READ-ONLY, type=ADTSMax_AllwdACOutputCurL1, init-value=SendCANR_Max_AllwdACOutputCurL1Value:0
    SendCANR_Max_AllwdACOutputCurL1Vld: service-kind=ANY-STANDARDIZED, invalidation-policy{data-element=SendCANR_Max_AllwdACOutputCurL1Vld, handle-invalid=DONT-INVALIDATE}  # Valid
      data SendCANR_Max_AllwdACOutputCurL1Vld: category=VALUE, sw-calibration-access=READ-ONLY, type=ADTSBoolean, init-value=SendCANR_Max_AllwdACOutputCurL1VldValue:1
    SendCANR_Max_AllwdACOutputVltL1: service-kind=ANY-STANDARDIZED, invalidation-policy{data-element=SendCANR_Max_AllwdACOutputVltL1, handle-invalid=DONT-INVALIDATE}
      data SendCANR_Max_AllwdACOutputVltL1: category=VALUE, sw-calibration-access=READ-ONLY, type=ADTSMax_AllwdACOutputVltL1, init-value=SendCANR_Max_AllwdACOutputVltL1Value:0
    SendCANR_Max_AllwdACOutputVltL1Vld: service-kind=ANY-STANDARDIZED, invalidation-policy{data-element=SendCANR_Max_AllwdACOutputVltL1Vld, handle-invalid=DONT-INVALIDATE}  # Valid
      data SendCANR_Max_AllwdACOutputVltL1Vld: category=VALUE, sw-calibration-access=READ-ONLY, type=ADTSBoolean, init-value=SendCANR_Max_AllwdACOutputVltL1VldValue:1
    SendCANR_MessgCounterHVBATTERY2: service-kind=ANY-STANDARDIZED, invalidation-policy{data-element=SendCANR_MessgCounterHVBATTERY2, handle-invalid=DONT-INVALIDATE}
      data SendCANR_MessgCounterHVBATTERY2: category=VALUE, sw-calibration-access=READ-ONLY, type=ADTSMessgCounterHVBATTERY2, init-value=SendCANR_MessgCounterHVBATTERY2Value:0
    SendCANR_MessgCounterHVBATTERY2Vld: service-kind=ANY-STANDARDIZED, invalidation-policy{data-element=SendCANR_MessgCounterHVBATTERY2Vld, handle-invalid=DONT-INVALIDATE}  # Valid
      data SendCANR_MessgCounterHVBATTERY2Vld: category=VALUE, sw-calibration-access=READ-ONLY, type=ADTSBoolean, init-value=SendCANR_MessgCounterHVBATTERY2VldValue:1
    SendCANR_MinBatteryPackVoltage: service-kind=ANY-STANDARDIZED, invalidation-policy{data-element=SendCANR_MinBatteryPackVoltage, handle-invalid=DONT-INVALIDATE}
      data SendCANR_MinBatteryPackVoltage: category=VALUE, sw-calibration-access=READ-ONLY, type=ADTSMinBatteryPackVoltage, init-value=SendCANR_MinBatteryPackVoltageValue:0
    SendCANR_MinBatteryPackVoltageVld: service-kind=ANY-STANDARDIZED, invalidation-policy{data-element=SendCANR_MinBatteryPackVoltageVld, handle-invalid=DONT-INVALIDATE}  # Valid
      data SendCANR_MinBatteryPackVoltageVld: category=VALUE, sw-calibration-access=READ-ONLY, type=ADTSBoolean, init-value=SendCANR_MinBatteryPackVoltageVldValue:1
    SendCANR_MnCmftZnHVBtTmpFrDsply: service-kind=ANY-STANDARDIZED, invalidation-policy{data-element=SendCANR_MnCmftZnHVBtTmpFrDsply, handle-invalid=DONT-INVALIDATE}
      data SendCANR_MnCmftZnHVBtTmpFrDsply: category=VALUE, sw-calibration-access=READ-ONLY, type=ADTSMnCmftZnHVBtTmpFrDsply, init-value=SendCANR_MnCmftZnHVBtTmpFrDsplyValue:215
    SendCANR_MnCmftZnHVBtTmpFrDsplyVld: service-kind=ANY-STANDARDIZED, invalidation-policy{data-element=SendCANR_MnCmftZnHVBtTmpFrDsplyVld, handle-invalid=DONT-INVALIDATE}  # Valid
      data SendCANR_MnCmftZnHVBtTmpFrDsplyVld: category=VALUE, sw-calibration-access=READ-ONLY, type=ADTSBoolean, init-value=SendCANR_MnCmftZnHVBtTmpFrDsplyVldValue:1
    SendCANR_MnDrtgZnHVBtTmpFrDsply: service-kind=ANY-STANDARDIZED, invalidation-policy{data-element=SendCANR_MnDrtgZnHVBtTmpFrDsply, handle-invalid=DONT-INVALIDATE}
      data SendCANR_MnDrtgZnHVBtTmpFrDsply: category=VALUE, sw-calibration-access=READ-ONLY, type=ADTSMnDrtgZnHVBtTmpFrDsply, init-value=SendCANR_MnDrtgZnHVBtTmpFrDsplyValue:215
    SendCANR_MnDrtgZnHVBtTmpFrDsplyVld: service-kind=ANY-STANDARDIZED, invalidation-policy{data-element=SendCANR_MnDrtgZnHVBtTmpFrDsplyVld, handle-invalid=DONT-INVALIDATE}  # Valid
      data SendCANR_MnDrtgZnHVBtTmpFrDsplyVld: category=VALUE, sw-calibration-access=READ-ONLY, type=ADTSBoolean, init-value=SendCANR_MnDrtgZnHVBtTmpFrDsplyVldValue:1
    SendCANR_Motor1_RPM: service-kind=ANY-STANDARDIZED, invalidation-policy{data-element=SendCANR_Motor1_RPM, handle-invalid=DONT-INVALIDATE}
      data SendCANR_Motor1_RPM: category=VALUE, sw-calibration-access=READ-ONLY, type=ADTSMotor1_RPM, init-value=SendCANR_Motor1_RPMValue:0
    SendCANR_Motor1_RPM_Vld: service-kind=ANY-STANDARDIZED, invalidation-policy{data-element=SendCANR_Motor1_RPM_Vld, handle-invalid=DONT-INVALIDATE}  # Valid
      data SendCANR_Motor1_RPM_Vld: category=VALUE, sw-calibration-access=READ-ONLY, type=ADTSBoolean, init-value=SendCANR_Motor1_RPM_VldValue:1
    SendCANR_Motor2_RPM: service-kind=ANY-STANDARDIZED, invalidation-policy{data-element=SendCANR_Motor2_RPM, handle-invalid=DONT-INVALIDATE}
      data SendCANR_Motor2_RPM: category=VALUE, sw-calibration-access=READ-ONLY, type=ADTSMotor2_RPM, init-value=SendCANR_Motor2_RPMValue:0
    SendCANR_Motor2_RPM_Vld: service-kind=ANY-STANDARDIZED, invalidation-policy{data-element=SendCANR_Motor2_RPM_Vld, handle-invalid=DONT-INVALIDATE}  # Valid
      data SendCANR_Motor2_RPM_Vld: category=VALUE, sw-calibration-access=READ-ONLY, type=ADTSBoolean, init-value=SendCANR_Motor2_RPM_VldValue:1
    SendCANR_MotorA_DC_Current: service-kind=ANY-STANDARDIZED, invalidation-policy{data-element=SendCANR_MotorA_DC_Current, handle-invalid=DONT-INVALIDATE}
      data SendCANR_MotorA_DC_Current: category=VALUE, sw-calibration-access=READ-ONLY, type=ADTSMotorA_DC_Current, init-value=SendCANR_MotorA_DC_CurrentValue:0
    SendCANR_MotorA_DC_CurrentVld: service-kind=ANY-STANDARDIZED, invalidation-policy{data-element=SendCANR_MotorA_DC_CurrentVld, handle-invalid=DONT-INVALIDATE}  # Valid
      data SendCANR_MotorA_DC_CurrentVld: category=VALUE, sw-calibration-access=READ-ONLY, type=ADTSBoolean, init-value=SendCANR_MotorA_DC_CurrentVldValue:1
    SendCANR_MotorA_DC_Voltage: service-kind=ANY-STANDARDIZED, invalidation-policy{data-element=SendCANR_MotorA_DC_Voltage, handle-invalid=DONT-INVALIDATE}
      data SendCANR_MotorA_DC_Voltage: category=VALUE, sw-calibration-access=READ-ONLY, type=ADTSMotorA_DC_Voltage, init-value=SendCANR_MotorA_DC_VoltageValue:0
    SendCANR_MotorA_DC_VoltageVld: service-kind=ANY-STANDARDIZED, invalidation-policy{data-element=SendCANR_MotorA_DC_VoltageVld, handle-invalid=DONT-INVALIDATE}  # Valid
      data SendCANR_MotorA_DC_VoltageVld: category=VALUE, sw-calibration-access=READ-ONLY, type=ADTSBoolean, init-value=SendCANR_MotorA_DC_VoltageVldValue:1
    SendCANR_MotorA_InverterState: service-kind=ANY-STANDARDIZED, invalidation-policy{data-element=SendCANR_MotorA_InverterState, handle-invalid=DONT-INVALIDATE}
      data SendCANR_MotorA_InverterState: category=VALUE, sw-calibration-access=READ-ONLY, type=ADTSMotorA_InverterState, init-value=SendCANR_MotorA_InverterStateValue:0
    SendCANR_MotorA_InverterStateVld: service-kind=ANY-STANDARDIZED, invalidation-policy{data-element=SendCANR_MotorA_InverterStateVld, handle-invalid=DONT-INVALIDATE}  # Valid
      data SendCANR_MotorA_InverterStateVld: category=VALUE, sw-calibration-access=READ-ONLY, type=ADTSBoolean, init-value=SendCANR_MotorA_InverterStateVldValue:1
    SendCANR_MotorA_InverterTemp: service-kind=ANY-STANDARDIZED, invalidation-policy{data-element=SendCANR_MotorA_InverterTemp, handle-invalid=DONT-INVALIDATE}
      data SendCANR_MotorA_InverterTemp: category=VALUE, sw-calibration-access=READ-ONLY, type=ADTSMotorA_InverterTemp, init-value=SendCANR_MotorA_InverterTempValue:0
    SendCANR_MotorA_InverterTempVld: service-kind=ANY-STANDARDIZED, invalidation-policy{data-element=SendCANR_MotorA_InverterTempVld, handle-invalid=DONT-INVALIDATE}  # Valid
      data SendCANR_MotorA_InverterTempVld: category=VALUE, sw-calibration-access=READ-ONLY, type=ADTSBoolean, init-value=SendCANR_MotorA_InverterTempVldValue:1
    SendCANR_MotorA_RPM: service-kind=ANY-STANDARDIZED, invalidation-policy{data-element=SendCANR_MotorA_RPM, handle-invalid=DONT-INVALIDATE}
      data SendCANR_MotorA_RPM: category=VALUE, sw-calibration-access=READ-ONLY, type=ADTSMotorA_RPM, init-value=SendCANR_MotorA_RPMValue:0
    SendCANR_MotorA_RPM_Vld: service-kind=ANY-STANDARDIZED, invalidation-policy{data-element=SendCANR_MotorA_RPM_Vld, handle-invalid=DONT-INVALIDATE}  # Valid
      data SendCANR_MotorA_RPM_Vld: category=VALUE, sw-calibration-access=READ-ONLY, type=ADTSBoolean, init-value=SendCANR_MotorA_RPM_VldValue:1
    SendCANR_MotorA_Temperature: service-kind=ANY-STANDARDIZED, invalidation-policy{data-element=SendCANR_MotorA_Temperature, handle-invalid=DONT-INVALIDATE}
      data SendCANR_MotorA_Temperature: category=VALUE, sw-calibration-access=READ-ONLY, type=ADTSMotorA_Temperature, init-value=SendCANR_MotorA_TemperatureValue:0
    SendCANR_MotorA_TemperatureVld: service-kind=ANY-STANDARDIZED, invalidation-policy{data-element=SendCANR_MotorA_TemperatureVld, handle-invalid=DONT-INVALIDATE}  # Valid
      data SendCANR_MotorA_TemperatureVld: category=VALUE, sw-calibration-access=READ-ONLY, type=ADTSBoolean, init-value=SendCANR_MotorA_TemperatureVldValue:1
    SendCANR_MotorA_TorqueAchieved: service-kind=ANY-STANDARDIZED, invalidation-policy{data-element=SendCANR_MotorA_TorqueAchieved, handle-invalid=DONT-INVALIDATE}
      data SendCANR_MotorA_TorqueAchieved: category=VALUE, sw-calibration-access=READ-ONLY, type=ADTSMotorA_TorqueAchieved, init-value=SendCANR_MotorA_TorqueAchievedValue:0
    SendCANR_MotorA_TorqueAchievedVld: service-kind=ANY-STANDARDIZED, invalidation-policy{data-element=SendCANR_MotorA_TorqueAchievedVld, handle-invalid=DONT-INVALIDATE}  # Valid
      data SendCANR_MotorA_TorqueAchievedVld: category=VALUE, sw-calibration-access=READ-ONLY, type=ADTSBoolean, init-value=SendCANR_MotorA_TorqueAchievedVldValue:1
    SendCANR_MotorB_DC_Current: service-kind=ANY-STANDARDIZED, invalidation-policy{data-element=SendCANR_MotorB_DC_Current, handle-invalid=DONT-INVALIDATE}
      data SendCANR_MotorB_DC_Current: category=VALUE, sw-calibration-access=READ-ONLY, type=ADTSMotorB_DC_Current, init-value=SendCANR_MotorB_DC_CurrentValue:0
    SendCANR_MotorB_DC_CurrentVld: service-kind=ANY-STANDARDIZED, invalidation-policy{data-element=SendCANR_MotorB_DC_CurrentVld, handle-invalid=DONT-INVALIDATE}  # Valid
      data SendCANR_MotorB_DC_CurrentVld: category=VALUE, sw-calibration-access=READ-ONLY, type=ADTSBoolean, init-value=SendCANR_MotorB_DC_CurrentVldValue:1
    SendCANR_MotorB_DC_Voltage: service-kind=ANY-STANDARDIZED, invalidation-policy{data-element=SendCANR_MotorB_DC_Voltage, handle-invalid=DONT-INVALIDATE}
      data SendCANR_MotorB_DC_Voltage: category=VALUE, sw-calibration-access=READ-ONLY, type=ADTSMotorB_DC_Voltage, init-value=SendCANR_MotorB_DC_VoltageValue:0
    SendCANR_MotorB_DC_VoltageVld: service-kind=ANY-STANDARDIZED, invalidation-policy{data-element=SendCANR_MotorB_DC_VoltageVld, handle-invalid=DONT-INVALIDATE}  # Valid
      data SendCANR_MotorB_DC_VoltageVld: category=VALUE, sw-calibration-access=READ-ONLY, type=ADTSBoolean, init-value=SendCANR_MotorB_DC_VoltageVldValue:1
    SendCANR_MotorB_InverterState: service-kind=ANY-STANDARDIZED, invalidation-policy{data-element=SendCANR_MotorB_InverterState, handle-invalid=DONT-INVALIDATE}
      data SendCANR_MotorB_InverterState: category=VALUE, sw-calibration-access=READ-ONLY, type=ADTSMotorB_InverterState, init-value=SendCANR_MotorB_InverterStateValue:0
    SendCANR_MotorB_InverterStateVld: service-kind=ANY-STANDARDIZED, invalidation-policy{data-element=SendCANR_MotorB_InverterStateVld, handle-invalid=DONT-INVALIDATE}  # Valid
      data SendCANR_MotorB_InverterStateVld: category=VALUE, sw-calibration-access=READ-ONLY, type=ADTSBoolean, init-value=SendCANR_MotorB_InverterStateVldValue:1
    SendCANR_MotorB_InverterTemp: service-kind=ANY-STANDARDIZED, invalidation-policy{data-element=SendCANR_MotorB_InverterTemp, handle-invalid=DONT-INVALIDATE}
      data SendCANR_MotorB_InverterTemp: category=VALUE, sw-calibration-access=READ-ONLY, type=ADTSMotorB_InverterTemp, init-value=SendCANR_MotorB_InverterTempValue:0
    SendCANR_MotorB_InverterTempVld: service-kind=ANY-STANDARDIZED, invalidation-policy{data-element=SendCANR_MotorB_InverterTempVld, handle-invalid=DONT-INVALIDATE}  # Valid
      data SendCANR_MotorB_InverterTempVld: category=VALUE, sw-calibration-access=READ-ONLY, type=ADTSBoolean, init-value=SendCANR_MotorB_InverterTempVldValue:1
    SendCANR_MotorB_RPM: service-kind=ANY-STANDARDIZED, invalidation-policy{data-element=SendCANR_MotorB_RPM, handle-invalid=DONT-INVALIDATE}
      data SendCANR_MotorB_RPM: category=VALUE, sw-calibration-access=READ-ONLY, type=ADTSMotorB_RPM, init-value=SendCANR_MotorB_RPMValue:0
    SendCANR_MotorB_RPM_Vld: service-kind=ANY-STANDARDIZED, invalidation-policy{data-element=SendCANR_MotorB_RPM_Vld, handle-invalid=DONT-INVALIDATE}  # Valid
      data SendCANR_MotorB_RPM_Vld: category=VALUE, sw-calibration-access=READ-ONLY, type=ADTSBoolean, init-value=SendCANR_MotorB_RPM_VldValue:1
    SendCANR_MotorB_Temperature: service-kind=ANY-STANDARDIZED, invalidation-policy{data-element=SendCANR_MotorB_Temperature, handle-invalid=DONT-INVALIDATE}
      data SendCANR_MotorB_Temperature: category=VALUE, sw-calibration-access=READ-ONLY, type=ADTSMotorB_Temperature, init-value=SendCANR_MotorB_TemperatureValue:0
    SendCANR_MotorB_TemperatureVld: service-kind=ANY-STANDARDIZED, invalidation-policy{data-element=SendCANR_MotorB_TemperatureVld, handle-invalid=DONT-INVALIDATE}  # Valid
      data SendCANR_MotorB_TemperatureVld: category=VALUE, sw-calibration-access=READ-ONLY, type=ADTSBoolean, init-value=SendCANR_MotorB_TemperatureVldValue:1
    SendCANR_MotorB_TorqueAchieved: service-kind=ANY-STANDARDIZED, invalidation-policy{data-element=SendCANR_MotorB_TorqueAchieved, handle-invalid=DONT-INVALIDATE}
      data SendCANR_MotorB_TorqueAchieved: category=VALUE, sw-calibration-access=READ-ONLY, type=ADTSMotorB_TorqueAchieved, init-value=SendCANR_MotorB_TorqueAchievedValue:0
    SendCANR_MotorB_TorqueAchievedVld: service-kind=ANY-STANDARDIZED, invalidation-policy{data-element=SendCANR_MotorB_TorqueAchievedVld, handle-invalid=DONT-INVALIDATE}  # Valid
      data SendCANR_MotorB_TorqueAchievedVld: category=VALUE, sw-calibration-access=READ-ONLY, type=ADTSBoolean, init-value=SendCANR_MotorB_TorqueAchievedVldValue:1
    SendCANR_MsgCounter_BCM10_FD16: service-kind=ANY-STANDARDIZED, invalidation-policy{data-element=SendCANR_MsgCounter_BCM10_FD16, handle-invalid=DONT-INVALIDATE}
      data SendCANR_MsgCounter_BCM10_FD16: category=VALUE, sw-calibration-access=READ-ONLY, type=ADTSMsgCounter_BCM10_FD16, init-value=SendCANR_MsgCounter_BCM10_FD16Value:0
    SendCANR_MsgCounter_BCM10_FD16Vld: service-kind=ANY-STANDARDIZED, invalidation-policy{data-element=SendCANR_MsgCounter_BCM10_FD16Vld, handle-invalid=DONT-INVALIDATE}  # Valid
      data SendCANR_MsgCounter_BCM10_FD16Vld: category=VALUE, sw-calibration-access=READ-ONLY, type=ADTSBoolean, init-value=SendCANR_MsgCounter_BCM10_FD16VldValue:1
    SendCANR_MsgCtrHYB_SYSTEM_EPT1: service-kind=ANY-STANDARDIZED, invalidation-policy{data-element=SendCANR_MsgCtrHYB_SYSTEM_EPT1, handle-invalid=DONT-INVALIDATE}
      data SendCANR_MsgCtrHYB_SYSTEM_EPT1: category=VALUE, sw-calibration-access=READ-ONLY, type=ADTSMsgCtrHYB_SYSTEM_EPT1, init-value=SendCANR_MsgCtrHYB_SYSTEM_EPT1Value:0
    SendCANR_MsgCtrHYB_SYSTEM_EPT1Vld: service-kind=ANY-STANDARDIZED, invalidation-policy{data-element=SendCANR_MsgCtrHYB_SYSTEM_EPT1Vld, handle-invalid=DONT-INVALIDATE}  # Valid
      data SendCANR_MsgCtrHYB_SYSTEM_EPT1Vld: category=VALUE, sw-calibration-access=READ-ONLY, type=ADTSBoolean, init-value=SendCANR_MsgCtrHYB_SYSTEM_EPT1VldValue:1
    SendCANR_MxCmftZnHVBtTmpFrDsply: service-kind=ANY-STANDARDIZED, invalidation-policy{data-element=SendCANR_MxCmftZnHVBtTmpFrDsply, handle-invalid=DONT-INVALIDATE}
      data SendCANR_MxCmftZnHVBtTmpFrDsply: category=VALUE, sw-calibration-access=READ-ONLY, type=ADTSMxCmftZnHVBtTmpFrDsply, init-value=SendCANR_MxCmftZnHVBtTmpFrDsplyValue:215
    SendCANR_MxCmftZnHVBtTmpFrDsplyVld: service-kind=ANY-STANDARDIZED, invalidation-policy{data-element=SendCANR_MxCmftZnHVBtTmpFrDsplyVld, handle-invalid=DONT-INVALIDATE}  # Valid
      data SendCANR_MxCmftZnHVBtTmpFrDsplyVld: category=VALUE, sw-calibration-access=READ-ONLY, type=ADTSBoolean, init-value=SendCANR_MxCmftZnHVBtTmpFrDsplyVldValue:1
    SendCANR_MxDrtgZnHVBtTmpFrDsply: service-kind=ANY-STANDARDIZED, invalidation-policy{data-element=SendCANR_MxDrtgZnHVBtTmpFrDsply, handle-invalid=DONT-INVALIDATE}
      data SendCANR_MxDrtgZnHVBtTmpFrDsply: category=VALUE, sw-calibration-access=READ-ONLY, type=ADTSMxDrtgZnHVBtTmpFrDsply, init-value=SendCANR_MxDrtgZnHVBtTmpFrDsplyValue:215
    SendCANR_MxDrtgZnHVBtTmpFrDsplyVld: service-kind=ANY-STANDARDIZED, invalidation-policy{data-element=SendCANR_MxDrtgZnHVBtTmpFrDsplyVld, handle-invalid=DONT-INVALIDATE}  # Valid
      data SendCANR_MxDrtgZnHVBtTmpFrDsplyVld: category=VALUE, sw-calibration-access=READ-ONLY, type=ADTSBoolean, init-value=SendCANR_MxDrtgZnHVBtTmpFrDsplyVldValue:1
    SendCANR_N_PDU_342_FD11: service-kind=ANY-STANDARDIZED, invalidation-policy{data-element=SendCANR_N_PDU_342_FD11, handle-invalid=DONT-INVALIDATE}
      data SendCANR_N_PDU_342_FD11: category=VALUE, sw-calibration-access=READ-ONLY, type=ADTSN_PDU_342_FD11, init-value=SendCANR_N_PDU_342_FD11Value:0
    SendCANR_N_PDU_342_FD11Vld: service-kind=ANY-STANDARDIZED, invalidation-policy{data-element=SendCANR_N_PDU_342_FD11Vld, handle-invalid=DONT-INVALIDATE}  # Valid
      data SendCANR_N_PDU_342_FD11Vld: category=VALUE, sw-calibration-access=READ-ONLY, type=ADTSBoolean, init-value=SendCANR_N_PDU_342_FD11VldValue:1
    SendCANR_N_PDU_342_FD3: service-kind=ANY-STANDARDIZED, invalidation-policy{data-element=SendCANR_N_PDU_342_FD3, handle-invalid=DONT-INVALIDATE}
      data SendCANR_N_PDU_342_FD3: category=VALUE, sw-calibration-access=READ-ONLY, type=ADTSN_PDU_342_FD3, init-value=SendCANR_N_PDU_342_FD3Value:0
    SendCANR_N_PDU_342_FD3Vld: service-kind=ANY-STANDARDIZED, invalidation-policy{data-element=SendCANR_N_PDU_342_FD3Vld, handle-invalid=DONT-INVALIDATE}  # Valid
      data SendCANR_N_PDU_342_FD3Vld: category=VALUE, sw-calibration-access=READ-ONLY, type=ADTSBoolean, init-value=SendCANR_N_PDU_342_FD3VldValue:1
    SendCANR_N_PDU_7B_FD11: service-kind=ANY-STANDARDIZED, invalidation-policy{data-element=SendCANR_N_PDU_7B_FD11, handle-invalid=DONT-INVALIDATE}
      data SendCANR_N_PDU_7B_FD11: category=VALUE, sw-calibration-access=READ-ONLY, type=ADTSN_PDU_7B_FD11, init-value=SendCANR_N_PDU_7B_FD11Value:0
    SendCANR_N_PDU_7B_FD11Vld: service-kind=ANY-STANDARDIZED, invalidation-policy{data-element=SendCANR_N_PDU_7B_FD11Vld, handle-invalid=DONT-INVALIDATE}  # Valid
      data SendCANR_N_PDU_7B_FD11Vld: category=VALUE, sw-calibration-access=READ-ONLY, type=ADTSBoolean, init-value=SendCANR_N_PDU_7B_FD11VldValue:1
    SendCANR_N_PDU_7C_FD11: service-kind=ANY-STANDARDIZED, invalidation-policy{data-element=SendCANR_N_PDU_7C_FD11, handle-invalid=DONT-INVALIDATE}
      data SendCANR_N_PDU_7C_FD11: category=VALUE, sw-calibration-access=READ-ONLY, type=ADTSN_PDU_7C_FD11, init-value=SendCANR_N_PDU_7C_FD11Value:0
    SendCANR_N_PDU_7C_FD11Vld: service-kind=ANY-STANDARDIZED, invalidation-policy{data-element=SendCANR_N_PDU_7C_FD11Vld, handle-invalid=DONT-INVALIDATE}  # Valid
      data SendCANR_N_PDU_7C_FD11Vld: category=VALUE, sw-calibration-access=READ-ONLY, type=ADTSBoolean, init-value=SendCANR_N_PDU_7C_FD11VldValue:1
    SendCANR_N_PDU_7E_FD16: service-kind=ANY-STANDARDIZED, invalidation-policy{data-element=SendCANR_N_PDU_7E_FD16, handle-invalid=DONT-INVALIDATE}
      data SendCANR_N_PDU_7E_FD16: category=VALUE, sw-calibration-access=READ-ONLY, type=ADTSN_PDU_7E_FD16, init-value=SendCANR_N_PDU_7E_FD16Value:0
    SendCANR_N_PDU_7E_FD16Vld: service-kind=ANY-STANDARDIZED, invalidation-policy{data-element=SendCANR_N_PDU_7E_FD16Vld, handle-invalid=DONT-INVALIDATE}  # Valid
      data SendCANR_N_PDU_7E_FD16Vld: category=VALUE, sw-calibration-access=READ-ONLY, type=ADTSBoolean, init-value=SendCANR_N_PDU_7E_FD16VldValue:1
    SendCANR_N_PDU_7E_FD5: service-kind=ANY-STANDARDIZED, invalidation-policy{data-element=SendCANR_N_PDU_7E_FD5, handle-invalid=DONT-INVALIDATE}
      data SendCANR_N_PDU_7E_FD5: category=VALUE, sw-calibration-access=READ-ONLY, type=ADTSN_PDU_7E_FD5, init-value=SendCANR_N_PDU_7E_FD5Value:0
    SendCANR_N_PDU_7E_FD5Vld: service-kind=ANY-STANDARDIZED, invalidation-policy{data-element=SendCANR_N_PDU_7E_FD5Vld, handle-invalid=DONT-INVALIDATE}  # Valid
      data SendCANR_N_PDU_7E_FD5Vld: category=VALUE, sw-calibration-access=READ-ONLY, type=ADTSBoolean, init-value=SendCANR_N_PDU_7E_FD5VldValue:1
    SendCANR_N_PDU_7F_FD16: service-kind=ANY-STANDARDIZED, invalidation-policy{data-element=SendCANR_N_PDU_7F_FD16, handle-invalid=DONT-INVALIDATE}
      data SendCANR_N_PDU_7F_FD16: category=VALUE, sw-calibration-access=READ-ONLY, type=ADTSN_PDU_7F_FD16, init-value=SendCANR_N_PDU_7F_FD16Value:0
    SendCANR_N_PDU_7F_FD16Vld: service-kind=ANY-STANDARDIZED, invalidation-policy{data-element=SendCANR_N_PDU_7F_FD16Vld, handle-invalid=DONT-INVALIDATE}  # Valid
      data SendCANR_N_PDU_7F_FD16Vld: category=VALUE, sw-calibration-access=READ-ONLY, type=ADTSBoolean, init-value=SendCANR_N_PDU_7F_FD16VldValue:1
    SendCANR_N_PDU_7F_FD5: service-kind=ANY-STANDARDIZED, invalidation-policy{data-element=SendCANR_N_PDU_7F_FD5, handle-invalid=DONT-INVALIDATE}
      data SendCANR_N_PDU_7F_FD5: category=VALUE, sw-calibration-access=READ-ONLY, type=ADTSN_PDU_7F_FD5, init-value=SendCANR_N_PDU_7F_FD5Value:0
    SendCANR_N_PDU_7F_FD5Vld: service-kind=ANY-STANDARDIZED, invalidation-policy{data-element=SendCANR_N_PDU_7F_FD5Vld, handle-invalid=DONT-INVALIDATE}  # Valid
      data SendCANR_N_PDU_7F_FD5Vld: category=VALUE, sw-calibration-access=READ-ONLY, type=ADTSBoolean, init-value=SendCANR_N_PDU_7F_FD5VldValue:1
    SendCANR_N_PDU_81: service-kind=ANY-STANDARDIZED, invalidation-policy{data-element=SendCANR_N_PDU_81, handle-invalid=DONT-INVALIDATE}
      data SendCANR_N_PDU_81: category=VALUE, sw-calibration-access=READ-ONLY, type=ADTSN_PDU_81, init-value=SendCANR_N_PDU_81Value:0
    SendCANR_N_PDU_81Vld: service-kind=ANY-STANDARDIZED, invalidation-policy{data-element=SendCANR_N_PDU_81Vld, handle-invalid=DONT-INVALIDATE}  # Valid
      data SendCANR_N_PDU_81Vld: category=VALUE, sw-calibration-access=READ-ONLY, type=ADTSBoolean, init-value=SendCANR_N_PDU_81VldValue:1
    SendCANR_N_PDU_86: service-kind=ANY-STANDARDIZED, invalidation-policy{data-element=SendCANR_N_PDU_86, handle-invalid=DONT-INVALIDATE}
      data SendCANR_N_PDU_86: category=VALUE, sw-calibration-access=READ-ONLY, type=ADTSN_PDU_86, init-value=SendCANR_N_PDU_86Value:0
    SendCANR_N_PDU_86Vld: service-kind=ANY-STANDARDIZED, invalidation-policy{data-element=SendCANR_N_PDU_86Vld, handle-invalid=DONT-INVALIDATE}  # Valid
      data SendCANR_N_PDU_86Vld: category=VALUE, sw-calibration-access=READ-ONLY, type=ADTSBoolean, init-value=SendCANR_N_PDU_86VldValue:1
    SendCANR_N_PDU_GLIWA_MCPA_TX_FD3: service-kind=ANY-STANDARDIZED, invalidation-policy{data-element=SendCANR_N_PDU_GLIWA_MCPA_TX_FD3, handle-invalid=DONT-INVALIDATE}
      data SendCANR_N_PDU_GLIWA_MCPA_TX_FD3: category=VALUE, sw-calibration-access=READ-ONLY, type=ADTSN_PDU_GLIWA_MCPA_TX_FD3, init-value=SendCANR_N_PDU_GLIWA_MCPA_TX_FD3Value:0
    SendCANR_N_PDU_GLIWA_MCPA_TX_FD3Vld: service-kind=ANY-STANDARDIZED, invalidation-policy{data-element=SendCANR_N_PDU_GLIWA_MCPA_TX_FD3Vld, handle-invalid=DONT-INVALIDATE}  # Valid
      data SendCANR_N_PDU_GLIWA_MCPA_TX_FD3Vld: category=VALUE, sw-calibration-access=READ-ONLY, type=ADTSBoolean, init-value=SendCANR_N_PDU_GLIWA_MCPA_TX_FD3VldValue:1
    SendCANR_N_PDU_GLIWA_MCPB_TX_FD3: service-kind=ANY-STANDARDIZED, invalidation-policy{data-element=SendCANR_N_PDU_GLIWA_MCPB_TX_FD3, handle-invalid=DONT-INVALIDATE}
      data SendCANR_N_PDU_GLIWA_MCPB_TX_FD3: category=VALUE, sw-calibration-access=READ-ONLY, type=ADTSN_PDU_GLIWA_MCPB_TX_FD3, init-value=SendCANR_N_PDU_GLIWA_MCPB_TX_FD3Value:0
    SendCANR_N_PDU_GLIWA_MCPB_TX_FD3Vld: service-kind=ANY-STANDARDIZED, invalidation-policy{data-element=SendCANR_N_PDU_GLIWA_MCPB_TX_FD3Vld, handle-invalid=DONT-INVALIDATE}  # Valid
      data SendCANR_N_PDU_GLIWA_MCPB_TX_FD3Vld: category=VALUE, sw-calibration-access=READ-ONLY, type=ADTSBoolean, init-value=SendCANR_N_PDU_GLIWA_MCPB_TX_FD3VldValue:1
    SendCANR_NextChrg_Strt_Time_Min: service-kind=ANY-STANDARDIZED, invalidation-policy{data-element=SendCANR_NextChrg_Strt_Time_Min, handle-invalid=KEEP}
      data SendCANR_NextChrg_Strt_Time_Min: category=VALUE, sw-calibration-access=READ-ONLY, type=ADTSNextChrg_Strt_Time_Min, init-value=SendCANR_NextChrg_Strt_Time_MinValue:0
    SendCANR_NextChrg_Strt_Time_MinVld: service-kind=ANY-STANDARDIZED, invalidation-policy{data-element=SendCANR_NextChrg_Strt_Time_MinVld, handle-invalid=DONT-INVALIDATE}  # Valid
      data SendCANR_NextChrg_Strt_Time_MinVld: category=VALUE, sw-calibration-access=READ-ONLY, type=ADTSBoolean, init-value=SendCANR_NextChrg_Strt_Time_MinVldValue:1
    SendCANR_Next_Charge_StartDay: service-kind=ANY-STANDARDIZED, invalidation-policy{data-element=SendCANR_Next_Charge_StartDay, handle-invalid=KEEP}
      data SendCANR_Next_Charge_StartDay: category=VALUE, sw-calibration-access=READ-ONLY, type=ADTSNext_Charge_StartDay, init-value=SendCANR_Next_Charge_StartDayValue:0
    SendCANR_Next_Charge_StartDayVld: service-kind=ANY-STANDARDIZED, invalidation-policy{data-element=SendCANR_Next_Charge_StartDayVld, handle-invalid=DONT-INVALIDATE}  # Valid
      data SendCANR_Next_Charge_StartDayVld: category=VALUE, sw-calibration-access=READ-ONLY, type=ADTSBoolean, init-value=SendCANR_Next_Charge_StartDayVldValue:1
    SendCANR_Next_Chrg_EndDay: service-kind=ANY-STANDARDIZED, invalidation-policy{data-element=SendCANR_Next_Chrg_EndDay, handle-invalid=KEEP}
      data SendCANR_Next_Chrg_EndDay: category=VALUE, sw-calibration-access=READ-ONLY, type=ADTSNext_Chrg_EndDay, init-value=SendCANR_Next_Chrg_EndDayValue:0
    SendCANR_Next_Chrg_EndDayVld: service-kind=ANY-STANDARDIZED, invalidation-policy{data-element=SendCANR_Next_Chrg_EndDayVld, handle-invalid=DONT-INVALIDATE}  # Valid
      data SendCANR_Next_Chrg_EndDayVld: category=VALUE, sw-calibration-access=READ-ONLY, type=ADTSBoolean, init-value=SendCANR_Next_Chrg_EndDayVldValue:1
    SendCANR_Next_Chrg_End_Time_Hr: service-kind=ANY-STANDARDIZED, invalidation-policy{data-element=SendCANR_Next_Chrg_End_Time_Hr, handle-invalid=KEEP}
      data SendCANR_Next_Chrg_End_Time_Hr: category=VALUE, sw-calibration-access=READ-ONLY, type=ADTSNext_Chrg_End_Time_Hr, init-value=SendCANR_Next_Chrg_End_Time_HrValue:0
    SendCANR_Next_Chrg_End_Time_HrVld: service-kind=ANY-STANDARDIZED, invalidation-policy{data-element=SendCANR_Next_Chrg_End_Time_HrVld, handle-invalid=DONT-INVALIDATE}  # Valid
      data SendCANR_Next_Chrg_End_Time_HrVld: category=VALUE, sw-calibration-access=READ-ONLY, type=ADTSBoolean, init-value=SendCANR_Next_Chrg_End_Time_HrVldValue:1
    SendCANR_Next_Chrg_End_Time_Min: service-kind=ANY-STANDARDIZED, invalidation-policy{data-element=SendCANR_Next_Chrg_End_Time_Min, handle-invalid=KEEP}
      data SendCANR_Next_Chrg_End_Time_Min: category=VALUE, sw-calibration-access=READ-ONLY, type=ADTSNext_Chrg_End_Time_Min, init-value=SendCANR_Next_Chrg_End_Time_MinValue:0
    SendCANR_Next_Chrg_End_Time_MinVld: service-kind=ANY-STANDARDIZED, invalidation-policy{data-element=SendCANR_Next_Chrg_End_Time_MinVld, handle-invalid=DONT-INVALIDATE}  # Valid
      data SendCANR_Next_Chrg_End_Time_MinVld: category=VALUE, sw-calibration-access=READ-ONLY, type=ADTSBoolean, init-value=SendCANR_Next_Chrg_End_Time_MinVldValue:1
    SendCANR_Next_Chrg_Strt_Time_Hr: service-kind=ANY-STANDARDIZED, invalidation-policy{data-element=SendCANR_Next_Chrg_Strt_Time_Hr, handle-invalid=KEEP}
      data SendCANR_Next_Chrg_Strt_Time_Hr: category=VALUE, sw-calibration-access=READ-ONLY, type=ADTSNext_Chrg_Strt_Time_Hr, init-value=SendCANR_Next_Chrg_Strt_Time_HrValue:0
    SendCANR_Next_Chrg_Strt_Time_HrVld: service-kind=ANY-STANDARDIZED, invalidation-policy{data-element=SendCANR_Next_Chrg_Strt_Time_HrVld, handle-invalid=DONT-INVALIDATE}  # Valid
      data SendCANR_Next_Chrg_Strt_Time_HrVld: category=VALUE, sw-calibration-access=READ-ONLY, type=ADTSBoolean, init-value=SendCANR_Next_Chrg_Strt_Time_HrVldValue:1
    SendCANR_Next_Climate_Day: service-kind=ANY-STANDARDIZED, invalidation-policy{data-element=SendCANR_Next_Climate_Day, handle-invalid=KEEP}
      data SendCANR_Next_Climate_Day: category=VALUE, sw-calibration-access=READ-ONLY, type=ADTSNext_Climate_Day, init-value=SendCANR_Next_Climate_DayValue:0
    SendCANR_Next_Climate_DayVld: service-kind=ANY-STANDARDIZED, invalidation-policy{data-element=SendCANR_Next_Climate_DayVld, handle-invalid=DONT-INVALIDATE}  # Valid
      data SendCANR_Next_Climate_DayVld: category=VALUE, sw-calibration-access=READ-ONLY, type=ADTSBoolean, init-value=SendCANR_Next_Climate_DayVldValue:1
    SendCANR_Next_Climate_Time_Hr: service-kind=ANY-STANDARDIZED, invalidation-policy{data-element=SendCANR_Next_Climate_Time_Hr, handle-invalid=KEEP}
      data SendCANR_Next_Climate_Time_Hr: category=VALUE, sw-calibration-access=READ-ONLY, type=ADTSNext_Climate_Time_Hr, init-value=SendCANR_Next_Climate_Time_HrValue:0
    SendCANR_Next_Climate_Time_HrVld: service-kind=ANY-STANDARDIZED, invalidation-policy{data-element=SendCANR_Next_Climate_Time_HrVld, handle-invalid=DONT-INVALIDATE}  # Valid
      data SendCANR_Next_Climate_Time_HrVld: category=VALUE, sw-calibration-access=READ-ONLY, type=ADTSBoolean, init-value=SendCANR_Next_Climate_Time_HrVldValue:1
    SendCANR_Next_Climate_Time_Min: service-kind=ANY-STANDARDIZED, invalidation-policy{data-element=SendCANR_Next_Climate_Time_Min, handle-invalid=KEEP}
      data SendCANR_Next_Climate_Time_Min: category=VALUE, sw-calibration-access=READ-ONLY, type=ADTSNext_Climate_Time_Min, init-value=SendCANR_Next_Climate_Time_MinValue:0
    SendCANR_Next_Climate_Time_MinVld: service-kind=ANY-STANDARDIZED, invalidation-policy{data-element=SendCANR_Next_Climate_Time_MinVld, handle-invalid=DONT-INVALIDATE}  # Valid
      data SendCANR_Next_Climate_Time_MinVld: category=VALUE, sw-calibration-access=READ-ONLY, type=ADTSBoolean, init-value=SendCANR_Next_Climate_Time_MinVldValue:1
    SendCANR_Next_SchCabin_Temp: service-kind=ANY-STANDARDIZED, invalidation-policy{data-element=SendCANR_Next_SchCabin_Temp, handle-invalid=KEEP}
      data SendCANR_Next_SchCabin_Temp: category=VALUE, sw-calibration-access=READ-ONLY, type=ADTSNext_SchCabin_Temp, init-value=SendCANR_Next_SchCabin_TempValue:22
    SendCANR_Next_SchCabin_TempVld: service-kind=ANY-STANDARDIZED, invalidation-policy{data-element=SendCANR_Next_SchCabin_TempVld, handle-invalid=DONT-INVALIDATE}  # Valid
      data SendCANR_Next_SchCabin_TempVld: category=VALUE, sw-calibration-access=READ-ONLY, type=ADTSBoolean, init-value=SendCANR_Next_SchCabin_TempVldValue:1
    SendCANR_NxtExtChargEndTimeHr: service-kind=ANY-STANDARDIZED, invalidation-policy{data-element=SendCANR_NxtExtChargEndTimeHr, handle-invalid=KEEP}
      data SendCANR_NxtExtChargEndTimeHr: category=VALUE, sw-calibration-access=READ-ONLY, type=ADTSNxtExtChargEndTimeHr, init-value=SendCANR_NxtExtChargEndTimeHrValue:0
    SendCANR_NxtExtChargEndTimeHrVld: service-kind=ANY-STANDARDIZED, invalidation-policy{data-element=SendCANR_NxtExtChargEndTimeHrVld, handle-invalid=DONT-INVALIDATE}  # Valid
      data SendCANR_NxtExtChargEndTimeHrVld: category=VALUE, sw-calibration-access=READ-ONLY, type=ADTSBoolean, init-value=SendCANR_NxtExtChargEndTimeHrVldValue:1
    SendCANR_NxtExtChargeEndTimeMin: service-kind=ANY-STANDARDIZED, invalidation-policy{data-element=SendCANR_NxtExtChargeEndTimeMin, handle-invalid=KEEP}
      data SendCANR_NxtExtChargeEndTimeMin: category=VALUE, sw-calibration-access=READ-ONLY, type=ADTSNxtExtChargeEndTimeMin, init-value=SendCANR_NxtExtChargeEndTimeMinValue:75
    SendCANR_NxtExtChargeEndTimeMinVld: service-kind=ANY-STANDARDIZED, invalidation-policy{data-element=SendCANR_NxtExtChargeEndTimeMinVld, handle-invalid=DONT-INVALIDATE}  # Valid
      data SendCANR_NxtExtChargeEndTimeMinVld: category=VALUE, sw-calibration-access=READ-ONLY, type=ADTSBoolean, init-value=SendCANR_NxtExtChargeEndTimeMinVldValue:1
    SendCANR_NxtExternalChargEndDay: service-kind=ANY-STANDARDIZED, invalidation-policy{data-element=SendCANR_NxtExternalChargEndDay, handle-invalid=KEEP}
      data SendCANR_NxtExternalChargEndDay: category=VALUE, sw-calibration-access=READ-ONLY, type=ADTSNxtExternalChargEndDay, init-value=SendCANR_NxtExternalChargEndDayValue:15
    SendCANR_NxtExternalChargEndDayVld: service-kind=ANY-STANDARDIZED, invalidation-policy{data-element=SendCANR_NxtExternalChargEndDayVld, handle-invalid=DONT-INVALIDATE}  # Valid
      data SendCANR_NxtExternalChargEndDayVld: category=VALUE, sw-calibration-access=READ-ONLY, type=ADTSBoolean, init-value=SendCANR_NxtExternalChargEndDayVldValue:1
    SendCANR_NxtExternlChrgExtnlTgt: service-kind=ANY-STANDARDIZED, invalidation-policy{data-element=SendCANR_NxtExternlChrgExtnlTgt, handle-invalid=DONT-INVALIDATE}
      data SendCANR_NxtExternlChrgExtnlTgt: category=VALUE, sw-calibration-access=READ-ONLY, type=ADTSNxtExternlChrgExtnlTgt, init-value=SendCANR_NxtExternlChrgExtnlTgtValue:125
    SendCANR_NxtExternlChrgExtnlTgtVld: service-kind=ANY-STANDARDIZED, invalidation-policy{data-element=SendCANR_NxtExternlChrgExtnlTgtVld, handle-invalid=DONT-INVALIDATE}  # Valid
      data SendCANR_NxtExternlChrgExtnlTgtVld: category=VALUE, sw-calibration-access=READ-ONLY, type=ADTSBoolean, init-value=SendCANR_NxtExternlChrgExtnlTgtVldValue:1
    SendCANR_NxtExtnlChrgImediatTgt: service-kind=ANY-STANDARDIZED, invalidation-policy{data-element=SendCANR_NxtExtnlChrgImediatTgt, handle-invalid=DONT-INVALIDATE}
      data SendCANR_NxtExtnlChrgImediatTgt: category=VALUE, sw-calibration-access=READ-ONLY, type=ADTSNxtExtnlChrgImediatTgt, init-value=SendCANR_NxtExtnlChrgImediatTgtValue:75
    SendCANR_NxtExtnlChrgImediatTgtVld: service-kind=ANY-STANDARDIZED, invalidation-policy{data-element=SendCANR_NxtExtnlChrgImediatTgtVld, handle-invalid=DONT-INVALIDATE}  # Valid
      data SendCANR_NxtExtnlChrgImediatTgtVld: category=VALUE, sw-calibration-access=READ-ONLY, type=ADTSBoolean, init-value=SendCANR_NxtExtnlChrgImediatTgtVldValue:1
    SendCANR_Nxt_ChargeScheduleType: service-kind=ANY-STANDARDIZED, invalidation-policy{data-element=SendCANR_Nxt_ChargeScheduleType, handle-invalid=DONT-INVALIDATE}
      data SendCANR_Nxt_ChargeScheduleType: category=VALUE, sw-calibration-access=READ-ONLY, type=ADTSNxt_ChargeScheduleType, init-value=SendCANR_Nxt_ChargeScheduleTypeValue:0
    SendCANR_Nxt_ChargeScheduleTypeVld: service-kind=ANY-STANDARDIZED, invalidation-policy{data-element=SendCANR_Nxt_ChargeScheduleTypeVld, handle-invalid=DONT-INVALIDATE}  # Valid
      data SendCANR_Nxt_ChargeScheduleTypeVld: category=VALUE, sw-calibration-access=READ-ONLY, type=ADTSBoolean, init-value=SendCANR_Nxt_ChargeScheduleTypeVldValue:1
    SendCANR_OBCMOutVoltSyncTgtFD11: service-kind=ANY-STANDARDIZED, invalidation-policy{data-element=SendCANR_OBCMOutVoltSyncTgtFD11, handle-invalid=KEEP}
      data SendCANR_OBCMOutVoltSyncTgtFD11: category=VALUE, sw-calibration-access=READ-ONLY, type=ADTSOBCMOutVoltSyncTgtFD11, init-value=SendCANR_OBCMOutVoltSyncTgtFD11Value:0
    SendCANR_OBCMOutVoltSyncTgtFD11Vld: service-kind=ANY-STANDARDIZED, invalidation-policy{data-element=SendCANR_OBCMOutVoltSyncTgtFD11Vld, handle-invalid=DONT-INVALIDATE}  # Valid
      data SendCANR_OBCMOutVoltSyncTgtFD11Vld: category=VALUE, sw-calibration-access=READ-ONLY, type=ADTSBoolean, init-value=SendCANR_OBCMOutVoltSyncTgtFD11VldValue:1
    SendCANR_OBCMOutVoltSyncTgtFD15: service-kind=ANY-STANDARDIZED, invalidation-policy{data-element=SendCANR_OBCMOutVoltSyncTgtFD15, handle-invalid=KEEP}
      data SendCANR_OBCMOutVoltSyncTgtFD15: category=VALUE, sw-calibration-access=READ-ONLY, type=ADTSOBCMOutVoltSyncTgtFD15, init-value=SendCANR_OBCMOutVoltSyncTgtFD15Value:0
    SendCANR_OBCMOutVoltSyncTgtFD15Vld: service-kind=ANY-STANDARDIZED, invalidation-policy{data-element=SendCANR_OBCMOutVoltSyncTgtFD15Vld, handle-invalid=DONT-INVALIDATE}  # Valid
      data SendCANR_OBCMOutVoltSyncTgtFD15Vld: category=VALUE, sw-calibration-access=READ-ONLY, type=ADTSBoolean, init-value=SendCANR_OBCMOutVoltSyncTgtFD15VldValue:1
    SendCANR_OperationalModeStsFD11: service-kind=ANY-STANDARDIZED, invalidation-policy{data-element=SendCANR_OperationalModeStsFD11, handle-invalid=KEEP}
      data SendCANR_OperationalModeStsFD11: category=VALUE, sw-calibration-access=READ-ONLY, type=ADTSOperationalModeStsFD11, init-value=SendCANR_OperationalModeStsFD11Value:0
    SendCANR_OperationalModeStsFD11Vld: service-kind=ANY-STANDARDIZED, invalidation-policy{data-element=SendCANR_OperationalModeStsFD11Vld, handle-invalid=DONT-INVALIDATE}  # Valid
      data SendCANR_OperationalModeStsFD11Vld: category=VALUE, sw-calibration-access=READ-ONLY, type=ADTSBoolean, init-value=SendCANR_OperationalModeStsFD11VldValue:1
    SendCANR_OperationalModeStsFD16: service-kind=ANY-STANDARDIZED, invalidation-policy{data-element=SendCANR_OperationalModeStsFD16, handle-invalid=KEEP}
      data SendCANR_OperationalModeStsFD16: category=VALUE, sw-calibration-access=READ-ONLY, type=ADTSOperationalModeStsFD16, init-value=SendCANR_OperationalModeStsFD16Value:0
    SendCANR_OperationalModeStsFD16Vld: service-kind=ANY-STANDARDIZED, invalidation-policy{data-element=SendCANR_OperationalModeStsFD16Vld, handle-invalid=DONT-INVALIDATE}  # Valid
      data SendCANR_OperationalModeStsFD16Vld: category=VALUE, sw-calibration-access=READ-ONLY, type=ADTSBoolean, init-value=SendCANR_OperationalModeStsFD16VldValue:1
    SendCANR_OperationalModeSts_FD5: service-kind=ANY-STANDARDIZED, invalidation-policy{data-element=SendCANR_OperationalModeSts_FD5, handle-invalid=KEEP}
      data SendCANR_OperationalModeSts_FD5: category=VALUE, sw-calibration-access=READ-ONLY, type=ADTSOperationalModeSts_FD5, init-value=SendCANR_OperationalModeSts_FD5Value:0
    SendCANR_OperationalModeSts_FD5Vld: service-kind=ANY-STANDARDIZED, invalidation-policy{data-element=SendCANR_OperationalModeSts_FD5Vld, handle-invalid=DONT-INVALIDATE}  # Valid
      data SendCANR_OperationalModeSts_FD5Vld: category=VALUE, sw-calibration-access=READ-ONLY, type=ADTSBoolean, init-value=SendCANR_OperationalModeSts_FD5VldValue:1
    SendCANR_P2P_Timer: service-kind=ANY-STANDARDIZED, invalidation-policy{data-element=SendCANR_P2P_Timer, handle-invalid=DONT-INVALIDATE}
      data SendCANR_P2P_Timer: category=VALUE, sw-calibration-access=READ-ONLY, type=ADTSP2P_Timer, init-value=SendCANR_P2P_TimerValue:0
    SendCANR_P2P_TimerVld: service-kind=ANY-STANDARDIZED, invalidation-policy{data-element=SendCANR_P2P_TimerVld, handle-invalid=DONT-INVALIDATE}  # Valid
      data SendCANR_P2P_TimerVld: category=VALUE, sw-calibration-access=READ-ONLY, type=ADTSBoolean, init-value=SendCANR_P2P_TimerVldValue:1
    SendCANR_PerWakeUp_Diag_FD11: service-kind=ANY-STANDARDIZED, invalidation-policy{data-element=SendCANR_PerWakeUp_Diag_FD11, handle-invalid=DONT-INVALIDATE}
      data SendCANR_PerWakeUp_Diag_FD11: category=VALUE, sw-calibration-access=READ-ONLY, type=ADTSPerWakeUp_Diag_FD11, init-value=SendCANR_PerWakeUp_Diag_FD11Value:0
    SendCANR_PerWakeUp_Diag_FD11Vld: service-kind=ANY-STANDARDIZED, invalidation-policy{data-element=SendCANR_PerWakeUp_Diag_FD11Vld, handle-invalid=DONT-INVALIDATE}  # Valid
      data SendCANR_PerWakeUp_Diag_FD11Vld: category=VALUE, sw-calibration-access=READ-ONLY, type=ADTSBoolean, init-value=SendCANR_PerWakeUp_Diag_FD11VldValue:1
    SendCANR_PerWakeUp_Diag_FD16: service-kind=ANY-STANDARDIZED, invalidation-policy{data-element=SendCANR_PerWakeUp_Diag_FD16, handle-invalid=DONT-INVALIDATE}
      data SendCANR_PerWakeUp_Diag_FD16: category=VALUE, sw-calibration-access=READ-ONLY, type=ADTSPerWakeUp_Diag_FD16, init-value=SendCANR_PerWakeUp_Diag_FD16Value:0
    SendCANR_PerWakeUp_Diag_FD16Vld: service-kind=ANY-STANDARDIZED, invalidation-policy{data-element=SendCANR_PerWakeUp_Diag_FD16Vld, handle-invalid=DONT-INVALIDATE}  # Valid
      data SendCANR_PerWakeUp_Diag_FD16Vld: category=VALUE, sw-calibration-access=READ-ONLY, type=ADTSBoolean, init-value=SendCANR_PerWakeUp_Diag_FD16VldValue:1
    SendCANR_PerWakeUp_Diag_FD5: service-kind=ANY-STANDARDIZED, invalidation-policy{data-element=SendCANR_PerWakeUp_Diag_FD5, handle-invalid=DONT-INVALIDATE}
      data SendCANR_PerWakeUp_Diag_FD5: category=VALUE, sw-calibration-access=READ-ONLY, type=ADTSPerWakeUp_Diag_FD5, init-value=SendCANR_PerWakeUp_Diag_FD5Value:0
    SendCANR_PerWakeUp_Diag_FD5Vld: service-kind=ANY-STANDARDIZED, invalidation-policy{data-element=SendCANR_PerWakeUp_Diag_FD5Vld, handle-invalid=DONT-INVALIDATE}  # Valid
      data SendCANR_PerWakeUp_Diag_FD5Vld: category=VALUE, sw-calibration-access=READ-ONLY, type=ADTSBoolean, init-value=SendCANR_PerWakeUp_Diag_FD5VldValue:1
    SendCANR_PnC_Failure: service-kind=ANY-STANDARDIZED, invalidation-policy{data-element=SendCANR_PnC_Failure, handle-invalid=DONT-INVALIDATE}
      data SendCANR_PnC_Failure: category=VALUE, sw-calibration-access=READ-ONLY, type=ADTSBoolean, init-value=SendCANR_PnC_FailureValue:0
    SendCANR_PnC_FailureVld: service-kind=ANY-STANDARDIZED, invalidation-policy{data-element=SendCANR_PnC_FailureVld, handle-invalid=DONT-INVALIDATE}  # Valid
      data SendCANR_PnC_FailureVld: category=VALUE, sw-calibration-access=READ-ONLY, type=ADTSBoolean, init-value=SendCANR_PnC_FailureVldValue:1
    SendCANR_PnC_Reattepmt_Failure: service-kind=ANY-STANDARDIZED, invalidation-policy{data-element=SendCANR_PnC_Reattepmt_Failure, handle-invalid=DONT-INVALIDATE}
      data SendCANR_PnC_Reattepmt_Failure: category=VALUE, sw-calibration-access=READ-ONLY, type=ADTSBoolean, init-value=SendCANR_PnC_Reattepmt_FailureValue:0
    SendCANR_PnC_Reattepmt_FailureVld: service-kind=ANY-STANDARDIZED, invalidation-policy{data-element=SendCANR_PnC_Reattepmt_FailureVld, handle-invalid=DONT-INVALIDATE}  # Valid
      data SendCANR_PnC_Reattepmt_FailureVld: category=VALUE, sw-calibration-access=READ-ONLY, type=ADTSBoolean, init-value=SendCANR_PnC_Reattepmt_FailureVldValue:1
    SendCANR_PrplsnSysActive_10B: service-kind=ANY-STANDARDIZED, invalidation-policy{data-element=SendCANR_PrplsnSysActive_10B, handle-invalid=DONT-INVALIDATE}
      data SendCANR_PrplsnSysActive_10B: category=VALUE, sw-calibration-access=READ-ONLY, type=ADTSBoolean, init-value=SendCANR_PrplsnSysActive_10BValue:0
    SendCANR_PrplsnSysActive_10B_Vld: service-kind=ANY-STANDARDIZED, invalidation-policy{data-element=SendCANR_PrplsnSysActive_10B_Vld, handle-invalid=DONT-INVALIDATE}  # Valid
      data SendCANR_PrplsnSysActive_10B_Vld: category=VALUE, sw-calibration-access=READ-ONLY, type=ADTSBoolean, init-value=SendCANR_PrplsnSysActive_10B_VldValue:1
    SendCANR_PrvCanNMStFD03EVCU2FD3: service-kind=ANY-STANDARDIZED, invalidation-policy{data-element=SendCANR_PrvCanNMStFD03EVCU2FD3, handle-invalid=DONT-INVALIDATE}
      data SendCANR_PrvCanNMStFD03EVCU2FD3: category=VALUE, sw-calibration-access=READ-ONLY, type=ADTSPrvCanNMStFD03EVCU2FD3, init-value=SendCANR_PrvCanNMStFD03EVCU2FD3Value:0
    SendCANR_PrvCanNMStFD03EVCU2FD3Vld: service-kind=ANY-STANDARDIZED, invalidation-policy{data-element=SendCANR_PrvCanNMStFD03EVCU2FD3Vld, handle-invalid=DONT-INVALIDATE}  # Valid
      data SendCANR_PrvCanNMStFD03EVCU2FD3Vld: category=VALUE, sw-calibration-access=READ-ONLY, type=ADTSBoolean, init-value=SendCANR_PrvCanNMStFD03EVCU2FD3VldValue:1
    SendCANR_PrvCanNMStFD05EVCU2FD3: service-kind=ANY-STANDARDIZED, invalidation-policy{data-element=SendCANR_PrvCanNMStFD05EVCU2FD3, handle-invalid=DONT-INVALIDATE}
      data SendCANR_PrvCanNMStFD05EVCU2FD3: category=VALUE, sw-calibration-access=READ-ONLY, type=ADTSPrvCanNMStFD05EVCU2FD3, init-value=SendCANR_PrvCanNMStFD05EVCU2FD3Value:0
    SendCANR_PrvCanNMStFD05EVCU2FD3Vld: service-kind=ANY-STANDARDIZED, invalidation-policy{data-element=SendCANR_PrvCanNMStFD05EVCU2FD3Vld, handle-invalid=DONT-INVALIDATE}  # Valid
      data SendCANR_PrvCanNMStFD05EVCU2FD3Vld: category=VALUE, sw-calibration-access=READ-ONLY, type=ADTSBoolean, init-value=SendCANR_PrvCanNMStFD05EVCU2FD3VldValue:1
    SendCANR_PrvCanNMStFD11EVCU2FD3: service-kind=ANY-STANDARDIZED, invalidation-policy{data-element=SendCANR_PrvCanNMStFD11EVCU2FD3, handle-invalid=DONT-INVALIDATE}
      data SendCANR_PrvCanNMStFD11EVCU2FD3: category=VALUE, sw-calibration-access=READ-ONLY, type=ADTSPrvCanNMStFD11EVCU2FD3, init-value=SendCANR_PrvCanNMStFD11EVCU2FD3Value:0
    SendCANR_PrvCanNMStFD11EVCU2FD3Vld: service-kind=ANY-STANDARDIZED, invalidation-policy{data-element=SendCANR_PrvCanNMStFD11EVCU2FD3Vld, handle-invalid=DONT-INVALIDATE}  # Valid
      data SendCANR_PrvCanNMStFD11EVCU2FD3Vld: category=VALUE, sw-calibration-access=READ-ONLY, type=ADTSBoolean, init-value=SendCANR_PrvCanNMStFD11EVCU2FD3VldValue:1
    SendCANR_PrvCanNMStFD16EVCU2FD3: service-kind=ANY-STANDARDIZED, invalidation-policy{data-element=SendCANR_PrvCanNMStFD16EVCU2FD3, handle-invalid=DONT-INVALIDATE}
      data SendCANR_PrvCanNMStFD16EVCU2FD3: category=VALUE, sw-calibration-access=READ-ONLY, type=ADTSPrvCanNMStFD16EVCU2FD3, init-value=SendCANR_PrvCanNMStFD16EVCU2FD3Value:0
    SendCANR_PrvCanNMStFD16EVCU2FD3Vld: service-kind=ANY-STANDARDIZED, invalidation-policy{data-element=SendCANR_PrvCanNMStFD16EVCU2FD3Vld, handle-invalid=DONT-INVALIDATE}  # Valid
      data SendCANR_PrvCanNMStFD16EVCU2FD3Vld: category=VALUE, sw-calibration-access=READ-ONLY, type=ADTSBoolean, init-value=SendCANR_PrvCanNMStFD16EVCU2FD3VldValue:1
    SendCANR_PtPrplsnActv_FD11: service-kind=ANY-STANDARDIZED, invalidation-policy{data-element=SendCANR_PtPrplsnActv_FD11, handle-invalid=DONT-INVALIDATE}
      data SendCANR_PtPrplsnActv_FD11: category=VALUE, sw-calibration-access=READ-ONLY, type=ADTSBoolean, init-value=SendCANR_PtPrplsnActv_FD11Value:0
    SendCANR_PtPrplsnActv_FD11Vld: service-kind=ANY-STANDARDIZED, invalidation-policy{data-element=SendCANR_PtPrplsnActv_FD11Vld, handle-invalid=DONT-INVALIDATE}  # Valid
      data SendCANR_PtPrplsnActv_FD11Vld: category=VALUE, sw-calibration-access=READ-ONLY, type=ADTSBoolean, init-value=SendCANR_PtPrplsnActv_FD11VldValue:1
    SendCANR_PtrainPrplsnActvPTFD11: service-kind=ANY-STANDARDIZED, invalidation-policy{data-element=SendCANR_PtrainPrplsnActvPTFD11, handle-invalid=DONT-INVALIDATE}
      data SendCANR_PtrainPrplsnActvPTFD11: category=VALUE, sw-calibration-access=READ-ONLY, type=ADTSBoolean, init-value=SendCANR_PtrainPrplsnActvPTFD11Value:0
    SendCANR_PtrainPrplsnActvPTFD11Vld: service-kind=ANY-STANDARDIZED, invalidation-policy{data-element=SendCANR_PtrainPrplsnActvPTFD11Vld, handle-invalid=DONT-INVALIDATE}  # Valid
      data SendCANR_PtrainPrplsnActvPTFD11Vld: category=VALUE, sw-calibration-access=READ-ONLY, type=ADTSBoolean, init-value=SendCANR_PtrainPrplsnActvPTFD11VldValue:1
    SendCANR_PvCanNMStFD03EVCU2FD11: service-kind=ANY-STANDARDIZED, invalidation-policy{data-element=SendCANR_PvCanNMStFD03EVCU2FD11, handle-invalid=DONT-INVALIDATE}
      data SendCANR_PvCanNMStFD03EVCU2FD11: category=VALUE, sw-calibration-access=READ-ONLY, type=ADTSPvCanNMStFD03EVCU2FD11, init-value=SendCANR_PvCanNMStFD03EVCU2FD11Value:0
    SendCANR_PvCanNMStFD03EVCU2FD11Vld: service-kind=ANY-STANDARDIZED, invalidation-policy{data-element=SendCANR_PvCanNMStFD03EVCU2FD11Vld, handle-invalid=DONT-INVALIDATE}  # Valid
      data SendCANR_PvCanNMStFD03EVCU2FD11Vld: category=VALUE, sw-calibration-access=READ-ONLY, type=ADTSBoolean, init-value=SendCANR_PvCanNMStFD03EVCU2FD11VldValue:1
    SendCANR_PvCanNMStFD05EVCU2FD11: service-kind=ANY-STANDARDIZED, invalidation-policy{data-element=SendCANR_PvCanNMStFD05EVCU2FD11, handle-invalid=DONT-INVALIDATE}
      data SendCANR_PvCanNMStFD05EVCU2FD11: category=VALUE, sw-calibration-access=READ-ONLY, type=ADTSPvCanNMStFD05EVCU2FD11, init-value=SendCANR_PvCanNMStFD05EVCU2FD11Value:0
    SendCANR_PvCanNMStFD05EVCU2FD11Vld: service-kind=ANY-STANDARDIZED, invalidation-policy{data-element=SendCANR_PvCanNMStFD05EVCU2FD11Vld, handle-invalid=DONT-INVALIDATE}  # Valid
      data SendCANR_PvCanNMStFD05EVCU2FD11Vld: category=VALUE, sw-calibration-access=READ-ONLY, type=ADTSBoolean, init-value=SendCANR_PvCanNMStFD05EVCU2FD11VldValue:1
    SendCANR_PvCanNMStFD11EVCU2FD11: service-kind=ANY-STANDARDIZED, invalidation-policy{data-element=SendCANR_PvCanNMStFD11EVCU2FD11, handle-invalid=DONT-INVALIDATE}
      data SendCANR_PvCanNMStFD11EVCU2FD11: category=VALUE, sw-calibration-access=READ-ONLY, type=ADTSPvCanNMStFD11EVCU2FD11, init-value=SendCANR_PvCanNMStFD11EVCU2FD11Value:0
    SendCANR_PvCanNMStFD11EVCU2FD11Vld: service-kind=ANY-STANDARDIZED, invalidation-policy{data-element=SendCANR_PvCanNMStFD11EVCU2FD11Vld, handle-invalid=DONT-INVALIDATE}  # Valid
      data SendCANR_PvCanNMStFD11EVCU2FD11Vld: category=VALUE, sw-calibration-access=READ-ONLY, type=ADTSBoolean, init-value=SendCANR_PvCanNMStFD11EVCU2FD11VldValue:1
    SendCANR_PvCanNMStFD16EVCU2FD11: service-kind=ANY-STANDARDIZED, invalidation-policy{data-element=SendCANR_PvCanNMStFD16EVCU2FD11, handle-invalid=DONT-INVALIDATE}
      data SendCANR_PvCanNMStFD16EVCU2FD11: category=VALUE, sw-calibration-access=READ-ONLY, type=ADTSPvCanNMStFD16EVCU2FD11, init-value=SendCANR_PvCanNMStFD16EVCU2FD11Value:0
    SendCANR_PvCanNMStFD16EVCU2FD11Vld: service-kind=ANY-STANDARDIZED, invalidation-policy{data-element=SendCANR_PvCanNMStFD16EVCU2FD11Vld, handle-invalid=DONT-INVALIDATE}  # Valid
      data SendCANR_PvCanNMStFD16EVCU2FD11Vld: category=VALUE, sw-calibration-access=READ-ONLY, type=ADTSBoolean, init-value=SendCANR_PvCanNMStFD16EVCU2FD11VldValue:1
    SendCANR_PwrSht_Prep_Prt_Cmplt: service-kind=ANY-STANDARDIZED, invalidation-policy{data-element=SendCANR_PwrSht_Prep_Prt_Cmplt, handle-invalid=DONT-INVALIDATE}
      data SendCANR_PwrSht_Prep_Prt_Cmplt: category=VALUE, sw-calibration-access=READ-ONLY, type=ADTSPwrSht_Prep_Prt_Cmplt, init-value=SendCANR_PwrSht_Prep_Prt_CmpltValue:0
    SendCANR_PwrSht_Prep_Prt_CmpltVld: service-kind=ANY-STANDARDIZED, invalidation-policy{data-element=SendCANR_PwrSht_Prep_Prt_CmpltVld, handle-invalid=DONT-INVALIDATE}  # Valid
      data SendCANR_PwrSht_Prep_Prt_CmpltVld: category=VALUE, sw-calibration-access=READ-ONLY, type=ADTSBoolean, init-value=SendCANR_PwrSht_Prep_Prt_CmpltVldValue:1
    SendCANR_QualifyDriveCycle_FD11: service-kind=ANY-STANDARDIZED, invalidation-policy{data-element=SendCANR_QualifyDriveCycle_FD11, handle-invalid=DONT-INVALIDATE}
      data SendCANR_QualifyDriveCycle_FD11: category=VALUE, sw-calibration-access=READ-ONLY, type=ADTSBoolean, init-value=SendCANR_QualifyDriveCycle_FD11Value:0
    SendCANR_QualifyDriveCycle_FD11Vld: service-kind=ANY-STANDARDIZED, invalidation-policy{data-element=SendCANR_QualifyDriveCycle_FD11Vld, handle-invalid=DONT-INVALIDATE}  # Valid
      data SendCANR_QualifyDriveCycle_FD11Vld: category=VALUE, sw-calibration-access=READ-ONLY, type=ADTSBoolean, init-value=SendCANR_QualifyDriveCycle_FD11VldValue:1
    SendCANR_RACE_PREP_AMBIENT_TMP: service-kind=ANY-STANDARDIZED, invalidation-policy{data-element=SendCANR_RACE_PREP_AMBIENT_TMP, handle-invalid=DONT-INVALIDATE}
      data SendCANR_RACE_PREP_AMBIENT_TMP: category=VALUE, sw-calibration-access=READ-ONLY, type=ADTSBoolean, init-value=SendCANR_RACE_PREP_AMBIENT_TMPValue:0
    SendCANR_RACE_PREP_AMBIENT_TMP_Vld: service-kind=ANY-STANDARDIZED, invalidation-policy{data-element=SendCANR_RACE_PREP_AMBIENT_TMP_Vld, handle-invalid=DONT-INVALIDATE}  # Valid
      data SendCANR_RACE_PREP_AMBIENT_TMP_Vld: category=VALUE, sw-calibration-access=READ-ONLY, type=ADTSBoolean, init-value=SendCANR_RACE_PREP_AMBIENT_TMP_VldValue:1
    SendCANR_RACE_PREP_BATT_LVL_STS: service-kind=ANY-STANDARDIZED, invalidation-policy{data-element=SendCANR_RACE_PREP_BATT_LVL_STS, handle-invalid=DONT-INVALIDATE}
      data SendCANR_RACE_PREP_BATT_LVL_STS: category=VALUE, sw-calibration-access=READ-ONLY, type=ADTSBoolean, init-value=SendCANR_RACE_PREP_BATT_LVL_STSValue:0
    SendCANR_RACE_PREP_BATT_LVL_STS_Vld: service-kind=ANY-STANDARDIZED, invalidation-policy{data-element=SendCANR_RACE_PREP_BATT_LVL_STS_Vld, handle-invalid=DONT-INVALIDATE}  # Valid
      data SendCANR_RACE_PREP_BATT_LVL_STS_Vld: category=VALUE, sw-calibration-access=READ-ONLY, type=ADTSBoolean, init-value=SendCANR_RACE_PREP_BATT_LVL_STS_VldValue:1
    SendCANR_RACE_PREP_EV_DEAC_TIME: service-kind=ANY-STANDARDIZED, invalidation-policy{data-element=SendCANR_RACE_PREP_EV_DEAC_TIME, handle-invalid=KEEP}
      data SendCANR_RACE_PREP_EV_DEAC_TIME: category=VALUE, sw-calibration-access=READ-ONLY, type=ADTSRACE_PREP_EV_DEAC_TIME, init-value=SendCANR_RACE_PREP_EV_DEAC_TIMEValue:0
    SendCANR_RACE_PREP_EV_DEAC_TIME_Vld: service-kind=ANY-STANDARDIZED, invalidation-policy{data-element=SendCANR_RACE_PREP_EV_DEAC_TIME_Vld, handle-invalid=DONT-INVALIDATE}  # Valid
      data SendCANR_RACE_PREP_EV_DEAC_TIME_Vld: category=VALUE, sw-calibration-access=READ-ONLY, type=ADTSBoolean, init-value=SendCANR_RACE_PREP_EV_DEAC_TIME_VldValue:1
    SendCANR_RACE_PREP_EV_SYS_STS: service-kind=ANY-STANDARDIZED, invalidation-policy{data-element=SendCANR_RACE_PREP_EV_SYS_STS, handle-invalid=DONT-INVALIDATE}
      data SendCANR_RACE_PREP_EV_SYS_STS: category=VALUE, sw-calibration-access=READ-ONLY, type=ADTSBoolean, init-value=SendCANR_RACE_PREP_EV_SYS_STSValue:0
    SendCANR_RACE_PREP_EV_SYS_STS_Vld: service-kind=ANY-STANDARDIZED, invalidation-policy{data-element=SendCANR_RACE_PREP_EV_SYS_STS_Vld, handle-invalid=DONT-INVALIDATE}  # Valid
      data SendCANR_RACE_PREP_EV_SYS_STS_Vld: category=VALUE, sw-calibration-access=READ-ONLY, type=ADTSBoolean, init-value=SendCANR_RACE_PREP_EV_SYS_STS_VldValue:1
    SendCANR_RACE_PREP_RCE_TYP_STS: service-kind=ANY-STANDARDIZED, invalidation-policy{data-element=SendCANR_RACE_PREP_RCE_TYP_STS, handle-invalid=DONT-INVALIDATE}
      data SendCANR_RACE_PREP_RCE_TYP_STS: category=VALUE, sw-calibration-access=READ-ONLY, type=ADTSBoolean, init-value=SendCANR_RACE_PREP_RCE_TYP_STSValue:0
    SendCANR_RACE_PREP_RCE_TYP_STS_Vld: service-kind=ANY-STANDARDIZED, invalidation-policy{data-element=SendCANR_RACE_PREP_RCE_TYP_STS_Vld, handle-invalid=DONT-INVALIDATE}  # Valid
      data SendCANR_RACE_PREP_RCE_TYP_STS_Vld: category=VALUE, sw-calibration-access=READ-ONLY, type=ADTSBoolean, init-value=SendCANR_RACE_PREP_RCE_TYP_STS_VldValue:1
    SendCANR_RACE_PREP_THERMAL_TGT: service-kind=ANY-STANDARDIZED, invalidation-policy{data-element=SendCANR_RACE_PREP_THERMAL_TGT, handle-invalid=KEEP}
      data SendCANR_RACE_PREP_THERMAL_TGT: category=VALUE, sw-calibration-access=READ-ONLY, type=ADTSRACE_PREP_THERMAL_TGT, init-value=SendCANR_RACE_PREP_THERMAL_TGTValue:0
    SendCANR_RACE_PREP_THERMAL_TGT_Vld: service-kind=ANY-STANDARDIZED, invalidation-policy{data-element=SendCANR_RACE_PREP_THERMAL_TGT_Vld, handle-invalid=DONT-INVALIDATE}  # Valid
      data SendCANR_RACE_PREP_THERMAL_TGT_Vld: category=VALUE, sw-calibration-access=READ-ONLY, type=ADTSBoolean, init-value=SendCANR_RACE_PREP_THERMAL_TGT_VldValue:1
    SendCANR_RACE_PRP_HVBTT_SOC_TGT: service-kind=ANY-STANDARDIZED, invalidation-policy{data-element=SendCANR_RACE_PRP_HVBTT_SOC_TGT, handle-invalid=KEEP}
      data SendCANR_RACE_PRP_HVBTT_SOC_TGT: category=VALUE, sw-calibration-access=READ-ONLY, type=ADTSRACE_PRP_HVBTT_SOC_TGT, init-value=SendCANR_RACE_PRP_HVBTT_SOC_TGTValue:0
    SendCANR_RACE_PRP_HVBTT_SOC_TGT_Vld: service-kind=ANY-STANDARDIZED, invalidation-policy{data-element=SendCANR_RACE_PRP_HVBTT_SOC_TGT_Vld, handle-invalid=DONT-INVALIDATE}  # Valid
      data SendCANR_RACE_PRP_HVBTT_SOC_TGT_Vld: category=VALUE, sw-calibration-access=READ-ONLY, type=ADTSBoolean, init-value=SendCANR_RACE_PRP_HVBTT_SOC_TGT_VldValue:1
    SendCANR_RELSD_FailureSts: service-kind=ANY-STANDARDIZED, invalidation-policy{data-element=SendCANR_RELSD_FailureSts, handle-invalid=DONT-INVALIDATE}
      data SendCANR_RELSD_FailureSts: category=VALUE, sw-calibration-access=READ-ONLY, type=ADTSRELSD_FailureSts, init-value=SendCANR_RELSD_FailureStsValue:3
    SendCANR_RELSD_FailureStsVld: service-kind=ANY-STANDARDIZED, invalidation-policy{data-element=SendCANR_RELSD_FailureStsVld, handle-invalid=DONT-INVALIDATE}  # Valid
      data SendCANR_RELSD_FailureStsVld: category=VALUE, sw-calibration-access=READ-ONLY, type=ADTSBoolean, init-value=SendCANR_RELSD_FailureStsVldValue:1
    SendCANR_RELSD_Status: service-kind=ANY-STANDARDIZED, invalidation-policy{data-element=SendCANR_RELSD_Status, handle-invalid=DONT-INVALIDATE}
      data SendCANR_RELSD_Status: category=VALUE, sw-calibration-access=READ-ONLY, type=ADTSRELSD_Status, init-value=SendCANR_RELSD_StatusValue:0
    SendCANR_RELSD_StatusVld: service-kind=ANY-STANDARDIZED, invalidation-policy{data-element=SendCANR_RELSD_StatusVld, handle-invalid=DONT-INVALIDATE}  # Valid
      data SendCANR_RELSD_StatusVld: category=VALUE, sw-calibration-access=READ-ONLY, type=ADTSBoolean, init-value=SendCANR_RELSD_StatusVldValue:1
    SendCANR_RELSD_TgtTrq_FD16: service-kind=ANY-STANDARDIZED, invalidation-policy{data-element=SendCANR_RELSD_TgtTrq_FD16, handle-invalid=KEEP}
      data SendCANR_RELSD_TgtTrq_FD16: category=VALUE, sw-calibration-access=READ-ONLY, type=ADTSRELSD_TgtTrq_FD16, init-value=SendCANR_RELSD_TgtTrq_FD16Value:0
    SendCANR_RELSD_TgtTrq_FD3: service-kind=ANY-STANDARDIZED, invalidation-policy{data-element=SendCANR_RELSD_TgtTrq_FD3, handle-invalid=KEEP}
      data SendCANR_RELSD_TgtTrq_FD3: category=VALUE, sw-calibration-access=READ-ONLY, type=ADTSRELSD_TgtTrq_FD3, init-value=SendCANR_RELSD_TgtTrqValue_FD3:0
    SendCANR_RELSD_TgtTrq_FD16Vld: service-kind=ANY-STANDARDIZED, invalidation-policy{data-element=SendCANR_RELSD_TgtTrq_FD16Vld, handle-invalid=DONT-INVALIDATE}  # Valid
      data SendCANR_RELSD_TgtTrq_FD16Vld: category=VALUE, sw-calibration-access=READ-ONLY, type=ADTSBoolean, init-value=SendCANR_RELSD_TgtTrq_FD16VldValue:1
    SendCANR_RELSD_TgtTrq_FD3Vld: service-kind=ANY-STANDARDIZED, invalidation-policy{data-element=SendCANR_RELSD_TgtTrq_FD3Vld, handle-invalid=DONT-INVALIDATE}  # Valid
      data SendCANR_RELSD_TgtTrq_FD3Vld: category=VALUE, sw-calibration-access=READ-ONLY, type=ADTSBoolean, init-value=SendCANR_RELSD_TgtTrq_FD3VldValue:1
    SendCANR_RI_AC_FAN_Range: service-kind=ANY-STANDARDIZED, invalidation-policy{data-element=SendCANR_RI_AC_FAN_Range, handle-invalid=KEEP}
      data SendCANR_RI_AC_FAN_Range: category=VALUE, sw-calibration-access=READ-ONLY, type=ADTSRI_AC_FAN_Range, init-value=SendCANR_RI_AC_FAN_RangeValue:0
    SendCANR_RI_AC_FAN_RangeVld: service-kind=ANY-STANDARDIZED, invalidation-policy{data-element=SendCANR_RI_AC_FAN_RangeVld, handle-invalid=DONT-INVALIDATE}  # Valid
      data SendCANR_RI_AC_FAN_RangeVld: category=VALUE, sw-calibration-access=READ-ONLY, type=ADTSBoolean, init-value=SendCANR_RI_AC_FAN_RangeVldValue:1
    SendCANR_RI_AUDIO_Range: service-kind=ANY-STANDARDIZED, invalidation-policy{data-element=SendCANR_RI_AUDIO_Range, handle-invalid=KEEP}
      data SendCANR_RI_AUDIO_Range: category=VALUE, sw-calibration-access=READ-ONLY, type=ADTSRI_AUDIO_Range, init-value=SendCANR_RI_AUDIO_RangeValue:0
    SendCANR_RI_AUDIO_RangeVld: service-kind=ANY-STANDARDIZED, invalidation-policy{data-element=SendCANR_RI_AUDIO_RangeVld, handle-invalid=DONT-INVALIDATE}  # Valid
      data SendCANR_RI_AUDIO_RangeVld: category=VALUE, sw-calibration-access=READ-ONLY, type=ADTSBoolean, init-value=SendCANR_RI_AUDIO_RangeVldValue:1
    SendCANR_RI_DEFROST_Range: service-kind=ANY-STANDARDIZED, invalidation-policy{data-element=SendCANR_RI_DEFROST_Range, handle-invalid=KEEP}
      data SendCANR_RI_DEFROST_Range: category=VALUE, sw-calibration-access=READ-ONLY, type=ADTSRI_DEFROST_Range, init-value=SendCANR_RI_DEFROST_RangeValue:0
    SendCANR_RI_DEFROST_RangeVld: service-kind=ANY-STANDARDIZED, invalidation-policy{data-element=SendCANR_RI_DEFROST_RangeVld, handle-invalid=DONT-INVALIDATE}  # Valid
      data SendCANR_RI_DEFROST_RangeVld: category=VALUE, sw-calibration-access=READ-ONLY, type=ADTSBoolean, init-value=SendCANR_RI_DEFROST_RangeVldValue:1
    SendCANR_RI_LIGHTS_Range: service-kind=ANY-STANDARDIZED, invalidation-policy{data-element=SendCANR_RI_LIGHTS_Range, handle-invalid=KEEP}
      data SendCANR_RI_LIGHTS_Range: category=VALUE, sw-calibration-access=READ-ONLY, type=ADTSRI_LIGHTS_Range, init-value=SendCANR_RI_LIGHTS_RangeValue:0
    SendCANR_RI_LIGHTS_RangeVld: service-kind=ANY-STANDARDIZED, invalidation-policy{data-element=SendCANR_RI_LIGHTS_RangeVld, handle-invalid=DONT-INVALIDATE}  # Valid
      data SendCANR_RI_LIGHTS_RangeVld: category=VALUE, sw-calibration-access=READ-ONLY, type=ADTSBoolean, init-value=SendCANR_RI_LIGHTS_RangeVldValue:1
    SendCANR_RI_OTHER_Range: service-kind=ANY-STANDARDIZED, invalidation-policy{data-element=SendCANR_RI_OTHER_Range, handle-invalid=DONT-INVALIDATE}
      data SendCANR_RI_OTHER_Range: category=VALUE, sw-calibration-access=READ-ONLY, type=ADTSRI_OTHER_Range, init-value=SendCANR_RI_OTHER_RangeValue:0
    SendCANR_RI_OTHER_RangeVld: service-kind=ANY-STANDARDIZED, invalidation-policy{data-element=SendCANR_RI_OTHER_RangeVld, handle-invalid=DONT-INVALIDATE}  # Valid
      data SendCANR_RI_OTHER_RangeVld: category=VALUE, sw-calibration-access=READ-ONLY, type=ADTSBoolean, init-value=SendCANR_RI_OTHER_RangeVldValue:1
    SendCANR_RI_SEATSWHL_Range: service-kind=ANY-STANDARDIZED, invalidation-policy{data-element=SendCANR_RI_SEATSWHL_Range, handle-invalid=KEEP}
      data SendCANR_RI_SEATSWHL_Range: category=VALUE, sw-calibration-access=READ-ONLY, type=ADTSRI_SEATSWHL_Range, init-value=SendCANR_RI_SEATSWHL_RangeValue:0
    SendCANR_RI_SEATSWHL_RangeVld: service-kind=ANY-STANDARDIZED, invalidation-policy{data-element=SendCANR_RI_SEATSWHL_RangeVld, handle-invalid=DONT-INVALIDATE}  # Valid
      data SendCANR_RI_SEATSWHL_RangeVld: category=VALUE, sw-calibration-access=READ-ONLY, type=ADTSBoolean, init-value=SendCANR_RI_SEATSWHL_RangeVldValue:1
    SendCANR_RI_TOTAL_Range_Add: service-kind=ANY-STANDARDIZED, invalidation-policy{data-element=SendCANR_RI_TOTAL_Range_Add, handle-invalid=KEEP}
      data SendCANR_RI_TOTAL_Range_Add: category=VALUE, sw-calibration-access=READ-ONLY, type=ADTSRI_TOTAL_Range_Add, init-value=SendCANR_RI_TOTAL_Range_AddValue:0
    SendCANR_RI_TOTAL_Range_AddVld: service-kind=ANY-STANDARDIZED, invalidation-policy{data-element=SendCANR_RI_TOTAL_Range_AddVld, handle-invalid=DONT-INVALIDATE}  # Valid
      data SendCANR_RI_TOTAL_Range_AddVld: category=VALUE, sw-calibration-access=READ-ONLY, type=ADTSBoolean, init-value=SendCANR_RI_TOTAL_Range_AddVldValue:1
    SendCANR_Racemode_Popup_PT: service-kind=ANY-STANDARDIZED, invalidation-policy{data-element=SendCANR_Racemode_Popup_PT, handle-invalid=DONT-INVALIDATE}
      data SendCANR_Racemode_Popup_PT: category=VALUE, sw-calibration-access=READ-ONLY, type=ADTSRacemode_Popup_PT, init-value=SendCANR_Racemode_Popup_PTValue:0
    SendCANR_Racemode_Popup_PT_Vld: service-kind=ANY-STANDARDIZED, invalidation-policy{data-element=SendCANR_Racemode_Popup_PT_Vld, handle-invalid=DONT-INVALIDATE}  # Valid
      data SendCANR_Racemode_Popup_PT_Vld: category=VALUE, sw-calibration-access=READ-ONLY, type=ADTSBoolean, init-value=SendCANR_Racemode_Popup_PT_VldValue:1
    SendCANR_RadiatorFanSts: service-kind=ANY-STANDARDIZED, invalidation-policy{data-element=SendCANR_RadiatorFanSts, handle-invalid=KEEP}
      data SendCANR_RadiatorFanSts: category=VALUE, sw-calibration-access=READ-ONLY, type=ADTSRadiatorFanSts, init-value=SendCANR_RadiatorFanStsValue:0
    SendCANR_RadiatorFanStsVld: service-kind=ANY-STANDARDIZED, invalidation-policy{data-element=SendCANR_RadiatorFanStsVld, handle-invalid=DONT-INVALIDATE}  # Valid
      data SendCANR_RadiatorFanStsVld: category=VALUE, sw-calibration-access=READ-ONLY, type=ADTSBoolean, init-value=SendCANR_RadiatorFanStsVldValue:1
    SendCANR_Ready_Status_EVCU2: service-kind=ANY-STANDARDIZED, invalidation-policy{data-element=SendCANR_Ready_Status_EVCU2, handle-invalid=DONT-INVALIDATE}
      data SendCANR_Ready_Status_EVCU2: category=VALUE, sw-calibration-access=READ-ONLY, type=ADTSReady_Status_EVCU2, init-value=SendCANR_Ready_Status_EVCU2Value:0
    SendCANR_Ready_Status_EVCU2Vld: service-kind=ANY-STANDARDIZED, invalidation-policy{data-element=SendCANR_Ready_Status_EVCU2Vld, handle-invalid=DONT-INVALIDATE}  # Valid
      data SendCANR_Ready_Status_EVCU2Vld: category=VALUE, sw-calibration-access=READ-ONLY, type=ADTSBoolean, init-value=SendCANR_Ready_Status_EVCU2VldValue:1
    SendCANR_Real_Time_Clock_FD16: service-kind=ANY-STANDARDIZED, invalidation-policy{data-element=SendCANR_Real_Time_Clock_FD16, handle-invalid=KEEP}
      data SendCANR_Real_Time_Clock_FD16: category=VALUE, sw-calibration-access=READ-ONLY, type=ADTSReal_Time_Clock_FD16, init-value=SendCANR_Real_Time_Clock_FD16Value:0
    SendCANR_Real_Time_Clock_FD16Vld: service-kind=ANY-STANDARDIZED, invalidation-policy{data-element=SendCANR_Real_Time_Clock_FD16Vld, handle-invalid=DONT-INVALIDATE}  # Valid
      data SendCANR_Real_Time_Clock_FD16Vld: category=VALUE, sw-calibration-access=READ-ONLY, type=ADTSBoolean, init-value=SendCANR_Real_Time_Clock_FD16VldValue:1
    SendCANR_Real_Time_Clock_FD5: service-kind=ANY-STANDARDIZED, invalidation-policy{data-element=SendCANR_Real_Time_Clock_FD5, handle-invalid=KEEP}
      data SendCANR_Real_Time_Clock_FD5: category=VALUE, sw-calibration-access=READ-ONLY, type=ADTSReal_Time_Clock_FD5, init-value=SendCANR_Real_Time_Clock_FD5Value:0
    SendCANR_Real_Time_Clock_FD5Vld: service-kind=ANY-STANDARDIZED, invalidation-policy{data-element=SendCANR_Real_Time_Clock_FD5Vld, handle-invalid=DONT-INVALIDATE}  # Valid
      data SendCANR_Real_Time_Clock_FD5Vld: category=VALUE, sw-calibration-access=READ-ONLY, type=ADTSBoolean, init-value=SendCANR_Real_Time_Clock_FD5VldValue:1
    SendCANR_Real_Time_Valdity_FD16: service-kind=ANY-STANDARDIZED, invalidation-policy{data-element=SendCANR_Real_Time_Valdity_FD16, handle-invalid=DONT-INVALIDATE}
      data SendCANR_Real_Time_Valdity_FD16: category=VALUE, sw-calibration-access=READ-ONLY, type=ADTSBoolean, init-value=SendCANR_Real_Time_Valdity_FD16Value:0
    SendCANR_Real_Time_Valdity_FD16Vld: service-kind=ANY-STANDARDIZED, invalidation-policy{data-element=SendCANR_Real_Time_Valdity_FD16Vld, handle-invalid=DONT-INVALIDATE}  # Valid
      data SendCANR_Real_Time_Valdity_FD16Vld: category=VALUE, sw-calibration-access=READ-ONLY, type=ADTSBoolean, init-value=SendCANR_Real_Time_Valdity_FD16VldValue:1
    SendCANR_Real_Time_Validity_FD5: service-kind=ANY-STANDARDIZED, invalidation-policy{data-element=SendCANR_Real_Time_Validity_FD5, handle-invalid=DONT-INVALIDATE}
      data SendCANR_Real_Time_Validity_FD5: category=VALUE, sw-calibration-access=READ-ONLY, type=ADTSBoolean, init-value=SendCANR_Real_Time_Validity_FD5Value:0
    SendCANR_Real_Time_Validity_FD5Vld: service-kind=ANY-STANDARDIZED, invalidation-policy{data-element=SendCANR_Real_Time_Validity_FD5Vld, handle-invalid=DONT-INVALIDATE}  # Valid
      data SendCANR_Real_Time_Validity_FD5Vld: category=VALUE, sw-calibration-access=READ-ONLY, type=ADTSBoolean, init-value=SendCANR_Real_Time_Validity_FD5VldValue:1
    SendCANR_RearAirHtrCoreTemp: service-kind=ANY-STANDARDIZED, invalidation-policy{data-element=SendCANR_RearAirHtrCoreTemp, handle-invalid=KEEP}
      data SendCANR_RearAirHtrCoreTemp: category=VALUE, sw-calibration-access=READ-ONLY, type=ADTSRearAirHtrCoreTemp, init-value=SendCANR_RearAirHtrCoreTempValue:175
    SendCANR_RearAirHtrCoreTempVld: service-kind=ANY-STANDARDIZED, invalidation-policy{data-element=SendCANR_RearAirHtrCoreTempVld, handle-invalid=DONT-INVALIDATE}  # Valid
      data SendCANR_RearAirHtrCoreTempVld: category=VALUE, sw-calibration-access=READ-ONLY, type=ADTSBoolean, init-value=SendCANR_RearAirHtrCoreTempVldValue:1
    SendCANR_RearAirHtrPCBTemp: service-kind=ANY-STANDARDIZED, invalidation-policy{data-element=SendCANR_RearAirHtrPCBTemp, handle-invalid=KEEP}
      data SendCANR_RearAirHtrPCBTemp: category=VALUE, sw-calibration-access=READ-ONLY, type=ADTSRearAirHtrPCBTemp, init-value=SendCANR_RearAirHtrPCBTempValue:175
    SendCANR_RearAirHtrPCBTempVld: service-kind=ANY-STANDARDIZED, invalidation-policy{data-element=SendCANR_RearAirHtrPCBTempVld, handle-invalid=DONT-INVALIDATE}  # Valid
      data SendCANR_RearAirHtrPCBTempVld: category=VALUE, sw-calibration-access=READ-ONLY, type=ADTSBoolean, init-value=SendCANR_RearAirHtrPCBTempVldValue:1
    SendCANR_RearAirHtrPwrCnsAct: service-kind=ANY-STANDARDIZED, invalidation-policy{data-element=SendCANR_RearAirHtrPwrCnsAct, handle-invalid=KEEP}
      data SendCANR_RearAirHtrPwrCnsAct: category=VALUE, sw-calibration-access=READ-ONLY, type=ADTSRearAirHtrPwrCnsAct, init-value=SendCANR_RearAirHtrPwrCnsActValue:0
    SendCANR_RearAirHtrPwrCnsActVld: service-kind=ANY-STANDARDIZED, invalidation-policy{data-element=SendCANR_RearAirHtrPwrCnsActVld, handle-invalid=DONT-INVALIDATE}  # Valid
      data SendCANR_RearAirHtrPwrCnsActVld: category=VALUE, sw-calibration-access=READ-ONLY, type=ADTSBoolean, init-value=SendCANR_RearAirHtrPwrCnsActVldValue:1
    SendCANR_SGCP_DC_Current_P_FD11: service-kind=ANY-STANDARDIZED, invalidation-policy{data-element=SendCANR_SGCP_DC_Current_P_FD11, handle-invalid=DONT-INVALIDATE}
      data SendCANR_SGCP_DC_Current_P_FD11: category=VALUE, sw-calibration-access=READ-ONLY, type=ADTSSGCP_DC_Current_P_FD11, init-value=SendCANR_SGCP_DC_Current_P_FD11Value:0
    SendCANR_SGCP_DC_Current_P_FD11Vld: service-kind=ANY-STANDARDIZED, invalidation-policy{data-element=SendCANR_SGCP_DC_Current_P_FD11Vld, handle-invalid=DONT-INVALIDATE}  # Valid
      data SendCANR_SGCP_DC_Current_P_FD11Vld: category=VALUE, sw-calibration-access=READ-ONLY, type=ADTSBoolean, init-value=SendCANR_SGCP_DC_Current_P_FD11VldValue:1
    SendCANR_SGCP_OIL_FlwRate_FD16: service-kind=ANY-STANDARDIZED, invalidation-policy{data-element=SendCANR_SGCP_OIL_FlwRate_FD16, handle-invalid=KEEP}
      data SendCANR_SGCP_OIL_FlwRate_FD16: category=VALUE, sw-calibration-access=READ-ONLY, type=ADTSSGCP_OIL_FlwRate_FD16, init-value=SendCANR_SGCP_OIL_FlwRate_FD16Value:0
    SendCANR_SGCP_OIL_FlwRate_FD16Vld: service-kind=ANY-STANDARDIZED, invalidation-policy{data-element=SendCANR_SGCP_OIL_FlwRate_FD16Vld, handle-invalid=DONT-INVALIDATE}  # Valid
      data SendCANR_SGCP_OIL_FlwRate_FD16Vld: category=VALUE, sw-calibration-access=READ-ONLY, type=ADTSBoolean, init-value=SendCANR_SGCP_OIL_FlwRate_FD16VldValue:1
    SendCANR_SGCP_OIL_FlwRate_FD5: service-kind=ANY-STANDARDIZED, invalidation-policy{data-element=SendCANR_SGCP_OIL_FlwRate_FD5, handle-invalid=KEEP}
      data SendCANR_SGCP_OIL_FlwRate_FD5: category=VALUE, sw-calibration-access=READ-ONLY, type=ADTSSGCP_OIL_FlwRate_FD5, init-value=SendCANR_SGCP_OIL_FlwRate_FD5Value:0
    SendCANR_SGCP_OIL_FlwRate_FD5Vld: service-kind=ANY-STANDARDIZED, invalidation-policy{data-element=SendCANR_SGCP_OIL_FlwRate_FD5Vld, handle-invalid=DONT-INVALIDATE}  # Valid
      data SendCANR_SGCP_OIL_FlwRate_FD5Vld: category=VALUE, sw-calibration-access=READ-ONLY, type=ADTSBoolean, init-value=SendCANR_SGCP_OIL_FlwRate_FD5VldValue:1
    SendCANR_SGCP_OIL_TEMP_FD16: service-kind=ANY-STANDARDIZED, invalidation-policy{data-element=SendCANR_SGCP_OIL_TEMP_FD16, handle-invalid=KEEP}
      data SendCANR_SGCP_OIL_TEMP_FD16: category=VALUE, sw-calibration-access=READ-ONLY, type=ADTSSGCP_OIL_TEMP_FD16, init-value=SendCANR_SGCP_OIL_TEMP_FD16Value:-50
    SendCANR_SGCP_OIL_TEMP_FD16Vld: service-kind=ANY-STANDARDIZED, invalidation-policy{data-element=SendCANR_SGCP_OIL_TEMP_FD16Vld, handle-invalid=DONT-INVALIDATE}  # Valid
      data SendCANR_SGCP_OIL_TEMP_FD16Vld: category=VALUE, sw-calibration-access=READ-ONLY, type=ADTSBoolean, init-value=SendCANR_SGCP_OIL_TEMP_FD16VldValue:1
    SendCANR_SGCP_OIL_TEMP_FD5: service-kind=ANY-STANDARDIZED, invalidation-policy{data-element=SendCANR_SGCP_OIL_TEMP_FD5, handle-invalid=KEEP}
      data SendCANR_SGCP_OIL_TEMP_FD5: category=VALUE, sw-calibration-access=READ-ONLY, type=ADTSSGCP_OIL_TEMP_FD5, init-value=SendCANR_SGCP_OIL_TEMP_FD5Value:-50
    SendCANR_SGCP_OIL_TEMP_FD5Vld: service-kind=ANY-STANDARDIZED, invalidation-policy{data-element=SendCANR_SGCP_OIL_TEMP_FD5Vld, handle-invalid=DONT-INVALIDATE}  # Valid
      data SendCANR_SGCP_OIL_TEMP_FD5Vld: category=VALUE, sw-calibration-access=READ-ONLY, type=ADTSBoolean, init-value=SendCANR_SGCP_OIL_TEMP_FD5VldValue:1
    SendCANR_SGCP_Temp_FD11: service-kind=ANY-STANDARDIZED, invalidation-policy{data-element=SendCANR_SGCP_Temp_FD11, handle-invalid=KEEP}
      data SendCANR_SGCP_Temp_FD11: category=VALUE, sw-calibration-access=READ-ONLY, type=ADTSSGCP_Temp_FD11, init-value=SendCANR_SGCP_Temp_FD11Value:-40
    SendCANR_SGCP_Temp_FD11Vld: service-kind=ANY-STANDARDIZED, invalidation-policy{data-element=SendCANR_SGCP_Temp_FD11Vld, handle-invalid=DONT-INVALIDATE}  # Valid
      data SendCANR_SGCP_Temp_FD11Vld: category=VALUE, sw-calibration-access=READ-ONLY, type=ADTSBoolean, init-value=SendCANR_SGCP_Temp_FD11VldValue:1
    SendCANR_SchCond_Time_Till_Dep: service-kind=ANY-STANDARDIZED, invalidation-policy{data-element=SendCANR_SchCond_Time_Till_Dep, handle-invalid=KEEP}
      data SendCANR_SchCond_Time_Till_Dep: category=VALUE, sw-calibration-access=READ-ONLY, type=ADTSSchCond_Time_Till_Dep, init-value=SendCANR_SchCond_Time_Till_DepValue:0
    SendCANR_SchCond_Time_Till_DepVld: service-kind=ANY-STANDARDIZED, invalidation-policy{data-element=SendCANR_SchCond_Time_Till_DepVld, handle-invalid=DONT-INVALIDATE}  # Valid
      data SendCANR_SchCond_Time_Till_DepVld: category=VALUE, sw-calibration-access=READ-ONLY, type=ADTSBoolean, init-value=SendCANR_SchCond_Time_Till_DepVldValue:1
    SendCANR_Sch_PreCondition_Sts: service-kind=ANY-STANDARDIZED, invalidation-policy{data-element=SendCANR_Sch_PreCondition_Sts, handle-invalid=KEEP}
      data SendCANR_Sch_PreCondition_Sts: category=VALUE, sw-calibration-access=READ-ONLY, type=ADTSSch_PreCondition_Sts, init-value=SendCANR_Sch_PreCondition_StsValue:0
    SendCANR_Sch_PreCondition_StsVld: service-kind=ANY-STANDARDIZED, invalidation-policy{data-element=SendCANR_Sch_PreCondition_StsVld, handle-invalid=DONT-INVALIDATE}  # Valid
      data SendCANR_Sch_PreCondition_StsVld: category=VALUE, sw-calibration-access=READ-ONLY, type=ADTSBoolean, init-value=SendCANR_Sch_PreCondition_StsVldValue:1
    SendCANR_Schedule_Confirmed1: service-kind=ANY-STANDARDIZED, invalidation-policy{data-element=SendCANR_Schedule_Confirmed1, handle-invalid=DONT-INVALIDATE}
      data SendCANR_Schedule_Confirmed1: category=VALUE, sw-calibration-access=READ-ONLY, type=ADTSBoolean, init-value=SendCANR_Schedule_Confirmed1Value:0
    SendCANR_Schedule_Confirmed1Vld: service-kind=ANY-STANDARDIZED, invalidation-policy{data-element=SendCANR_Schedule_Confirmed1Vld, handle-invalid=DONT-INVALIDATE}  # Valid
      data SendCANR_Schedule_Confirmed1Vld: category=VALUE, sw-calibration-access=READ-ONLY, type=ADTSBoolean, init-value=SendCANR_Schedule_Confirmed1VldValue:1
    SendCANR_Schedule_Confirmed2: service-kind=ANY-STANDARDIZED, invalidation-policy{data-element=SendCANR_Schedule_Confirmed2, handle-invalid=DONT-INVALIDATE}
      data SendCANR_Schedule_Confirmed2: category=VALUE, sw-calibration-access=READ-ONLY, type=ADTSBoolean, init-value=SendCANR_Schedule_Confirmed2Value:0
    SendCANR_Schedule_Confirmed2Vld: service-kind=ANY-STANDARDIZED, invalidation-policy{data-element=SendCANR_Schedule_Confirmed2Vld, handle-invalid=DONT-INVALIDATE}  # Valid
      data SendCANR_Schedule_Confirmed2Vld: category=VALUE, sw-calibration-access=READ-ONLY, type=ADTSBoolean, init-value=SendCANR_Schedule_Confirmed2VldValue:1
    SendCANR_Schedule_Day1_Sts: service-kind=ANY-STANDARDIZED, invalidation-policy{data-element=SendCANR_Schedule_Day1_Sts, handle-invalid=KEEP}
      data SendCANR_Schedule_Day1_Sts: category=VALUE, sw-calibration-access=READ-ONLY, type=ADTSSchedule_Day1_Sts, init-value=SendCANR_Schedule_Day1_StsValue:0
    SendCANR_Schedule_Day1_StsVld: service-kind=ANY-STANDARDIZED, invalidation-policy{data-element=SendCANR_Schedule_Day1_StsVld, handle-invalid=DONT-INVALIDATE}  # Valid
      data SendCANR_Schedule_Day1_StsVld: category=VALUE, sw-calibration-access=READ-ONLY, type=ADTSBoolean, init-value=SendCANR_Schedule_Day1_StsVldValue:1
    SendCANR_Schedule_Day2_Sts: service-kind=ANY-STANDARDIZED, invalidation-policy{data-element=SendCANR_Schedule_Day2_Sts, handle-invalid=KEEP}
      data SendCANR_Schedule_Day2_Sts: category=VALUE, sw-calibration-access=READ-ONLY, type=ADTSSchedule_Day2_Sts, init-value=SendCANR_Schedule_Day2_StsValue:0
    SendCANR_Schedule_Day2_StsVld: service-kind=ANY-STANDARDIZED, invalidation-policy{data-element=SendCANR_Schedule_Day2_StsVld, handle-invalid=DONT-INVALIDATE}  # Valid
      data SendCANR_Schedule_Day2_StsVld: category=VALUE, sw-calibration-access=READ-ONLY, type=ADTSBoolean, init-value=SendCANR_Schedule_Day2_StsVldValue:1
    SendCANR_StageKitCFG: service-kind=ANY-STANDARDIZED, invalidation-policy{data-element=SendCANR_StageKitCFG, handle-invalid=DONT-INVALIDATE}
      data SendCANR_StageKitCFG: category=VALUE, sw-calibration-access=READ-ONLY, type=ADTSStageKitCFG, init-value=SendCANR_StageKitCFGValue:0
    SendCANR_StageKitCFG_Vld: service-kind=ANY-STANDARDIZED, invalidation-policy{data-element=SendCANR_StageKitCFG_Vld, handle-invalid=DONT-INVALIDATE}  # Valid
      data SendCANR_StageKitCFG_Vld: category=VALUE, sw-calibration-access=READ-ONLY, type=ADTSBoolean, init-value=SendCANR_StageKitCFG_VldValue:1
    SendCANR_Start_Time_Hr1_Sts: service-kind=ANY-STANDARDIZED, invalidation-policy{data-element=SendCANR_Start_Time_Hr1_Sts, handle-invalid=KEEP}
      data SendCANR_Start_Time_Hr1_Sts: category=VALUE, sw-calibration-access=READ-ONLY, type=ADTSStart_Time_Hr1_Sts, init-value=SendCANR_Start_Time_Hr1_StsValue:0
    SendCANR_Start_Time_Hr1_StsVld: service-kind=ANY-STANDARDIZED, invalidation-policy{data-element=SendCANR_Start_Time_Hr1_StsVld, handle-invalid=DONT-INVALIDATE}  # Valid
      data SendCANR_Start_Time_Hr1_StsVld: category=VALUE, sw-calibration-access=READ-ONLY, type=ADTSBoolean, init-value=SendCANR_Start_Time_Hr1_StsVldValue:1
    SendCANR_Start_Time_Hr2_Sts: service-kind=ANY-STANDARDIZED, invalidation-policy{data-element=SendCANR_Start_Time_Hr2_Sts, handle-invalid=KEEP}
      data SendCANR_Start_Time_Hr2_Sts: category=VALUE, sw-calibration-access=READ-ONLY, type=ADTSStart_Time_Hr2_Sts, init-value=SendCANR_Start_Time_Hr2_StsValue:0
    SendCANR_Start_Time_Hr2_StsVld: service-kind=ANY-STANDARDIZED, invalidation-policy{data-element=SendCANR_Start_Time_Hr2_StsVld, handle-invalid=DONT-INVALIDATE}  # Valid
      data SendCANR_Start_Time_Hr2_StsVld: category=VALUE, sw-calibration-access=READ-ONLY, type=ADTSBoolean, init-value=SendCANR_Start_Time_Hr2_StsVldValue:1
    SendCANR_Start_Time_Min1_Sts: service-kind=ANY-STANDARDIZED, invalidation-policy{data-element=SendCANR_Start_Time_Min1_Sts, handle-invalid=KEEP}
      data SendCANR_Start_Time_Min1_Sts: category=VALUE, sw-calibration-access=READ-ONLY, type=ADTSStart_Time_Min1_Sts, init-value=SendCANR_Start_Time_Min1_StsValue:0
    SendCANR_Start_Time_Min1_StsVld: service-kind=ANY-STANDARDIZED, invalidation-policy{data-element=SendCANR_Start_Time_Min1_StsVld, handle-invalid=DONT-INVALIDATE}  # Valid
      data SendCANR_Start_Time_Min1_StsVld: category=VALUE, sw-calibration-access=READ-ONLY, type=ADTSBoolean, init-value=SendCANR_Start_Time_Min1_StsVldValue:1
    SendCANR_Start_Time_Min2_Sts: service-kind=ANY-STANDARDIZED, invalidation-policy{data-element=SendCANR_Start_Time_Min2_Sts, handle-invalid=KEEP}
      data SendCANR_Start_Time_Min2_Sts: category=VALUE, sw-calibration-access=READ-ONLY, type=ADTSStart_Time_Min2_Sts, init-value=SendCANR_Start_Time_Min2_StsValue:0
    SendCANR_Start_Time_Min2_StsVld: service-kind=ANY-STANDARDIZED, invalidation-policy{data-element=SendCANR_Start_Time_Min2_StsVld, handle-invalid=DONT-INVALIDATE}  # Valid
      data SendCANR_Start_Time_Min2_StsVld: category=VALUE, sw-calibration-access=READ-ONLY, type=ADTSBoolean, init-value=SendCANR_Start_Time_Min2_StsVldValue:1
    SendCANR_StopReqBeforeCharge: service-kind=ANY-STANDARDIZED, invalidation-policy{data-element=SendCANR_StopReqBeforeCharge, handle-invalid=DONT-INVALIDATE}
      data SendCANR_StopReqBeforeCharge: category=VALUE, sw-calibration-access=READ-ONLY, type=ADTSBoolean, init-value=SendCANR_StopReqBeforeChargeValue:0
    SendCANR_StopReqBeforeChargeVld: service-kind=ANY-STANDARDIZED, invalidation-policy{data-element=SendCANR_StopReqBeforeChargeVld, handle-invalid=DONT-INVALIDATE}  # Valid
      data SendCANR_StopReqBeforeChargeVld: category=VALUE, sw-calibration-access=READ-ONLY, type=ADTSBoolean, init-value=SendCANR_StopReqBeforeChargeVldValue:1
    SendCANR_StyActSrcFD03EVCU2FD11: service-kind=ANY-STANDARDIZED, invalidation-policy{data-element=SendCANR_StyActSrcFD03EVCU2FD11, handle-invalid=DONT-INVALIDATE}
      data SendCANR_StyActSrcFD03EVCU2FD11: category=VALUE, sw-calibration-access=READ-ONLY, type=ADTSStyActSrcFD03EVCU2FD11, init-value=SendCANR_StyActSrcFD03EVCU2FD11Value:0
    SendCANR_StyActSrcFD03EVCU2FD11Vld: service-kind=ANY-STANDARDIZED, invalidation-policy{data-element=SendCANR_StyActSrcFD03EVCU2FD11Vld, handle-invalid=DONT-INVALIDATE}  # Valid
      data SendCANR_StyActSrcFD03EVCU2FD11Vld: category=VALUE, sw-calibration-access=READ-ONLY, type=ADTSBoolean, init-value=SendCANR_StyActSrcFD03EVCU2FD11VldValue:1
    SendCANR_StyActSrcFD03_EVCU2FD3: service-kind=ANY-STANDARDIZED, invalidation-policy{data-element=SendCANR_StyActSrcFD03_EVCU2FD3, handle-invalid=DONT-INVALIDATE}
      data SendCANR_StyActSrcFD03_EVCU2FD3: category=VALUE, sw-calibration-access=READ-ONLY, type=ADTSStyActSrcFD03_EVCU2FD3, init-value=SendCANR_StyActSrcFD03_EVCU2FD3Value:0
    SendCANR_StyActSrcFD03_EVCU2FD3Vld: service-kind=ANY-STANDARDIZED, invalidation-policy{data-element=SendCANR_StyActSrcFD03_EVCU2FD3Vld, handle-invalid=DONT-INVALIDATE}  # Valid
      data SendCANR_StyActSrcFD03_EVCU2FD3Vld: category=VALUE, sw-calibration-access=READ-ONLY, type=ADTSBoolean, init-value=SendCANR_StyActSrcFD03_EVCU2FD3VldValue:1
    SendCANR_StyActSrcFD05EVCU2FD11: service-kind=ANY-STANDARDIZED, invalidation-policy{data-element=SendCANR_StyActSrcFD05EVCU2FD11, handle-invalid=DONT-INVALIDATE}
      data SendCANR_StyActSrcFD05EVCU2FD11: category=VALUE, sw-calibration-access=READ-ONLY, type=ADTSStyActSrcFD05EVCU2FD11, init-value=SendCANR_StyActSrcFD05EVCU2FD11Value:0
    SendCANR_StyActSrcFD05EVCU2FD11Vld: service-kind=ANY-STANDARDIZED, invalidation-policy{data-element=SendCANR_StyActSrcFD05EVCU2FD11Vld, handle-invalid=DONT-INVALIDATE}  # Valid
      data SendCANR_StyActSrcFD05EVCU2FD11Vld: category=VALUE, sw-calibration-access=READ-ONLY, type=ADTSBoolean, init-value=SendCANR_StyActSrcFD05EVCU2FD11VldValue:1
    SendCANR_StyActSrcFD05_EVCU2FD3: service-kind=ANY-STANDARDIZED, invalidation-policy{data-element=SendCANR_StyActSrcFD05_EVCU2FD3, handle-invalid=DONT-INVALIDATE}
      data SendCANR_StyActSrcFD05_EVCU2FD3: category=VALUE, sw-calibration-access=READ-ONLY, type=ADTSStyActSrcFD05_EVCU2FD3, init-value=SendCANR_StyActSrcFD05_EVCU2FD3Value:0
    SendCANR_StyActSrcFD05_EVCU2FD3Vld: service-kind=ANY-STANDARDIZED, invalidation-policy{data-element=SendCANR_StyActSrcFD05_EVCU2FD3Vld, handle-invalid=DONT-INVALIDATE}  # Valid
      data SendCANR_StyActSrcFD05_EVCU2FD3Vld: category=VALUE, sw-calibration-access=READ-ONLY, type=ADTSBoolean, init-value=SendCANR_StyActSrcFD05_EVCU2FD3VldValue:1
    SendCANR_StyActSrcFD11EVCU2FD11: service-kind=ANY-STANDARDIZED, invalidation-policy{data-element=SendCANR_StyActSrcFD11EVCU2FD11, handle-invalid=DONT-INVALIDATE}
      data SendCANR_StyActSrcFD11EVCU2FD11: category=VALUE, sw-calibration-access=READ-ONLY, type=ADTSStyActSrcFD11EVCU2FD11, init-value=SendCANR_StyActSrcFD11EVCU2FD11Value:0
    SendCANR_StyActSrcFD11EVCU2FD11Vld: service-kind=ANY-STANDARDIZED, invalidation-policy{data-element=SendCANR_StyActSrcFD11EVCU2FD11Vld, handle-invalid=DONT-INVALIDATE}  # Valid
      data SendCANR_StyActSrcFD11EVCU2FD11Vld: category=VALUE, sw-calibration-access=READ-ONLY, type=ADTSBoolean, init-value=SendCANR_StyActSrcFD11EVCU2FD11VldValue:1
    SendCANR_StyActSrcFD11_EVCU2FD3: service-kind=ANY-STANDARDIZED, invalidation-policy{data-element=SendCANR_StyActSrcFD11_EVCU2FD3, handle-invalid=DONT-INVALIDATE}
      data SendCANR_StyActSrcFD11_EVCU2FD3: category=VALUE, sw-calibration-access=READ-ONLY, type=ADTSStyActSrcFD11_EVCU2FD3, init-value=SendCANR_StyActSrcFD11_EVCU2FD3Value:0
    SendCANR_StyActSrcFD11_EVCU2FD3Vld: service-kind=ANY-STANDARDIZED, invalidation-policy{data-element=SendCANR_StyActSrcFD11_EVCU2FD3Vld, handle-invalid=DONT-INVALIDATE}  # Valid
      data SendCANR_StyActSrcFD11_EVCU2FD3Vld: category=VALUE, sw-calibration-access=READ-ONLY, type=ADTSBoolean, init-value=SendCANR_StyActSrcFD11_EVCU2FD3VldValue:1
    SendCANR_StyActSrcFD16EVCU2FD11: service-kind=ANY-STANDARDIZED, invalidation-policy{data-element=SendCANR_StyActSrcFD16EVCU2FD11, handle-invalid=DONT-INVALIDATE}
      data SendCANR_StyActSrcFD16EVCU2FD11: category=VALUE, sw-calibration-access=READ-ONLY, type=ADTSStyActSrcFD16EVCU2FD11, init-value=SendCANR_StyActSrcFD16EVCU2FD11Value:0
    SendCANR_StyActSrcFD16EVCU2FD11Vld: service-kind=ANY-STANDARDIZED, invalidation-policy{data-element=SendCANR_StyActSrcFD16EVCU2FD11Vld, handle-invalid=DONT-INVALIDATE}  # Valid
      data SendCANR_StyActSrcFD16EVCU2FD11Vld: category=VALUE, sw-calibration-access=READ-ONLY, type=ADTSBoolean, init-value=SendCANR_StyActSrcFD16EVCU2FD11VldValue:1
    SendCANR_StyActSrcFD16_EVCU2FD3: service-kind=ANY-STANDARDIZED, invalidation-policy{data-element=SendCANR_StyActSrcFD16_EVCU2FD3, handle-invalid=DONT-INVALIDATE}
      data SendCANR_StyActSrcFD16_EVCU2FD3: category=VALUE, sw-calibration-access=READ-ONLY, type=ADTSStyActSrcFD16_EVCU2FD3, init-value=SendCANR_StyActSrcFD16_EVCU2FD3Value:0
    SendCANR_StyActSrcFD16_EVCU2FD3Vld: service-kind=ANY-STANDARDIZED, invalidation-policy{data-element=SendCANR_StyActSrcFD16_EVCU2FD3Vld, handle-invalid=DONT-INVALIDATE}  # Valid
      data SendCANR_StyActSrcFD16_EVCU2FD3Vld: category=VALUE, sw-calibration-access=READ-ONLY, type=ADTSBoolean, init-value=SendCANR_StyActSrcFD16_EVCU2FD3VldValue:1
    SendCANR_SugSpeedMax: service-kind=ANY-STANDARDIZED, invalidation-policy{data-element=SendCANR_SugSpeedMax, handle-invalid=KEEP}
      data SendCANR_SugSpeedMax: category=VALUE, sw-calibration-access=READ-ONLY, type=ADTSSugSpeedMax, init-value=SendCANR_SugSpeedMaxValue:314
    SendCANR_SugSpeedMaxVld: service-kind=ANY-STANDARDIZED, invalidation-policy{data-element=SendCANR_SugSpeedMaxVld, handle-invalid=DONT-INVALIDATE}  # Valid
      data SendCANR_SugSpeedMaxVld: category=VALUE, sw-calibration-access=READ-ONLY, type=ADTSBoolean, init-value=SendCANR_SugSpeedMaxVldValue:1
    SendCANR_SugSpeedMin: service-kind=ANY-STANDARDIZED, invalidation-policy{data-element=SendCANR_SugSpeedMin, handle-invalid=KEEP}
      data SendCANR_SugSpeedMin: category=VALUE, sw-calibration-access=READ-ONLY, type=ADTSSugSpeedMin, init-value=SendCANR_SugSpeedMinValue:0
    SendCANR_SugSpeedMinVld: service-kind=ANY-STANDARDIZED, invalidation-policy{data-element=SendCANR_SugSpeedMinVld, handle-invalid=DONT-INVALIDATE}  # Valid
      data SendCANR_SugSpeedMinVld: category=VALUE, sw-calibration-access=READ-ONLY, type=ADTSBoolean, init-value=SendCANR_SugSpeedMinVldValue:1
    SendCANR_SugSpeedThreshold: service-kind=ANY-STANDARDIZED, invalidation-policy{data-element=SendCANR_SugSpeedThreshold, handle-invalid=KEEP}
      data SendCANR_SugSpeedThreshold: category=VALUE, sw-calibration-access=READ-ONLY, type=ADTSSugSpeedThreshold, init-value=SendCANR_SugSpeedThresholdValue:0
    SendCANR_SugSpeedThresholdVld: service-kind=ANY-STANDARDIZED, invalidation-policy{data-element=SendCANR_SugSpeedThresholdVld, handle-invalid=DONT-INVALIDATE}  # Valid
      data SendCANR_SugSpeedThresholdVld: category=VALUE, sw-calibration-access=READ-ONLY, type=ADTSBoolean, init-value=SendCANR_SugSpeedThresholdVldValue:1
    SendCANR_Syst_Actual_Charge_Lim: service-kind=ANY-STANDARDIZED, invalidation-policy{data-element=SendCANR_Syst_Actual_Charge_Lim, handle-invalid=KEEP}
      data SendCANR_Syst_Actual_Charge_Lim: category=VALUE, sw-calibration-access=READ-ONLY, type=ADTSSyst_Actual_Charge_Lim, init-value=SendCANR_Syst_Actual_Charge_LimValue:0
    SendCANR_Syst_Actual_Charge_LimVld: service-kind=ANY-STANDARDIZED, invalidation-policy{data-element=SendCANR_Syst_Actual_Charge_LimVld, handle-invalid=DONT-INVALIDATE}  # Valid
      data SendCANR_Syst_Actual_Charge_LimVld: category=VALUE, sw-calibration-access=READ-ONLY, type=ADTSBoolean, init-value=SendCANR_Syst_Actual_Charge_LimVldValue:1
    SendCANR_Syst_Actual_Charge_Pwr: service-kind=ANY-STANDARDIZED, invalidation-policy{data-element=SendCANR_Syst_Actual_Charge_Pwr, handle-invalid=KEEP}
      data SendCANR_Syst_Actual_Charge_Pwr: category=VALUE, sw-calibration-access=READ-ONLY, type=ADTSSyst_Actual_Charge_Pwr, init-value=SendCANR_Syst_Actual_Charge_PwrValue:0
    SendCANR_Syst_Actual_Charge_PwrVld: service-kind=ANY-STANDARDIZED, invalidation-policy{data-element=SendCANR_Syst_Actual_Charge_PwrVld, handle-invalid=DONT-INVALIDATE}  # Valid
      data SendCANR_Syst_Actual_Charge_PwrVld: category=VALUE, sw-calibration-access=READ-ONLY, type=ADTSBoolean, init-value=SendCANR_Syst_Actual_Charge_PwrVldValue:1
    SendCANR_T4_Sensor_Temp_FD16: service-kind=ANY-STANDARDIZED, invalidation-policy{data-element=SendCANR_T4_Sensor_Temp_FD16, handle-invalid=DONT-INVALIDATE}
      data SendCANR_T4_Sensor_Temp_FD16: category=VALUE, sw-calibration-access=READ-ONLY, type=ADTST4_Sensor_Temp_FD16, init-value=SendCANR_T4_Sensor_Temp_FD16Value:-40
    SendCANR_T4_Sensor_Temp_FD16Vld: service-kind=ANY-STANDARDIZED, invalidation-policy{data-element=SendCANR_T4_Sensor_Temp_FD16Vld, handle-invalid=DONT-INVALIDATE}  # Valid
      data SendCANR_T4_Sensor_Temp_FD16Vld: category=VALUE, sw-calibration-access=READ-ONLY, type=ADTSBoolean, init-value=SendCANR_T4_Sensor_Temp_FD16VldValue:1
    SendCANR_T4_Sensor_Temp_FD3: service-kind=ANY-STANDARDIZED, invalidation-policy{data-element=SendCANR_T4_Sensor_Temp_FD3, handle-invalid=DONT-INVALIDATE}
      data SendCANR_T4_Sensor_Temp_FD3: category=VALUE, sw-calibration-access=READ-ONLY, type=ADTST4_Sensor_Temp_FD3, init-value=SendCANR_T4_Sensor_Temp_FD3Value:-40
    SendCANR_T4_Sensor_Temp_FD3Vld: service-kind=ANY-STANDARDIZED, invalidation-policy{data-element=SendCANR_T4_Sensor_Temp_FD3Vld, handle-invalid=DONT-INVALIDATE}  # Valid
      data SendCANR_T4_Sensor_Temp_FD3Vld: category=VALUE, sw-calibration-access=READ-ONLY, type=ADTSBoolean, init-value=SendCANR_T4_Sensor_Temp_FD3VldValue:1
    SendCANR_T4_Sensor_Temp_FD5: service-kind=ANY-STANDARDIZED, invalidation-policy{data-element=SendCANR_T4_Sensor_Temp_FD5, handle-invalid=DONT-INVALIDATE}
      data SendCANR_T4_Sensor_Temp_FD5: category=VALUE, sw-calibration-access=READ-ONLY, type=ADTST4_Sensor_Temp_FD5, init-value=SendCANR_T4_Sensor_Temp_FD5Value:-40
    SendCANR_T4_Sensor_Temp_FD5Vld: service-kind=ANY-STANDARDIZED, invalidation-policy{data-element=SendCANR_T4_Sensor_Temp_FD5Vld, handle-invalid=DONT-INVALIDATE}  # Valid
      data SendCANR_T4_Sensor_Temp_FD5Vld: category=VALUE, sw-calibration-access=READ-ONLY, type=ADTSBoolean, init-value=SendCANR_T4_Sensor_Temp_FD5VldValue:1
    SendCANR_T7_CoolantTmpVldty_FD5: service-kind=ANY-STANDARDIZED, invalidation-policy{data-element=SendCANR_T7_CoolantTmpVldty_FD5, handle-invalid=DONT-INVALIDATE}
      data SendCANR_T7_CoolantTmpVldty_FD5: category=VALUE, sw-calibration-access=READ-ONLY, type=ADTSBoolean, init-value=SendCANR_T7_CoolantTmpVldty_FD5Value:0
    SendCANR_T7_CoolantTmpVldty_FD5Vld: service-kind=ANY-STANDARDIZED, invalidation-policy{data-element=SendCANR_T7_CoolantTmpVldty_FD5Vld, handle-invalid=DONT-INVALIDATE}  # Valid
      data SendCANR_T7_CoolantTmpVldty_FD5Vld: category=VALUE, sw-calibration-access=READ-ONLY, type=ADTSBoolean, init-value=SendCANR_T7_CoolantTmpVldty_FD5VldValue:1
    SendCANR_T7_CoolntTmpVldty_FD16: service-kind=ANY-STANDARDIZED, invalidation-policy{data-element=SendCANR_T7_CoolntTmpVldty_FD16, handle-invalid=DONT-INVALIDATE}
      data SendCANR_T7_CoolntTmpVldty_FD16: category=VALUE, sw-calibration-access=READ-ONLY, type=ADTSBoolean, init-value=SendCANR_T7_CoolntTmpVldty_FD16Value:0
    SendCANR_T7_CoolntTmpVldty_FD16Vld: service-kind=ANY-STANDARDIZED, invalidation-policy{data-element=SendCANR_T7_CoolntTmpVldty_FD16Vld, handle-invalid=DONT-INVALIDATE}  # Valid
      data SendCANR_T7_CoolntTmpVldty_FD16Vld: category=VALUE, sw-calibration-access=READ-ONLY, type=ADTSBoolean, init-value=SendCANR_T7_CoolntTmpVldty_FD16VldValue:1
    SendCANR_T7_Sensor_Temp_FD16: service-kind=ANY-STANDARDIZED, invalidation-policy{data-element=SendCANR_T7_Sensor_Temp_FD16, handle-invalid=DONT-INVALIDATE}
      data SendCANR_T7_Sensor_Temp_FD16: category=VALUE, sw-calibration-access=READ-ONLY, type=ADTST7_Sensor_Temp_FD16, init-value=SendCANR_T7_Sensor_Temp_FD16Value:-40
    SendCANR_T7_Sensor_Temp_FD16Vld: service-kind=ANY-STANDARDIZED, invalidation-policy{data-element=SendCANR_T7_Sensor_Temp_FD16Vld, handle-invalid=DONT-INVALIDATE}  # Valid
      data SendCANR_T7_Sensor_Temp_FD16Vld: category=VALUE, sw-calibration-access=READ-ONLY, type=ADTSBoolean, init-value=SendCANR_T7_Sensor_Temp_FD16VldValue:1
    SendCANR_T7_Sensor_Temp_FD5: service-kind=ANY-STANDARDIZED, invalidation-policy{data-element=SendCANR_T7_Sensor_Temp_FD5, handle-invalid=DONT-INVALIDATE}
      data SendCANR_T7_Sensor_Temp_FD5: category=VALUE, sw-calibration-access=READ-ONLY, type=ADTST7_Sensor_Temp_FD5, init-value=SendCANR_T7_Sensor_Temp_FD5Value:-40
    SendCANR_T7_Sensor_Temp_FD5Vld: service-kind=ANY-STANDARDIZED, invalidation-policy{data-element=SendCANR_T7_Sensor_Temp_FD5Vld, handle-invalid=DONT-INVALIDATE}  # Valid
      data SendCANR_T7_Sensor_Temp_FD5Vld: category=VALUE, sw-calibration-access=READ-ONLY, type=ADTSBoolean, init-value=SendCANR_T7_Sensor_Temp_FD5VldValue:1
    SendCANR_TotalBatteryCapacity: service-kind=ANY-STANDARDIZED, invalidation-policy{data-element=SendCANR_TotalBatteryCapacity, handle-invalid=DONT-INVALIDATE}
      data SendCANR_TotalBatteryCapacity: category=VALUE, sw-calibration-access=READ-ONLY, type=ADTSTotalBatteryCapacity, init-value=SendCANR_TotalBatteryCapacityValue:0
    SendCANR_TotalBatteryCapacityVld: service-kind=ANY-STANDARDIZED, invalidation-policy{data-element=SendCANR_TotalBatteryCapacityVld, handle-invalid=DONT-INVALIDATE}  # Valid
      data SendCANR_TotalBatteryCapacityVld: category=VALUE, sw-calibration-access=READ-ONLY, type=ADTSBoolean, init-value=SendCANR_TotalBatteryCapacityVldValue:1
    SendCANR_TotalOdometer_FD11: service-kind=ANY-STANDARDIZED, invalidation-policy{data-element=SendCANR_TotalOdometer_FD11, handle-invalid=DONT-INVALIDATE}
      data SendCANR_TotalOdometer_FD11: category=VALUE, sw-calibration-access=READ-ONLY, type=ADTSTotalOdometer_FD11, init-value=SendCANR_TotalOdometer_FD11Value:0
    SendCANR_TotalOdometer_FD11Vld: service-kind=ANY-STANDARDIZED, invalidation-policy{data-element=SendCANR_TotalOdometer_FD11Vld, handle-invalid=DONT-INVALIDATE}  # Valid
      data SendCANR_TotalOdometer_FD11Vld: category=VALUE, sw-calibration-access=READ-ONLY, type=ADTSBoolean, init-value=SendCANR_TotalOdometer_FD11VldValue:1
    SendCANR_TotalOdometer_FD16: service-kind=ANY-STANDARDIZED, invalidation-policy{data-element=SendCANR_TotalOdometer_FD16, handle-invalid=DONT-INVALIDATE}
      data SendCANR_TotalOdometer_FD16: category=VALUE, sw-calibration-access=READ-ONLY, type=ADTSTotalOdometer_FD16, init-value=SendCANR_TotalOdometer_FD16Value:0
    SendCANR_TotalOdometer_FD16Vld: service-kind=ANY-STANDARDIZED, invalidation-policy{data-element=SendCANR_TotalOdometer_FD16Vld, handle-invalid=DONT-INVALIDATE}  # Valid
      data SendCANR_TotalOdometer_FD16Vld: category=VALUE, sw-calibration-access=READ-ONLY, type=ADTSBoolean, init-value=SendCANR_TotalOdometer_FD16VldValue:1
    SendCANR_TotalOdometer_FD5: service-kind=ANY-STANDARDIZED, invalidation-policy{data-element=SendCANR_TotalOdometer_FD5, handle-invalid=DONT-INVALIDATE}
      data SendCANR_TotalOdometer_FD5: category=VALUE, sw-calibration-access=READ-ONLY, type=ADTSTotalOdometer_FD5, init-value=SendCANR_TotalOdometer_FD5Value:0
    SendCANR_TotalOdometer_FD5Vld: service-kind=ANY-STANDARDIZED, invalidation-policy{data-element=SendCANR_TotalOdometer_FD5Vld, handle-invalid=DONT-INVALIDATE}  # Valid
      data SendCANR_TotalOdometer_FD5Vld: category=VALUE, sw-calibration-access=READ-ONLY, type=ADTSBoolean, init-value=SendCANR_TotalOdometer_FD5VldValue:1
    SendCANR_Total_Battery_Capacity: service-kind=ANY-STANDARDIZED, invalidation-policy{data-element=SendCANR_Total_Battery_Capacity, handle-invalid=KEEP}
      data SendCANR_Total_Battery_Capacity: category=VALUE, sw-calibration-access=READ-ONLY, type=ADTSTotal_Battery_Capacity, init-value=SendCANR_Total_Battery_CapacityValue:0
    SendCANR_Total_Battery_CapacityVld: service-kind=ANY-STANDARDIZED, invalidation-policy{data-element=SendCANR_Total_Battery_CapacityVld, handle-invalid=DONT-INVALIDATE}  # Valid
      data SendCANR_Total_Battery_CapacityVld: category=VALUE, sw-calibration-access=READ-ONLY, type=ADTSBoolean, init-value=SendCANR_Total_Battery_CapacityVldValue:1
    SendCANR_Turtle_Speed_Limit: service-kind=ANY-STANDARDIZED, invalidation-policy{data-element=SendCANR_Turtle_Speed_Limit, handle-invalid=KEEP}
      data SendCANR_Turtle_Speed_Limit: category=VALUE, sw-calibration-access=READ-ONLY, type=ADTSTurtle_Speed_Limit, init-value=SendCANR_Turtle_Speed_LimitValue:255
    SendCANR_Turtle_Speed_LimitVld: service-kind=ANY-STANDARDIZED, invalidation-policy{data-element=SendCANR_Turtle_Speed_LimitVld, handle-invalid=DONT-INVALIDATE}  # Valid
      data SendCANR_Turtle_Speed_LimitVld: category=VALUE, sw-calibration-access=READ-ONLY, type=ADTSBoolean, init-value=SendCANR_Turtle_Speed_LimitVldValue:1
    SendCANR_V2HTotalPowerTimehours: service-kind=ANY-STANDARDIZED, invalidation-policy{data-element=SendCANR_V2HTotalPowerTimehours, handle-invalid=DONT-INVALIDATE}
      data SendCANR_V2HTotalPowerTimehours: category=VALUE, sw-calibration-access=READ-ONLY, type=ADTSV2HTotalPowerTimehours, init-value=SendCANR_V2HTotalPowerTimehoursValue:0
    SendCANR_V2HTotalPowerTimehoursVld: service-kind=ANY-STANDARDIZED, invalidation-policy{data-element=SendCANR_V2HTotalPowerTimehoursVld, handle-invalid=DONT-INVALIDATE}  # Valid
      data SendCANR_V2HTotalPowerTimehoursVld: category=VALUE, sw-calibration-access=READ-ONLY, type=ADTSBoolean, init-value=SendCANR_V2HTotalPowerTimehoursVldValue:1
    SendCANR_V2HTotalPowerTimeminut: service-kind=ANY-STANDARDIZED, invalidation-policy{data-element=SendCANR_V2HTotalPowerTimeminut, handle-invalid=DONT-INVALIDATE}
      data SendCANR_V2HTotalPowerTimeminut: category=VALUE, sw-calibration-access=READ-ONLY, type=ADTSV2HTotalPowerTimeminut, init-value=SendCANR_V2HTotalPowerTimeminutValue:0
    SendCANR_V2HTotalPowerTimeminutVld: service-kind=ANY-STANDARDIZED, invalidation-policy{data-element=SendCANR_V2HTotalPowerTimeminutVld, handle-invalid=DONT-INVALIDATE}  # Valid
      data SendCANR_V2HTotalPowerTimeminutVld: category=VALUE, sw-calibration-access=READ-ONLY, type=ADTSBoolean, init-value=SendCANR_V2HTotalPowerTimeminutVldValue:1
    SendCANR_V2H_Discharge_Capacity: service-kind=ANY-STANDARDIZED, invalidation-policy{data-element=SendCANR_V2H_Discharge_Capacity, handle-invalid=DONT-INVALIDATE}
      data SendCANR_V2H_Discharge_Capacity: category=VALUE, sw-calibration-access=READ-ONLY, type=ADTSV2H_Discharge_Capacity, init-value=SendCANR_V2H_Discharge_CapacityValue:0
    SendCANR_V2H_Discharge_CapacityVld: service-kind=ANY-STANDARDIZED, invalidation-policy{data-element=SendCANR_V2H_Discharge_CapacityVld, handle-invalid=DONT-INVALIDATE}  # Valid
      data SendCANR_V2H_Discharge_CapacityVld: category=VALUE, sw-calibration-access=READ-ONLY, type=ADTSBoolean, init-value=SendCANR_V2H_Discharge_CapacityVldValue:1
    SendCANR_V2H_HVCMS_EVMaxP_LtFD5: service-kind=ANY-STANDARDIZED, invalidation-policy{data-element=SendCANR_V2H_HVCMS_EVMaxP_LtFD5, handle-invalid=DONT-INVALIDATE}
      data SendCANR_V2H_HVCMS_EVMaxP_LtFD5: category=VALUE, sw-calibration-access=READ-ONLY, type=ADTSV2H_HVCMS_EVMaxP_LtFD5, init-value=SendCANR_V2H_HVCMS_EVMaxP_LtFD5Value:-819.1
    SendCANR_V2H_HVCMS_EVMaxP_LtFD5Vld: service-kind=ANY-STANDARDIZED, invalidation-policy{data-element=SendCANR_V2H_HVCMS_EVMaxP_LtFD5Vld, handle-invalid=DONT-INVALIDATE}  # Valid
      data SendCANR_V2H_HVCMS_EVMaxP_LtFD5Vld: category=VALUE, sw-calibration-access=READ-ONLY, type=ADTSBoolean, init-value=SendCANR_V2H_HVCMS_EVMaxP_LtFD5VldValue:1
    SendCANR_V2H_Instant_Power_Draw: service-kind=ANY-STANDARDIZED, invalidation-policy{data-element=SendCANR_V2H_Instant_Power_Draw, handle-invalid=DONT-INVALIDATE}
      data SendCANR_V2H_Instant_Power_Draw: category=VALUE, sw-calibration-access=READ-ONLY, type=ADTSV2H_Instant_Power_Draw, init-value=SendCANR_V2H_Instant_Power_DrawValue:0
    SendCANR_V2H_Instant_Power_DrawVld: service-kind=ANY-STANDARDIZED, invalidation-policy{data-element=SendCANR_V2H_Instant_Power_DrawVld, handle-invalid=DONT-INVALIDATE}  # Valid
      data SendCANR_V2H_Instant_Power_DrawVld: category=VALUE, sw-calibration-access=READ-ONLY, type=ADTSBoolean, init-value=SendCANR_V2H_Instant_Power_DrawVldValue:1
    SendCANR_V2H_Reserve_BatterySts: service-kind=ANY-STANDARDIZED, invalidation-policy{data-element=SendCANR_V2H_Reserve_BatterySts, handle-invalid=DONT-INVALIDATE}
      data SendCANR_V2H_Reserve_BatterySts: category=VALUE, sw-calibration-access=READ-ONLY, type=ADTSV2H_Reserve_BatterySts, init-value=SendCANR_V2H_Reserve_BatteryStsValue:0
    SendCANR_V2H_Reserve_BatteryStsVld: service-kind=ANY-STANDARDIZED, invalidation-policy{data-element=SendCANR_V2H_Reserve_BatteryStsVld, handle-invalid=DONT-INVALIDATE}  # Valid
      data SendCANR_V2H_Reserve_BatteryStsVld: category=VALUE, sw-calibration-access=READ-ONLY, type=ADTSBoolean, init-value=SendCANR_V2H_Reserve_BatteryStsVldValue:1
    SendCANR_V2H_Status: service-kind=ANY-STANDARDIZED, invalidation-policy{data-element=SendCANR_V2H_Status, handle-invalid=DONT-INVALIDATE}
      data SendCANR_V2H_Status: category=VALUE, sw-calibration-access=READ-ONLY, type=ADTSV2H_Status, init-value=SendCANR_V2H_StatusValue:0
    SendCANR_V2H_StatusVld: service-kind=ANY-STANDARDIZED, invalidation-policy{data-element=SendCANR_V2H_StatusVld, handle-invalid=DONT-INVALIDATE}  # Valid
      data SendCANR_V2H_StatusVld: category=VALUE, sw-calibration-access=READ-ONLY, type=ADTSBoolean, init-value=SendCANR_V2H_StatusVldValue:1
    SendCANR_V2H_TotalPowerTimedays: service-kind=ANY-STANDARDIZED, invalidation-policy{data-element=SendCANR_V2H_TotalPowerTimedays, handle-invalid=DONT-INVALIDATE}
      data SendCANR_V2H_TotalPowerTimedays: category=VALUE, sw-calibration-access=READ-ONLY, type=ADTSV2H_TotalPowerTimedays, init-value=SendCANR_V2H_TotalPowerTimedaysValue:0
    SendCANR_V2H_TotalPowerTimedaysVld: service-kind=ANY-STANDARDIZED, invalidation-policy{data-element=SendCANR_V2H_TotalPowerTimedaysVld, handle-invalid=DONT-INVALIDATE}  # Valid
      data SendCANR_V2H_TotalPowerTimedaysVld: category=VALUE, sw-calibration-access=READ-ONLY, type=ADTSBoolean, init-value=SendCANR_V2H_TotalPowerTimedaysVldValue:1
    SendCANR_V2H_mode_Sts: service-kind=ANY-STANDARDIZED, invalidation-policy{data-element=SendCANR_V2H_mode_Sts, handle-invalid=DONT-INVALIDATE}
      data SendCANR_V2H_mode_Sts: category=VALUE, sw-calibration-access=READ-ONLY, type=ADTSBoolean, init-value=SendCANR_V2H_mode_StsValue:0
    SendCANR_V2H_mode_StsVld: service-kind=ANY-STANDARDIZED, invalidation-policy{data-element=SendCANR_V2H_mode_StsVld, handle-invalid=DONT-INVALIDATE}  # Valid
      data SendCANR_V2H_mode_StsVld: category=VALUE, sw-calibration-access=READ-ONLY, type=ADTSBoolean, init-value=SendCANR_V2H_mode_StsVldValue:1
    SendCANR_V2LInstantPwrDrawFrunk: service-kind=ANY-STANDARDIZED, invalidation-policy{data-element=SendCANR_V2LInstantPwrDrawFrunk, handle-invalid=DONT-INVALIDATE}
      data SendCANR_V2LInstantPwrDrawFrunk: category=VALUE, sw-calibration-access=READ-ONLY, type=ADTSV2LInstantPwrDrawFrunk, init-value=SendCANR_V2LInstantPwrDrawFrunkValue:0
    SendCANR_V2LInstantPwrDrawFrunkVld: service-kind=ANY-STANDARDIZED, invalidation-policy{data-element=SendCANR_V2LInstantPwrDrawFrunkVld, handle-invalid=DONT-INVALIDATE}  # Valid
      data SendCANR_V2LInstantPwrDrawFrunkVld: category=VALUE, sw-calibration-access=READ-ONLY, type=ADTSBoolean, init-value=SendCANR_V2LInstantPwrDrawFrunkVldValue:1
    SendCANR_V2LInstantPwrDrawTrunk: service-kind=ANY-STANDARDIZED, invalidation-policy{data-element=SendCANR_V2LInstantPwrDrawTrunk, handle-invalid=DONT-INVALIDATE}
      data SendCANR_V2LInstantPwrDrawTrunk: category=VALUE, sw-calibration-access=READ-ONLY, type=ADTSV2LInstantPwrDrawTrunk, init-value=SendCANR_V2LInstantPwrDrawTrunkValue:0
    SendCANR_V2LInstantPwrDrawTrunkVld: service-kind=ANY-STANDARDIZED, invalidation-policy{data-element=SendCANR_V2LInstantPwrDrawTrunkVld, handle-invalid=DONT-INVALIDATE}  # Valid
      data SendCANR_V2LInstantPwrDrawTrunkVld: category=VALUE, sw-calibration-access=READ-ONLY, type=ADTSBoolean, init-value=SendCANR_V2LInstantPwrDrawTrunkVldValue:1
    SendCANR_V2LTotalPowerTimehours: service-kind=ANY-STANDARDIZED, invalidation-policy{data-element=SendCANR_V2LTotalPowerTimehours, handle-invalid=DONT-INVALIDATE}
      data SendCANR_V2LTotalPowerTimehours: category=VALUE, sw-calibration-access=READ-ONLY, type=ADTSV2LTotalPowerTimehours, init-value=SendCANR_V2LTotalPowerTimehoursValue:0
    SendCANR_V2LTotalPowerTimehoursVld: service-kind=ANY-STANDARDIZED, invalidation-policy{data-element=SendCANR_V2LTotalPowerTimehoursVld, handle-invalid=DONT-INVALIDATE}  # Valid
      data SendCANR_V2LTotalPowerTimehoursVld: category=VALUE, sw-calibration-access=READ-ONLY, type=ADTSBoolean, init-value=SendCANR_V2LTotalPowerTimehoursVldValue:1
    SendCANR_V2LTotalPowerTimeminut: service-kind=ANY-STANDARDIZED, invalidation-policy{data-element=SendCANR_V2LTotalPowerTimeminut, handle-invalid=DONT-INVALIDATE}
      data SendCANR_V2LTotalPowerTimeminut: category=VALUE, sw-calibration-access=READ-ONLY, type=ADTSV2LTotalPowerTimeminut, init-value=SendCANR_V2LTotalPowerTimeminutValue:0
    SendCANR_V2LTotalPowerTimeminutVld: service-kind=ANY-STANDARDIZED, invalidation-policy{data-element=SendCANR_V2LTotalPowerTimeminutVld, handle-invalid=DONT-INVALIDATE}  # Valid
      data SendCANR_V2LTotalPowerTimeminutVld: category=VALUE, sw-calibration-access=READ-ONLY, type=ADTSBoolean, init-value=SendCANR_V2LTotalPowerTimeminutVldValue:1
    SendCANR_V2L_Frunk_Status: service-kind=ANY-STANDARDIZED, invalidation-policy{data-element=SendCANR_V2L_Frunk_Status, handle-invalid=DONT-INVALIDATE}
      data SendCANR_V2L_Frunk_Status: category=VALUE, sw-calibration-access=READ-ONLY, type=ADTSV2L_Frunk_Status, init-value=SendCANR_V2L_Frunk_StatusValue:0
    SendCANR_V2L_Frunk_StatusVld: service-kind=ANY-STANDARDIZED, invalidation-policy{data-element=SendCANR_V2L_Frunk_StatusVld, handle-invalid=DONT-INVALIDATE}  # Valid
      data SendCANR_V2L_Frunk_StatusVld: category=VALUE, sw-calibration-access=READ-ONLY, type=ADTSBoolean, init-value=SendCANR_V2L_Frunk_StatusVldValue:1
    SendCANR_V2L_Total_PwrTimedays: service-kind=ANY-STANDARDIZED, invalidation-policy{data-element=SendCANR_V2L_Total_PwrTimedays, handle-invalid=DONT-INVALIDATE}
      data SendCANR_V2L_Total_PwrTimedays: category=VALUE, sw-calibration-access=READ-ONLY, type=ADTSV2L_Total_PwrTimedays, init-value=SendCANR_V2L_Total_PwrTimedaysValue:0
    SendCANR_V2L_Total_PwrTimedaysVld: service-kind=ANY-STANDARDIZED, invalidation-policy{data-element=SendCANR_V2L_Total_PwrTimedaysVld, handle-invalid=DONT-INVALIDATE}  # Valid
      data SendCANR_V2L_Total_PwrTimedaysVld: category=VALUE, sw-calibration-access=READ-ONLY, type=ADTSBoolean, init-value=SendCANR_V2L_Total_PwrTimedaysVldValue:1
    SendCANR_V2L_Trunk_Status: service-kind=ANY-STANDARDIZED, invalidation-policy{data-element=SendCANR_V2L_Trunk_Status, handle-invalid=DONT-INVALIDATE}
      data SendCANR_V2L_Trunk_Status: category=VALUE, sw-calibration-access=READ-ONLY, type=ADTSV2L_Trunk_Status, init-value=SendCANR_V2L_Trunk_StatusValue:0
    SendCANR_V2L_Trunk_StatusVld: service-kind=ANY-STANDARDIZED, invalidation-policy{data-element=SendCANR_V2L_Trunk_StatusVld, handle-invalid=DONT-INVALIDATE}  # Valid
      data SendCANR_V2L_Trunk_StatusVld: category=VALUE, sw-calibration-access=READ-ONLY, type=ADTSBoolean, init-value=SendCANR_V2L_Trunk_StatusVldValue:1
    SendCANR_V2L_mode_Sts: service-kind=ANY-STANDARDIZED, invalidation-policy{data-element=SendCANR_V2L_mode_Sts, handle-invalid=DONT-INVALIDATE}
      data SendCANR_V2L_mode_Sts: category=VALUE, sw-calibration-access=READ-ONLY, type=ADTSBoolean, init-value=SendCANR_V2L_mode_StsValue:0
    SendCANR_V2L_mode_StsVld: service-kind=ANY-STANDARDIZED, invalidation-policy{data-element=SendCANR_V2L_mode_StsVld, handle-invalid=DONT-INVALIDATE}  # Valid
      data SendCANR_V2L_mode_StsVld: category=VALUE, sw-calibration-access=READ-ONLY, type=ADTSBoolean, init-value=SendCANR_V2L_mode_StsVldValue:1
    SendCANR_V2VTotalPowerTimehours: service-kind=ANY-STANDARDIZED, invalidation-policy{data-element=SendCANR_V2VTotalPowerTimehours, handle-invalid=DONT-INVALIDATE}
      data SendCANR_V2VTotalPowerTimehours: category=VALUE, sw-calibration-access=READ-ONLY, type=ADTSV2VTotalPowerTimehours, init-value=SendCANR_V2VTotalPowerTimehoursValue:0
    SendCANR_V2VTotalPowerTimehoursVld: service-kind=ANY-STANDARDIZED, invalidation-policy{data-element=SendCANR_V2VTotalPowerTimehoursVld, handle-invalid=DONT-INVALIDATE}  # Valid
      data SendCANR_V2VTotalPowerTimehoursVld: category=VALUE, sw-calibration-access=READ-ONLY, type=ADTSBoolean, init-value=SendCANR_V2VTotalPowerTimehoursVldValue:1
    SendCANR_V2VTotalPowerTimeminut: service-kind=ANY-STANDARDIZED, invalidation-policy{data-element=SendCANR_V2VTotalPowerTimeminut, handle-invalid=DONT-INVALIDATE}
      data SendCANR_V2VTotalPowerTimeminut: category=VALUE, sw-calibration-access=READ-ONLY, type=ADTSV2VTotalPowerTimeminut, init-value=SendCANR_V2VTotalPowerTimeminutValue:0
    SendCANR_V2VTotalPowerTimeminutVld: service-kind=ANY-STANDARDIZED, invalidation-policy{data-element=SendCANR_V2VTotalPowerTimeminutVld, handle-invalid=DONT-INVALIDATE}  # Valid
      data SendCANR_V2VTotalPowerTimeminutVld: category=VALUE, sw-calibration-access=READ-ONLY, type=ADTSBoolean, init-value=SendCANR_V2VTotalPowerTimeminutVldValue:1
    SendCANR_V2V_Instant_Power_Draw: service-kind=ANY-STANDARDIZED, invalidation-policy{data-element=SendCANR_V2V_Instant_Power_Draw, handle-invalid=DONT-INVALIDATE}
      data SendCANR_V2V_Instant_Power_Draw: category=VALUE, sw-calibration-access=READ-ONLY, type=ADTSV2V_Instant_Power_Draw, init-value=SendCANR_V2V_Instant_Power_DrawValue:0
    SendCANR_V2V_Instant_Power_DrawVld: service-kind=ANY-STANDARDIZED, invalidation-policy{data-element=SendCANR_V2V_Instant_Power_DrawVld, handle-invalid=DONT-INVALIDATE}  # Valid
      data SendCANR_V2V_Instant_Power_DrawVld: category=VALUE, sw-calibration-access=READ-ONLY, type=ADTSBoolean, init-value=SendCANR_V2V_Instant_Power_DrawVldValue:1
    SendCANR_V2V_Status: service-kind=ANY-STANDARDIZED, invalidation-policy{data-element=SendCANR_V2V_Status, handle-invalid=DONT-INVALIDATE}
      data SendCANR_V2V_Status: category=VALUE, sw-calibration-access=READ-ONLY, type=ADTSV2V_Status, init-value=SendCANR_V2V_StatusValue:0
    SendCANR_V2V_StatusVld: service-kind=ANY-STANDARDIZED, invalidation-policy{data-element=SendCANR_V2V_StatusVld, handle-invalid=DONT-INVALIDATE}  # Valid
      data SendCANR_V2V_StatusVld: category=VALUE, sw-calibration-access=READ-ONLY, type=ADTSBoolean, init-value=SendCANR_V2V_StatusVldValue:1
    SendCANR_V2V_TotalPowerTimedays: service-kind=ANY-STANDARDIZED, invalidation-policy{data-element=SendCANR_V2V_TotalPowerTimedays, handle-invalid=DONT-INVALIDATE}
      data SendCANR_V2V_TotalPowerTimedays: category=VALUE, sw-calibration-access=READ-ONLY, type=ADTSV2V_TotalPowerTimedays, init-value=SendCANR_V2V_TotalPowerTimedaysValue:0
    SendCANR_V2V_TotalPowerTimedaysVld: service-kind=ANY-STANDARDIZED, invalidation-policy{data-element=SendCANR_V2V_TotalPowerTimedaysVld, handle-invalid=DONT-INVALIDATE}  # Valid
      data SendCANR_V2V_TotalPowerTimedaysVld: category=VALUE, sw-calibration-access=READ-ONLY, type=ADTSBoolean, init-value=SendCANR_V2V_TotalPowerTimedaysVldValue:1
    SendCANR_V2V_mode_Sts: service-kind=ANY-STANDARDIZED, invalidation-policy{data-element=SendCANR_V2V_mode_Sts, handle-invalid=DONT-INVALIDATE}
      data SendCANR_V2V_mode_Sts: category=VALUE, sw-calibration-access=READ-ONLY, type=ADTSBoolean, init-value=SendCANR_V2V_mode_StsValue:0
    SendCANR_V2V_mode_StsVld: service-kind=ANY-STANDARDIZED, invalidation-policy{data-element=SendCANR_V2V_mode_StsVld, handle-invalid=DONT-INVALIDATE}  # Valid
      data SendCANR_V2V_mode_StsVld: category=VALUE, sw-calibration-access=READ-ONLY, type=ADTSBoolean, init-value=SendCANR_V2V_mode_StsVldValue:1
    SendCANR_V2X_HVCMSSltdEngTrfTyp: service-kind=ANY-STANDARDIZED, invalidation-policy{data-element=SendCANR_V2X_HVCMSSltdEngTrfTyp, handle-invalid=DONT-INVALIDATE}
      data SendCANR_V2X_HVCMSSltdEngTrfTyp: category=VALUE, sw-calibration-access=READ-ONLY, type=ADTSBoolean, init-value=SendCANR_V2X_HVCMSSltdEngTrfTypValue:0
    SendCANR_V2X_HVCMSSltdEngTrfTypVld: service-kind=ANY-STANDARDIZED, invalidation-policy{data-element=SendCANR_V2X_HVCMSSltdEngTrfTypVld, handle-invalid=DONT-INVALIDATE}  # Valid
      data SendCANR_V2X_HVCMSSltdEngTrfTypVld: category=VALUE, sw-calibration-access=READ-ONLY, type=ADTSBoolean, init-value=SendCANR_V2X_HVCMSSltdEngTrfTypVldValue:1
    SendCANR_V2X_Info: service-kind=ANY-STANDARDIZED, invalidation-policy{data-element=SendCANR_V2X_Info, handle-invalid=KEEP}
      data SendCANR_V2X_Info: category=VALUE, sw-calibration-access=READ-ONLY, type=ADTSV2X_Info, init-value=SendCANR_V2X_InfoValue:0
    SendCANR_V2X_InfoVld: service-kind=ANY-STANDARDIZED, invalidation-policy{data-element=SendCANR_V2X_InfoVld, handle-invalid=DONT-INVALIDATE}  # Valid
      data SendCANR_V2X_InfoVld: category=VALUE, sw-calibration-access=READ-ONLY, type=ADTSBoolean, init-value=SendCANR_V2X_InfoVldValue:1
    SendCANR_VDCMCntrtAuthentIDFD11: service-kind=ANY-STANDARDIZED, invalidation-policy{data-element=SendCANR_VDCMCntrtAuthentIDFD11, handle-invalid=DONT-INVALIDATE}
      data SendCANR_VDCMCntrtAuthentIDFD11: category=VALUE, sw-calibration-access=READ-ONLY, type=ADTSVDCMCntrtAuthentIDFD11, init-value=SendCANR_VDCMCntrtAuthentIDFD11Value:0
    SendCANR_VDCMCntrtAuthentIDFD11Vld: service-kind=ANY-STANDARDIZED, invalidation-policy{data-element=SendCANR_VDCMCntrtAuthentIDFD11Vld, handle-invalid=DONT-INVALIDATE}  # Valid
      data SendCANR_VDCMCntrtAuthentIDFD11Vld: category=VALUE, sw-calibration-access=READ-ONLY, type=ADTSBoolean, init-value=SendCANR_VDCMCntrtAuthentIDFD11VldValue:1
    SendCANR_VDCMOBCDchaCurrLimFD11: service-kind=ANY-STANDARDIZED, invalidation-policy{data-element=SendCANR_VDCMOBCDchaCurrLimFD11, handle-invalid=DONT-INVALIDATE}
      data SendCANR_VDCMOBCDchaCurrLimFD11: category=VALUE, sw-calibration-access=READ-ONLY, type=ADTSVDCMOBCDchaCurrLimFD11, init-value=SendCANR_VDCMOBCDchaCurrLimFD11Value:-733.5
    SendCANR_VDCMOBCDchaCurrLimFD11Vld: service-kind=ANY-STANDARDIZED, invalidation-policy{data-element=SendCANR_VDCMOBCDchaCurrLimFD11Vld, handle-invalid=DONT-INVALIDATE}  # Valid
      data SendCANR_VDCMOBCDchaCurrLimFD11Vld: category=VALUE, sw-calibration-access=READ-ONLY, type=ADTSBoolean, init-value=SendCANR_VDCMOBCDchaCurrLimFD11VldValue:1
    SendCANR_VDCMOBCDchaCurrLimFD5: service-kind=ANY-STANDARDIZED, invalidation-policy{data-element=SendCANR_VDCMOBCDchaCurrLimFD5, handle-invalid=DONT-INVALIDATE}
      data SendCANR_VDCMOBCDchaCurrLimFD5: category=VALUE, sw-calibration-access=READ-ONLY, type=ADTSVDCMOBCDchaCurrLimFD5, init-value=SendCANR_VDCMOBCDchaCurrLimFD5Value:-733.5
    SendCANR_VDCMOBCDchaCurrLimFD5Vld: service-kind=ANY-STANDARDIZED, invalidation-policy{data-element=SendCANR_VDCMOBCDchaCurrLimFD5Vld, handle-invalid=DONT-INVALIDATE}  # Valid
      data SendCANR_VDCMOBCDchaCurrLimFD5Vld: category=VALUE, sw-calibration-access=READ-ONLY, type=ADTSBoolean, init-value=SendCANR_VDCMOBCDchaCurrLimFD5VldValue:1
    SendCANR_VDCMTypeCNegotnStsFD11: service-kind=ANY-STANDARDIZED, invalidation-policy{data-element=SendCANR_VDCMTypeCNegotnStsFD11, handle-invalid=DONT-INVALIDATE}
      data SendCANR_VDCMTypeCNegotnStsFD11: category=VALUE, sw-calibration-access=READ-ONLY, type=ADTSVDCMTypeCNegotnStsFD11, init-value=SendCANR_VDCMTypeCNegotnStsFD11Value:0
    SendCANR_VDCMTypeCNegotnStsFD11Vld: service-kind=ANY-STANDARDIZED, invalidation-policy{data-element=SendCANR_VDCMTypeCNegotnStsFD11Vld, handle-invalid=DONT-INVALIDATE}  # Valid
      data SendCANR_VDCMTypeCNegotnStsFD11Vld: category=VALUE, sw-calibration-access=READ-ONLY, type=ADTSBoolean, init-value=SendCANR_VDCMTypeCNegotnStsFD11VldValue:1
    SendCANR_VDCMTypeCNegotnStsFD5: service-kind=ANY-STANDARDIZED, invalidation-policy{data-element=SendCANR_VDCMTypeCNegotnStsFD5, handle-invalid=DONT-INVALIDATE}
      data SendCANR_VDCMTypeCNegotnStsFD5: category=VALUE, sw-calibration-access=READ-ONLY, type=ADTSVDCMTypeCNegotnStsFD5, init-value=SendCANR_VDCMTypeCNegotnStsFD5Value:0
    SendCANR_VDCMTypeCNegotnStsFD5Vld: service-kind=ANY-STANDARDIZED, invalidation-policy{data-element=SendCANR_VDCMTypeCNegotnStsFD5Vld, handle-invalid=DONT-INVALIDATE}  # Valid
      data SendCANR_VDCMTypeCNegotnStsFD5Vld: category=VALUE, sw-calibration-access=READ-ONLY, type=ADTSBoolean, init-value=SendCANR_VDCMTypeCNegotnStsFD5VldValue:1
    SendCANR_VDCM_BattBulkSOC_FD11: service-kind=ANY-STANDARDIZED, invalidation-policy{data-element=SendCANR_VDCM_BattBulkSOC_FD11, handle-invalid=DONT-INVALIDATE}
      data SendCANR_VDCM_BattBulkSOC_FD11: category=VALUE, sw-calibration-access=READ-ONLY, type=ADTSVDCM_BattBulkSOC_FD11, init-value=SendCANR_VDCM_BattBulkSOC_FD11Value:0
    SendCANR_VDCM_BattBulkSOC_FD11Vld: service-kind=ANY-STANDARDIZED, invalidation-policy{data-element=SendCANR_VDCM_BattBulkSOC_FD11Vld, handle-invalid=DONT-INVALIDATE}  # Valid
      data SendCANR_VDCM_BattBulkSOC_FD11Vld: category=VALUE, sw-calibration-access=READ-ONLY, type=ADTSBoolean, init-value=SendCANR_VDCM_BattBulkSOC_FD11VldValue:1
    SendCANR_VDCM_BattBulkSOC_FD5: service-kind=ANY-STANDARDIZED, invalidation-policy{data-element=SendCANR_VDCM_BattBulkSOC_FD5, handle-invalid=DONT-INVALIDATE}
      data SendCANR_VDCM_BattBulkSOC_FD5: category=VALUE, sw-calibration-access=READ-ONLY, type=ADTSVDCM_BattBulkSOC_FD5, init-value=SendCANR_VDCM_BattBulkSOC_FD5Value:0
    SendCANR_VDCM_BattBulkSOC_FD5Vld: service-kind=ANY-STANDARDIZED, invalidation-policy{data-element=SendCANR_VDCM_BattBulkSOC_FD5Vld, handle-invalid=DONT-INVALIDATE}  # Valid
      data SendCANR_VDCM_BattBulkSOC_FD5Vld: category=VALUE, sw-calibration-access=READ-ONLY, type=ADTSBoolean, init-value=SendCANR_VDCM_BattBulkSOC_FD5VldValue:1
    SendCANR_VDCM_CntrctAuthIDFD5: service-kind=ANY-STANDARDIZED, invalidation-policy{data-element=SendCANR_VDCM_CntrctAuthIDFD5, handle-invalid=DONT-INVALIDATE}
      data SendCANR_VDCM_CntrctAuthIDFD5: category=VALUE, sw-calibration-access=READ-ONLY, type=ADTSVDCM_CntrctAuthIDFD5, init-value=SendCANR_VDCM_CntrctAuthIDFD5Value:0
    SendCANR_VDCM_CntrctAuthIDFD5Vld: service-kind=ANY-STANDARDIZED, invalidation-policy{data-element=SendCANR_VDCM_CntrctAuthIDFD5Vld, handle-invalid=DONT-INVALIDATE}  # Valid
      data SendCANR_VDCM_CntrctAuthIDFD5Vld: category=VALUE, sw-calibration-access=READ-ONLY, type=ADTSBoolean, init-value=SendCANR_VDCM_CntrctAuthIDFD5VldValue:1
    SendCANR_VDCM_GenChallenge_FD11: service-kind=ANY-STANDARDIZED, invalidation-policy{data-element=SendCANR_VDCM_GenChallenge_FD11, handle-invalid=DONT-INVALIDATE}
      data SendCANR_VDCM_GenChallenge_FD11: category=VALUE, sw-calibration-access=READ-ONLY, type=ADTSVDCM_GenChallenge_FD11, init-value=SendCANR_VDCM_GenChallenge_FD11Value:0
    SendCANR_VDCM_GenChallenge_FD11Vld: service-kind=ANY-STANDARDIZED, invalidation-policy{data-element=SendCANR_VDCM_GenChallenge_FD11Vld, handle-invalid=DONT-INVALIDATE}  # Valid
      data SendCANR_VDCM_GenChallenge_FD11Vld: category=VALUE, sw-calibration-access=READ-ONLY, type=ADTSBoolean, init-value=SendCANR_VDCM_GenChallenge_FD11VldValue:1
    SendCANR_VDCM_GenChallenge_FD5: service-kind=ANY-STANDARDIZED, invalidation-policy{data-element=SendCANR_VDCM_GenChallenge_FD5, handle-invalid=DONT-INVALIDATE}
      data SendCANR_VDCM_GenChallenge_FD5: category=VALUE, sw-calibration-access=READ-ONLY, type=ADTSVDCM_GenChallenge_FD5, init-value=SendCANR_VDCM_GenChallenge_FD5Value:0
    SendCANR_VDCM_GenChallenge_FD5Vld: service-kind=ANY-STANDARDIZED, invalidation-policy{data-element=SendCANR_VDCM_GenChallenge_FD5Vld, handle-invalid=DONT-INVALIDATE}  # Valid
      data SendCANR_VDCM_GenChallenge_FD5Vld: category=VALUE, sw-calibration-access=READ-ONLY, type=ADTSBoolean, init-value=SendCANR_VDCM_GenChallenge_FD5VldValue:1
    SendCANR_VIN_DATA_FD11: service-kind=ANY-STANDARDIZED, invalidation-policy{data-element=SendCANR_VIN_DATA_FD11, handle-invalid=DONT-INVALIDATE}
      data SendCANR_VIN_DATA_FD11: category=VALUE, sw-calibration-access=READ-ONLY, type=ADTSVIN_DATA_FD11, init-value=SendCANR_VIN_DATA_FD11Value:0
    SendCANR_VIN_DATA_FD11Vld: service-kind=ANY-STANDARDIZED, invalidation-policy{data-element=SendCANR_VIN_DATA_FD11Vld, handle-invalid=DONT-INVALIDATE}  # Valid
      data SendCANR_VIN_DATA_FD11Vld: category=VALUE, sw-calibration-access=READ-ONLY, type=ADTSBoolean, init-value=SendCANR_VIN_DATA_FD11VldValue:1
    SendCANR_VIN_DATA_FD16: service-kind=ANY-STANDARDIZED, invalidation-policy{data-element=SendCANR_VIN_DATA_FD16, handle-invalid=DONT-INVALIDATE}
      data SendCANR_VIN_DATA_FD16: category=VALUE, sw-calibration-access=READ-ONLY, type=ADTSVIN_DATA_FD16, init-value=SendCANR_VIN_DATA_FD16Value:0
    SendCANR_VIN_DATA_FD16Vld: service-kind=ANY-STANDARDIZED, invalidation-policy{data-element=SendCANR_VIN_DATA_FD16Vld, handle-invalid=DONT-INVALIDATE}  # Valid
      data SendCANR_VIN_DATA_FD16Vld: category=VALUE, sw-calibration-access=READ-ONLY, type=ADTSBoolean, init-value=SendCANR_VIN_DATA_FD16VldValue:1
    SendCANR_VIN_DATA_FD5: service-kind=ANY-STANDARDIZED, invalidation-policy{data-element=SendCANR_VIN_DATA_FD5, handle-invalid=DONT-INVALIDATE}
      data SendCANR_VIN_DATA_FD5: category=VALUE, sw-calibration-access=READ-ONLY, type=ADTSVIN_DATA_FD5, init-value=SendCANR_VIN_DATA_FD5Value:0
    SendCANR_VIN_DATA_FD5Vld: service-kind=ANY-STANDARDIZED, invalidation-policy{data-element=SendCANR_VIN_DATA_FD5Vld, handle-invalid=DONT-INVALIDATE}  # Valid
      data SendCANR_VIN_DATA_FD5Vld: category=VALUE, sw-calibration-access=READ-ONLY, type=ADTSBoolean, init-value=SendCANR_VIN_DATA_FD5VldValue:1
    SendCANR_VIN_MSG_FD11: service-kind=ANY-STANDARDIZED, invalidation-policy{data-element=SendCANR_VIN_MSG_FD11, handle-invalid=KEEP}
      data SendCANR_VIN_MSG_FD11: category=VALUE, sw-calibration-access=READ-ONLY, type=ADTSVIN_MSG_FD11, init-value=SendCANR_VIN_MSG_FD11Value:3
    SendCANR_VIN_MSG_FD11Vld: service-kind=ANY-STANDARDIZED, invalidation-policy{data-element=SendCANR_VIN_MSG_FD11Vld, handle-invalid=DONT-INVALIDATE}  # Valid
      data SendCANR_VIN_MSG_FD11Vld: category=VALUE, sw-calibration-access=READ-ONLY, type=ADTSBoolean, init-value=SendCANR_VIN_MSG_FD11VldValue:1
    SendCANR_VIN_MSG_FD16: service-kind=ANY-STANDARDIZED, invalidation-policy{data-element=SendCANR_VIN_MSG_FD16, handle-invalid=KEEP}
      data SendCANR_VIN_MSG_FD16: category=VALUE, sw-calibration-access=READ-ONLY, type=ADTSVIN_MSG_FD16, init-value=SendCANR_VIN_MSG_FD16Value:3
    SendCANR_VIN_MSG_FD16Vld: service-kind=ANY-STANDARDIZED, invalidation-policy{data-element=SendCANR_VIN_MSG_FD16Vld, handle-invalid=DONT-INVALIDATE}  # Valid
      data SendCANR_VIN_MSG_FD16Vld: category=VALUE, sw-calibration-access=READ-ONLY, type=ADTSBoolean, init-value=SendCANR_VIN_MSG_FD16VldValue:1
    SendCANR_VIN_MSG_FD5: service-kind=ANY-STANDARDIZED, invalidation-policy{data-element=SendCANR_VIN_MSG_FD5, handle-invalid=KEEP}
      data SendCANR_VIN_MSG_FD5: category=VALUE, sw-calibration-access=READ-ONLY, type=ADTSVIN_MSG_FD5, init-value=SendCANR_VIN_MSG_FD5Value:3
    SendCANR_VIN_MSG_FD5Vld: service-kind=ANY-STANDARDIZED, invalidation-policy{data-element=SendCANR_VIN_MSG_FD5Vld, handle-invalid=DONT-INVALIDATE}  # Valid
      data SendCANR_VIN_MSG_FD5Vld: category=VALUE, sw-calibration-access=READ-ONLY, type=ADTSBoolean, init-value=SendCANR_VIN_MSG_FD5VldValue:1
    SendCANR_VehicleDriveSts: service-kind=ANY-STANDARDIZED, invalidation-policy{data-element=SendCANR_VehicleDriveSts, handle-invalid=DONT-INVALIDATE}
      data SendCANR_VehicleDriveSts: category=VALUE, sw-calibration-access=READ-ONLY, type=ADTSBoolean, init-value=SendCANR_VehicleDriveStsValue:0
    SendCANR_VehicleDriveStsVld: service-kind=ANY-STANDARDIZED, invalidation-policy{data-element=SendCANR_VehicleDriveStsVld, handle-invalid=DONT-INVALIDATE}  # Valid
      data SendCANR_VehicleDriveStsVld: category=VALUE, sw-calibration-access=READ-ONLY, type=ADTSBoolean, init-value=SendCANR_VehicleDriveStsVldValue:1
    SendCANR_VehicleSpeedVSOSigFD11: service-kind=ANY-STANDARDIZED, invalidation-policy{data-element=SendCANR_VehicleSpeedVSOSigFD11, handle-invalid=KEEP}
      data SendCANR_VehicleSpeedVSOSigFD11: category=VALUE, sw-calibration-access=READ-ONLY, type=ADTSVehicleSpeedVSOSigFD11, init-value=SendCANR_VehicleSpeedVSOSigFD11Value:0
    SendCANR_VehicleSpeedVSOSigFD11Vld: service-kind=ANY-STANDARDIZED, invalidation-policy{data-element=SendCANR_VehicleSpeedVSOSigFD11Vld, handle-invalid=DONT-INVALIDATE}  # Valid
      data SendCANR_VehicleSpeedVSOSigFD11Vld: category=VALUE, sw-calibration-access=READ-ONLY, type=ADTSBoolean, init-value=SendCANR_VehicleSpeedVSOSigFD11VldValue:1
    SendCANR_WU_Timer_Value_FD11: service-kind=ANY-STANDARDIZED, invalidation-policy{data-element=SendCANR_WU_Timer_Value_FD11, handle-invalid=DONT-INVALIDATE}
      data SendCANR_WU_Timer_Value_FD11: category=VALUE, sw-calibration-access=READ-ONLY, type=ADTSWU_Timer_Value_FD11, init-value=SendCANR_WU_Timer_Value_FD11Value:0
    SendCANR_WU_Timer_Value_FD11Vld: service-kind=ANY-STANDARDIZED, invalidation-policy{data-element=SendCANR_WU_Timer_Value_FD11Vld, handle-invalid=DONT-INVALIDATE}  # Valid
      data SendCANR_WU_Timer_Value_FD11Vld: category=VALUE, sw-calibration-access=READ-ONLY, type=ADTSBoolean, init-value=SendCANR_WU_Timer_Value_FD11VldValue:1
    SendCANR_WU_Timer_Value_FD16: service-kind=ANY-STANDARDIZED, invalidation-policy{data-element=SendCANR_WU_Timer_Value_FD16, handle-invalid=DONT-INVALIDATE}
      data SendCANR_WU_Timer_Value_FD16: category=VALUE, sw-calibration-access=READ-ONLY, type=ADTSWU_Timer_Value_FD16, init-value=SendCANR_WU_Timer_Value_FD16Value:0
    SendCANR_WU_Timer_Value_FD16Vld: service-kind=ANY-STANDARDIZED, invalidation-policy{data-element=SendCANR_WU_Timer_Value_FD16Vld, handle-invalid=DONT-INVALIDATE}  # Valid
      data SendCANR_WU_Timer_Value_FD16Vld: category=VALUE, sw-calibration-access=READ-ONLY, type=ADTSBoolean, init-value=SendCANR_WU_Timer_Value_FD16VldValue:1
    SendCANR_WU_Timer_Value_FD5: service-kind=ANY-STANDARDIZED, invalidation-policy{data-element=SendCANR_WU_Timer_Value_FD5, handle-invalid=DONT-INVALIDATE}
      data SendCANR_WU_Timer_Value_FD5: category=VALUE, sw-calibration-access=READ-ONLY, type=ADTSWU_Timer_Value_FD5, init-value=SendCANR_WU_Timer_Value_FD5Value:0
    SendCANR_WU_Timer_Value_FD5Vld: service-kind=ANY-STANDARDIZED, invalidation-policy{data-element=SendCANR_WU_Timer_Value_FD5Vld, handle-invalid=DONT-INVALIDATE}  # Valid
      data SendCANR_WU_Timer_Value_FD5Vld: category=VALUE, sw-calibration-access=READ-ONLY, type=ADTSBoolean, init-value=SendCANR_WU_Timer_Value_FD5VldValue:1
    SendCANR_WarningMotorA_Overtemp: service-kind=ANY-STANDARDIZED, invalidation-policy{data-element=SendCANR_WarningMotorA_Overtemp, handle-invalid=DONT-INVALIDATE}
      data SendCANR_WarningMotorA_Overtemp: category=VALUE, sw-calibration-access=READ-ONLY, type=ADTSBoolean, init-value=SendCANR_WarningMotorA_OvertempValue:0
    SendCANR_WarningMotorA_OvertempVld: service-kind=ANY-STANDARDIZED, invalidation-policy{data-element=SendCANR_WarningMotorA_OvertempVld, handle-invalid=DONT-INVALIDATE}  # Valid
      data SendCANR_WarningMotorA_OvertempVld: category=VALUE, sw-calibration-access=READ-ONLY, type=ADTSBoolean, init-value=SendCANR_WarningMotorA_OvertempVldValue:1
    SendCANR_WarningMotorB_Overtemp: service-kind=ANY-STANDARDIZED, invalidation-policy{data-element=SendCANR_WarningMotorB_Overtemp, handle-invalid=DONT-INVALIDATE}
      data SendCANR_WarningMotorB_Overtemp: category=VALUE, sw-calibration-access=READ-ONLY, type=ADTSBoolean, init-value=SendCANR_WarningMotorB_OvertempValue:0
    SendCANR_WarningMotorB_OvertempVld: service-kind=ANY-STANDARDIZED, invalidation-policy{data-element=SendCANR_WarningMotorB_OvertempVld, handle-invalid=DONT-INVALIDATE}  # Valid
      data SendCANR_WarningMotorB_OvertempVld: category=VALUE, sw-calibration-access=READ-ONLY, type=ADTSBoolean, init-value=SendCANR_WarningMotorB_OvertempVldValue:1
    SendCANR_Warning_DCDCPerf_DPT: service-kind=ANY-STANDARDIZED, invalidation-policy{data-element=SendCANR_Warning_DCDCPerf_DPT, handle-invalid=DONT-INVALIDATE}
      data SendCANR_Warning_DCDCPerf_DPT: category=VALUE, sw-calibration-access=READ-ONLY, type=ADTSBoolean, init-value=SendCANR_Warning_DCDCPerf_DPTValue:0
    SendCANR_Warning_DCDCPerf_DPT_Vld: service-kind=ANY-STANDARDIZED, invalidation-policy{data-element=SendCANR_Warning_DCDCPerf_DPT_Vld, handle-invalid=DONT-INVALIDATE}  # Valid
      data SendCANR_Warning_DCDCPerf_DPT_Vld: category=VALUE, sw-calibration-access=READ-ONLY, type=ADTSBoolean, init-value=SendCANR_Warning_DCDCPerf_DPT_VldValue:1
    SendCANR_Warning_DCDCTemp_DPT: service-kind=ANY-STANDARDIZED, invalidation-policy{data-element=SendCANR_Warning_DCDCTemp_DPT, handle-invalid=DONT-INVALIDATE}
      data SendCANR_Warning_DCDCTemp_DPT: category=VALUE, sw-calibration-access=READ-ONLY, type=ADTSBoolean, init-value=SendCANR_Warning_DCDCTemp_DPTValue:0
    SendCANR_Warning_DCDCTemp_DPT_Vld: service-kind=ANY-STANDARDIZED, invalidation-policy{data-element=SendCANR_Warning_DCDCTemp_DPT_Vld, handle-invalid=DONT-INVALIDATE}  # Valid
      data SendCANR_Warning_DCDCTemp_DPT_Vld: category=VALUE, sw-calibration-access=READ-ONLY, type=ADTSBoolean, init-value=SendCANR_Warning_DCDCTemp_DPT_VldValue:1
    SendCANR_Warning_IvtrA_Overtemp: service-kind=ANY-STANDARDIZED, invalidation-policy{data-element=SendCANR_Warning_IvtrA_Overtemp, handle-invalid=DONT-INVALIDATE}
      data SendCANR_Warning_IvtrA_Overtemp: category=VALUE, sw-calibration-access=READ-ONLY, type=ADTSBoolean, init-value=SendCANR_Warning_IvtrA_OvertempValue:0
    SendCANR_Warning_IvtrA_OvertempVld: service-kind=ANY-STANDARDIZED, invalidation-policy{data-element=SendCANR_Warning_IvtrA_OvertempVld, handle-invalid=DONT-INVALIDATE}  # Valid
      data SendCANR_Warning_IvtrA_OvertempVld: category=VALUE, sw-calibration-access=READ-ONLY, type=ADTSBoolean, init-value=SendCANR_Warning_IvtrA_OvertempVldValue:1
    SendCANR_Warning_IvtrB_Overtemp: service-kind=ANY-STANDARDIZED, invalidation-policy{data-element=SendCANR_Warning_IvtrB_Overtemp, handle-invalid=DONT-INVALIDATE}
      data SendCANR_Warning_IvtrB_Overtemp: category=VALUE, sw-calibration-access=READ-ONLY, type=ADTSBoolean, init-value=SendCANR_Warning_IvtrB_OvertempValue:0
    SendCANR_Warning_IvtrB_OvertempVld: service-kind=ANY-STANDARDIZED, invalidation-policy{data-element=SendCANR_Warning_IvtrB_OvertempVld, handle-invalid=DONT-INVALIDATE}  # Valid
      data SendCANR_Warning_IvtrB_OvertempVld: category=VALUE, sw-calibration-access=READ-ONLY, type=ADTSBoolean, init-value=SendCANR_Warning_IvtrB_OvertempVldValue:1
    SendCANR_WkeupSrcFD03_EVCU2FD11: service-kind=ANY-STANDARDIZED, invalidation-policy{data-element=SendCANR_WkeupSrcFD03_EVCU2FD11, handle-invalid=DONT-INVALIDATE}
      data SendCANR_WkeupSrcFD03_EVCU2FD11: category=VALUE, sw-calibration-access=READ-ONLY, type=ADTSWkeupSrcFD03_EVCU2FD11, init-value=SendCANR_WkeupSrcFD03_EVCU2FD11Value:0
    SendCANR_WkeupSrcFD03_EVCU2FD11Vld: service-kind=ANY-STANDARDIZED, invalidation-policy{data-element=SendCANR_WkeupSrcFD03_EVCU2FD11Vld, handle-invalid=DONT-INVALIDATE}  # Valid
      data SendCANR_WkeupSrcFD03_EVCU2FD11Vld: category=VALUE, sw-calibration-access=READ-ONLY, type=ADTSBoolean, init-value=SendCANR_WkeupSrcFD03_EVCU2FD11VldValue:1
    SendCANR_WkeupSrcFD03_EVCU2_FD3: service-kind=ANY-STANDARDIZED, invalidation-policy{data-element=SendCANR_WkeupSrcFD03_EVCU2_FD3, handle-invalid=DONT-INVALIDATE}
      data SendCANR_WkeupSrcFD03_EVCU2_FD3: category=VALUE, sw-calibration-access=READ-ONLY, type=ADTSWkeupSrcFD03_EVCU2_FD3, init-value=SendCANR_WkeupSrcFD03_EVCU2_FD3Value:0
    SendCANR_WkeupSrcFD03_EVCU2_FD3Vld: service-kind=ANY-STANDARDIZED, invalidation-policy{data-element=SendCANR_WkeupSrcFD03_EVCU2_FD3Vld, handle-invalid=DONT-INVALIDATE}  # Valid
      data SendCANR_WkeupSrcFD03_EVCU2_FD3Vld: category=VALUE, sw-calibration-access=READ-ONLY, type=ADTSBoolean, init-value=SendCANR_WkeupSrcFD03_EVCU2_FD3VldValue:1
    SendCANR_WkeupSrcFD05_EVCU2FD11: service-kind=ANY-STANDARDIZED, invalidation-policy{data-element=SendCANR_WkeupSrcFD05_EVCU2FD11, handle-invalid=DONT-INVALIDATE}
      data SendCANR_WkeupSrcFD05_EVCU2FD11: category=VALUE, sw-calibration-access=READ-ONLY, type=ADTSWkeupSrcFD05_EVCU2FD11, init-value=SendCANR_WkeupSrcFD05_EVCU2FD11Value:0
    SendCANR_WkeupSrcFD05_EVCU2FD11Vld: service-kind=ANY-STANDARDIZED, invalidation-policy{data-element=SendCANR_WkeupSrcFD05_EVCU2FD11Vld, handle-invalid=DONT-INVALIDATE}  # Valid
      data SendCANR_WkeupSrcFD05_EVCU2FD11Vld: category=VALUE, sw-calibration-access=READ-ONLY, type=ADTSBoolean, init-value=SendCANR_WkeupSrcFD05_EVCU2FD11VldValue:1
    SendCANR_WkeupSrcFD05_EVCU2_FD3: service-kind=ANY-STANDARDIZED, invalidation-policy{data-element=SendCANR_WkeupSrcFD05_EVCU2_FD3, handle-invalid=DONT-INVALIDATE}
      data SendCANR_WkeupSrcFD05_EVCU2_FD3: category=VALUE, sw-calibration-access=READ-ONLY, type=ADTSWkeupSrcFD05_EVCU2_FD3, init-value=SendCANR_WkeupSrcFD05_EVCU2_FD3Value:0
    SendCANR_WkeupSrcFD05_EVCU2_FD3Vld: service-kind=ANY-STANDARDIZED, invalidation-policy{data-element=SendCANR_WkeupSrcFD05_EVCU2_FD3Vld, handle-invalid=DONT-INVALIDATE}  # Valid
      data SendCANR_WkeupSrcFD05_EVCU2_FD3Vld: category=VALUE, sw-calibration-access=READ-ONLY, type=ADTSBoolean, init-value=SendCANR_WkeupSrcFD05_EVCU2_FD3VldValue:1
    SendCANR_WkeupSrcFD11_EVCU2FD11: service-kind=ANY-STANDARDIZED, invalidation-policy{data-element=SendCANR_WkeupSrcFD11_EVCU2FD11, handle-invalid=DONT-INVALIDATE}
      data SendCANR_WkeupSrcFD11_EVCU2FD11: category=VALUE, sw-calibration-access=READ-ONLY, type=ADTSWkeupSrcFD11_EVCU2FD11, init-value=SendCANR_WkeupSrcFD11_EVCU2FD11Value:0
    SendCANR_WkeupSrcFD11_EVCU2FD11Vld: service-kind=ANY-STANDARDIZED, invalidation-policy{data-element=SendCANR_WkeupSrcFD11_EVCU2FD11Vld, handle-invalid=DONT-INVALIDATE}  # Valid
      data SendCANR_WkeupSrcFD11_EVCU2FD11Vld: category=VALUE, sw-calibration-access=READ-ONLY, type=ADTSBoolean, init-value=SendCANR_WkeupSrcFD11_EVCU2FD11VldValue:1
    SendCANR_WkeupSrcFD11_EVCU2_FD3: service-kind=ANY-STANDARDIZED, invalidation-policy{data-element=SendCANR_WkeupSrcFD11_EVCU2_FD3, handle-invalid=DONT-INVALIDATE}
      data SendCANR_WkeupSrcFD11_EVCU2_FD3: category=VALUE, sw-calibration-access=READ-ONLY, type=ADTSWkeupSrcFD11_EVCU2_FD3, init-value=SendCANR_WkeupSrcFD11_EVCU2_FD3Value:0
    SendCANR_WkeupSrcFD11_EVCU2_FD3Vld: service-kind=ANY-STANDARDIZED, invalidation-policy{data-element=SendCANR_WkeupSrcFD11_EVCU2_FD3Vld, handle-invalid=DONT-INVALIDATE}  # Valid
      data SendCANR_WkeupSrcFD11_EVCU2_FD3Vld: category=VALUE, sw-calibration-access=READ-ONLY, type=ADTSBoolean, init-value=SendCANR_WkeupSrcFD11_EVCU2_FD3VldValue:1
    SendCANR_WkeupSrcFD16_EVCU2FD11: service-kind=ANY-STANDARDIZED, invalidation-policy{data-element=SendCANR_WkeupSrcFD16_EVCU2FD11, handle-invalid=DONT-INVALIDATE}
      data SendCANR_WkeupSrcFD16_EVCU2FD11: category=VALUE, sw-calibration-access=READ-ONLY, type=ADTSWkeupSrcFD16_EVCU2FD11, init-value=SendCANR_WkeupSrcFD16_EVCU2FD11Value:0
    SendCANR_WkeupSrcFD16_EVCU2FD11Vld: service-kind=ANY-STANDARDIZED, invalidation-policy{data-element=SendCANR_WkeupSrcFD16_EVCU2FD11Vld, handle-invalid=DONT-INVALIDATE}  # Valid
      data SendCANR_WkeupSrcFD16_EVCU2FD11Vld: category=VALUE, sw-calibration-access=READ-ONLY, type=ADTSBoolean, init-value=SendCANR_WkeupSrcFD16_EVCU2FD11VldValue:1
    SendCANR_WkeupSrcFD16_EVCU2_FD3: service-kind=ANY-STANDARDIZED, invalidation-policy{data-element=SendCANR_WkeupSrcFD16_EVCU2_FD3, handle-invalid=DONT-INVALIDATE}
      data SendCANR_WkeupSrcFD16_EVCU2_FD3: category=VALUE, sw-calibration-access=READ-ONLY, type=ADTSWkeupSrcFD16_EVCU2_FD3, init-value=SendCANR_WkeupSrcFD16_EVCU2_FD3Value:0
    SendCANR_WkeupSrcFD16_EVCU2_FD3Vld: service-kind=ANY-STANDARDIZED, invalidation-policy{data-element=SendCANR_WkeupSrcFD16_EVCU2_FD3Vld, handle-invalid=DONT-INVALIDATE}  # Valid
      data SendCANR_WkeupSrcFD16_EVCU2_FD3Vld: category=VALUE, sw-calibration-access=READ-ONLY, type=ADTSBoolean, init-value=SendCANR_WkeupSrcFD16_EVCU2_FD3VldValue:1
    SendCANR_Wrng_PackTempHigh_FD3: service-kind=ANY-STANDARDIZED, invalidation-policy{data-element=SendCANR_Wrng_PackTempHigh_FD3, handle-invalid=DONT-INVALIDATE}
      data SendCANR_Wrng_PackTempHigh_FD3: category=VALUE, sw-calibration-access=READ-ONLY, type=ADTSBoolean, init-value=SendCANR_Wrng_PackTempHigh_FD3Value:0
    SendCANR_Wrng_PackTempHigh_FD3Vld: service-kind=ANY-STANDARDIZED, invalidation-policy{data-element=SendCANR_Wrng_PackTempHigh_FD3Vld, handle-invalid=DONT-INVALIDATE}  # Valid
      data SendCANR_Wrng_PackTempHigh_FD3Vld: category=VALUE, sw-calibration-access=READ-ONLY, type=ADTSBoolean, init-value=SendCANR_Wrng_PackTempHigh_FD3VldValue:1
    VeCANR_I_APM2_HVChrgBusCurrent: service-kind=ANY-STANDARDIZED, invalidation-policy{data-element=VeCANR_I_APM2_HVChrgBusCurrent, handle-invalid=DONT-INVALIDATE}
      data VeCANR_I_APM2_HVChrgBusCurrent: category=VALUE, sw-calibration-access=READ-ONLY, type=ADTSAPM2_HVChrgBusCurrent, init-value=VeCANR_I_APM2_HVChrgBusCurrentValue:0
    VeCANR_I_APM2_IInpMaxCnvr: service-kind=ANY-STANDARDIZED, invalidation-policy{data-element=VeCANR_I_APM2_IInpMaxCnvr, handle-invalid=KEEP}
      data VeCANR_I_APM2_IInpMaxCnvr: category=VALUE, sw-calibration-access=READ-ONLY, type=ADTSAPM2_IInpMaxCnvr, init-value=VeCANR_I_APM2_IInpMaxCnvrValue:0
    VeCANR_I_CdMAvailopcurentEXT: service-kind=ANY-STANDARDIZED, invalidation-policy{data-element=VeCANR_I_CdMAvailopcurentEXT, handle-invalid=DONT-INVALIDATE}
      data VeCANR_I_CdMAvailopcurentEXT: category=VALUE, sw-calibration-access=READ-ONLY, type=ADTSCdMAvailopcurentEXT, init-value=VeCANR_I_CdMAvailopcurentEXTValue:0
    VeCANR_I_CurrEVSE: service-kind=ANY-STANDARDIZED, invalidation-policy{data-element=VeCANR_I_CurrEVSE, handle-invalid=KEEP}
      data VeCANR_I_CurrEVSE: category=VALUE, sw-calibration-access=READ-ONLY, type=ADTSCurrEVSE, init-value=VeCANR_I_CurrEVSEValue:0
    VeCANR_I_MCPA_DC_Current_P_FD16: service-kind=ANY-STANDARDIZED, invalidation-policy{data-element=VeCANR_I_MCPA_DC_Current_P_FD16, handle-invalid=DONT-INVALIDATE}
      data VeCANR_I_MCPA_DC_Current_P_FD16: category=VALUE, sw-calibration-access=READ-ONLY, type=ADTSMCPA_DC_Current_P_FD16, init-value=VeCANR_I_MCPA_DC_Current_P_FD16Value:0
    VeCANR_I_MCPA_DC_Current_P_FD5: service-kind=ANY-STANDARDIZED, invalidation-policy{data-element=VeCANR_I_MCPA_DC_Current_P_FD5, handle-invalid=DONT-INVALIDATE}
      data VeCANR_I_MCPA_DC_Current_P_FD5: category=VALUE, sw-calibration-access=READ-ONLY, type=ADTSMCPA_DC_Current_P_FD5, init-value=VeCANR_I_MCPA_DC_Current_P_FD5Value:0
    VeCANR_I_MCPB_DC_Current_P_FD16: service-kind=ANY-STANDARDIZED, invalidation-policy{data-element=VeCANR_I_MCPB_DC_Current_P_FD16, handle-invalid=DONT-INVALIDATE}
      data VeCANR_I_MCPB_DC_Current_P_FD16: category=VALUE, sw-calibration-access=READ-ONLY, type=ADTSMCPB_DC_Current_P_FD16, init-value=VeCANR_I_MCPB_DC_Current_P_FD16Value:0
    VeCANR_I_MCPB_DC_Current_P_FD5: service-kind=ANY-STANDARDIZED, invalidation-policy{data-element=VeCANR_I_MCPB_DC_Current_P_FD5, handle-invalid=DONT-INVALIDATE}
      data VeCANR_I_MCPB_DC_Current_P_FD5: category=VALUE, sw-calibration-access=READ-ONLY, type=ADTSMCPB_DC_Current_P_FD5, init-value=VeCANR_I_MCPB_DC_Current_P_FD5Value:0
    VeCANR_I_SGCP_DC_Current_P_FD16: service-kind=ANY-STANDARDIZED, invalidation-policy{data-element=VeCANR_I_SGCP_DC_Current_P_FD16, handle-invalid=DONT-INVALIDATE}
      data VeCANR_I_SGCP_DC_Current_P_FD16: category=VALUE, sw-calibration-access=READ-ONLY, type=ADTSSGCP_DC_Current_P_FD16, init-value=VeCANR_I_SGCP_DC_Current_P_FD16Value:0
    VeCANR_I_SGCP_DC_Current_P_FD5: service-kind=ANY-STANDARDIZED, invalidation-policy{data-element=VeCANR_I_SGCP_DC_Current_P_FD5, handle-invalid=DONT-INVALIDATE}
      data VeCANR_I_SGCP_DC_Current_P_FD5: category=VALUE, sw-calibration-access=READ-ONLY, type=ADTSSGCP_DC_Current_P_FD5, init-value=VeCANR_I_SGCP_DC_Current_P_FD5Value:0
    VeCANR_P_ACplug_PwrMax_FD5: service-kind=ANY-STANDARDIZED, invalidation-policy{data-element=VeCANR_P_ACplug_PwrMax_FD5, handle-invalid=KEEP}
      data VeCANR_P_ACplug_PwrMax_FD5: category=VALUE, sw-calibration-access=READ-ONLY, type=ADTSACplug_PwrMax_FD5, init-value=VeCANR_P_ACplug_PwrMax_FD5Value:-32767
    VeCANR_P_V2H_HVCMS_EVSEMxPLtFD5: service-kind=ANY-STANDARDIZED, invalidation-policy{data-element=VeCANR_P_V2H_HVCMS_EVSEMxPLtFD5, handle-invalid=DONT-INVALIDATE}
      data VeCANR_P_V2H_HVCMS_EVSEMxPLtFD5: category=VALUE, sw-calibration-access=READ-ONLY, type=ADTSV2H_HVCMS_EVSEMxPLtFD5, init-value=VeCANR_P_V2H_HVCMS_EVSEMxPLtFD5Value:-819.1
    VeCANR_Pct_BMS_HV_SOC_Max_FD11: service-kind=ANY-STANDARDIZED, invalidation-policy{data-element=VeCANR_Pct_BMS_HV_SOC_Max_FD11, handle-invalid=DONT-INVALIDATE}
      data VeCANR_Pct_BMS_HV_SOC_Max_FD11: category=VALUE, sw-calibration-access=READ-ONLY, type=ADTSBMS_HV_SOC_Max_FD11, init-value=VeCANR_Pct_BMS_HV_SOC_Max_FD11Value:19.60785
    VeCANR_Pct_BMS_HV_SOC_Max_FD5: service-kind=ANY-STANDARDIZED, invalidation-policy{data-element=VeCANR_Pct_BMS_HV_SOC_Max_FD5, handle-invalid=DONT-INVALIDATE}
      data VeCANR_Pct_BMS_HV_SOC_Max_FD5: category=VALUE, sw-calibration-access=READ-ONLY, type=ADTSBMS_HV_SOC_Max_FD5, init-value=VeCANR_Pct_BMS_HV_SOC_Max_FD5Value:19.60785
    VeCANR_Pct_BMS_HV_SOC_Min_FD11: service-kind=ANY-STANDARDIZED, invalidation-policy{data-element=VeCANR_Pct_BMS_HV_SOC_Min_FD11, handle-invalid=DONT-INVALIDATE}
      data VeCANR_Pct_BMS_HV_SOC_Min_FD11: category=VALUE, sw-calibration-access=READ-ONLY, type=ADTSBMS_HV_SOC_Min_FD11, init-value=VeCANR_Pct_BMS_HV_SOC_Min_FD11Value:19.56285
    VeCANR_Pct_BMS_HV_SOC_Min_FD5: service-kind=ANY-STANDARDIZED, invalidation-policy{data-element=VeCANR_Pct_BMS_HV_SOC_Min_FD5, handle-invalid=DONT-INVALIDATE}
      data VeCANR_Pct_BMS_HV_SOC_Min_FD5: category=VALUE, sw-calibration-access=READ-ONLY, type=ADTSBMS_HV_SOC_Min_FD5, init-value=VeCANR_Pct_BMS_HV_SOC_Min_FD5Value:19.56285
    VeCANR_Pct_PwrEff: service-kind=ANY-STANDARDIZED, invalidation-policy{data-element=VeCANR_Pct_PwrEff, handle-invalid=KEEP}
      data VeCANR_Pct_PwrEff: category=VALUE, sw-calibration-access=READ-ONLY, type=ADTSPwrEff, init-value=VeCANR_Pct_PwrEffValue:0
    VeCANR_Pct_V2H_Reserve_Battery: service-kind=ANY-STANDARDIZED, invalidation-policy{data-element=VeCANR_Pct_V2H_Reserve_Battery, handle-invalid=DONT-INVALIDATE}
      data VeCANR_Pct_V2H_Reserve_Battery: category=VALUE, sw-calibration-access=READ-ONLY, type=ADTSV2H_Reserve_Battery, init-value=VeCANR_Pct_V2H_Reserve_BatteryValue:0
    VeCANR_Pct_V2L_Reserve_Battery: service-kind=ANY-STANDARDIZED, invalidation-policy{data-element=VeCANR_Pct_V2L_Reserve_Battery, handle-invalid=DONT-INVALIDATE}
      data VeCANR_Pct_V2L_Reserve_Battery: category=VALUE, sw-calibration-access=READ-ONLY, type=ADTSV2L_Reserve_Battery, init-value=VeCANR_Pct_V2L_Reserve_BatteryValue:0
    VeCANR_Pct_V2V_Reserve_Battery: service-kind=ANY-STANDARDIZED, invalidation-policy{data-element=VeCANR_Pct_V2V_Reserve_Battery, handle-invalid=DONT-INVALIDATE}
      data VeCANR_Pct_V2V_Reserve_Battery: category=VALUE, sw-calibration-access=READ-ONLY, type=ADTSV2V_Reserve_Battery, init-value=VeCANR_Pct_V2V_Reserve_BatteryValue:0
    VeCANR_T_APM2_TempFET1: service-kind=ANY-STANDARDIZED, invalidation-policy{data-element=VeCANR_T_APM2_TempFET1, handle-invalid=DONT-INVALIDATE}
      data VeCANR_T_APM2_TempFET1: category=VALUE, sw-calibration-access=READ-ONLY, type=ADTSAPM2_TempFET1, init-value=VeCANR_T_APM2_TempFET1Value:20
    VeCANR_T_APM2_TempFET2: service-kind=ANY-STANDARDIZED, invalidation-policy{data-element=VeCANR_T_APM2_TempFET2, handle-invalid=DONT-INVALIDATE}
      data VeCANR_T_APM2_TempFET2: category=VALUE, sw-calibration-access=READ-ONLY, type=ADTSAPM2_TempFET2, init-value=VeCANR_T_APM2_TempFET2Value:20
    VeCANR_T_APM2_TempInlet: service-kind=ANY-STANDARDIZED, invalidation-policy{data-element=VeCANR_T_APM2_TempInlet, handle-invalid=KEEP}
      data VeCANR_T_APM2_TempInlet: category=VALUE, sw-calibration-access=READ-ONLY, type=ADTSAPM2_TempInlet, init-value=VeCANR_T_APM2_TempInletValue:-40
    VeCANR_T_APM2_TempInt: service-kind=ANY-STANDARDIZED, invalidation-policy{data-element=VeCANR_T_APM2_TempInt, handle-invalid=DONT-INVALIDATE}
      data VeCANR_T_APM2_TempInt: category=VALUE, sw-calibration-access=READ-ONLY, type=ADTSAPM2_TempInt, init-value=VeCANR_T_APM2_TempIntValue:20
    VeCANR_T_APM2_TempL1: service-kind=ANY-STANDARDIZED, invalidation-policy{data-element=VeCANR_T_APM2_TempL1, handle-invalid=DONT-INVALIDATE}
      data VeCANR_T_APM2_TempL1: category=VALUE, sw-calibration-access=READ-ONLY, type=ADTSAPM2_TempL1, init-value=VeCANR_T_APM2_TempL1Value:20
    VeCANR_T_APM2_TempL2: service-kind=ANY-STANDARDIZED, invalidation-policy{data-element=VeCANR_T_APM2_TempL2, handle-invalid=DONT-INVALIDATE}
      data VeCANR_T_APM2_TempL2: category=VALUE, sw-calibration-access=READ-ONLY, type=ADTSAPM2_TempL2, init-value=VeCANR_T_APM2_TempL2Value:20
    VeCANR_T_APM2_TempMargin: service-kind=ANY-STANDARDIZED, invalidation-policy{data-element=VeCANR_T_APM2_TempMargin, handle-invalid=DONT-INVALIDATE}
      data VeCANR_T_APM2_TempMargin: category=VALUE, sw-calibration-access=READ-ONLY, type=ADTSAPM2_TempMargin, init-value=VeCANR_T_APM2_TempMarginValue:0.312000000000001
    VeCANR_T_BMS_HVLoTempThd_FD11: service-kind=ANY-STANDARDIZED, invalidation-policy{data-element=VeCANR_T_BMS_HVLoTempThd_FD11, handle-invalid=DONT-INVALIDATE}
      data VeCANR_T_BMS_HVLoTempThd_FD11: category=VALUE, sw-calibration-access=READ-ONLY, type=ADTSBMS_HVLoTempThd_FD11, init-value=VeCANR_T_BMS_HVLoTempThd_FD11Value:-40
    VeCANR_T_BMS_HVLoTempThd_FD5: service-kind=ANY-STANDARDIZED, invalidation-policy{data-element=VeCANR_T_BMS_HVLoTempThd_FD5, handle-invalid=DONT-INVALIDATE}
      data VeCANR_T_BMS_HVLoTempThd_FD5: category=VALUE, sw-calibration-access=READ-ONLY, type=ADTSBMS_HVLoTempThd_FD5, init-value=VeCANR_T_BMS_HVLoTempThd_FD5Value:-40
    VeCANR_T_BMS_HV_HiTempThd_FD11: service-kind=ANY-STANDARDIZED, invalidation-policy{data-element=VeCANR_T_BMS_HV_HiTempThd_FD11, handle-invalid=DONT-INVALIDATE}
      data VeCANR_T_BMS_HV_HiTempThd_FD11: category=VALUE, sw-calibration-access=READ-ONLY, type=ADTSBMS_HV_HiTempThd_FD11, init-value=VeCANR_T_BMS_HV_HiTempThd_FD11Value:-40
    VeCANR_T_BMS_HV_HiTempThd_FD5: service-kind=ANY-STANDARDIZED, invalidation-policy{data-element=VeCANR_T_BMS_HV_HiTempThd_FD5, handle-invalid=DONT-INVALIDATE}
      data VeCANR_T_BMS_HV_HiTempThd_FD5: category=VALUE, sw-calibration-access=READ-ONLY, type=ADTSBMS_HV_HiTempThd_FD5, init-value=VeCANR_T_BMS_HV_HiTempThd_FD5Value:-40
    VeCANR_T_Climate_Cabin_Temp1: service-kind=ANY-STANDARDIZED, invalidation-policy{data-element=VeCANR_T_Climate_Cabin_Temp1, handle-invalid=KEEP}
      data VeCANR_T_Climate_Cabin_Temp1: category=VALUE, sw-calibration-access=READ-ONLY, type=ADTSClimate_Cabin_Temp1, init-value=VeCANR_T_Climate_Cabin_Temp1Value:22
    VeCANR_T_Climate_Cabin_Temp2: service-kind=ANY-STANDARDIZED, invalidation-policy{data-element=VeCANR_T_Climate_Cabin_Temp2, handle-invalid=KEEP}
      data VeCANR_T_Climate_Cabin_Temp2: category=VALUE, sw-calibration-access=READ-ONLY, type=ADTSClimate_Cabin_Temp2, init-value=VeCANR_T_Climate_Cabin_Temp2Value:22
    VeCANR_T_Climate_TBM_CabinTemp1: service-kind=ANY-STANDARDIZED, invalidation-policy{data-element=VeCANR_T_Climate_TBM_CabinTemp1, handle-invalid=KEEP}
      data VeCANR_T_Climate_TBM_CabinTemp1: category=VALUE, sw-calibration-access=READ-ONLY, type=ADTSClimate_TBM_CabinTemp1, init-value=VeCANR_T_Climate_TBM_CabinTemp1Value:22
    VeCANR_T_Climate_TBM_CabinTemp2: service-kind=ANY-STANDARDIZED, invalidation-policy{data-element=VeCANR_T_Climate_TBM_CabinTemp2, handle-invalid=KEEP}
      data VeCANR_T_Climate_TBM_CabinTemp2: category=VALUE, sw-calibration-access=READ-ONLY, type=ADTSClimate_TBM_CabinTemp2, init-value=VeCANR_T_Climate_TBM_CabinTemp2Value:22
    VeCANR_T_EngIntAirTmp: service-kind=ANY-STANDARDIZED, invalidation-policy{data-element=VeCANR_T_EngIntAirTmp, handle-invalid=KEEP}
      data VeCANR_T_EngIntAirTmp: category=VALUE, sw-calibration-access=READ-ONLY, type=ADTSEngIntAirTmp, init-value=VeCANR_T_EngIntAirTmpValue:-40
    VeCANR_T_EngineWaterTemp: service-kind=ANY-STANDARDIZED, invalidation-policy{data-element=VeCANR_T_EngineWaterTemp, handle-invalid=KEEP}
      data VeCANR_T_EngineWaterTemp: category=VALUE, sw-calibration-access=READ-ONLY, type=ADTSEngineWaterTemp, init-value=VeCANR_T_EngineWaterTempValue:-40
    VeCANR_T_EstCatCnvTmp: service-kind=ANY-STANDARDIZED, invalidation-policy{data-element=VeCANR_T_EstCatCnvTmp, handle-invalid=KEEP}
      data VeCANR_T_EstCatCnvTmp: category=VALUE, sw-calibration-access=READ-ONLY, type=ADTSEstCatCnvTmp, init-value=VeCANR_T_EstCatCnvTmpValue:0
    VeCANR_T_MCPACtrlBoarTempP_FD16: service-kind=ANY-STANDARDIZED, invalidation-policy{data-element=VeCANR_T_MCPACtrlBoarTempP_FD16, handle-invalid=KEEP}
      data VeCANR_T_MCPACtrlBoarTempP_FD16: category=VALUE, sw-calibration-access=READ-ONLY, type=ADTSMCPACtrlBoarTempP_FD16, init-value=VeCANR_T_MCPACtrlBoarTempP_FD16Value:215
    VeCANR_T_MCPACtrlBoardTempP_FD5: service-kind=ANY-STANDARDIZED, invalidation-policy{data-element=VeCANR_T_MCPACtrlBoardTempP_FD5, handle-invalid=KEEP}
      data VeCANR_T_MCPACtrlBoardTempP_FD5: category=VALUE, sw-calibration-access=READ-ONLY, type=ADTSMCPACtrlBoardTempP_FD5, init-value=VeCANR_T_MCPACtrlBoardTempP_FD5Value:215
    VeCANR_T_MCPAPIMDCSdBusTempPFD5: service-kind=ANY-STANDARDIZED, invalidation-policy{data-element=VeCANR_T_MCPAPIMDCSdBusTempPFD5, handle-invalid=KEEP}
      data VeCANR_T_MCPAPIMDCSdBusTempPFD5: category=VALUE, sw-calibration-access=READ-ONLY, type=ADTSMCPAPIMDCSdBusTempPFD5, init-value=VeCANR_T_MCPAPIMDCSdBusTempPFD5Value:-40
    VeCANR_T_MCPAPIMDCSdBusTmpPFD16: service-kind=ANY-STANDARDIZED, invalidation-policy{data-element=VeCANR_T_MCPAPIMDCSdBusTmpPFD16, handle-invalid=KEEP}
      data VeCANR_T_MCPAPIMDCSdBusTmpPFD16: category=VALUE, sw-calibration-access=READ-ONLY, type=ADTSMCPAPIMDCSdBusTmpPFD16, init-value=VeCANR_T_MCPAPIMDCSdBusTmpPFD16Value:-40
    VeCANR_T_MCPARotorTemp_P_FD16: service-kind=ANY-STANDARDIZED, invalidation-policy{data-element=VeCANR_T_MCPARotorTemp_P_FD16, handle-invalid=KEEP}
      data VeCANR_T_MCPARotorTemp_P_FD16: category=VALUE, sw-calibration-access=READ-ONLY, type=ADTSMCPARotorTemp_P_FD16, init-value=VeCANR_T_MCPARotorTemp_P_FD16Value:215
    VeCANR_T_MCPARotorTemp_P_FD5: service-kind=ANY-STANDARDIZED, invalidation-policy{data-element=VeCANR_T_MCPARotorTemp_P_FD5, handle-invalid=KEEP}
      data VeCANR_T_MCPARotorTemp_P_FD5: category=VALUE, sw-calibration-access=READ-ONLY, type=ADTSMCPARotorTemp_P_FD5, init-value=VeCANR_T_MCPARotorTemp_P_FD5Value:215
    VeCANR_T_MCPA_ClantTmp_P_FD16: service-kind=ANY-STANDARDIZED, invalidation-policy{data-element=VeCANR_T_MCPA_ClantTmp_P_FD16, handle-invalid=KEEP}
      data VeCANR_T_MCPA_ClantTmp_P_FD16: category=VALUE, sw-calibration-access=READ-ONLY, type=ADTSMCPA_ClantTmp_P_FD16, init-value=VeCANR_T_MCPA_ClantTmp_P_FD16Value:-40
    VeCANR_T_MCPA_CoolntTmp_P_FD5: service-kind=ANY-STANDARDIZED, invalidation-policy{data-element=VeCANR_T_MCPA_CoolntTmp_P_FD5, handle-invalid=KEEP}
      data VeCANR_T_MCPA_CoolntTmp_P_FD5: category=VALUE, sw-calibration-access=READ-ONLY, type=ADTSMCPA_CoolntTmp_P_FD5, init-value=VeCANR_T_MCPA_CoolntTmp_P_FD5Value:-40
    VeCANR_T_MCPA_InvertTemp_P_FD16: service-kind=ANY-STANDARDIZED, invalidation-policy{data-element=VeCANR_T_MCPA_InvertTemp_P_FD16, handle-invalid=KEEP}
      data VeCANR_T_MCPA_InvertTemp_P_FD16: category=VALUE, sw-calibration-access=READ-ONLY, type=ADTSMCPA_InvertTemp_P_FD16, init-value=VeCANR_T_MCPA_InvertTemp_P_FD16Value:0
    VeCANR_T_MCPA_Invert_Temp_P_FD5: service-kind=ANY-STANDARDIZED, invalidation-policy{data-element=VeCANR_T_MCPA_Invert_Temp_P_FD5, handle-invalid=KEEP}
      data VeCANR_T_MCPA_Invert_Temp_P_FD5: category=VALUE, sw-calibration-access=READ-ONLY, type=ADTSMCPA_Invert_Temp_P_FD5, init-value=VeCANR_T_MCPA_Invert_Temp_P_FD5Value:0
    VeCANR_T_MCPBIMDCSdBusTempPFD5: service-kind=ANY-STANDARDIZED, invalidation-policy{data-element=VeCANR_T_MCPBIMDCSdBusTempPFD5, handle-invalid=KEEP}
      data VeCANR_T_MCPBIMDCSdBusTempPFD5: category=VALUE, sw-calibration-access=READ-ONLY, type=ADTSMCPBIMDCSdBusTempPFD5, init-value=VeCANR_T_MCPBIMDCSdBusTempPFD5Value:-40
    VeCANR_T_MCPBPIMDCSdBusTmpPFD16: service-kind=ANY-STANDARDIZED, invalidation-policy{data-element=VeCANR_T_MCPBPIMDCSdBusTmpPFD16, handle-invalid=KEEP}
      data VeCANR_T_MCPBPIMDCSdBusTmpPFD16: category=VALUE, sw-calibration-access=READ-ONLY, type=ADTSMCPBPIMDCSdBusTmpPFD16, init-value=VeCANR_T_MCPBPIMDCSdBusTmpPFD16Value:-40
    VeCANR_T_MCPBRotorTemp_P_FD16: service-kind=ANY-STANDARDIZED, invalidation-policy{data-element=VeCANR_T_MCPBRotorTemp_P_FD16, handle-invalid=KEEP}
      data VeCANR_T_MCPBRotorTemp_P_FD16: category=VALUE, sw-calibration-access=READ-ONLY, type=ADTSMCPBRotorTemp_P_FD16, init-value=VeCANR_T_MCPBRotorTemp_P_FD16Value:215
    VeCANR_T_MCPBRotorTemp_P_FD5: service-kind=ANY-STANDARDIZED, invalidation-policy{data-element=VeCANR_T_MCPBRotorTemp_P_FD5, handle-invalid=KEEP}
      data VeCANR_T_MCPBRotorTemp_P_FD5: category=VALUE, sw-calibration-access=READ-ONLY, type=ADTSMCPBRotorTemp_P_FD5, init-value=VeCANR_T_MCPBRotorTemp_P_FD5Value:215
    VeCANR_T_MCPB_CoolantTemp_P_FD5: service-kind=ANY-STANDARDIZED, invalidation-policy{data-element=VeCANR_T_MCPB_CoolantTemp_P_FD5, handle-invalid=KEEP}
      data VeCANR_T_MCPB_CoolantTemp_P_FD5: category=VALUE, sw-calibration-access=READ-ONLY, type=ADTSMCPB_CoolantTemp_P_FD5, init-value=VeCANR_T_MCPB_CoolantTemp_P_FD5Value:-40
    VeCANR_T_MCPB_CoolantTmp_P_FD16: service-kind=ANY-STANDARDIZED, invalidation-policy{data-element=VeCANR_T_MCPB_CoolantTmp_P_FD16, handle-invalid=KEEP}
      data VeCANR_T_MCPB_CoolantTmp_P_FD16: category=VALUE, sw-calibration-access=READ-ONLY, type=ADTSMCPB_CoolantTmp_P_FD16, init-value=VeCANR_T_MCPB_CoolantTmp_P_FD16Value:-40
    VeCANR_T_MCPB_InvertTemp_P_FD16: service-kind=ANY-STANDARDIZED, invalidation-policy{data-element=VeCANR_T_MCPB_InvertTemp_P_FD16, handle-invalid=KEEP}
      data VeCANR_T_MCPB_InvertTemp_P_FD16: category=VALUE, sw-calibration-access=READ-ONLY, type=ADTSMCPB_InvertTemp_P_FD16, init-value=VeCANR_T_MCPB_InvertTemp_P_FD16Value:0
    VeCANR_T_MCPB_Invert_Temp_P_FD5: service-kind=ANY-STANDARDIZED, invalidation-policy{data-element=VeCANR_T_MCPB_Invert_Temp_P_FD5, handle-invalid=KEEP}
      data VeCANR_T_MCPB_Invert_Temp_P_FD5: category=VALUE, sw-calibration-access=READ-ONLY, type=ADTSMCPB_Invert_Temp_P_FD5, init-value=VeCANR_T_MCPB_Invert_Temp_P_FD5Value:0
    VeCANR_T_OAT_PT_Est_FD3: service-kind=ANY-STANDARDIZED, invalidation-policy{data-element=VeCANR_T_OAT_PT_Est_FD3, handle-invalid=DONT-INVALIDATE}
      data VeCANR_T_OAT_PT_Est_FD3: category=VALUE, sw-calibration-access=READ-ONLY, type=ADTSOAT_PT_Est_FD3, init-value=VeCANR_T_OAT_PT_Est_FD3Value:-64
    VeCANR_T_OBC_Temp1_FD11: service-kind=ANY-STANDARDIZED, invalidation-policy{data-element=VeCANR_T_OBC_Temp1_FD11, handle-invalid=KEEP}
      data VeCANR_T_OBC_Temp1_FD11: category=VALUE, sw-calibration-access=READ-ONLY, type=ADTSOBC_Temp1_FD11, init-value=VeCANR_T_OBC_Temp1_FD11Value:-40
    VeCANR_T_OBC_Temp1_FD5: service-kind=ANY-STANDARDIZED, invalidation-policy{data-element=VeCANR_T_OBC_Temp1_FD5, handle-invalid=KEEP}
      data VeCANR_T_OBC_Temp1_FD5: category=VALUE, sw-calibration-access=READ-ONLY, type=ADTSOBC_Temp1_FD5, init-value=VeCANR_T_OBC_Temp1_FD5Value:-40
    VeCANR_T_OBC_Temp2_FD11: service-kind=ANY-STANDARDIZED, invalidation-policy{data-element=VeCANR_T_OBC_Temp2_FD11, handle-invalid=KEEP}
      data VeCANR_T_OBC_Temp2_FD11: category=VALUE, sw-calibration-access=READ-ONLY, type=ADTSOBC_Temp2_FD11, init-value=VeCANR_T_OBC_Temp2_FD11Value:-40
    VeCANR_T_OBC_Temp2_FD5: service-kind=ANY-STANDARDIZED, invalidation-policy{data-element=VeCANR_T_OBC_Temp2_FD5, handle-invalid=KEEP}
      data VeCANR_T_OBC_Temp2_FD5: category=VALUE, sw-calibration-access=READ-ONLY, type=ADTSOBC_Temp2_FD5, init-value=VeCANR_T_OBC_Temp2_FD5Value:-40
    VeCANR_T_OBC_Temp3_FD11: service-kind=ANY-STANDARDIZED, invalidation-policy{data-element=VeCANR_T_OBC_Temp3_FD11, handle-invalid=KEEP}
      data VeCANR_T_OBC_Temp3_FD11: category=VALUE, sw-calibration-access=READ-ONLY, type=ADTSOBC_Temp3_FD11, init-value=VeCANR_T_OBC_Temp3_FD11Value:-40
    VeCANR_T_OBC_Temp3_FD5: service-kind=ANY-STANDARDIZED, invalidation-policy{data-element=VeCANR_T_OBC_Temp3_FD5, handle-invalid=KEEP}
      data VeCANR_T_OBC_Temp3_FD5: category=VALUE, sw-calibration-access=READ-ONLY, type=ADTSOBC_Temp3_FD5, init-value=VeCANR_T_OBC_Temp3_FD5Value:-40
    VeCANR_T_OBC_Temp4_FD11: service-kind=ANY-STANDARDIZED, invalidation-policy{data-element=VeCANR_T_OBC_Temp4_FD11, handle-invalid=KEEP}
      data VeCANR_T_OBC_Temp4_FD11: category=VALUE, sw-calibration-access=READ-ONLY, type=ADTSOBC_Temp4_FD11, init-value=VeCANR_T_OBC_Temp4_FD11Value:-40
    VeCANR_T_OBC_Temp4_FD5: service-kind=ANY-STANDARDIZED, invalidation-policy{data-element=VeCANR_T_OBC_Temp4_FD5, handle-invalid=KEEP}
      data VeCANR_T_OBC_Temp4_FD5: category=VALUE, sw-calibration-access=READ-ONLY, type=ADTSOBC_Temp4_FD5, init-value=VeCANR_T_OBC_Temp4_FD5Value:-40
    VeCANR_T_SGCPCtrlBoarTempP_FD16: service-kind=ANY-STANDARDIZED, invalidation-policy{data-element=VeCANR_T_SGCPCtrlBoarTempP_FD16, handle-invalid=KEEP}
      data VeCANR_T_SGCPCtrlBoarTempP_FD16: category=VALUE, sw-calibration-access=READ-ONLY, type=ADTSSGCPCtrlBoarTempP_FD16, init-value=VeCANR_T_SGCPCtrlBoarTempP_FD16Value:215
    VeCANR_T_SGCPCtrlBoardTempP_FD5: service-kind=ANY-STANDARDIZED, invalidation-policy{data-element=VeCANR_T_SGCPCtrlBoardTempP_FD5, handle-invalid=KEEP}
      data VeCANR_T_SGCPCtrlBoardTempP_FD5: category=VALUE, sw-calibration-access=READ-ONLY, type=ADTSSGCPCtrlBoardTempP_FD5, init-value=VeCANR_T_SGCPCtrlBoardTempP_FD5Value:215
    VeCANR_T_SGCPPIMDCSdBusTempPFD5: service-kind=ANY-STANDARDIZED, invalidation-policy{data-element=VeCANR_T_SGCPPIMDCSdBusTempPFD5, handle-invalid=KEEP}
      data VeCANR_T_SGCPPIMDCSdBusTempPFD5: category=VALUE, sw-calibration-access=READ-ONLY, type=ADTSSGCPPIMDCSdBusTempPFD5, init-value=VeCANR_T_SGCPPIMDCSdBusTempPFD5Value:-40
    VeCANR_T_SGCPPIMDCSdBusTmpPFD16: service-kind=ANY-STANDARDIZED, invalidation-policy{data-element=VeCANR_T_SGCPPIMDCSdBusTmpPFD16, handle-invalid=KEEP}
      data VeCANR_T_SGCPPIMDCSdBusTmpPFD16: category=VALUE, sw-calibration-access=READ-ONLY, type=ADTSSGCPPIMDCSdBusTmpPFD16, init-value=VeCANR_T_SGCPPIMDCSdBusTmpPFD16Value:-40
    VeCANR_T_SGCPRotorTemp_P_FD16: service-kind=ANY-STANDARDIZED, invalidation-policy{data-element=VeCANR_T_SGCPRotorTemp_P_FD16, handle-invalid=KEEP}
      data VeCANR_T_SGCPRotorTemp_P_FD16: category=VALUE, sw-calibration-access=READ-ONLY, type=ADTSSGCPRotorTemp_P_FD16, init-value=VeCANR_T_SGCPRotorTemp_P_FD16Value:215
    VeCANR_T_SGCPRotorTemp_P_FD5: service-kind=ANY-STANDARDIZED, invalidation-policy{data-element=VeCANR_T_SGCPRotorTemp_P_FD5, handle-invalid=KEEP}
      data VeCANR_T_SGCPRotorTemp_P_FD5: category=VALUE, sw-calibration-access=READ-ONLY, type=ADTSSGCPRotorTemp_P_FD5, init-value=VeCANR_T_SGCPRotorTemp_P_FD5Value:215
    VeCANR_T_SGCP_CoolantTemp_P_FD5: service-kind=ANY-STANDARDIZED, invalidation-policy{data-element=VeCANR_T_SGCP_CoolantTemp_P_FD5, handle-invalid=KEEP}
      data VeCANR_T_SGCP_CoolantTemp_P_FD5: category=VALUE, sw-calibration-access=READ-ONLY, type=ADTSSGCP_CoolantTemp_P_FD5, init-value=VeCANR_T_SGCP_CoolantTemp_P_FD5Value:-40
    VeCANR_T_SGCP_CoolantTmp_P_FD16: service-kind=ANY-STANDARDIZED, invalidation-policy{data-element=VeCANR_T_SGCP_CoolantTmp_P_FD16, handle-invalid=KEEP}
      data VeCANR_T_SGCP_CoolantTmp_P_FD16: category=VALUE, sw-calibration-access=READ-ONLY, type=ADTSSGCP_CoolantTmp_P_FD16, init-value=VeCANR_T_SGCP_CoolantTmp_P_FD16Value:-40
    VeCANR_T_SGCP_InvertTemp_P_FD16: service-kind=ANY-STANDARDIZED, invalidation-policy{data-element=VeCANR_T_SGCP_InvertTemp_P_FD16, handle-invalid=KEEP}
      data VeCANR_T_SGCP_InvertTemp_P_FD16: category=VALUE, sw-calibration-access=READ-ONLY, type=ADTSSGCP_InvertTemp_P_FD16, init-value=VeCANR_T_SGCP_InvertTemp_P_FD16Value:0
    VeCANR_T_SGCP_Invert_Temp_P_FD5: service-kind=ANY-STANDARDIZED, invalidation-policy{data-element=VeCANR_T_SGCP_Invert_Temp_P_FD5, handle-invalid=KEEP}
      data VeCANR_T_SGCP_Invert_Temp_P_FD5: category=VALUE, sw-calibration-access=READ-ONLY, type=ADTSSGCP_Invert_Temp_P_FD5, init-value=VeCANR_T_SGCP_Invert_Temp_P_FD5Value:0
    VeCANR_U_APM2_HVChrgBusVoltage: service-kind=ANY-STANDARDIZED, invalidation-policy{data-element=VeCANR_U_APM2_HVChrgBusVoltage, handle-invalid=DONT-INVALIDATE}
      data VeCANR_U_APM2_HVChrgBusVoltage: category=VALUE, sw-calibration-access=READ-ONLY, type=ADTSAPM2_HVChrgBusVoltage, init-value=VeCANR_U_APM2_HVChrgBusVoltageValue:0
    VeCANR_U_CdM_ExtFun_Thres_Volt: service-kind=ANY-STANDARDIZED, invalidation-policy{data-element=VeCANR_U_CdM_ExtFun_Thres_Volt, handle-invalid=DONT-INVALIDATE}
      data VeCANR_U_CdM_ExtFun_Thres_Volt: category=VALUE, sw-calibration-access=READ-ONLY, type=ADTSCdM_ExtFun_Thres_Volt, init-value=VeCANR_U_CdM_ExtFun_Thres_VoltValue:0
    VeCANR_U_EVSE_ThrshldVoltage: service-kind=ANY-STANDARDIZED, invalidation-policy{data-element=VeCANR_U_EVSE_ThrshldVoltage, handle-invalid=DONT-INVALIDATE}
      data VeCANR_U_EVSE_ThrshldVoltage: category=VALUE, sw-calibration-access=READ-ONLY, type=ADTSEVSE_ThrshldVoltage, init-value=VeCANR_U_EVSE_ThrshldVoltageValue:0
    VeCANR_U_MCPA_DC_Voltage_P_FD16: service-kind=ANY-STANDARDIZED, invalidation-policy{data-element=VeCANR_U_MCPA_DC_Voltage_P_FD16, handle-invalid=KEEP}
      data VeCANR_U_MCPA_DC_Voltage_P_FD16: category=VALUE, sw-calibration-access=READ-ONLY, type=ADTSMCPA_DC_Voltage_P_FD16, init-value=VeCANR_U_MCPA_DC_Voltage_P_FD16Value:0
    VeCANR_U_MCPA_DC_Voltage_P_FD5: service-kind=ANY-STANDARDIZED, invalidation-policy{data-element=VeCANR_U_MCPA_DC_Voltage_P_FD5, handle-invalid=KEEP}
      data VeCANR_U_MCPA_DC_Voltage_P_FD5: category=VALUE, sw-calibration-access=READ-ONLY, type=ADTSMCPA_DC_Voltage_P_FD5, init-value=VeCANR_U_MCPA_DC_Voltage_P_FD5Value:0
    VeCANR_U_MCPB_DC_Voltage_P_FD16: service-kind=ANY-STANDARDIZED, invalidation-policy{data-element=VeCANR_U_MCPB_DC_Voltage_P_FD16, handle-invalid=KEEP}
      data VeCANR_U_MCPB_DC_Voltage_P_FD16: category=VALUE, sw-calibration-access=READ-ONLY, type=ADTSMCPB_DC_Voltage_P_FD16, init-value=VeCANR_U_MCPB_DC_Voltage_P_FD16Value:0
    VeCANR_U_MCPB_DC_Voltage_P_FD5: service-kind=ANY-STANDARDIZED, invalidation-policy{data-element=VeCANR_U_MCPB_DC_Voltage_P_FD5, handle-invalid=KEEP}
      data VeCANR_U_MCPB_DC_Voltage_P_FD5: category=VALUE, sw-calibration-access=READ-ONLY, type=ADTSMCPB_DC_Voltage_P_FD5, init-value=VeCANR_U_MCPB_DC_Voltage_P_FD5Value:0
    VeCANR_U_OBC_Pilot_FD5: service-kind=ANY-STANDARDIZED, invalidation-policy{data-element=VeCANR_U_OBC_Pilot_FD5, handle-invalid=DONT-INVALIDATE}
      data VeCANR_U_OBC_Pilot_FD5: category=VALUE, sw-calibration-access=READ-ONLY, type=ADTSOBC_Pilot_FD5, init-value=VeCANR_U_OBC_Pilot_FD5Value:0
    VeCANR_U_OBC_Prox_FD5: service-kind=ANY-STANDARDIZED, invalidation-policy{data-element=VeCANR_U_OBC_Prox_FD5, handle-invalid=DONT-INVALIDATE}
      data VeCANR_U_OBC_Prox_FD5: category=VALUE, sw-calibration-access=READ-ONLY, type=ADTSOBC_Prox_FD5, init-value=VeCANR_U_OBC_Prox_FD5Value:0
    VeCANR_U_SGCP_DC_Voltage_P_FD16: service-kind=ANY-STANDARDIZED, invalidation-policy{data-element=VeCANR_U_SGCP_DC_Voltage_P_FD16, handle-invalid=KEEP}
      data VeCANR_U_SGCP_DC_Voltage_P_FD16: category=VALUE, sw-calibration-access=READ-ONLY, type=ADTSSGCP_DC_Voltage_P_FD16, init-value=VeCANR_U_SGCP_DC_Voltage_P_FD16Value:0
    VeCANR_U_SGCP_DC_Voltage_P_FD5: service-kind=ANY-STANDARDIZED, invalidation-policy{data-element=VeCANR_U_SGCP_DC_Voltage_P_FD5, handle-invalid=KEEP}
      data VeCANR_U_SGCP_DC_Voltage_P_FD5: category=VALUE, sw-calibration-access=READ-ONLY, type=ADTSSGCP_DC_Voltage_P_FD5, init-value=VeCANR_U_SGCP_DC_Voltage_P_FD5Value:0
    VeCANR_U_VltgChgEVSE: service-kind=ANY-STANDARDIZED, invalidation-policy{data-element=VeCANR_U_VltgChgEVSE, handle-invalid=KEEP}
      data VeCANR_U_VltgChgEVSE: category=VALUE, sw-calibration-access=READ-ONLY, type=ADTSVltgChgEVSE, init-value=VeCANR_U_VltgChgEVSEValue:0
    VeCANR_U_VltgChgInt: service-kind=ANY-STANDARDIZED, invalidation-policy{data-element=VeCANR_U_VltgChgInt, handle-invalid=KEEP}
      data VeCANR_U_VltgChgInt: category=VALUE, sw-calibration-access=READ-ONLY, type=ADTSVltgChgInt, init-value=VeCANR_U_VltgChgIntValue:0
    VeCANR_b_ACplug_PwrMax_FD5TO: service-kind=ANY-STANDARDIZED, invalidation-policy{data-element=VeCANR_b_ACplug_PwrMax_FD5TO, handle-invalid=DONT-INVALIDATE}  # Time Out
      data VeCANR_b_ACplug_PwrMax_FD5TO: category=VALUE, sw-calibration-access=READ-ONLY, type=ADTSBoolean, init-value=VeCANR_b_ACplug_PwrMax_FD5TOValue:0
    VeCANR_b_APM2InterlockStsTO: service-kind=ANY-STANDARDIZED, invalidation-policy{data-element=VeCANR_b_APM2InterlockStsTO, handle-invalid=DONT-INVALIDATE}  # Time Out
      data VeCANR_b_APM2InterlockStsTO: category=VALUE, sw-calibration-access=READ-ONLY, type=ADTSBoolean, init-value=VeCANR_b_APM2InterlockStsTOValue:0
    VeCANR_b_APM2_BoostSwitchSts: service-kind=ANY-STANDARDIZED, invalidation-policy{data-element=VeCANR_b_APM2_BoostSwitchSts, handle-invalid=DONT-INVALIDATE}
      data VeCANR_b_APM2_BoostSwitchSts: category=VALUE, sw-calibration-access=READ-ONLY, type=ADTSBoolean, init-value=VeCANR_b_APM2_BoostSwitchStsValue:0
    VeCANR_b_APM2_BoostSwitchStsTO: service-kind=ANY-STANDARDIZED, invalidation-policy{data-element=VeCANR_b_APM2_BoostSwitchStsTO, handle-invalid=DONT-INVALIDATE}  # Time Out
      data VeCANR_b_APM2_BoostSwitchStsTO: category=VALUE, sw-calibration-access=READ-ONLY, type=ADTSBoolean, init-value=VeCANR_b_APM2_BoostSwitchStsTOValue:0
    VeCANR_b_APM2_ContactorFaultTO: service-kind=ANY-STANDARDIZED, invalidation-policy{data-element=VeCANR_b_APM2_ContactorFaultTO, handle-invalid=DONT-INVALIDATE}  # Time Out
      data VeCANR_b_APM2_ContactorFaultTO: category=VALUE, sw-calibration-access=READ-ONLY, type=ADTSBoolean, init-value=VeCANR_b_APM2_ContactorFaultTOValue:0
    VeCANR_b_APM2_DcChEnaSts_Fdbk: service-kind=ANY-STANDARDIZED, invalidation-policy{data-element=VeCANR_b_APM2_DcChEnaSts_Fdbk, handle-invalid=DONT-INVALIDATE}
      data VeCANR_b_APM2_DcChEnaSts_Fdbk: category=VALUE, sw-calibration-access=READ-ONLY, type=ADTSBoolean, init-value=VeCANR_b_APM2_DcChEnaSts_FdbkValue:0
    VeCANR_b_APM2_DcChEnaSts_FdbkTO: service-kind=ANY-STANDARDIZED, invalidation-policy{data-element=VeCANR_b_APM2_DcChEnaSts_FdbkTO, handle-invalid=DONT-INVALIDATE}  # Time Out
      data VeCANR_b_APM2_DcChEnaSts_FdbkTO: category=VALUE, sw-calibration-access=READ-ONLY, type=ADTSBoolean, init-value=VeCANR_b_APM2_DcChEnaSts_FdbkTOValue:0
    VeCANR_b_APM2_DeratRsnStsTO: service-kind=ANY-STANDARDIZED, invalidation-policy{data-element=VeCANR_b_APM2_DeratRsnStsTO, handle-invalid=DONT-INVALIDATE}  # Time Out
      data VeCANR_b_APM2_DeratRsnStsTO: category=VALUE, sw-calibration-access=READ-ONLY, type=ADTSBoolean, init-value=VeCANR_b_APM2_DeratRsnStsTOValue:0
    VeCANR_b_APM2_DisChargedStsFdbk: service-kind=ANY-STANDARDIZED, invalidation-policy{data-element=VeCANR_b_APM2_DisChargedStsFdbk, handle-invalid=DONT-INVALIDATE}
      data VeCANR_b_APM2_DisChargedStsFdbk: category=VALUE, sw-calibration-access=READ-ONLY, type=ADTSBoolean, init-value=VeCANR_b_APM2_DisChargedStsFdbkValue:0
    VeCANR_b_APM2_DisChargedStsFdbkTO: service-kind=ANY-STANDARDIZED, invalidation-policy{data-element=VeCANR_b_APM2_DisChargedStsFdbkTO, handle-invalid=DONT-INVALIDATE}  # Time Out
      data VeCANR_b_APM2_DisChargedStsFdbkTO: category=VALUE, sw-calibration-access=READ-ONLY, type=ADTSBoolean, init-value=VeCANR_b_APM2_DisChargedStsFdbkTOValue:0
    VeCANR_b_APM2_ErrorWordTO: service-kind=ANY-STANDARDIZED, invalidation-policy{data-element=VeCANR_b_APM2_ErrorWordTO, handle-invalid=DONT-INVALIDATE}  # Time Out
      data VeCANR_b_APM2_ErrorWordTO: category=VALUE, sw-calibration-access=READ-ONLY, type=ADTSBoolean, init-value=VeCANR_b_APM2_ErrorWordTOValue:0
    VeCANR_b_APM2_FaultStsTO: service-kind=ANY-STANDARDIZED, invalidation-policy{data-element=VeCANR_b_APM2_FaultStsTO, handle-invalid=DONT-INVALIDATE}  # Time Out
      data VeCANR_b_APM2_FaultStsTO: category=VALUE, sw-calibration-access=READ-ONLY, type=ADTSBoolean, init-value=VeCANR_b_APM2_FaultStsTOValue:0
    VeCANR_b_APM2_HVChrgBusCurrentTO: service-kind=ANY-STANDARDIZED, invalidation-policy{data-element=VeCANR_b_APM2_HVChrgBusCurrentTO, handle-invalid=DONT-INVALIDATE}  # Time Out
      data VeCANR_b_APM2_HVChrgBusCurrentTO: category=VALUE, sw-calibration-access=READ-ONLY, type=ADTSBoolean, init-value=VeCANR_b_APM2_HVChrgBusCurrentTOValue:0
    VeCANR_b_APM2_HVChrgBusVoltageTO: service-kind=ANY-STANDARDIZED, invalidation-policy{data-element=VeCANR_b_APM2_HVChrgBusVoltageTO, handle-invalid=DONT-INVALIDATE}  # Time Out
      data VeCANR_b_APM2_HVChrgBusVoltageTO: category=VALUE, sw-calibration-access=READ-ONLY, type=ADTSBoolean, init-value=VeCANR_b_APM2_HVChrgBusVoltageTOValue:0
    VeCANR_b_APM2_IInpMaxCnvrTO: service-kind=ANY-STANDARDIZED, invalidation-policy{data-element=VeCANR_b_APM2_IInpMaxCnvrTO, handle-invalid=DONT-INVALIDATE}  # Time Out
      data VeCANR_b_APM2_IInpMaxCnvrTO: category=VALUE, sw-calibration-access=READ-ONLY, type=ADTSBoolean, init-value=VeCANR_b_APM2_IInpMaxCnvrTOValue:0
    VeCANR_b_APM2_K6_WldgDtnStsTO: service-kind=ANY-STANDARDIZED, invalidation-policy{data-element=VeCANR_b_APM2_K6_WldgDtnStsTO, handle-invalid=DONT-INVALIDATE}  # Time Out
      data VeCANR_b_APM2_K6_WldgDtnStsTO: category=VALUE, sw-calibration-access=READ-ONLY, type=ADTSBoolean, init-value=VeCANR_b_APM2_K6_WldgDtnStsTOValue:0
    VeCANR_b_APM2_K7_WldgDtnStsTO: service-kind=ANY-STANDARDIZED, invalidation-policy{data-element=VeCANR_b_APM2_K7_WldgDtnStsTO, handle-invalid=DONT-INVALIDATE}  # Time Out
      data VeCANR_b_APM2_K7_WldgDtnStsTO: category=VALUE, sw-calibration-access=READ-ONLY, type=ADTSBoolean, init-value=VeCANR_b_APM2_K7_WldgDtnStsTOValue:0
    VeCANR_b_APM2_ModeSts_FbkTO: service-kind=ANY-STANDARDIZED, invalidation-policy{data-element=VeCANR_b_APM2_ModeSts_FbkTO, handle-invalid=DONT-INVALIDATE}  # Time Out
      data VeCANR_b_APM2_ModeSts_FbkTO: category=VALUE, sw-calibration-access=READ-ONLY, type=ADTSBoolean, init-value=VeCANR_b_APM2_ModeSts_FbkTOValue:0
    VeCANR_b_APM2_RecoveryActionTO: service-kind=ANY-STANDARDIZED, invalidation-policy{data-element=VeCANR_b_APM2_RecoveryActionTO, handle-invalid=DONT-INVALIDATE}  # Time Out
      data VeCANR_b_APM2_RecoveryActionTO: category=VALUE, sw-calibration-access=READ-ONLY, type=ADTSBoolean, init-value=VeCANR_b_APM2_RecoveryActionTOValue:0
    VeCANR_b_APM2_Service_Lamp_Req: service-kind=ANY-STANDARDIZED, invalidation-policy{data-element=VeCANR_b_APM2_Service_Lamp_Req, handle-invalid=DONT-INVALIDATE}
      data VeCANR_b_APM2_Service_Lamp_Req: category=VALUE, sw-calibration-access=READ-ONLY, type=ADTSBoolean, init-value=VeCANR_b_APM2_Service_Lamp_ReqValue:0
    VeCANR_b_APM2_Service_Lamp_ReqTO: service-kind=ANY-STANDARDIZED, invalidation-policy{data-element=VeCANR_b_APM2_Service_Lamp_ReqTO, handle-invalid=DONT-INVALIDATE}  # Time Out
      data VeCANR_b_APM2_Service_Lamp_ReqTO: category=VALUE, sw-calibration-access=READ-ONLY, type=ADTSBoolean, init-value=VeCANR_b_APM2_Service_Lamp_ReqTOValue:0
    VeCANR_b_APM2_TempFET1TO: service-kind=ANY-STANDARDIZED, invalidation-policy{data-element=VeCANR_b_APM2_TempFET1TO, handle-invalid=DONT-INVALIDATE}  # Time Out
      data VeCANR_b_APM2_TempFET1TO: category=VALUE, sw-calibration-access=READ-ONLY, type=ADTSBoolean, init-value=VeCANR_b_APM2_TempFET1TOValue:0
    VeCANR_b_APM2_TempFET2TO: service-kind=ANY-STANDARDIZED, invalidation-policy{data-element=VeCANR_b_APM2_TempFET2TO, handle-invalid=DONT-INVALIDATE}  # Time Out
      data VeCANR_b_APM2_TempFET2TO: category=VALUE, sw-calibration-access=READ-ONLY, type=ADTSBoolean, init-value=VeCANR_b_APM2_TempFET2TOValue:0
    VeCANR_b_APM2_TempInletTO: service-kind=ANY-STANDARDIZED, invalidation-policy{data-element=VeCANR_b_APM2_TempInletTO, handle-invalid=DONT-INVALIDATE}  # Time Out
      data VeCANR_b_APM2_TempInletTO: category=VALUE, sw-calibration-access=READ-ONLY, type=ADTSBoolean, init-value=VeCANR_b_APM2_TempInletTOValue:0
    VeCANR_b_APM2_TempIntTO: service-kind=ANY-STANDARDIZED, invalidation-policy{data-element=VeCANR_b_APM2_TempIntTO, handle-invalid=DONT-INVALIDATE}  # Time Out
      data VeCANR_b_APM2_TempIntTO: category=VALUE, sw-calibration-access=READ-ONLY, type=ADTSBoolean, init-value=VeCANR_b_APM2_TempIntTOValue:0
    VeCANR_b_APM2_TempL1TO: service-kind=ANY-STANDARDIZED, invalidation-policy{data-element=VeCANR_b_APM2_TempL1TO, handle-invalid=DONT-INVALIDATE}  # Time Out
      data VeCANR_b_APM2_TempL1TO: category=VALUE, sw-calibration-access=READ-ONLY, type=ADTSBoolean, init-value=VeCANR_b_APM2_TempL1TOValue:0
    VeCANR_b_APM2_TempL2TO: service-kind=ANY-STANDARDIZED, invalidation-policy{data-element=VeCANR_b_APM2_TempL2TO, handle-invalid=DONT-INVALIDATE}  # Time Out
      data VeCANR_b_APM2_TempL2TO: category=VALUE, sw-calibration-access=READ-ONLY, type=ADTSBoolean, init-value=VeCANR_b_APM2_TempL2TOValue:0
    VeCANR_b_APM2_TempMarginTO: service-kind=ANY-STANDARDIZED, invalidation-policy{data-element=VeCANR_b_APM2_TempMarginTO, handle-invalid=DONT-INVALIDATE}  # Time Out
      data VeCANR_b_APM2_TempMarginTO: category=VALUE, sw-calibration-access=READ-ONLY, type=ADTSBoolean, init-value=VeCANR_b_APM2_TempMarginTOValue:0
    VeCANR_b_AUD_LVL_TO: service-kind=ANY-STANDARDIZED, invalidation-policy{data-element=VeCANR_b_AUD_LVL_TO, handle-invalid=DONT-INVALIDATE}  # Time Out
      data VeCANR_b_AUD_LVL_TO: category=VALUE, sw-calibration-access=READ-ONLY, type=ADTSBoolean, init-value=VeCANR_b_AUD_LVL_TOValue:0
    VeCANR_b_AllowClimateSchd1TO: service-kind=ANY-STANDARDIZED, invalidation-policy{data-element=VeCANR_b_AllowClimateSchd1TO, handle-invalid=DONT-INVALIDATE}  # Time Out
      data VeCANR_b_AllowClimateSchd1TO: category=VALUE, sw-calibration-access=READ-ONLY, type=ADTSBoolean, init-value=VeCANR_b_AllowClimateSchd1TOValue:0
    VeCANR_b_AllowClimateSchd2TO: service-kind=ANY-STANDARDIZED, invalidation-policy{data-element=VeCANR_b_AllowClimateSchd2TO, handle-invalid=DONT-INVALIDATE}  # Time Out
      data VeCANR_b_AllowClimateSchd2TO: category=VALUE, sw-calibration-access=READ-ONLY, type=ADTSBoolean, init-value=VeCANR_b_AllowClimateSchd2TOValue:0
    VeCANR_b_BMS_HVLoTempThd_FD11TO: service-kind=ANY-STANDARDIZED, invalidation-policy{data-element=VeCANR_b_BMS_HVLoTempThd_FD11TO, handle-invalid=DONT-INVALIDATE}  # Time Out
      data VeCANR_b_BMS_HVLoTempThd_FD11TO: category=VALUE, sw-calibration-access=READ-ONLY, type=ADTSBoolean, init-value=VeCANR_b_BMS_HVLoTempThd_FD11TOValue:0
    VeCANR_b_BMS_HVLoTempThd_FD5TO: service-kind=ANY-STANDARDIZED, invalidation-policy{data-element=VeCANR_b_BMS_HVLoTempThd_FD5TO, handle-invalid=DONT-INVALIDATE}  # Time Out
      data VeCANR_b_BMS_HVLoTempThd_FD5TO: category=VALUE, sw-calibration-access=READ-ONLY, type=ADTSBoolean, init-value=VeCANR_b_BMS_HVLoTempThd_FD5TOValue:0
    VeCANR_b_BMS_HV_HiTempThd_FD11TO: service-kind=ANY-STANDARDIZED, invalidation-policy{data-element=VeCANR_b_BMS_HV_HiTempThd_FD11TO, handle-invalid=DONT-INVALIDATE}  # Time Out
      data VeCANR_b_BMS_HV_HiTempThd_FD11TO: category=VALUE, sw-calibration-access=READ-ONLY, type=ADTSBoolean, init-value=VeCANR_b_BMS_HV_HiTempThd_FD11TOValue:0
    VeCANR_b_BMS_HV_HiTempThd_FD5TO: service-kind=ANY-STANDARDIZED, invalidation-policy{data-element=VeCANR_b_BMS_HV_HiTempThd_FD5TO, handle-invalid=DONT-INVALIDATE}  # Time Out
      data VeCANR_b_BMS_HV_HiTempThd_FD5TO: category=VALUE, sw-calibration-access=READ-ONLY, type=ADTSBoolean, init-value=VeCANR_b_BMS_HV_HiTempThd_FD5TOValue:0
    VeCANR_b_BMS_HV_SOCAcrcyStsFD11TO: service-kind=ANY-STANDARDIZED, invalidation-policy{data-element=VeCANR_b_BMS_HV_SOCAcrcyStsFD11TO, handle-invalid=DONT-INVALIDATE}  # Time Out
      data VeCANR_b_BMS_HV_SOCAcrcyStsFD11TO: category=VALUE, sw-calibration-access=READ-ONLY, type=ADTSBoolean, init-value=VeCANR_b_BMS_HV_SOCAcrcyStsFD11TOValue:0
    VeCANR_b_BMS_HV_SOCAcrcyStsFD5TO: service-kind=ANY-STANDARDIZED, invalidation-policy{data-element=VeCANR_b_BMS_HV_SOCAcrcyStsFD5TO, handle-invalid=DONT-INVALIDATE}  # Time Out
      data VeCANR_b_BMS_HV_SOCAcrcyStsFD5TO: category=VALUE, sw-calibration-access=READ-ONLY, type=ADTSBoolean, init-value=VeCANR_b_BMS_HV_SOCAcrcyStsFD5TOValue:0
    VeCANR_b_BMS_HV_SOC_Max_FD11TO: service-kind=ANY-STANDARDIZED, invalidation-policy{data-element=VeCANR_b_BMS_HV_SOC_Max_FD11TO, handle-invalid=DONT-INVALIDATE}  # Time Out
      data VeCANR_b_BMS_HV_SOC_Max_FD11TO: category=VALUE, sw-calibration-access=READ-ONLY, type=ADTSBoolean, init-value=VeCANR_b_BMS_HV_SOC_Max_FD11TOValue:0
    VeCANR_b_BMS_HV_SOC_Max_FD5TO: service-kind=ANY-STANDARDIZED, invalidation-policy{data-element=VeCANR_b_BMS_HV_SOC_Max_FD5TO, handle-invalid=DONT-INVALIDATE}  # Time Out
      data VeCANR_b_BMS_HV_SOC_Max_FD5TO: category=VALUE, sw-calibration-access=READ-ONLY, type=ADTSBoolean, init-value=VeCANR_b_BMS_HV_SOC_Max_FD5TOValue:0
    VeCANR_b_BMS_HV_SOC_Min_FD11TO: service-kind=ANY-STANDARDIZED, invalidation-policy{data-element=VeCANR_b_BMS_HV_SOC_Min_FD11TO, handle-invalid=DONT-INVALIDATE}  # Time Out
      data VeCANR_b_BMS_HV_SOC_Min_FD11TO: category=VALUE, sw-calibration-access=READ-ONLY, type=ADTSBoolean, init-value=VeCANR_b_BMS_HV_SOC_Min_FD11TOValue:0
    VeCANR_b_BMS_HV_SOC_Min_FD5TO: service-kind=ANY-STANDARDIZED, invalidation-policy{data-element=VeCANR_b_BMS_HV_SOC_Min_FD5TO, handle-invalid=DONT-INVALIDATE}  # Time Out
      data VeCANR_b_BMS_HV_SOC_Min_FD5TO: category=VALUE, sw-calibration-access=READ-ONLY, type=ADTSBoolean, init-value=VeCANR_b_BMS_HV_SOC_Min_FD5TOValue:0
    VeCANR_b_BarPrsAbsTO: service-kind=ANY-STANDARDIZED, invalidation-policy{data-element=VeCANR_b_BarPrsAbsTO, handle-invalid=DONT-INVALIDATE}  # Time Out
      data VeCANR_b_BarPrsAbsTO: category=VALUE, sw-calibration-access=READ-ONLY, type=ADTSBoolean, init-value=VeCANR_b_BarPrsAbsTOValue:0
    VeCANR_b_BarPrsAbsV: service-kind=ANY-STANDARDIZED, invalidation-policy{data-element=VeCANR_b_BarPrsAbsV, handle-invalid=DONT-INVALIDATE}
      data VeCANR_b_BarPrsAbsV: category=VALUE, sw-calibration-access=READ-ONLY, type=ADTSBoolean, init-value=VeCANR_b_BarPrsAbsVValue:0
    VeCANR_b_BarPrsAbsV_TO: service-kind=ANY-STANDARDIZED, invalidation-policy{data-element=VeCANR_b_BarPrsAbsV_TO, handle-invalid=DONT-INVALIDATE}  # Time Out
      data VeCANR_b_BarPrsAbsV_TO: category=VALUE, sw-calibration-access=READ-ONLY, type=ADTSBoolean, init-value=VeCANR_b_BarPrsAbsV_TOValue:0
    VeCANR_b_CLrDiagInfoMCPA_P_FD16: service-kind=ANY-STANDARDIZED, invalidation-policy{data-element=VeCANR_b_CLrDiagInfoMCPA_P_FD16, handle-invalid=DONT-INVALIDATE}
      data VeCANR_b_CLrDiagInfoMCPA_P_FD16: category=VALUE, sw-calibration-access=READ-ONLY, type=ADTSBoolean, init-value=VeCANR_b_CLrDiagInfoMCPA_P_FD16Value:0
    VeCANR_b_CLrDiagInfoMCPA_P_FD16TO: service-kind=ANY-STANDARDIZED, invalidation-policy{data-element=VeCANR_b_CLrDiagInfoMCPA_P_FD16TO, handle-invalid=DONT-INVALIDATE}  # Time Out
      data VeCANR_b_CLrDiagInfoMCPA_P_FD16TO: category=VALUE, sw-calibration-access=READ-ONLY, type=ADTSBoolean, init-value=VeCANR_b_CLrDiagInfoMCPA_P_FD16TOValue:0
    VeCANR_b_CLrDiagInfoMCPB_P_FD16: service-kind=ANY-STANDARDIZED, invalidation-policy{data-element=VeCANR_b_CLrDiagInfoMCPB_P_FD16, handle-invalid=DONT-INVALIDATE}
      data VeCANR_b_CLrDiagInfoMCPB_P_FD16: category=VALUE, sw-calibration-access=READ-ONLY, type=ADTSBoolean, init-value=VeCANR_b_CLrDiagInfoMCPB_P_FD16Value:0
    VeCANR_b_CLrDiagInfoMCPB_P_FD16TO: service-kind=ANY-STANDARDIZED, invalidation-policy{data-element=VeCANR_b_CLrDiagInfoMCPB_P_FD16TO, handle-invalid=DONT-INVALIDATE}  # Time Out
      data VeCANR_b_CLrDiagInfoMCPB_P_FD16TO: category=VALUE, sw-calibration-access=READ-ONLY, type=ADTSBoolean, init-value=VeCANR_b_CLrDiagInfoMCPB_P_FD16TOValue:0
    VeCANR_b_CLrDiagInfoSGCP_P_FD16: service-kind=ANY-STANDARDIZED, invalidation-policy{data-element=VeCANR_b_CLrDiagInfoSGCP_P_FD16, handle-invalid=DONT-INVALIDATE}
      data VeCANR_b_CLrDiagInfoSGCP_P_FD16: category=VALUE, sw-calibration-access=READ-ONLY, type=ADTSBoolean, init-value=VeCANR_b_CLrDiagInfoSGCP_P_FD16Value:0
    VeCANR_b_CLrDiagInfoSGCP_P_FD16TO: service-kind=ANY-STANDARDIZED, invalidation-policy{data-element=VeCANR_b_CLrDiagInfoSGCP_P_FD16TO, handle-invalid=DONT-INVALIDATE}  # Time Out
      data VeCANR_b_CLrDiagInfoSGCP_P_FD16TO: category=VALUE, sw-calibration-access=READ-ONLY, type=ADTSBoolean, init-value=VeCANR_b_CLrDiagInfoSGCP_P_FD16TOValue:0
    VeCANR_b_CLrDiagInfo_MCPA_P_FD5: service-kind=ANY-STANDARDIZED, invalidation-policy{data-element=VeCANR_b_CLrDiagInfo_MCPA_P_FD5, handle-invalid=DONT-INVALIDATE}
      data VeCANR_b_CLrDiagInfo_MCPA_P_FD5: category=VALUE, sw-calibration-access=READ-ONLY, type=ADTSBoolean, init-value=VeCANR_b_CLrDiagInfo_MCPA_P_FD5Value:0
