[part 3 of 3: package /STLASharedInterfaces/IFCOEs/IFPlatform_Can]
AUTOSAR XML (schema 4-3-0)
package /STLASharedInterfaces/IFCOEs/IFPlatform_Can  (continued)
  1752 x sender receiver interface:  (continued)
    VeCANR_b_CLrDiagInfo_MCPA_P_FD5TO: service-kind=ANY-STANDARDIZED, invalidation-policy{data-element=VeCANR_b_CLrDiagInfo_MCPA_P_FD5TO, handle-invalid=DONT-INVALIDATE}  # Time Out
      data VeCANR_b_CLrDiagInfo_MCPA_P_FD5TO: category=VALUE, sw-calibration-access=READ-ONLY, type=ADTSBoolean, init-value=VeCANR_b_CLrDiagInfo_MCPA_P_FD5TOValue:0
    VeCANR_b_CLrDiagInfo_MCPB_P_FD5: service-kind=ANY-STANDARDIZED, invalidation-policy{data-element=VeCANR_b_CLrDiagInfo_MCPB_P_FD5, handle-invalid=DONT-INVALIDATE}
      data VeCANR_b_CLrDiagInfo_MCPB_P_FD5: category=VALUE, sw-calibration-access=READ-ONLY, type=ADTSBoolean, init-value=VeCANR_b_CLrDiagInfo_MCPB_P_FD5Value:0
    VeCANR_b_CLrDiagInfo_MCPB_P_FD5TO: service-kind=ANY-STANDARDIZED, invalidation-policy{data-element=VeCANR_b_CLrDiagInfo_MCPB_P_FD5TO, handle-invalid=DONT-INVALIDATE}  # Time Out
      data VeCANR_b_CLrDiagInfo_MCPB_P_FD5TO: category=VALUE, sw-calibration-access=READ-ONLY, type=ADTSBoolean, init-value=VeCANR_b_CLrDiagInfo_MCPB_P_FD5TOValue:0
    VeCANR_b_CLrDiagInfo_SGCP_P_FD5: service-kind=ANY-STANDARDIZED, invalidation-policy{data-element=VeCANR_b_CLrDiagInfo_SGCP_P_FD5, handle-invalid=DONT-INVALIDATE}
      data VeCANR_b_CLrDiagInfo_SGCP_P_FD5: category=VALUE, sw-calibration-access=READ-ONLY, type=ADTSBoolean, init-value=VeCANR_b_CLrDiagInfo_SGCP_P_FD5Value:0
    VeCANR_b_CLrDiagInfo_SGCP_P_FD5TO: service-kind=ANY-STANDARDIZED, invalidation-policy{data-element=VeCANR_b_CLrDiagInfo_SGCP_P_FD5TO, handle-invalid=DONT-INVALIDATE}  # Time Out
      data VeCANR_b_CLrDiagInfo_SGCP_P_FD5TO: category=VALUE, sw-calibration-access=READ-ONLY, type=ADTSBoolean, init-value=VeCANR_b_CLrDiagInfo_SGCP_P_FD5TOValue:0
    VeCANR_b_CRC_FOTA_MASTER_TO: service-kind=ANY-STANDARDIZED, invalidation-policy{data-element=VeCANR_b_CRC_FOTA_MASTER_TO, handle-invalid=DONT-INVALIDATE}  # Time Out
      data VeCANR_b_CRC_FOTA_MASTER_TO: category=VALUE, sw-calibration-access=READ-ONLY, type=ADTSBoolean, init-value=VeCANR_b_CRC_FOTA_MASTER_TOValue:0
    VeCANR_b_CRC_IDCM_OBD_DTC_TO: service-kind=ANY-STANDARDIZED, invalidation-policy{data-element=VeCANR_b_CRC_IDCM_OBD_DTC_TO, handle-invalid=DONT-INVALIDATE}  # Time Out
      data VeCANR_b_CRC_IDCM_OBD_DTC_TO: category=VALUE, sw-calibration-access=READ-ONLY, type=ADTSBoolean, init-value=VeCANR_b_CRC_IDCM_OBD_DTC_TOValue:0
    VeCANR_b_CRC_MCPA_STATUS_FD16TO: service-kind=ANY-STANDARDIZED, invalidation-policy{data-element=VeCANR_b_CRC_MCPA_STATUS_FD16TO, handle-invalid=DONT-INVALIDATE}  # Time Out
      data VeCANR_b_CRC_MCPA_STATUS_FD16TO: category=VALUE, sw-calibration-access=READ-ONLY, type=ADTSBoolean, init-value=VeCANR_b_CRC_MCPA_STATUS_FD16TOValue:0
    VeCANR_b_CRC_MCPA_STATUS_FD5TO: service-kind=ANY-STANDARDIZED, invalidation-policy{data-element=VeCANR_b_CRC_MCPA_STATUS_FD5TO, handle-invalid=DONT-INVALIDATE}  # Time Out
      data VeCANR_b_CRC_MCPA_STATUS_FD5TO: category=VALUE, sw-calibration-access=READ-ONLY, type=ADTSBoolean, init-value=VeCANR_b_CRC_MCPA_STATUS_FD5TOValue:0
    VeCANR_b_CRC_MCPB_STATUS_FD16TO: service-kind=ANY-STANDARDIZED, invalidation-policy{data-element=VeCANR_b_CRC_MCPB_STATUS_FD16TO, handle-invalid=DONT-INVALIDATE}  # Time Out
      data VeCANR_b_CRC_MCPB_STATUS_FD16TO: category=VALUE, sw-calibration-access=READ-ONLY, type=ADTSBoolean, init-value=VeCANR_b_CRC_MCPB_STATUS_FD16TOValue:0
    VeCANR_b_CRC_MCPB_STATUS_FD5TO: service-kind=ANY-STANDARDIZED, invalidation-policy{data-element=VeCANR_b_CRC_MCPB_STATUS_FD5TO, handle-invalid=DONT-INVALIDATE}  # Time Out
      data VeCANR_b_CRC_MCPB_STATUS_FD5TO: category=VALUE, sw-calibration-access=READ-ONLY, type=ADTSBoolean, init-value=VeCANR_b_CRC_MCPB_STATUS_FD5TOValue:0
    VeCANR_b_CRC_SGCP_STATUS_FD16TO: service-kind=ANY-STANDARDIZED, invalidation-policy{data-element=VeCANR_b_CRC_SGCP_STATUS_FD16TO, handle-invalid=DONT-INVALIDATE}  # Time Out
      data VeCANR_b_CRC_SGCP_STATUS_FD16TO: category=VALUE, sw-calibration-access=READ-ONLY, type=ADTSBoolean, init-value=VeCANR_b_CRC_SGCP_STATUS_FD16TOValue:0
    VeCANR_b_CRC_SGCP_STATUS_FD5TO: service-kind=ANY-STANDARDIZED, invalidation-policy{data-element=VeCANR_b_CRC_SGCP_STATUS_FD5TO, handle-invalid=DONT-INVALIDATE}  # Time Out
      data VeCANR_b_CRC_SGCP_STATUS_FD5TO: category=VALUE, sw-calibration-access=READ-ONLY, type=ADTSBoolean, init-value=VeCANR_b_CRC_SGCP_STATUS_FD5TOValue:0
    VeCANR_b_CarbWarmUp: service-kind=ANY-STANDARDIZED, invalidation-policy{data-element=VeCANR_b_CarbWarmUp, handle-invalid=DONT-INVALIDATE}
      data VeCANR_b_CarbWarmUp: category=VALUE, sw-calibration-access=READ-ONLY, type=ADTSBoolean, init-value=VeCANR_b_CarbWarmUpValue:0
    VeCANR_b_CarbWarmUpTO: service-kind=ANY-STANDARDIZED, invalidation-policy{data-element=VeCANR_b_CarbWarmUpTO, handle-invalid=DONT-INVALIDATE}  # Time Out
      data VeCANR_b_CarbWarmUpTO: category=VALUE, sw-calibration-access=READ-ONLY, type=ADTSBoolean, init-value=VeCANR_b_CarbWarmUpTOValue:0
    VeCANR_b_CdMAvailopcurentEXT_TO: service-kind=ANY-STANDARDIZED, invalidation-policy{data-element=VeCANR_b_CdMAvailopcurentEXT_TO, handle-invalid=DONT-INVALIDATE}  # Time Out
      data VeCANR_b_CdMAvailopcurentEXT_TO: category=VALUE, sw-calibration-access=READ-ONLY, type=ADTSBoolean, init-value=VeCANR_b_CdMAvailopcurentEXT_TOValue:0
    VeCANR_b_CdMChargerconnectlock: service-kind=ANY-STANDARDIZED, invalidation-policy{data-element=VeCANR_b_CdMChargerconnectlock, handle-invalid=DONT-INVALIDATE}
      data VeCANR_b_CdMChargerconnectlock: category=VALUE, sw-calibration-access=READ-ONLY, type=ADTSBoolean, init-value=VeCANR_b_CdMChargerconnectlockValue:0
    VeCANR_b_CdMChargerconnectlockTO: service-kind=ANY-STANDARDIZED, invalidation-policy{data-element=VeCANR_b_CdMChargerconnectlockTO, handle-invalid=DONT-INVALIDATE}  # Time Out
      data VeCANR_b_CdMChargerconnectlockTO: category=VALUE, sw-calibration-access=READ-ONLY, type=ADTSBoolean, init-value=VeCANR_b_CdMChargerconnectlockTOValue:0
    VeCANR_b_CdM_ExtFun_Thres_VoltTO: service-kind=ANY-STANDARDIZED, invalidation-policy{data-element=VeCANR_b_CdM_ExtFun_Thres_VoltTO, handle-invalid=DONT-INVALIDATE}  # Time Out
      data VeCANR_b_CdM_ExtFun_Thres_VoltTO: category=VALUE, sw-calibration-access=READ-ONLY, type=ADTSBoolean, init-value=VeCANR_b_CdM_ExtFun_Thres_VoltTOValue:0
    VeCANR_b_ChargeUntilFull1: service-kind=ANY-STANDARDIZED, invalidation-policy{data-element=VeCANR_b_ChargeUntilFull1, handle-invalid=DONT-INVALIDATE}
      data VeCANR_b_ChargeUntilFull1: category=VALUE, sw-calibration-access=READ-ONLY, type=ADTSBoolean, init-value=VeCANR_b_ChargeUntilFull1Value:0
    VeCANR_b_ChargeUntilFull1TO: service-kind=ANY-STANDARDIZED, invalidation-policy{data-element=VeCANR_b_ChargeUntilFull1TO, handle-invalid=DONT-INVALIDATE}  # Time Out
      data VeCANR_b_ChargeUntilFull1TO: category=VALUE, sw-calibration-access=READ-ONLY, type=ADTSBoolean, init-value=VeCANR_b_ChargeUntilFull1TOValue:0
    VeCANR_b_ChargeUntilFull2: service-kind=ANY-STANDARDIZED, invalidation-policy{data-element=VeCANR_b_ChargeUntilFull2, handle-invalid=DONT-INVALIDATE}
      data VeCANR_b_ChargeUntilFull2: category=VALUE, sw-calibration-access=READ-ONLY, type=ADTSBoolean, init-value=VeCANR_b_ChargeUntilFull2Value:0
    VeCANR_b_ChargeUntilFull2TO: service-kind=ANY-STANDARDIZED, invalidation-policy{data-element=VeCANR_b_ChargeUntilFull2TO, handle-invalid=DONT-INVALIDATE}  # Time Out
      data VeCANR_b_ChargeUntilFull2TO: category=VALUE, sw-calibration-access=READ-ONLY, type=ADTSBoolean, init-value=VeCANR_b_ChargeUntilFull2TOValue:0
    VeCANR_b_Charge_Schedule_Type1TO: service-kind=ANY-STANDARDIZED, invalidation-policy{data-element=VeCANR_b_Charge_Schedule_Type1TO, handle-invalid=DONT-INVALIDATE}  # Time Out
      data VeCANR_b_Charge_Schedule_Type1TO: category=VALUE, sw-calibration-access=READ-ONLY, type=ADTSBoolean, init-value=VeCANR_b_Charge_Schedule_Type1TOValue:0
    VeCANR_b_Charge_Schedule_Type2TO: service-kind=ANY-STANDARDIZED, invalidation-policy{data-element=VeCANR_b_Charge_Schedule_Type2TO, handle-invalid=DONT-INVALIDATE}  # Time Out
      data VeCANR_b_Charge_Schedule_Type2TO: category=VALUE, sw-calibration-access=READ-ONLY, type=ADTSBoolean, init-value=VeCANR_b_Charge_Schedule_Type2TOValue:0
    VeCANR_b_Charging_WHr_FD5TO: service-kind=ANY-STANDARDIZED, invalidation-policy{data-element=VeCANR_b_Charging_WHr_FD5TO, handle-invalid=DONT-INVALIDATE}  # Time Out
      data VeCANR_b_Charging_WHr_FD5TO: category=VALUE, sw-calibration-access=READ-ONLY, type=ADTSBoolean, init-value=VeCANR_b_Charging_WHr_FD5TOValue:0
    VeCANR_b_ChrgFailSts_FD5TO: service-kind=ANY-STANDARDIZED, invalidation-policy{data-element=VeCANR_b_ChrgFailSts_FD5TO, handle-invalid=DONT-INVALIDATE}  # Time Out
      data VeCANR_b_ChrgFailSts_FD5TO: category=VALUE, sw-calibration-access=READ-ONLY, type=ADTSBoolean, init-value=VeCANR_b_ChrgFailSts_FD5TOValue:0
    VeCANR_b_ClimateSchd1_DayTO: service-kind=ANY-STANDARDIZED, invalidation-policy{data-element=VeCANR_b_ClimateSchd1_DayTO, handle-invalid=DONT-INVALIDATE}  # Time Out
      data VeCANR_b_ClimateSchd1_DayTO: category=VALUE, sw-calibration-access=READ-ONLY, type=ADTSBoolean, init-value=VeCANR_b_ClimateSchd1_DayTOValue:0
    VeCANR_b_ClimateSchd1_Dprtr_HrTO: service-kind=ANY-STANDARDIZED, invalidation-policy{data-element=VeCANR_b_ClimateSchd1_Dprtr_HrTO, handle-invalid=DONT-INVALIDATE}  # Time Out
      data VeCANR_b_ClimateSchd1_Dprtr_HrTO: category=VALUE, sw-calibration-access=READ-ONLY, type=ADTSBoolean, init-value=VeCANR_b_ClimateSchd1_Dprtr_HrTOValue:0
    VeCANR_b_ClimateSchd1_Dprtr_MinTO: service-kind=ANY-STANDARDIZED, invalidation-policy{data-element=VeCANR_b_ClimateSchd1_Dprtr_MinTO, handle-invalid=DONT-INVALIDATE}  # Time Out
      data VeCANR_b_ClimateSchd1_Dprtr_MinTO: category=VALUE, sw-calibration-access=READ-ONLY, type=ADTSBoolean, init-value=VeCANR_b_ClimateSchd1_Dprtr_MinTOValue:0
    VeCANR_b_ClimateSchd2_DayTO: service-kind=ANY-STANDARDIZED, invalidation-policy{data-element=VeCANR_b_ClimateSchd2_DayTO, handle-invalid=DONT-INVALIDATE}  # Time Out
      data VeCANR_b_ClimateSchd2_DayTO: category=VALUE, sw-calibration-access=READ-ONLY, type=ADTSBoolean, init-value=VeCANR_b_ClimateSchd2_DayTOValue:0
    VeCANR_b_ClimateSchd2_Dprtr_HrTO: service-kind=ANY-STANDARDIZED, invalidation-policy{data-element=VeCANR_b_ClimateSchd2_Dprtr_HrTO, handle-invalid=DONT-INVALIDATE}  # Time Out
      data VeCANR_b_ClimateSchd2_Dprtr_HrTO: category=VALUE, sw-calibration-access=READ-ONLY, type=ADTSBoolean, init-value=VeCANR_b_ClimateSchd2_Dprtr_HrTOValue:0
    VeCANR_b_ClimateSchd2_Dprtr_MinTO: service-kind=ANY-STANDARDIZED, invalidation-policy{data-element=VeCANR_b_ClimateSchd2_Dprtr_MinTO, handle-invalid=DONT-INVALIDATE}  # Time Out
      data VeCANR_b_ClimateSchd2_Dprtr_MinTO: category=VALUE, sw-calibration-access=READ-ONLY, type=ADTSBoolean, init-value=VeCANR_b_ClimateSchd2_Dprtr_MinTOValue:0
    VeCANR_b_Climate_Cabin_Temp1TO: service-kind=ANY-STANDARDIZED, invalidation-policy{data-element=VeCANR_b_Climate_Cabin_Temp1TO, handle-invalid=DONT-INVALIDATE}  # Time Out
      data VeCANR_b_Climate_Cabin_Temp1TO: category=VALUE, sw-calibration-access=READ-ONLY, type=ADTSBoolean, init-value=VeCANR_b_Climate_Cabin_Temp1TOValue:0
    VeCANR_b_Climate_Cabin_Temp2TO: service-kind=ANY-STANDARDIZED, invalidation-policy{data-element=VeCANR_b_Climate_Cabin_Temp2TO, handle-invalid=DONT-INVALIDATE}  # Time Out
      data VeCANR_b_Climate_Cabin_Temp2TO: category=VALUE, sw-calibration-access=READ-ONLY, type=ADTSBoolean, init-value=VeCANR_b_Climate_Cabin_Temp2TOValue:0
    VeCANR_b_Climate_TBM_CabinTemp1TO: service-kind=ANY-STANDARDIZED, invalidation-policy{data-element=VeCANR_b_Climate_TBM_CabinTemp1TO, handle-invalid=DONT-INVALIDATE}  # Time Out
      data VeCANR_b_Climate_TBM_CabinTemp1TO: category=VALUE, sw-calibration-access=READ-ONLY, type=ADTSBoolean, init-value=VeCANR_b_Climate_TBM_CabinTemp1TOValue:0
    VeCANR_b_Climate_TBM_CabinTemp2TO: service-kind=ANY-STANDARDIZED, invalidation-policy{data-element=VeCANR_b_Climate_TBM_CabinTemp2TO, handle-invalid=DONT-INVALIDATE}  # Time Out
      data VeCANR_b_Climate_TBM_CabinTemp2TO: category=VALUE, sw-calibration-access=READ-ONLY, type=ADTSBoolean, init-value=VeCANR_b_Climate_TBM_CabinTemp2TOValue:0
    VeCANR_b_Command_15StsTO: service-kind=ANY-STANDARDIZED, invalidation-policy{data-element=VeCANR_b_Command_15StsTO, handle-invalid=DONT-INVALIDATE}  # Time Out
      data VeCANR_b_Command_15StsTO: category=VALUE, sw-calibration-access=READ-ONLY, type=ADTSBoolean, init-value=VeCANR_b_Command_15StsTOValue:0
    VeCANR_b_Contract_Certi_PrntFD5: service-kind=ANY-STANDARDIZED, invalidation-policy{data-element=VeCANR_b_Contract_Certi_PrntFD5, handle-invalid=DONT-INVALIDATE}
      data VeCANR_b_Contract_Certi_PrntFD5: category=VALUE, sw-calibration-access=READ-ONLY, type=ADTSBoolean, init-value=VeCANR_b_Contract_Certi_PrntFD5Value:0
    VeCANR_b_Contract_Certi_PrntFD5TO: service-kind=ANY-STANDARDIZED, invalidation-policy{data-element=VeCANR_b_Contract_Certi_PrntFD5TO, handle-invalid=DONT-INVALIDATE}  # Time Out
      data VeCANR_b_Contract_Certi_PrntFD5TO: category=VALUE, sw-calibration-access=READ-ONLY, type=ADTSBoolean, init-value=VeCANR_b_Contract_Certi_PrntFD5TOValue:0
    VeCANR_b_CooperativeVehclLocatn: service-kind=ANY-STANDARDIZED, invalidation-policy{data-element=VeCANR_b_CooperativeVehclLocatn, handle-invalid=DONT-INVALIDATE}
      data VeCANR_b_CooperativeVehclLocatn: category=VALUE, sw-calibration-access=READ-ONLY, type=ADTSBoolean, init-value=VeCANR_b_CooperativeVehclLocatnValue:0
    VeCANR_b_CooperativeVehclLocatnTO: service-kind=ANY-STANDARDIZED, invalidation-policy{data-element=VeCANR_b_CooperativeVehclLocatnTO, handle-invalid=DONT-INVALIDATE}  # Time Out
      data VeCANR_b_CooperativeVehclLocatnTO: category=VALUE, sw-calibration-access=READ-ONLY, type=ADTSBoolean, init-value=VeCANR_b_CooperativeVehclLocatnTOValue:0
    VeCANR_b_CurrEVSE_TO: service-kind=ANY-STANDARDIZED, invalidation-policy{data-element=VeCANR_b_CurrEVSE_TO, handle-invalid=DONT-INVALIDATE}  # Time Out
      data VeCANR_b_CurrEVSE_TO: category=VALUE, sw-calibration-access=READ-ONLY, type=ADTSBoolean, init-value=VeCANR_b_CurrEVSE_TOValue:0
    VeCANR_b_Day1_TLM_TO: service-kind=ANY-STANDARDIZED, invalidation-policy{data-element=VeCANR_b_Day1_TLM_TO, handle-invalid=DONT-INVALIDATE}  # Time Out
      data VeCANR_b_Day1_TLM_TO: category=VALUE, sw-calibration-access=READ-ONLY, type=ADTSBoolean, init-value=VeCANR_b_Day1_TLM_TOValue:0
    VeCANR_b_Day2_TLM_TO: service-kind=ANY-STANDARDIZED, invalidation-policy{data-element=VeCANR_b_Day2_TLM_TO, handle-invalid=DONT-INVALIDATE}  # Time Out
      data VeCANR_b_Day2_TLM_TO: category=VALUE, sw-calibration-access=READ-ONLY, type=ADTSBoolean, init-value=VeCANR_b_Day2_TLM_TOValue:0
    VeCANR_b_Digit_01TO: service-kind=ANY-STANDARDIZED, invalidation-policy{data-element=VeCANR_b_Digit_01TO, handle-invalid=DONT-INVALIDATE}  # Time Out
      data VeCANR_b_Digit_01TO: category=VALUE, sw-calibration-access=READ-ONLY, type=ADTSBoolean, init-value=VeCANR_b_Digit_01TOValue:0
    VeCANR_b_Digit_02TO: service-kind=ANY-STANDARDIZED, invalidation-policy{data-element=VeCANR_b_Digit_02TO, handle-invalid=DONT-INVALIDATE}  # Time Out
      data VeCANR_b_Digit_02TO: category=VALUE, sw-calibration-access=READ-ONLY, type=ADTSBoolean, init-value=VeCANR_b_Digit_02TOValue:0
    VeCANR_b_Digit_03TO: service-kind=ANY-STANDARDIZED, invalidation-policy{data-element=VeCANR_b_Digit_03TO, handle-invalid=DONT-INVALIDATE}  # Time Out
      data VeCANR_b_Digit_03TO: category=VALUE, sw-calibration-access=READ-ONLY, type=ADTSBoolean, init-value=VeCANR_b_Digit_03TOValue:0
    VeCANR_b_Digit_04TO: service-kind=ANY-STANDARDIZED, invalidation-policy{data-element=VeCANR_b_Digit_04TO, handle-invalid=DONT-INVALIDATE}  # Time Out
      data VeCANR_b_Digit_04TO: category=VALUE, sw-calibration-access=READ-ONLY, type=ADTSBoolean, init-value=VeCANR_b_Digit_04TOValue:0
    VeCANR_b_Digit_05TO: service-kind=ANY-STANDARDIZED, invalidation-policy{data-element=VeCANR_b_Digit_05TO, handle-invalid=DONT-INVALIDATE}  # Time Out
      data VeCANR_b_Digit_05TO: category=VALUE, sw-calibration-access=READ-ONLY, type=ADTSBoolean, init-value=VeCANR_b_Digit_05TOValue:0
    VeCANR_b_Digit_06TO: service-kind=ANY-STANDARDIZED, invalidation-policy{data-element=VeCANR_b_Digit_06TO, handle-invalid=DONT-INVALIDATE}  # Time Out
      data VeCANR_b_Digit_06TO: category=VALUE, sw-calibration-access=READ-ONLY, type=ADTSBoolean, init-value=VeCANR_b_Digit_06TOValue:0
    VeCANR_b_Digit_07TO: service-kind=ANY-STANDARDIZED, invalidation-policy{data-element=VeCANR_b_Digit_07TO, handle-invalid=DONT-INVALIDATE}  # Time Out
      data VeCANR_b_Digit_07TO: category=VALUE, sw-calibration-access=READ-ONLY, type=ADTSBoolean, init-value=VeCANR_b_Digit_07TOValue:0
    VeCANR_b_Digit_08TO: service-kind=ANY-STANDARDIZED, invalidation-policy{data-element=VeCANR_b_Digit_08TO, handle-invalid=DONT-INVALIDATE}  # Time Out
      data VeCANR_b_Digit_08TO: category=VALUE, sw-calibration-access=READ-ONLY, type=ADTSBoolean, init-value=VeCANR_b_Digit_08TOValue:0
    VeCANR_b_Digit_09TO: service-kind=ANY-STANDARDIZED, invalidation-policy{data-element=VeCANR_b_Digit_09TO, handle-invalid=DONT-INVALIDATE}  # Time Out
      data VeCANR_b_Digit_09TO: category=VALUE, sw-calibration-access=READ-ONLY, type=ADTSBoolean, init-value=VeCANR_b_Digit_09TOValue:0
    VeCANR_b_Digit_10TO: service-kind=ANY-STANDARDIZED, invalidation-policy{data-element=VeCANR_b_Digit_10TO, handle-invalid=DONT-INVALIDATE}  # Time Out
      data VeCANR_b_Digit_10TO: category=VALUE, sw-calibration-access=READ-ONLY, type=ADTSBoolean, init-value=VeCANR_b_Digit_10TOValue:0
    VeCANR_b_Digit_11TO: service-kind=ANY-STANDARDIZED, invalidation-policy{data-element=VeCANR_b_Digit_11TO, handle-invalid=DONT-INVALIDATE}  # Time Out
      data VeCANR_b_Digit_11TO: category=VALUE, sw-calibration-access=READ-ONLY, type=ADTSBoolean, init-value=VeCANR_b_Digit_11TOValue:0
    VeCANR_b_EVSEBTRyCompatibilty: service-kind=ANY-STANDARDIZED, invalidation-policy{data-element=VeCANR_b_EVSEBTRyCompatibilty, handle-invalid=DONT-INVALIDATE}
      data VeCANR_b_EVSEBTRyCompatibilty: category=VALUE, sw-calibration-access=READ-ONLY, type=ADTSBoolean, init-value=VeCANR_b_EVSEBTRyCompatibiltyValue:0
    VeCANR_b_EVSEBTRyCompatibiltyTO: service-kind=ANY-STANDARDIZED, invalidation-policy{data-element=VeCANR_b_EVSEBTRyCompatibiltyTO, handle-invalid=DONT-INVALIDATE}  # Time Out
      data VeCANR_b_EVSEBTRyCompatibiltyTO: category=VALUE, sw-calibration-access=READ-ONLY, type=ADTSBoolean, init-value=VeCANR_b_EVSEBTRyCompatibiltyTOValue:0
    VeCANR_b_EVSEChargingStmError: service-kind=ANY-STANDARDIZED, invalidation-policy{data-element=VeCANR_b_EVSEChargingStmError, handle-invalid=DONT-INVALIDATE}
      data VeCANR_b_EVSEChargingStmError: category=VALUE, sw-calibration-access=READ-ONLY, type=ADTSBoolean, init-value=VeCANR_b_EVSEChargingStmErrorValue:0
    VeCANR_b_EVSEChargingStmErrorTO: service-kind=ANY-STANDARDIZED, invalidation-policy{data-element=VeCANR_b_EVSEChargingStmErrorTO, handle-invalid=DONT-INVALIDATE}  # Time Out
      data VeCANR_b_EVSEChargingStmErrorTO: category=VALUE, sw-calibration-access=READ-ONLY, type=ADTSBoolean, init-value=VeCANR_b_EVSEChargingStmErrorTOValue:0
    VeCANR_b_EVSEOfdACThreePhasFD5: service-kind=ANY-STANDARDIZED, invalidation-policy{data-element=VeCANR_b_EVSEOfdACThreePhasFD5, handle-invalid=DONT-INVALIDATE}
      data VeCANR_b_EVSEOfdACThreePhasFD5: category=VALUE, sw-calibration-access=READ-ONLY, type=ADTSBoolean, init-value=VeCANR_b_EVSEOfdACThreePhasFD5Value:0
    VeCANR_b_EVSEOfdACThreePhasFD5TO: service-kind=ANY-STANDARDIZED, invalidation-policy{data-element=VeCANR_b_EVSEOfdACThreePhasFD5TO, handle-invalid=DONT-INVALIDATE}  # Time Out
      data VeCANR_b_EVSEOfdACThreePhasFD5TO: category=VALUE, sw-calibration-access=READ-ONLY, type=ADTSBoolean, init-value=VeCANR_b_EVSEOfdACThreePhasFD5TOValue:0
    VeCANR_b_EVSE_CHAdeMOProtocolTO: service-kind=ANY-STANDARDIZED, invalidation-policy{data-element=VeCANR_b_EVSE_CHAdeMOProtocolTO, handle-invalid=DONT-INVALIDATE}  # Time Out
      data VeCANR_b_EVSE_CHAdeMOProtocolTO: category=VALUE, sw-calibration-access=READ-ONLY, type=ADTSBoolean, init-value=VeCANR_b_EVSE_CHAdeMOProtocolTOValue:0
    VeCANR_b_EVSE_EnergizingState: service-kind=ANY-STANDARDIZED, invalidation-policy{data-element=VeCANR_b_EVSE_EnergizingState, handle-invalid=DONT-INVALIDATE}
      data VeCANR_b_EVSE_EnergizingState: category=VALUE, sw-calibration-access=READ-ONLY, type=ADTSBoolean, init-value=VeCANR_b_EVSE_EnergizingStateValue:0
    VeCANR_b_EVSE_EnergizingStateTO: service-kind=ANY-STANDARDIZED, invalidation-policy{data-element=VeCANR_b_EVSE_EnergizingStateTO, handle-invalid=DONT-INVALIDATE}  # Time Out
      data VeCANR_b_EVSE_EnergizingStateTO: category=VALUE, sw-calibration-access=READ-ONLY, type=ADTSBoolean, init-value=VeCANR_b_EVSE_EnergizingStateTOValue:0
    VeCANR_b_EVSE_OfdACSingPhasFD5: service-kind=ANY-STANDARDIZED, invalidation-policy{data-element=VeCANR_b_EVSE_OfdACSingPhasFD5, handle-invalid=DONT-INVALIDATE}
      data VeCANR_b_EVSE_OfdACSingPhasFD5: category=VALUE, sw-calibration-access=READ-ONLY, type=ADTSBoolean, init-value=VeCANR_b_EVSE_OfdACSingPhasFD5Value:0
    VeCANR_b_EVSE_OfdACSingPhasFD5TO: service-kind=ANY-STANDARDIZED, invalidation-policy{data-element=VeCANR_b_EVSE_OfdACSingPhasFD5TO, handle-invalid=DONT-INVALIDATE}  # Time Out
      data VeCANR_b_EVSE_OfdACSingPhasFD5TO: category=VALUE, sw-calibration-access=READ-ONLY, type=ADTSBoolean, init-value=VeCANR_b_EVSE_OfdACSingPhasFD5TOValue:0
    VeCANR_b_EVSE_RemainingMinTO: service-kind=ANY-STANDARDIZED, invalidation-policy{data-element=VeCANR_b_EVSE_RemainingMinTO, handle-invalid=DONT-INVALIDATE}  # Time Out
      data VeCANR_b_EVSE_RemainingMinTO: category=VALUE, sw-calibration-access=READ-ONLY, type=ADTSBoolean, init-value=VeCANR_b_EVSE_RemainingMinTOValue:0
    VeCANR_b_EVSE_RemainingSecTO: service-kind=ANY-STANDARDIZED, invalidation-policy{data-element=VeCANR_b_EVSE_RemainingSecTO, handle-invalid=DONT-INVALIDATE}  # Time Out
      data VeCANR_b_EVSE_RemainingSecTO: category=VALUE, sw-calibration-access=READ-ONLY, type=ADTSBoolean, init-value=VeCANR_b_EVSE_RemainingSecTOValue:0
    VeCANR_b_EVSE_ThrshldVoltageTO: service-kind=ANY-STANDARDIZED, invalidation-policy{data-element=VeCANR_b_EVSE_ThrshldVoltageTO, handle-invalid=DONT-INVALIDATE}  # Time Out
      data VeCANR_b_EVSE_ThrshldVoltageTO: category=VALUE, sw-calibration-access=READ-ONLY, type=ADTSBoolean, init-value=VeCANR_b_EVSE_ThrshldVoltageTOValue:0
    VeCANR_b_Enable_ClimateSchd1: service-kind=ANY-STANDARDIZED, invalidation-policy{data-element=VeCANR_b_Enable_ClimateSchd1, handle-invalid=DONT-INVALIDATE}
      data VeCANR_b_Enable_ClimateSchd1: category=VALUE, sw-calibration-access=READ-ONLY, type=ADTSBoolean, init-value=VeCANR_b_Enable_ClimateSchd1Value:0
    VeCANR_b_Enable_ClimateSchd1TO: service-kind=ANY-STANDARDIZED, invalidation-policy{data-element=VeCANR_b_Enable_ClimateSchd1TO, handle-invalid=DONT-INVALIDATE}  # Time Out
      data VeCANR_b_Enable_ClimateSchd1TO: category=VALUE, sw-calibration-access=READ-ONLY, type=ADTSBoolean, init-value=VeCANR_b_Enable_ClimateSchd1TOValue:0
    VeCANR_b_Enable_ClimateSchd2: service-kind=ANY-STANDARDIZED, invalidation-policy{data-element=VeCANR_b_Enable_ClimateSchd2, handle-invalid=DONT-INVALIDATE}
      data VeCANR_b_Enable_ClimateSchd2: category=VALUE, sw-calibration-access=READ-ONLY, type=ADTSBoolean, init-value=VeCANR_b_Enable_ClimateSchd2Value:0
    VeCANR_b_Enable_ClimateSchd2TO: service-kind=ANY-STANDARDIZED, invalidation-policy{data-element=VeCANR_b_Enable_ClimateSchd2TO, handle-invalid=DONT-INVALIDATE}  # Time Out
      data VeCANR_b_Enable_ClimateSchd2TO: category=VALUE, sw-calibration-access=READ-ONLY, type=ADTSBoolean, init-value=VeCANR_b_Enable_ClimateSchd2TOValue:0
    VeCANR_b_Enable_Schedule1: service-kind=ANY-STANDARDIZED, invalidation-policy{data-element=VeCANR_b_Enable_Schedule1, handle-invalid=DONT-INVALIDATE}
      data VeCANR_b_Enable_Schedule1: category=VALUE, sw-calibration-access=READ-ONLY, type=ADTSBoolean, init-value=VeCANR_b_Enable_Schedule1Value:0
    VeCANR_b_Enable_Schedule1TO: service-kind=ANY-STANDARDIZED, invalidation-policy{data-element=VeCANR_b_Enable_Schedule1TO, handle-invalid=DONT-INVALIDATE}  # Time Out
      data VeCANR_b_Enable_Schedule1TO: category=VALUE, sw-calibration-access=READ-ONLY, type=ADTSBoolean, init-value=VeCANR_b_Enable_Schedule1TOValue:0
    VeCANR_b_Enable_Schedule2: service-kind=ANY-STANDARDIZED, invalidation-policy{data-element=VeCANR_b_Enable_Schedule2, handle-invalid=DONT-INVALIDATE}
      data VeCANR_b_Enable_Schedule2: category=VALUE, sw-calibration-access=READ-ONLY, type=ADTSBoolean, init-value=VeCANR_b_Enable_Schedule2Value:0
    VeCANR_b_Enable_Schedule2TO: service-kind=ANY-STANDARDIZED, invalidation-policy{data-element=VeCANR_b_Enable_Schedule2TO, handle-invalid=DONT-INVALIDATE}  # Time Out
      data VeCANR_b_Enable_Schedule2TO: category=VALUE, sw-calibration-access=READ-ONLY, type=ADTSBoolean, init-value=VeCANR_b_Enable_Schedule2TOValue:0
    VeCANR_b_End_Time_Hr1TO: service-kind=ANY-STANDARDIZED, invalidation-policy{data-element=VeCANR_b_End_Time_Hr1TO, handle-invalid=DONT-INVALIDATE}  # Time Out
      data VeCANR_b_End_Time_Hr1TO: category=VALUE, sw-calibration-access=READ-ONLY, type=ADTSBoolean, init-value=VeCANR_b_End_Time_Hr1TOValue:0
    VeCANR_b_End_Time_Hr2TO: service-kind=ANY-STANDARDIZED, invalidation-policy{data-element=VeCANR_b_End_Time_Hr2TO, handle-invalid=DONT-INVALIDATE}  # Time Out
      data VeCANR_b_End_Time_Hr2TO: category=VALUE, sw-calibration-access=READ-ONLY, type=ADTSBoolean, init-value=VeCANR_b_End_Time_Hr2TOValue:0
    VeCANR_b_End_Time_Min1TO: service-kind=ANY-STANDARDIZED, invalidation-policy{data-element=VeCANR_b_End_Time_Min1TO, handle-invalid=DONT-INVALIDATE}  # Time Out
      data VeCANR_b_End_Time_Min1TO: category=VALUE, sw-calibration-access=READ-ONLY, type=ADTSBoolean, init-value=VeCANR_b_End_Time_Min1TOValue:0
    VeCANR_b_End_Time_Min2TO: service-kind=ANY-STANDARDIZED, invalidation-policy{data-element=VeCANR_b_End_Time_Min2TO, handle-invalid=DONT-INVALIDATE}  # Time Out
      data VeCANR_b_End_Time_Min2TO: category=VALUE, sw-calibration-access=READ-ONLY, type=ADTSBoolean, init-value=VeCANR_b_End_Time_Min2TOValue:0
    VeCANR_b_EngIntAirTmpTO: service-kind=ANY-STANDARDIZED, invalidation-policy{data-element=VeCANR_b_EngIntAirTmpTO, handle-invalid=DONT-INVALIDATE}  # Time Out
      data VeCANR_b_EngIntAirTmpTO: category=VALUE, sw-calibration-access=READ-ONLY, type=ADTSBoolean, init-value=VeCANR_b_EngIntAirTmpTOValue:0
    VeCANR_b_EngIntAirTmpV: service-kind=ANY-STANDARDIZED, invalidation-policy{data-element=VeCANR_b_EngIntAirTmpV, handle-invalid=DONT-INVALIDATE}
      data VeCANR_b_EngIntAirTmpV: category=VALUE, sw-calibration-access=READ-ONLY, type=ADTSBoolean, init-value=VeCANR_b_EngIntAirTmpVValue:0
    VeCANR_b_EngIntAirTmpV_TO: service-kind=ANY-STANDARDIZED, invalidation-policy{data-element=VeCANR_b_EngIntAirTmpV_TO, handle-invalid=DONT-INVALIDATE}  # Time Out
      data VeCANR_b_EngIntAirTmpV_TO: category=VALUE, sw-calibration-access=READ-ONLY, type=ADTSBoolean, init-value=VeCANR_b_EngIntAirTmpV_TOValue:0
    VeCANR_b_EngMaxRPM_W_TO: service-kind=ANY-STANDARDIZED, invalidation-policy{data-element=VeCANR_b_EngMaxRPM_W_TO, handle-invalid=DONT-INVALIDATE}  # Time Out
      data VeCANR_b_EngMaxRPM_W_TO: category=VALUE, sw-calibration-access=READ-ONLY, type=ADTSBoolean, init-value=VeCANR_b_EngMaxRPM_W_TOValue:0
    VeCANR_b_EngineWaterTempTO: service-kind=ANY-STANDARDIZED, invalidation-policy{data-element=VeCANR_b_EngineWaterTempTO, handle-invalid=DONT-INVALIDATE}  # Time Out
      data VeCANR_b_EngineWaterTempTO: category=VALUE, sw-calibration-access=READ-ONLY, type=ADTSBoolean, init-value=VeCANR_b_EngineWaterTempTOValue:0
    VeCANR_b_EstCatCnvTmpTO: service-kind=ANY-STANDARDIZED, invalidation-policy{data-element=VeCANR_b_EstCatCnvTmpTO, handle-invalid=DONT-INVALIDATE}  # Time Out
      data VeCANR_b_EstCatCnvTmpTO: category=VALUE, sw-calibration-access=READ-ONLY, type=ADTSBoolean, init-value=VeCANR_b_EstCatCnvTmpTOValue:0
    VeCANR_b_External_ChargeTarget1TO: service-kind=ANY-STANDARDIZED, invalidation-policy{data-element=VeCANR_b_External_ChargeTarget1TO, handle-invalid=DONT-INVALIDATE}  # Time Out
      data VeCANR_b_External_ChargeTarget1TO: category=VALUE, sw-calibration-access=READ-ONLY, type=ADTSBoolean, init-value=VeCANR_b_External_ChargeTarget1TOValue:0
    VeCANR_b_External_ChargeTarget2TO: service-kind=ANY-STANDARDIZED, invalidation-policy{data-element=VeCANR_b_External_ChargeTarget2TO, handle-invalid=DONT-INVALIDATE}  # Time Out
      data VeCANR_b_External_ChargeTarget2TO: category=VALUE, sw-calibration-access=READ-ONLY, type=ADTSBoolean, init-value=VeCANR_b_External_ChargeTarget2TOValue:0
    VeCANR_b_FOTA_StatusTO: service-kind=ANY-STANDARDIZED, invalidation-policy{data-element=VeCANR_b_FOTA_StatusTO, handle-invalid=DONT-INVALIDATE}  # Time Out
      data VeCANR_b_FOTA_StatusTO: category=VALUE, sw-calibration-access=READ-ONLY, type=ADTSBoolean, init-value=VeCANR_b_FOTA_StatusTOValue:0
    VeCANR_b_GPS_Date_DayTO: service-kind=ANY-STANDARDIZED, invalidation-policy{data-element=VeCANR_b_GPS_Date_DayTO, handle-invalid=DONT-INVALIDATE}  # Time Out
      data VeCANR_b_GPS_Date_DayTO: category=VALUE, sw-calibration-access=READ-ONLY, type=ADTSBoolean, init-value=VeCANR_b_GPS_Date_DayTOValue:0
    VeCANR_b_GPS_Date_MonthTO: service-kind=ANY-STANDARDIZED, invalidation-policy{data-element=VeCANR_b_GPS_Date_MonthTO, handle-invalid=DONT-INVALIDATE}  # Time Out
      data VeCANR_b_GPS_Date_MonthTO: category=VALUE, sw-calibration-access=READ-ONLY, type=ADTSBoolean, init-value=VeCANR_b_GPS_Date_MonthTOValue:0
    VeCANR_b_GPS_Date_YearTO: service-kind=ANY-STANDARDIZED, invalidation-policy{data-element=VeCANR_b_GPS_Date_YearTO, handle-invalid=DONT-INVALIDATE}  # Time Out
      data VeCANR_b_GPS_Date_YearTO: category=VALUE, sw-calibration-access=READ-ONLY, type=ADTSBoolean, init-value=VeCANR_b_GPS_Date_YearTOValue:0
    VeCANR_b_GPS_UTC_HourTO: service-kind=ANY-STANDARDIZED, invalidation-policy{data-element=VeCANR_b_GPS_UTC_HourTO, handle-invalid=DONT-INVALIDATE}  # Time Out
      data VeCANR_b_GPS_UTC_HourTO: category=VALUE, sw-calibration-access=READ-ONLY, type=ADTSBoolean, init-value=VeCANR_b_GPS_UTC_HourTOValue:0
    VeCANR_b_GPS_UTC_MinuteTO: service-kind=ANY-STANDARDIZED, invalidation-policy{data-element=VeCANR_b_GPS_UTC_MinuteTO, handle-invalid=DONT-INVALIDATE}  # Time Out
      data VeCANR_b_GPS_UTC_MinuteTO: category=VALUE, sw-calibration-access=READ-ONLY, type=ADTSBoolean, init-value=VeCANR_b_GPS_UTC_MinuteTOValue:0
    VeCANR_b_GPS_UTC_SecondTO: service-kind=ANY-STANDARDIZED, invalidation-policy{data-element=VeCANR_b_GPS_UTC_SecondTO, handle-invalid=DONT-INVALIDATE}  # Time Out
      data VeCANR_b_GPS_UTC_SecondTO: category=VALUE, sw-calibration-access=READ-ONLY, type=ADTSBoolean, init-value=VeCANR_b_GPS_UTC_SecondTOValue:0
    VeCANR_b_HAS_TelltaleStsTO: service-kind=ANY-STANDARDIZED, invalidation-policy{data-element=VeCANR_b_HAS_TelltaleStsTO, handle-invalid=DONT-INVALIDATE}  # Time Out
      data VeCANR_b_HAS_TelltaleStsTO: category=VALUE, sw-calibration-access=READ-ONLY, type=ADTSBoolean, init-value=VeCANR_b_HAS_TelltaleStsTOValue:0
    VeCANR_b_HEV_OnRq_BPCM_FD11: service-kind=ANY-STANDARDIZED, invalidation-policy{data-element=VeCANR_b_HEV_OnRq_BPCM_FD11, handle-invalid=DONT-INVALIDATE}
      data VeCANR_b_HEV_OnRq_BPCM_FD11: category=VALUE, sw-calibration-access=READ-ONLY, type=ADTSBoolean, init-value=VeCANR_b_HEV_OnRq_BPCM_FD11Value:0
    VeCANR_b_HEV_OnRq_BPCM_FD11TO: service-kind=ANY-STANDARDIZED, invalidation-policy{data-element=VeCANR_b_HEV_OnRq_BPCM_FD11TO, handle-invalid=DONT-INVALIDATE}  # Time Out
      data VeCANR_b_HEV_OnRq_BPCM_FD11TO: category=VALUE, sw-calibration-access=READ-ONLY, type=ADTSBoolean, init-value=VeCANR_b_HEV_OnRq_BPCM_FD11TOValue:0
    VeCANR_b_HEV_OnRq_BPCM_FD5: service-kind=ANY-STANDARDIZED, invalidation-policy{data-element=VeCANR_b_HEV_OnRq_BPCM_FD5, handle-invalid=DONT-INVALIDATE}
      data VeCANR_b_HEV_OnRq_BPCM_FD5: category=VALUE, sw-calibration-access=READ-ONLY, type=ADTSBoolean, init-value=VeCANR_b_HEV_OnRq_BPCM_FD5Value:0
    VeCANR_b_HEV_OnRq_BPCM_FD5TO: service-kind=ANY-STANDARDIZED, invalidation-policy{data-element=VeCANR_b_HEV_OnRq_BPCM_FD5TO, handle-invalid=DONT-INVALIDATE}  # Time Out
      data VeCANR_b_HEV_OnRq_BPCM_FD5TO: category=VALUE, sw-calibration-access=READ-ONLY, type=ADTSBoolean, init-value=VeCANR_b_HEV_OnRq_BPCM_FD5TOValue:0
    VeCANR_b_HVBatCelVoltHiThrsFD11TO: service-kind=ANY-STANDARDIZED, invalidation-policy{data-element=VeCANR_b_HVBatCelVoltHiThrsFD11TO, handle-invalid=DONT-INVALIDATE}  # Time Out
      data VeCANR_b_HVBatCelVoltHiThrsFD11TO: category=VALUE, sw-calibration-access=READ-ONLY, type=ADTSBoolean, init-value=VeCANR_b_HVBatCelVoltHiThrsFD11TOValue:0
    VeCANR_b_HVBatCelVoltHiThrsFD5TO: service-kind=ANY-STANDARDIZED, invalidation-policy{data-element=VeCANR_b_HVBatCelVoltHiThrsFD5TO, handle-invalid=DONT-INVALIDATE}  # Time Out
      data VeCANR_b_HVBatCelVoltHiThrsFD5TO: category=VALUE, sw-calibration-access=READ-ONLY, type=ADTSBoolean, init-value=VeCANR_b_HVBatCelVoltHiThrsFD5TOValue:0
    VeCANR_b_HVBatCelVoltLoThrsFD11TO: service-kind=ANY-STANDARDIZED, invalidation-policy{data-element=VeCANR_b_HVBatCelVoltLoThrsFD11TO, handle-invalid=DONT-INVALIDATE}  # Time Out
      data VeCANR_b_HVBatCelVoltLoThrsFD11TO: category=VALUE, sw-calibration-access=READ-ONLY, type=ADTSBoolean, init-value=VeCANR_b_HVBatCelVoltLoThrsFD11TOValue:0
    VeCANR_b_HVBatCelVoltLoThrsFD5TO: service-kind=ANY-STANDARDIZED, invalidation-policy{data-element=VeCANR_b_HVBatCelVoltLoThrsFD5TO, handle-invalid=DONT-INVALIDATE}  # Time Out
      data VeCANR_b_HVBatCelVoltLoThrsFD5TO: category=VALUE, sw-calibration-access=READ-ONLY, type=ADTSBoolean, init-value=VeCANR_b_HVBatCelVoltLoThrsFD5TOValue:0
    VeCANR_b_HVBatSleepTime_FD11TO: service-kind=ANY-STANDARDIZED, invalidation-policy{data-element=VeCANR_b_HVBatSleepTime_FD11TO, handle-invalid=DONT-INVALIDATE}  # Time Out
      data VeCANR_b_HVBatSleepTime_FD11TO: category=VALUE, sw-calibration-access=READ-ONLY, type=ADTSBoolean, init-value=VeCANR_b_HVBatSleepTime_FD11TOValue:0
    VeCANR_b_HVBatSleepTime_FD5TO: service-kind=ANY-STANDARDIZED, invalidation-policy{data-element=VeCANR_b_HVBatSleepTime_FD5TO, handle-invalid=DONT-INVALIDATE}  # Time Out
      data VeCANR_b_HVBatSleepTime_FD5TO: category=VALUE, sw-calibration-access=READ-ONLY, type=ADTSBoolean, init-value=VeCANR_b_HVBatSleepTime_FD5TOValue:0
    VeCANR_b_HVBattRealTimeClkFD11TO: service-kind=ANY-STANDARDIZED, invalidation-policy{data-element=VeCANR_b_HVBattRealTimeClkFD11TO, handle-invalid=DONT-INVALIDATE}  # Time Out
      data VeCANR_b_HVBattRealTimeClkFD11TO: category=VALUE, sw-calibration-access=READ-ONLY, type=ADTSBoolean, init-value=VeCANR_b_HVBattRealTimeClkFD11TOValue:0
    VeCANR_b_HVBattRealTimeClkVFD11: service-kind=ANY-STANDARDIZED, invalidation-policy{data-element=VeCANR_b_HVBattRealTimeClkVFD11, handle-invalid=DONT-INVALIDATE}
      data VeCANR_b_HVBattRealTimeClkVFD11: category=VALUE, sw-calibration-access=READ-ONLY, type=ADTSBoolean, init-value=VeCANR_b_HVBattRealTimeClkVFD11Value:0
    VeCANR_b_HVBattRealTimeClkVFD11TO: service-kind=ANY-STANDARDIZED, invalidation-policy{data-element=VeCANR_b_HVBattRealTimeClkVFD11TO, handle-invalid=DONT-INVALIDATE}  # Time Out
      data VeCANR_b_HVBattRealTimeClkVFD11TO: category=VALUE, sw-calibration-access=READ-ONLY, type=ADTSBoolean, init-value=VeCANR_b_HVBattRealTimeClkVFD11TOValue:0
    VeCANR_b_HVBatteryMILReq_FD11: service-kind=ANY-STANDARDIZED, invalidation-policy{data-element=VeCANR_b_HVBatteryMILReq_FD11, handle-invalid=DONT-INVALIDATE}
      data VeCANR_b_HVBatteryMILReq_FD11: category=VALUE, sw-calibration-access=READ-ONLY, type=ADTSBoolean, init-value=VeCANR_b_HVBatteryMILReq_FD11Value:0
    VeCANR_b_HVBatteryMILReq_FD11TO: service-kind=ANY-STANDARDIZED, invalidation-policy{data-element=VeCANR_b_HVBatteryMILReq_FD11TO, handle-invalid=DONT-INVALIDATE}  # Time Out
      data VeCANR_b_HVBatteryMILReq_FD11TO: category=VALUE, sw-calibration-access=READ-ONLY, type=ADTSBoolean, init-value=VeCANR_b_HVBatteryMILReq_FD11TOValue:0
    VeCANR_b_Hour1_TLM_TO: service-kind=ANY-STANDARDIZED, invalidation-policy{data-element=VeCANR_b_Hour1_TLM_TO, handle-invalid=DONT-INVALIDATE}  # Time Out
      data VeCANR_b_Hour1_TLM_TO: category=VALUE, sw-calibration-access=READ-ONLY, type=ADTSBoolean, init-value=VeCANR_b_Hour1_TLM_TOValue:0
    VeCANR_b_Hour2_TLM_TO: service-kind=ANY-STANDARDIZED, invalidation-policy{data-element=VeCANR_b_Hour2_TLM_TO, handle-invalid=DONT-INVALIDATE}  # Time Out
      data VeCANR_b_Hour2_TLM_TO: category=VALUE, sw-calibration-access=READ-ONLY, type=ADTSBoolean, init-value=VeCANR_b_Hour2_TLM_TOValue:0
    VeCANR_b_IDCM_CAL_ID_TO: service-kind=ANY-STANDARDIZED, invalidation-policy{data-element=VeCANR_b_IDCM_CAL_ID_TO, handle-invalid=DONT-INVALIDATE}  # Time Out
      data VeCANR_b_IDCM_CAL_ID_TO: category=VALUE, sw-calibration-access=READ-ONLY, type=ADTSBoolean, init-value=VeCANR_b_IDCM_CAL_ID_TOValue:0
    VeCANR_b_IDCM_CAL_VN_TO: service-kind=ANY-STANDARDIZED, invalidation-policy{data-element=VeCANR_b_IDCM_CAL_VN_TO, handle-invalid=DONT-INVALIDATE}  # Time Out
      data VeCANR_b_IDCM_CAL_VN_TO: category=VALUE, sw-calibration-access=READ-ONLY, type=ADTSBoolean, init-value=VeCANR_b_IDCM_CAL_VN_TOValue:0
    VeCANR_b_IDCM_DTC_Idx1TO: service-kind=ANY-STANDARDIZED, invalidation-policy{data-element=VeCANR_b_IDCM_DTC_Idx1TO, handle-invalid=DONT-INVALIDATE}  # Time Out
      data VeCANR_b_IDCM_DTC_Idx1TO: category=VALUE, sw-calibration-access=READ-ONLY, type=ADTSBoolean, init-value=VeCANR_b_IDCM_DTC_Idx1TOValue:0
    VeCANR_b_IDCM_DTC_Idx2TO: service-kind=ANY-STANDARDIZED, invalidation-policy{data-element=VeCANR_b_IDCM_DTC_Idx2TO, handle-invalid=DONT-INVALIDATE}  # Time Out
      data VeCANR_b_IDCM_DTC_Idx2TO: category=VALUE, sw-calibration-access=READ-ONLY, type=ADTSBoolean, init-value=VeCANR_b_IDCM_DTC_Idx2TOValue:0
    VeCANR_b_IDCM_DTC_Idx3TO: service-kind=ANY-STANDARDIZED, invalidation-policy{data-element=VeCANR_b_IDCM_DTC_Idx3TO, handle-invalid=DONT-INVALIDATE}  # Time Out
      data VeCANR_b_IDCM_DTC_Idx3TO: category=VALUE, sw-calibration-access=READ-ONLY, type=ADTSBoolean, init-value=VeCANR_b_IDCM_DTC_Idx3TOValue:0
    VeCANR_b_IDCM_DTC_Idx4TO: service-kind=ANY-STANDARDIZED, invalidation-policy{data-element=VeCANR_b_IDCM_DTC_Idx4TO, handle-invalid=DONT-INVALIDATE}  # Time Out
      data VeCANR_b_IDCM_DTC_Idx4TO: category=VALUE, sw-calibration-access=READ-ONLY, type=ADTSBoolean, init-value=VeCANR_b_IDCM_DTC_Idx4TOValue:0
    VeCANR_b_IDCM_DTC_Idx5TO: service-kind=ANY-STANDARDIZED, invalidation-policy{data-element=VeCANR_b_IDCM_DTC_Idx5TO, handle-invalid=DONT-INVALIDATE}  # Time Out
      data VeCANR_b_IDCM_DTC_Idx5TO: category=VALUE, sw-calibration-access=READ-ONLY, type=ADTSBoolean, init-value=VeCANR_b_IDCM_DTC_Idx5TOValue:0
    VeCANR_b_IDCM_DTC_Idx6TO: service-kind=ANY-STANDARDIZED, invalidation-policy{data-element=VeCANR_b_IDCM_DTC_Idx6TO, handle-invalid=DONT-INVALIDATE}  # Time Out
      data VeCANR_b_IDCM_DTC_Idx6TO: category=VALUE, sw-calibration-access=READ-ONLY, type=ADTSBoolean, init-value=VeCANR_b_IDCM_DTC_Idx6TOValue:0
    VeCANR_b_IDCM_DTC_Idx7TO: service-kind=ANY-STANDARDIZED, invalidation-policy{data-element=VeCANR_b_IDCM_DTC_Idx7TO, handle-invalid=DONT-INVALIDATE}  # Time Out
      data VeCANR_b_IDCM_DTC_Idx7TO: category=VALUE, sw-calibration-access=READ-ONLY, type=ADTSBoolean, init-value=VeCANR_b_IDCM_DTC_Idx7TOValue:0
    VeCANR_b_IDCM_DTC_Idx8TO: service-kind=ANY-STANDARDIZED, invalidation-policy{data-element=VeCANR_b_IDCM_DTC_Idx8TO, handle-invalid=DONT-INVALIDATE}  # Time Out
      data VeCANR_b_IDCM_DTC_Idx8TO: category=VALUE, sw-calibration-access=READ-ONLY, type=ADTSBoolean, init-value=VeCANR_b_IDCM_DTC_Idx8TOValue:0
    VeCANR_b_IDCM_DTC_Stat1TO: service-kind=ANY-STANDARDIZED, invalidation-policy{data-element=VeCANR_b_IDCM_DTC_Stat1TO, handle-invalid=DONT-INVALIDATE}  # Time Out
      data VeCANR_b_IDCM_DTC_Stat1TO: category=VALUE, sw-calibration-access=READ-ONLY, type=ADTSBoolean, init-value=VeCANR_b_IDCM_DTC_Stat1TOValue:0
    VeCANR_b_IDCM_DTC_Stat2TO: service-kind=ANY-STANDARDIZED, invalidation-policy{data-element=VeCANR_b_IDCM_DTC_Stat2TO, handle-invalid=DONT-INVALIDATE}  # Time Out
      data VeCANR_b_IDCM_DTC_Stat2TO: category=VALUE, sw-calibration-access=READ-ONLY, type=ADTSBoolean, init-value=VeCANR_b_IDCM_DTC_Stat2TOValue:0
    VeCANR_b_IDCM_DTC_Stat3TO: service-kind=ANY-STANDARDIZED, invalidation-policy{data-element=VeCANR_b_IDCM_DTC_Stat3TO, handle-invalid=DONT-INVALIDATE}  # Time Out
      data VeCANR_b_IDCM_DTC_Stat3TO: category=VALUE, sw-calibration-access=READ-ONLY, type=ADTSBoolean, init-value=VeCANR_b_IDCM_DTC_Stat3TOValue:0
    VeCANR_b_IDCM_DTC_Stat4TO: service-kind=ANY-STANDARDIZED, invalidation-policy{data-element=VeCANR_b_IDCM_DTC_Stat4TO, handle-invalid=DONT-INVALIDATE}  # Time Out
      data VeCANR_b_IDCM_DTC_Stat4TO: category=VALUE, sw-calibration-access=READ-ONLY, type=ADTSBoolean, init-value=VeCANR_b_IDCM_DTC_Stat4TOValue:0
    VeCANR_b_IDCM_DTC_Stat5TO: service-kind=ANY-STANDARDIZED, invalidation-policy{data-element=VeCANR_b_IDCM_DTC_Stat5TO, handle-invalid=DONT-INVALIDATE}  # Time Out
      data VeCANR_b_IDCM_DTC_Stat5TO: category=VALUE, sw-calibration-access=READ-ONLY, type=ADTSBoolean, init-value=VeCANR_b_IDCM_DTC_Stat5TOValue:0
    VeCANR_b_IDCM_DTC_Stat6TO: service-kind=ANY-STANDARDIZED, invalidation-policy{data-element=VeCANR_b_IDCM_DTC_Stat6TO, handle-invalid=DONT-INVALIDATE}  # Time Out
      data VeCANR_b_IDCM_DTC_Stat6TO: category=VALUE, sw-calibration-access=READ-ONLY, type=ADTSBoolean, init-value=VeCANR_b_IDCM_DTC_Stat6TOValue:0
    VeCANR_b_IDCM_DTC_Stat7TO: service-kind=ANY-STANDARDIZED, invalidation-policy{data-element=VeCANR_b_IDCM_DTC_Stat7TO, handle-invalid=DONT-INVALIDATE}  # Time Out
      data VeCANR_b_IDCM_DTC_Stat7TO: category=VALUE, sw-calibration-access=READ-ONLY, type=ADTSBoolean, init-value=VeCANR_b_IDCM_DTC_Stat7TOValue:0
    VeCANR_b_IDCM_DTC_Stat8TO: service-kind=ANY-STANDARDIZED, invalidation-policy{data-element=VeCANR_b_IDCM_DTC_Stat8TO, handle-invalid=DONT-INVALIDATE}  # Time Out
      data VeCANR_b_IDCM_DTC_Stat8TO: category=VALUE, sw-calibration-access=READ-ONLY, type=ADTSBoolean, init-value=VeCANR_b_IDCM_DTC_Stat8TOValue:0
    VeCANR_b_IDCM_RBM_IdxTO: service-kind=ANY-STANDARDIZED, invalidation-policy{data-element=VeCANR_b_IDCM_RBM_IdxTO, handle-invalid=DONT-INVALIDATE}  # Time Out
      data VeCANR_b_IDCM_RBM_IdxTO: category=VALUE, sw-calibration-access=READ-ONLY, type=ADTSBoolean, init-value=VeCANR_b_IDCM_RBM_IdxTOValue:0
    VeCANR_b_IDCM_RBM_StatTO: service-kind=ANY-STANDARDIZED, invalidation-policy{data-element=VeCANR_b_IDCM_RBM_StatTO, handle-invalid=DONT-INVALIDATE}  # Time Out
      data VeCANR_b_IDCM_RBM_StatTO: category=VALUE, sw-calibration-access=READ-ONLY, type=ADTSBoolean, init-value=VeCANR_b_IDCM_RBM_StatTOValue:0
    VeCANR_b_IDCM_Wakeup_HCP_FD11: service-kind=ANY-STANDARDIZED, invalidation-policy{data-element=VeCANR_b_IDCM_Wakeup_HCP_FD11, handle-invalid=DONT-INVALIDATE}
      data VeCANR_b_IDCM_Wakeup_HCP_FD11: category=VALUE, sw-calibration-access=READ-ONLY, type=ADTSBoolean, init-value=VeCANR_b_IDCM_Wakeup_HCP_FD11Value:0
    VeCANR_b_IDCM_Wakeup_HCP_FD11TO: service-kind=ANY-STANDARDIZED, invalidation-policy{data-element=VeCANR_b_IDCM_Wakeup_HCP_FD11TO, handle-invalid=DONT-INVALIDATE}  # Time Out
      data VeCANR_b_IDCM_Wakeup_HCP_FD11TO: category=VALUE, sw-calibration-access=READ-ONLY, type=ADTSBoolean, init-value=VeCANR_b_IDCM_Wakeup_HCP_FD11TOValue:0
    VeCANR_b_ITBM_TrlrStatTO: service-kind=ANY-STANDARDIZED, invalidation-policy{data-element=VeCANR_b_ITBM_TrlrStatTO, handle-invalid=DONT-INVALIDATE}  # Time Out
      data VeCANR_b_ITBM_TrlrStatTO: category=VALUE, sw-calibration-access=READ-ONLY, type=ADTSBoolean, init-value=VeCANR_b_ITBM_TrlrStatTOValue:0
    VeCANR_b_ImmediateChargeTarget1TO: service-kind=ANY-STANDARDIZED, invalidation-policy{data-element=VeCANR_b_ImmediateChargeTarget1TO, handle-invalid=DONT-INVALIDATE}  # Time Out
      data VeCANR_b_ImmediateChargeTarget1TO: category=VALUE, sw-calibration-access=READ-ONLY, type=ADTSBoolean, init-value=VeCANR_b_ImmediateChargeTarget1TOValue:0
    VeCANR_b_ImmediateChargeTarget2TO: service-kind=ANY-STANDARDIZED, invalidation-policy{data-element=VeCANR_b_ImmediateChargeTarget2TO, handle-invalid=DONT-INVALIDATE}  # Time Out
      data VeCANR_b_ImmediateChargeTarget2TO: category=VALUE, sw-calibration-access=READ-ONLY, type=ADTSBoolean, init-value=VeCANR_b_ImmediateChargeTarget2TOValue:0
    VeCANR_b_ImpactHardwireV_FD11: service-kind=ANY-STANDARDIZED, invalidation-policy{data-element=VeCANR_b_ImpactHardwireV_FD11, handle-invalid=DONT-INVALIDATE}
      data VeCANR_b_ImpactHardwireV_FD11: category=VALUE, sw-calibration-access=READ-ONLY, type=ADTSBoolean, init-value=VeCANR_b_ImpactHardwireV_FD11Value:0
    VeCANR_b_ImpactHardwireV_FD11TO: service-kind=ANY-STANDARDIZED, invalidation-policy{data-element=VeCANR_b_ImpactHardwireV_FD11TO, handle-invalid=DONT-INVALIDATE}  # Time Out
      data VeCANR_b_ImpactHardwireV_FD11TO: category=VALUE, sw-calibration-access=READ-ONLY, type=ADTSBoolean, init-value=VeCANR_b_ImpactHardwireV_FD11TOValue:0
    VeCANR_b_ImpactHardwireV_FD5: service-kind=ANY-STANDARDIZED, invalidation-policy{data-element=VeCANR_b_ImpactHardwireV_FD5, handle-invalid=DONT-INVALIDATE}
      data VeCANR_b_ImpactHardwireV_FD5: category=VALUE, sw-calibration-access=READ-ONLY, type=ADTSBoolean, init-value=VeCANR_b_ImpactHardwireV_FD5Value:0
    VeCANR_b_ImpactHardwireV_FD5TO: service-kind=ANY-STANDARDIZED, invalidation-policy{data-element=VeCANR_b_ImpactHardwireV_FD5TO, handle-invalid=DONT-INVALIDATE}  # Time Out
      data VeCANR_b_ImpactHardwireV_FD5TO: category=VALUE, sw-calibration-access=READ-ONLY, type=ADTSBoolean, init-value=VeCANR_b_ImpactHardwireV_FD5TOValue:0
    VeCANR_b_ImpactHardwire_FD11: service-kind=ANY-STANDARDIZED, invalidation-policy{data-element=VeCANR_b_ImpactHardwire_FD11, handle-invalid=DONT-INVALIDATE}
      data VeCANR_b_ImpactHardwire_FD11: category=VALUE, sw-calibration-access=READ-ONLY, type=ADTSBoolean, init-value=VeCANR_b_ImpactHardwire_FD11Value:0
    VeCANR_b_ImpactHardwire_FD11TO: service-kind=ANY-STANDARDIZED, invalidation-policy{data-element=VeCANR_b_ImpactHardwire_FD11TO, handle-invalid=DONT-INVALIDATE}  # Time Out
      data VeCANR_b_ImpactHardwire_FD11TO: category=VALUE, sw-calibration-access=READ-ONLY, type=ADTSBoolean, init-value=VeCANR_b_ImpactHardwire_FD11TOValue:0
    VeCANR_b_ImpactHardwire_FD5: service-kind=ANY-STANDARDIZED, invalidation-policy{data-element=VeCANR_b_ImpactHardwire_FD5, handle-invalid=DONT-INVALIDATE}
      data VeCANR_b_ImpactHardwire_FD5: category=VALUE, sw-calibration-access=READ-ONLY, type=ADTSBoolean, init-value=VeCANR_b_ImpactHardwire_FD5Value:0
    VeCANR_b_ImpactHardwire_FD5TO: service-kind=ANY-STANDARDIZED, invalidation-policy{data-element=VeCANR_b_ImpactHardwire_FD5TO, handle-invalid=DONT-INVALIDATE}  # Time Out
      data VeCANR_b_ImpactHardwire_FD5TO: category=VALUE, sw-calibration-access=READ-ONLY, type=ADTSBoolean, init-value=VeCANR_b_ImpactHardwire_FD5TOValue:0
    VeCANR_b_LgsDiagCldStrtCndFltPr: service-kind=ANY-STANDARDIZED, invalidation-policy{data-element=VeCANR_b_LgsDiagCldStrtCndFltPr, handle-invalid=DONT-INVALIDATE}
      data VeCANR_b_LgsDiagCldStrtCndFltPr: category=VALUE, sw-calibration-access=READ-ONLY, type=ADTSBoolean, init-value=VeCANR_b_LgsDiagCldStrtCndFltPrValue:0
    VeCANR_b_LgsDiagCldStrtCndFltPrTO: service-kind=ANY-STANDARDIZED, invalidation-policy{data-element=VeCANR_b_LgsDiagCldStrtCndFltPrTO, handle-invalid=DONT-INVALIDATE}  # Time Out
      data VeCANR_b_LgsDiagCldStrtCndFltPrTO: category=VALUE, sw-calibration-access=READ-ONLY, type=ADTSBoolean, init-value=VeCANR_b_LgsDiagCldStrtCndFltPrTOValue:0
    VeCANR_b_LgsDiagCldStrtCndMet: service-kind=ANY-STANDARDIZED, invalidation-policy{data-element=VeCANR_b_LgsDiagCldStrtCndMet, handle-invalid=DONT-INVALIDATE}
      data VeCANR_b_LgsDiagCldStrtCndMet: category=VALUE, sw-calibration-access=READ-ONLY, type=ADTSBoolean, init-value=VeCANR_b_LgsDiagCldStrtCndMetValue:0
    VeCANR_b_LgsDiagCldStrtCndMetTO: service-kind=ANY-STANDARDIZED, invalidation-policy{data-element=VeCANR_b_LgsDiagCldStrtCndMetTO, handle-invalid=DONT-INVALIDATE}  # Time Out
      data VeCANR_b_LgsDiagCldStrtCndMetTO: category=VALUE, sw-calibration-access=READ-ONLY, type=ADTSBoolean, init-value=VeCANR_b_LgsDiagCldStrtCndMetTOValue:0
    VeCANR_b_MCIDCMOBDDTC_TO: service-kind=ANY-STANDARDIZED, invalidation-policy{data-element=VeCANR_b_MCIDCMOBDDTC_TO, handle-invalid=DONT-INVALIDATE}  # Time Out
      data VeCANR_b_MCIDCMOBDDTC_TO: category=VALUE, sw-calibration-access=READ-ONLY, type=ADTSBoolean, init-value=VeCANR_b_MCIDCMOBDDTC_TOValue:0
    VeCANR_b_MCPACtrlBoarTempP_FD16TO: service-kind=ANY-STANDARDIZED, invalidation-policy{data-element=VeCANR_b_MCPACtrlBoarTempP_FD16TO, handle-invalid=DONT-INVALIDATE}  # Time Out
      data VeCANR_b_MCPACtrlBoarTempP_FD16TO: category=VALUE, sw-calibration-access=READ-ONLY, type=ADTSBoolean, init-value=VeCANR_b_MCPACtrlBoarTempP_FD16TOValue:0
    VeCANR_b_MCPACtrlBoardTempP_FD5TO: service-kind=ANY-STANDARDIZED, invalidation-policy{data-element=VeCANR_b_MCPACtrlBoardTempP_FD5TO, handle-invalid=DONT-INVALIDATE}  # Time Out
      data VeCANR_b_MCPACtrlBoardTempP_FD5TO: category=VALUE, sw-calibration-access=READ-ONLY, type=ADTSBoolean, init-value=VeCANR_b_MCPACtrlBoardTempP_FD5TOValue:0
    VeCANR_b_MCPAPIMDCSdBusTempPFD5TO: service-kind=ANY-STANDARDIZED, invalidation-policy{data-element=VeCANR_b_MCPAPIMDCSdBusTempPFD5TO, handle-invalid=DONT-INVALIDATE}  # Time Out
      data VeCANR_b_MCPAPIMDCSdBusTempPFD5TO: category=VALUE, sw-calibration-access=READ-ONLY, type=ADTSBoolean, init-value=VeCANR_b_MCPAPIMDCSdBusTempPFD5TOValue:0
    VeCANR_b_MCPAPIMDCSdBusTmpPFD16TO: service-kind=ANY-STANDARDIZED, invalidation-policy{data-element=VeCANR_b_MCPAPIMDCSdBusTmpPFD16TO, handle-invalid=DONT-INVALIDATE}  # Time Out
      data VeCANR_b_MCPAPIMDCSdBusTmpPFD16TO: category=VALUE, sw-calibration-access=READ-ONLY, type=ADTSBoolean, init-value=VeCANR_b_MCPAPIMDCSdBusTmpPFD16TOValue:0
    VeCANR_b_MCPARotorTemp_P_FD16TO: service-kind=ANY-STANDARDIZED, invalidation-policy{data-element=VeCANR_b_MCPARotorTemp_P_FD16TO, handle-invalid=DONT-INVALIDATE}  # Time Out
      data VeCANR_b_MCPARotorTemp_P_FD16TO: category=VALUE, sw-calibration-access=READ-ONLY, type=ADTSBoolean, init-value=VeCANR_b_MCPARotorTemp_P_FD16TOValue:0
    VeCANR_b_MCPARotorTemp_P_FD5TO: service-kind=ANY-STANDARDIZED, invalidation-policy{data-element=VeCANR_b_MCPARotorTemp_P_FD5TO, handle-invalid=DONT-INVALIDATE}  # Time Out
      data VeCANR_b_MCPARotorTemp_P_FD5TO: category=VALUE, sw-calibration-access=READ-ONLY, type=ADTSBoolean, init-value=VeCANR_b_MCPARotorTemp_P_FD5TOValue:0
    VeCANR_b_MCPAServLampReq_P_FD16: service-kind=ANY-STANDARDIZED, invalidation-policy{data-element=VeCANR_b_MCPAServLampReq_P_FD16, handle-invalid=DONT-INVALIDATE}
      data VeCANR_b_MCPAServLampReq_P_FD16: category=VALUE, sw-calibration-access=READ-ONLY, type=ADTSBoolean, init-value=VeCANR_b_MCPAServLampReq_P_FD16Value:0
    VeCANR_b_MCPAServLampReq_P_FD16TO: service-kind=ANY-STANDARDIZED, invalidation-policy{data-element=VeCANR_b_MCPAServLampReq_P_FD16TO, handle-invalid=DONT-INVALIDATE}  # Time Out
      data VeCANR_b_MCPAServLampReq_P_FD16TO: category=VALUE, sw-calibration-access=READ-ONLY, type=ADTSBoolean, init-value=VeCANR_b_MCPAServLampReq_P_FD16TOValue:0
    VeCANR_b_MCPAServLampReq_P_FD5: service-kind=ANY-STANDARDIZED, invalidation-policy{data-element=VeCANR_b_MCPAServLampReq_P_FD5, handle-invalid=DONT-INVALIDATE}
      data VeCANR_b_MCPAServLampReq_P_FD5: category=VALUE, sw-calibration-access=READ-ONLY, type=ADTSBoolean, init-value=VeCANR_b_MCPAServLampReq_P_FD5Value:0
    VeCANR_b_MCPAServLampReq_P_FD5TO: service-kind=ANY-STANDARDIZED, invalidation-policy{data-element=VeCANR_b_MCPAServLampReq_P_FD5TO, handle-invalid=DONT-INVALIDATE}  # Time Out
      data VeCANR_b_MCPAServLampReq_P_FD5TO: category=VALUE, sw-calibration-access=READ-ONLY, type=ADTSBoolean, init-value=VeCANR_b_MCPAServLampReq_P_FD5TOValue:0
    VeCANR_b_MCPA_ClantTmp_P_FD16TO: service-kind=ANY-STANDARDIZED, invalidation-policy{data-element=VeCANR_b_MCPA_ClantTmp_P_FD16TO, handle-invalid=DONT-INVALIDATE}  # Time Out
      data VeCANR_b_MCPA_ClantTmp_P_FD16TO: category=VALUE, sw-calibration-access=READ-ONLY, type=ADTSBoolean, init-value=VeCANR_b_MCPA_ClantTmp_P_FD16TOValue:0
    VeCANR_b_MCPA_CoolntTmp_P_FD5TO: service-kind=ANY-STANDARDIZED, invalidation-policy{data-element=VeCANR_b_MCPA_CoolntTmp_P_FD5TO, handle-invalid=DONT-INVALIDATE}  # Time Out
      data VeCANR_b_MCPA_CoolntTmp_P_FD5TO: category=VALUE, sw-calibration-access=READ-ONLY, type=ADTSBoolean, init-value=VeCANR_b_MCPA_CoolntTmp_P_FD5TOValue:0
    VeCANR_b_MCPA_DC_Crrent_V_P_FD5: service-kind=ANY-STANDARDIZED, invalidation-policy{data-element=VeCANR_b_MCPA_DC_Crrent_V_P_FD5, handle-invalid=DONT-INVALIDATE}
      data VeCANR_b_MCPA_DC_Crrent_V_P_FD5: category=VALUE, sw-calibration-access=READ-ONLY, type=ADTSBoolean, init-value=VeCANR_b_MCPA_DC_Crrent_V_P_FD5Value:0
    VeCANR_b_MCPA_DC_Crrent_V_P_FD5TO: service-kind=ANY-STANDARDIZED, invalidation-policy{data-element=VeCANR_b_MCPA_DC_Crrent_V_P_FD5TO, handle-invalid=DONT-INVALIDATE}  # Time Out
      data VeCANR_b_MCPA_DC_Crrent_V_P_FD5TO: category=VALUE, sw-calibration-access=READ-ONLY, type=ADTSBoolean, init-value=VeCANR_b_MCPA_DC_Crrent_V_P_FD5TOValue:0
    VeCANR_b_MCPA_DC_Crrnt_V_P_FD16: service-kind=ANY-STANDARDIZED, invalidation-policy{data-element=VeCANR_b_MCPA_DC_Crrnt_V_P_FD16, handle-invalid=DONT-INVALIDATE}
      data VeCANR_b_MCPA_DC_Crrnt_V_P_FD16: category=VALUE, sw-calibration-access=READ-ONLY, type=ADTSBoolean, init-value=VeCANR_b_MCPA_DC_Crrnt_V_P_FD16Value:0
    VeCANR_b_MCPA_DC_Crrnt_V_P_FD16TO: service-kind=ANY-STANDARDIZED, invalidation-policy{data-element=VeCANR_b_MCPA_DC_Crrnt_V_P_FD16TO, handle-invalid=DONT-INVALIDATE}  # Time Out
      data VeCANR_b_MCPA_DC_Crrnt_V_P_FD16TO: category=VALUE, sw-calibration-access=READ-ONLY, type=ADTSBoolean, init-value=VeCANR_b_MCPA_DC_Crrnt_V_P_FD16TOValue:0
    VeCANR_b_MCPA_DC_Current_P_FD16TO: service-kind=ANY-STANDARDIZED, invalidation-policy{data-element=VeCANR_b_MCPA_DC_Current_P_FD16TO, handle-invalid=DONT-INVALIDATE}  # Time Out
      data VeCANR_b_MCPA_DC_Current_P_FD16TO: category=VALUE, sw-calibration-access=READ-ONLY, type=ADTSBoolean, init-value=VeCANR_b_MCPA_DC_Current_P_FD16TOValue:0
    VeCANR_b_MCPA_DC_Current_P_FD5TO: service-kind=ANY-STANDARDIZED, invalidation-policy{data-element=VeCANR_b_MCPA_DC_Current_P_FD5TO, handle-invalid=DONT-INVALIDATE}  # Time Out
      data VeCANR_b_MCPA_DC_Current_P_FD5TO: category=VALUE, sw-calibration-access=READ-ONLY, type=ADTSBoolean, init-value=VeCANR_b_MCPA_DC_Current_P_FD5TOValue:0
    VeCANR_b_MCPA_DC_Volt_V_P_FD16: service-kind=ANY-STANDARDIZED, invalidation-policy{data-element=VeCANR_b_MCPA_DC_Volt_V_P_FD16, handle-invalid=DONT-INVALIDATE}
      data VeCANR_b_MCPA_DC_Volt_V_P_FD16: category=VALUE, sw-calibration-access=READ-ONLY, type=ADTSBoolean, init-value=VeCANR_b_MCPA_DC_Volt_V_P_FD16Value:0
    VeCANR_b_MCPA_DC_Volt_V_P_FD16TO: service-kind=ANY-STANDARDIZED, invalidation-policy{data-element=VeCANR_b_MCPA_DC_Volt_V_P_FD16TO, handle-invalid=DONT-INVALIDATE}  # Time Out
      data VeCANR_b_MCPA_DC_Volt_V_P_FD16TO: category=VALUE, sw-calibration-access=READ-ONLY, type=ADTSBoolean, init-value=VeCANR_b_MCPA_DC_Volt_V_P_FD16TOValue:0
    VeCANR_b_MCPA_DC_Volt_V_P_FD5: service-kind=ANY-STANDARDIZED, invalidation-policy{data-element=VeCANR_b_MCPA_DC_Volt_V_P_FD5, handle-invalid=DONT-INVALIDATE}
      data VeCANR_b_MCPA_DC_Volt_V_P_FD5: category=VALUE, sw-calibration-access=READ-ONLY, type=ADTSBoolean, init-value=VeCANR_b_MCPA_DC_Volt_V_P_FD5Value:0
    VeCANR_b_MCPA_DC_Volt_V_P_FD5TO: service-kind=ANY-STANDARDIZED, invalidation-policy{data-element=VeCANR_b_MCPA_DC_Volt_V_P_FD5TO, handle-invalid=DONT-INVALIDATE}  # Time Out
      data VeCANR_b_MCPA_DC_Volt_V_P_FD5TO: category=VALUE, sw-calibration-access=READ-ONLY, type=ADTSBoolean, init-value=VeCANR_b_MCPA_DC_Volt_V_P_FD5TOValue:0
    VeCANR_b_MCPA_DC_Voltage_P_FD16TO: service-kind=ANY-STANDARDIZED, invalidation-policy{data-element=VeCANR_b_MCPA_DC_Voltage_P_FD16TO, handle-invalid=DONT-INVALIDATE}  # Time Out
      data VeCANR_b_MCPA_DC_Voltage_P_FD16TO: category=VALUE, sw-calibration-access=READ-ONLY, type=ADTSBoolean, init-value=VeCANR_b_MCPA_DC_Voltage_P_FD16TOValue:0
    VeCANR_b_MCPA_DC_Voltage_P_FD5TO: service-kind=ANY-STANDARDIZED, invalidation-policy{data-element=VeCANR_b_MCPA_DC_Voltage_P_FD5TO, handle-invalid=DONT-INVALIDATE}  # Time Out
      data VeCANR_b_MCPA_DC_Voltage_P_FD5TO: category=VALUE, sw-calibration-access=READ-ONLY, type=ADTSBoolean, init-value=VeCANR_b_MCPA_DC_Voltage_P_FD5TOValue:0
    VeCANR_b_MCPA_DerateResn_P_FD16TO: service-kind=ANY-STANDARDIZED, invalidation-policy{data-element=VeCANR_b_MCPA_DerateResn_P_FD16TO, handle-invalid=DONT-INVALIDATE}  # Time Out
      data VeCANR_b_MCPA_DerateResn_P_FD16TO: category=VALUE, sw-calibration-access=READ-ONLY, type=ADTSBoolean, init-value=VeCANR_b_MCPA_DerateResn_P_FD16TOValue:0
    VeCANR_b_MCPA_DrateReason_P_FD5TO: service-kind=ANY-STANDARDIZED, invalidation-policy{data-element=VeCANR_b_MCPA_DrateReason_P_FD5TO, handle-invalid=DONT-INVALIDATE}  # Time Out
      data VeCANR_b_MCPA_DrateReason_P_FD5TO: category=VALUE, sw-calibration-access=READ-ONLY, type=ADTSBoolean, init-value=VeCANR_b_MCPA_DrateReason_P_FD5TOValue:0
    VeCANR_b_MCPA_InvertTemp_P_FD16TO: service-kind=ANY-STANDARDIZED, invalidation-policy{data-element=VeCANR_b_MCPA_InvertTemp_P_FD16TO, handle-invalid=DONT-INVALIDATE}  # Time Out
      data VeCANR_b_MCPA_InvertTemp_P_FD16TO: category=VALUE, sw-calibration-access=READ-ONLY, type=ADTSBoolean, init-value=VeCANR_b_MCPA_InvertTemp_P_FD16TOValue:0
    VeCANR_b_MCPA_Invert_Temp_P_FD5TO: service-kind=ANY-STANDARDIZED, invalidation-policy{data-element=VeCANR_b_MCPA_Invert_Temp_P_FD5TO, handle-invalid=DONT-INVALIDATE}  # Time Out
      data VeCANR_b_MCPA_Invert_Temp_P_FD5TO: category=VALUE, sw-calibration-access=READ-ONLY, type=ADTSBoolean, init-value=VeCANR_b_MCPA_Invert_Temp_P_FD5TOValue:0
    VeCANR_b_MCPBCtrlBoarTempP_FD16TO: service-kind=ANY-STANDARDIZED, invalidation-policy{data-element=VeCANR_b_MCPBCtrlBoarTempP_FD16TO, handle-invalid=DONT-INVALIDATE}  # Time Out
      data VeCANR_b_MCPBCtrlBoarTempP_FD16TO: category=VALUE, sw-calibration-access=READ-ONLY, type=ADTSBoolean, init-value=VeCANR_b_MCPBCtrlBoarTempP_FD16TOValue:0
    VeCANR_b_MCPBCtrlBoardTempP_FD5TO: service-kind=ANY-STANDARDIZED, invalidation-policy{data-element=VeCANR_b_MCPBCtrlBoardTempP_FD5TO, handle-invalid=DONT-INVALIDATE}  # Time Out
      data VeCANR_b_MCPBCtrlBoardTempP_FD5TO: category=VALUE, sw-calibration-access=READ-ONLY, type=ADTSBoolean, init-value=VeCANR_b_MCPBCtrlBoardTempP_FD5TOValue:0
    VeCANR_b_MCPBIMDCSdBusTempPFD5TO: service-kind=ANY-STANDARDIZED, invalidation-policy{data-element=VeCANR_b_MCPBIMDCSdBusTempPFD5TO, handle-invalid=DONT-INVALIDATE}  # Time Out
      data VeCANR_b_MCPBIMDCSdBusTempPFD5TO: category=VALUE, sw-calibration-access=READ-ONLY, type=ADTSBoolean, init-value=VeCANR_b_MCPBIMDCSdBusTempPFD5TOValue:0
    VeCANR_b_MCPBPIMDCSdBusTmpPFD16TO: service-kind=ANY-STANDARDIZED, invalidation-policy{data-element=VeCANR_b_MCPBPIMDCSdBusTmpPFD16TO, handle-invalid=DONT-INVALIDATE}  # Time Out
      data VeCANR_b_MCPBPIMDCSdBusTmpPFD16TO: category=VALUE, sw-calibration-access=READ-ONLY, type=ADTSBoolean, init-value=VeCANR_b_MCPBPIMDCSdBusTmpPFD16TOValue:0
    VeCANR_b_MCPBRotorTemp_P_FD16TO: service-kind=ANY-STANDARDIZED, invalidation-policy{data-element=VeCANR_b_MCPBRotorTemp_P_FD16TO, handle-invalid=DONT-INVALIDATE}  # Time Out
      data VeCANR_b_MCPBRotorTemp_P_FD16TO: category=VALUE, sw-calibration-access=READ-ONLY, type=ADTSBoolean, init-value=VeCANR_b_MCPBRotorTemp_P_FD16TOValue:0
    VeCANR_b_MCPBRotorTemp_P_FD5TO: service-kind=ANY-STANDARDIZED, invalidation-policy{data-element=VeCANR_b_MCPBRotorTemp_P_FD5TO, handle-invalid=DONT-INVALIDATE}  # Time Out
      data VeCANR_b_MCPBRotorTemp_P_FD5TO: category=VALUE, sw-calibration-access=READ-ONLY, type=ADTSBoolean, init-value=VeCANR_b_MCPBRotorTemp_P_FD5TOValue:0
    VeCANR_b_MCPBServLampReq_P_FD16: service-kind=ANY-STANDARDIZED, invalidation-policy{data-element=VeCANR_b_MCPBServLampReq_P_FD16, handle-invalid=DONT-INVALIDATE}
      data VeCANR_b_MCPBServLampReq_P_FD16: category=VALUE, sw-calibration-access=READ-ONLY, type=ADTSBoolean, init-value=VeCANR_b_MCPBServLampReq_P_FD16Value:0
    VeCANR_b_MCPBServLampReq_P_FD16TO: service-kind=ANY-STANDARDIZED, invalidation-policy{data-element=VeCANR_b_MCPBServLampReq_P_FD16TO, handle-invalid=DONT-INVALIDATE}  # Time Out
      data VeCANR_b_MCPBServLampReq_P_FD16TO: category=VALUE, sw-calibration-access=READ-ONLY, type=ADTSBoolean, init-value=VeCANR_b_MCPBServLampReq_P_FD16TOValue:0
    VeCANR_b_MCPBServLampReq_P_FD5: service-kind=ANY-STANDARDIZED, invalidation-policy{data-element=VeCANR_b_MCPBServLampReq_P_FD5, handle-invalid=DONT-INVALIDATE}
      data VeCANR_b_MCPBServLampReq_P_FD5: category=VALUE, sw-calibration-access=READ-ONLY, type=ADTSBoolean, init-value=VeCANR_b_MCPBServLampReq_P_FD5Value:0
    VeCANR_b_MCPBServLampReq_P_FD5TO: service-kind=ANY-STANDARDIZED, invalidation-policy{data-element=VeCANR_b_MCPBServLampReq_P_FD5TO, handle-invalid=DONT-INVALIDATE}  # Time Out
      data VeCANR_b_MCPBServLampReq_P_FD5TO: category=VALUE, sw-calibration-access=READ-ONLY, type=ADTSBoolean, init-value=VeCANR_b_MCPBServLampReq_P_FD5TOValue:0
    VeCANR_b_MCPB_CoolantTemp_P_FD5TO: service-kind=ANY-STANDARDIZED, invalidation-policy{data-element=VeCANR_b_MCPB_CoolantTemp_P_FD5TO, handle-invalid=DONT-INVALIDATE}  # Time Out
      data VeCANR_b_MCPB_CoolantTemp_P_FD5TO: category=VALUE, sw-calibration-access=READ-ONLY, type=ADTSBoolean, init-value=VeCANR_b_MCPB_CoolantTemp_P_FD5TOValue:0
    VeCANR_b_MCPB_CoolantTmp_P_FD16TO: service-kind=ANY-STANDARDIZED, invalidation-policy{data-element=VeCANR_b_MCPB_CoolantTmp_P_FD16TO, handle-invalid=DONT-INVALIDATE}  # Time Out
      data VeCANR_b_MCPB_CoolantTmp_P_FD16TO: category=VALUE, sw-calibration-access=READ-ONLY, type=ADTSBoolean, init-value=VeCANR_b_MCPB_CoolantTmp_P_FD16TOValue:0
    VeCANR_b_MCPB_DC_Crrent_V_P_FD5: service-kind=ANY-STANDARDIZED, invalidation-policy{data-element=VeCANR_b_MCPB_DC_Crrent_V_P_FD5, handle-invalid=DONT-INVALIDATE}
      data VeCANR_b_MCPB_DC_Crrent_V_P_FD5: category=VALUE, sw-calibration-access=READ-ONLY, type=ADTSBoolean, init-value=VeCANR_b_MCPB_DC_Crrent_V_P_FD5Value:0
    VeCANR_b_MCPB_DC_Crrent_V_P_FD5TO: service-kind=ANY-STANDARDIZED, invalidation-policy{data-element=VeCANR_b_MCPB_DC_Crrent_V_P_FD5TO, handle-invalid=DONT-INVALIDATE}  # Time Out
      data VeCANR_b_MCPB_DC_Crrent_V_P_FD5TO: category=VALUE, sw-calibration-access=READ-ONLY, type=ADTSBoolean, init-value=VeCANR_b_MCPB_DC_Crrent_V_P_FD5TOValue:0
    VeCANR_b_MCPB_DC_Crrnt_V_P_FD16: service-kind=ANY-STANDARDIZED, invalidation-policy{data-element=VeCANR_b_MCPB_DC_Crrnt_V_P_FD16, handle-invalid=DONT-INVALIDATE}
      data VeCANR_b_MCPB_DC_Crrnt_V_P_FD16: category=VALUE, sw-calibration-access=READ-ONLY, type=ADTSBoolean, init-value=VeCANR_b_MCPB_DC_Crrnt_V_P_FD16Value:0
    VeCANR_b_MCPB_DC_Crrnt_V_P_FD16TO: service-kind=ANY-STANDARDIZED, invalidation-policy{data-element=VeCANR_b_MCPB_DC_Crrnt_V_P_FD16TO, handle-invalid=DONT-INVALIDATE}  # Time Out
      data VeCANR_b_MCPB_DC_Crrnt_V_P_FD16TO: category=VALUE, sw-calibration-access=READ-ONLY, type=ADTSBoolean, init-value=VeCANR_b_MCPB_DC_Crrnt_V_P_FD16TOValue:0
    VeCANR_b_MCPB_DC_Current_P_FD16TO: service-kind=ANY-STANDARDIZED, invalidation-policy{data-element=VeCANR_b_MCPB_DC_Current_P_FD16TO, handle-invalid=DONT-INVALIDATE}  # Time Out
      data VeCANR_b_MCPB_DC_Current_P_FD16TO: category=VALUE, sw-calibration-access=READ-ONLY, type=ADTSBoolean, init-value=VeCANR_b_MCPB_DC_Current_P_FD16TOValue:0
    VeCANR_b_MCPB_DC_Current_P_FD5TO: service-kind=ANY-STANDARDIZED, invalidation-policy{data-element=VeCANR_b_MCPB_DC_Current_P_FD5TO, handle-invalid=DONT-INVALIDATE}  # Time Out
      data VeCANR_b_MCPB_DC_Current_P_FD5TO: category=VALUE, sw-calibration-access=READ-ONLY, type=ADTSBoolean, init-value=VeCANR_b_MCPB_DC_Current_P_FD5TOValue:0
    VeCANR_b_MCPB_DC_Volt_V_P_FD16: service-kind=ANY-STANDARDIZED, invalidation-policy{data-element=VeCANR_b_MCPB_DC_Volt_V_P_FD16, handle-invalid=DONT-INVALIDATE}
      data VeCANR_b_MCPB_DC_Volt_V_P_FD16: category=VALUE, sw-calibration-access=READ-ONLY, type=ADTSBoolean, init-value=VeCANR_b_MCPB_DC_Volt_V_P_FD16Value:0
    VeCANR_b_MCPB_DC_Volt_V_P_FD16TO: service-kind=ANY-STANDARDIZED, invalidation-policy{data-element=VeCANR_b_MCPB_DC_Volt_V_P_FD16TO, handle-invalid=DONT-INVALIDATE}  # Time Out
      data VeCANR_b_MCPB_DC_Volt_V_P_FD16TO: category=VALUE, sw-calibration-access=READ-ONLY, type=ADTSBoolean, init-value=VeCANR_b_MCPB_DC_Volt_V_P_FD16TOValue:0
    VeCANR_b_MCPB_DC_Volt_V_P_FD5: service-kind=ANY-STANDARDIZED, invalidation-policy{data-element=VeCANR_b_MCPB_DC_Volt_V_P_FD5, handle-invalid=DONT-INVALIDATE}
      data VeCANR_b_MCPB_DC_Volt_V_P_FD5: category=VALUE, sw-calibration-access=READ-ONLY, type=ADTSBoolean, init-value=VeCANR_b_MCPB_DC_Volt_V_P_FD5Value:0
    VeCANR_b_MCPB_DC_Volt_V_P_FD5TO: service-kind=ANY-STANDARDIZED, invalidation-policy{data-element=VeCANR_b_MCPB_DC_Volt_V_P_FD5TO, handle-invalid=DONT-INVALIDATE}  # Time Out
      data VeCANR_b_MCPB_DC_Volt_V_P_FD5TO: category=VALUE, sw-calibration-access=READ-ONLY, type=ADTSBoolean, init-value=VeCANR_b_MCPB_DC_Volt_V_P_FD5TOValue:0
    VeCANR_b_MCPB_DC_Voltage_P_FD16TO: service-kind=ANY-STANDARDIZED, invalidation-policy{data-element=VeCANR_b_MCPB_DC_Voltage_P_FD16TO, handle-invalid=DONT-INVALIDATE}  # Time Out
      data VeCANR_b_MCPB_DC_Voltage_P_FD16TO: category=VALUE, sw-calibration-access=READ-ONLY, type=ADTSBoolean, init-value=VeCANR_b_MCPB_DC_Voltage_P_FD16TOValue:0
    VeCANR_b_MCPB_DC_Voltage_P_FD5TO: service-kind=ANY-STANDARDIZED, invalidation-policy{data-element=VeCANR_b_MCPB_DC_Voltage_P_FD5TO, handle-invalid=DONT-INVALIDATE}  # Time Out
      data VeCANR_b_MCPB_DC_Voltage_P_FD5TO: category=VALUE, sw-calibration-access=READ-ONLY, type=ADTSBoolean, init-value=VeCANR_b_MCPB_DC_Voltage_P_FD5TOValue:0
    VeCANR_b_MCPB_DerateResn_P_FD16TO: service-kind=ANY-STANDARDIZED, invalidation-policy{data-element=VeCANR_b_MCPB_DerateResn_P_FD16TO, handle-invalid=DONT-INVALIDATE}  # Time Out
      data VeCANR_b_MCPB_DerateResn_P_FD16TO: category=VALUE, sw-calibration-access=READ-ONLY, type=ADTSBoolean, init-value=VeCANR_b_MCPB_DerateResn_P_FD16TOValue:0
    VeCANR_b_MCPB_DrateReason_P_FD5TO: service-kind=ANY-STANDARDIZED, invalidation-policy{data-element=VeCANR_b_MCPB_DrateReason_P_FD5TO, handle-invalid=DONT-INVALIDATE}  # Time Out
      data VeCANR_b_MCPB_DrateReason_P_FD5TO: category=VALUE, sw-calibration-access=READ-ONLY, type=ADTSBoolean, init-value=VeCANR_b_MCPB_DrateReason_P_FD5TOValue:0
    VeCANR_b_MCPB_InvertTemp_P_FD16TO: service-kind=ANY-STANDARDIZED, invalidation-policy{data-element=VeCANR_b_MCPB_InvertTemp_P_FD16TO, handle-invalid=DONT-INVALIDATE}  # Time Out
      data VeCANR_b_MCPB_InvertTemp_P_FD16TO: category=VALUE, sw-calibration-access=READ-ONLY, type=ADTSBoolean, init-value=VeCANR_b_MCPB_InvertTemp_P_FD16TOValue:0
    VeCANR_b_MCPB_Invert_Temp_P_FD5TO: service-kind=ANY-STANDARDIZED, invalidation-policy{data-element=VeCANR_b_MCPB_Invert_Temp_P_FD5TO, handle-invalid=DONT-INVALIDATE}  # Time Out
      data VeCANR_b_MCPB_Invert_Temp_P_FD5TO: category=VALUE, sw-calibration-access=READ-ONLY, type=ADTSBoolean, init-value=VeCANR_b_MCPB_Invert_Temp_P_FD5TOValue:0
    VeCANR_b_MC_FOTA_MASTER_TO: service-kind=ANY-STANDARDIZED, invalidation-policy{data-element=VeCANR_b_MC_FOTA_MASTER_TO, handle-invalid=DONT-INVALIDATE}  # Time Out
      data VeCANR_b_MC_FOTA_MASTER_TO: category=VALUE, sw-calibration-access=READ-ONLY, type=ADTSBoolean, init-value=VeCANR_b_MC_FOTA_MASTER_TOValue:0
    VeCANR_b_MC_MCPA_STATUS_FD16TO: service-kind=ANY-STANDARDIZED, invalidation-policy{data-element=VeCANR_b_MC_MCPA_STATUS_FD16TO, handle-invalid=DONT-INVALIDATE}  # Time Out
      data VeCANR_b_MC_MCPA_STATUS_FD16TO: category=VALUE, sw-calibration-access=READ-ONLY, type=ADTSBoolean, init-value=VeCANR_b_MC_MCPA_STATUS_FD16TOValue:0
    VeCANR_b_MC_MCPA_STATUS_FD5TO: service-kind=ANY-STANDARDIZED, invalidation-policy{data-element=VeCANR_b_MC_MCPA_STATUS_FD5TO, handle-invalid=DONT-INVALIDATE}  # Time Out
      data VeCANR_b_MC_MCPA_STATUS_FD5TO: category=VALUE, sw-calibration-access=READ-ONLY, type=ADTSBoolean, init-value=VeCANR_b_MC_MCPA_STATUS_FD5TOValue:0
    VeCANR_b_MC_MCPB_STATUS_FD16TO: service-kind=ANY-STANDARDIZED, invalidation-policy{data-element=VeCANR_b_MC_MCPB_STATUS_FD16TO, handle-invalid=DONT-INVALIDATE}  # Time Out
      data VeCANR_b_MC_MCPB_STATUS_FD16TO: category=VALUE, sw-calibration-access=READ-ONLY, type=ADTSBoolean, init-value=VeCANR_b_MC_MCPB_STATUS_FD16TOValue:0
    VeCANR_b_MC_MCPB_STATUS_FD5TO: service-kind=ANY-STANDARDIZED, invalidation-policy{data-element=VeCANR_b_MC_MCPB_STATUS_FD5TO, handle-invalid=DONT-INVALIDATE}  # Time Out
      data VeCANR_b_MC_MCPB_STATUS_FD5TO: category=VALUE, sw-calibration-access=READ-ONLY, type=ADTSBoolean, init-value=VeCANR_b_MC_MCPB_STATUS_FD5TOValue:0
    VeCANR_b_MC_SGCP_STATUS_FD16TO: service-kind=ANY-STANDARDIZED, invalidation-policy{data-element=VeCANR_b_MC_SGCP_STATUS_FD16TO, handle-invalid=DONT-INVALIDATE}  # Time Out
      data VeCANR_b_MC_SGCP_STATUS_FD16TO: category=VALUE, sw-calibration-access=READ-ONLY, type=ADTSBoolean, init-value=VeCANR_b_MC_SGCP_STATUS_FD16TOValue:0
    VeCANR_b_MC_SGCP_STATUS_FD5TO: service-kind=ANY-STANDARDIZED, invalidation-policy{data-element=VeCANR_b_MC_SGCP_STATUS_FD5TO, handle-invalid=DONT-INVALIDATE}  # Time Out
      data VeCANR_b_MC_SGCP_STATUS_FD5TO: category=VALUE, sw-calibration-access=READ-ONLY, type=ADTSBoolean, init-value=VeCANR_b_MC_SGCP_STATUS_FD5TOValue:0
    VeCANR_b_Minute1_TLM_TO: service-kind=ANY-STANDARDIZED, invalidation-policy{data-element=VeCANR_b_Minute1_TLM_TO, handle-invalid=DONT-INVALIDATE}  # Time Out
      data VeCANR_b_Minute1_TLM_TO: category=VALUE, sw-calibration-access=READ-ONLY, type=ADTSBoolean, init-value=VeCANR_b_Minute1_TLM_TOValue:0
    VeCANR_b_Minute2_TLM_TO: service-kind=ANY-STANDARDIZED, invalidation-policy{data-element=VeCANR_b_Minute2_TLM_TO, handle-invalid=DONT-INVALIDATE}  # Time Out
      data VeCANR_b_Minute2_TLM_TO: category=VALUE, sw-calibration-access=READ-ONLY, type=ADTSBoolean, init-value=VeCANR_b_Minute2_TLM_TOValue:0
    VeCANR_b_Month1_TLM_TO: service-kind=ANY-STANDARDIZED, invalidation-policy{data-element=VeCANR_b_Month1_TLM_TO, handle-invalid=DONT-INVALIDATE}  # Time Out
      data VeCANR_b_Month1_TLM_TO: category=VALUE, sw-calibration-access=READ-ONLY, type=ADTSBoolean, init-value=VeCANR_b_Month1_TLM_TOValue:0
    VeCANR_b_Month2_TLM_TO: service-kind=ANY-STANDARDIZED, invalidation-policy{data-element=VeCANR_b_Month2_TLM_TO, handle-invalid=DONT-INVALIDATE}  # Time Out
      data VeCANR_b_Month2_TLM_TO: category=VALUE, sw-calibration-access=READ-ONLY, type=ADTSBoolean, init-value=VeCANR_b_Month2_TLM_TOValue:0
    VeCANR_b_N_PDU_343_FD11TO: service-kind=ANY-STANDARDIZED, invalidation-policy{data-element=VeCANR_b_N_PDU_343_FD11TO, handle-invalid=DONT-INVALIDATE}  # Time Out
      data VeCANR_b_N_PDU_343_FD11TO: category=VALUE, sw-calibration-access=READ-ONLY, type=ADTSBoolean, init-value=VeCANR_b_N_PDU_343_FD11TOValue:0
    VeCANR_b_N_PDU_343_FD3TO: service-kind=ANY-STANDARDIZED, invalidation-policy{data-element=VeCANR_b_N_PDU_343_FD3TO, handle-invalid=DONT-INVALIDATE}  # Time Out
      data VeCANR_b_N_PDU_343_FD3TO: category=VALUE, sw-calibration-access=READ-ONLY, type=ADTSBoolean, init-value=VeCANR_b_N_PDU_343_FD3TOValue:0
    VeCANR_b_N_PDU_7B_FD16TO: service-kind=ANY-STANDARDIZED, invalidation-policy{data-element=VeCANR_b_N_PDU_7B_FD16TO, handle-invalid=DONT-INVALIDATE}  # Time Out
      data VeCANR_b_N_PDU_7B_FD16TO: category=VALUE, sw-calibration-access=READ-ONLY, type=ADTSBoolean, init-value=VeCANR_b_N_PDU_7B_FD16TOValue:0
    VeCANR_b_N_PDU_7B_FD5TO: service-kind=ANY-STANDARDIZED, invalidation-policy{data-element=VeCANR_b_N_PDU_7B_FD5TO, handle-invalid=DONT-INVALIDATE}  # Time Out
      data VeCANR_b_N_PDU_7B_FD5TO: category=VALUE, sw-calibration-access=READ-ONLY, type=ADTSBoolean, init-value=VeCANR_b_N_PDU_7B_FD5TOValue:0
    VeCANR_b_N_PDU_7C_FD16TO: service-kind=ANY-STANDARDIZED, invalidation-policy{data-element=VeCANR_b_N_PDU_7C_FD16TO, handle-invalid=DONT-INVALIDATE}  # Time Out
      data VeCANR_b_N_PDU_7C_FD16TO: category=VALUE, sw-calibration-access=READ-ONLY, type=ADTSBoolean, init-value=VeCANR_b_N_PDU_7C_FD16TOValue:0
    VeCANR_b_N_PDU_7C_FD5TO: service-kind=ANY-STANDARDIZED, invalidation-policy{data-element=VeCANR_b_N_PDU_7C_FD5TO, handle-invalid=DONT-INVALIDATE}  # Time Out
      data VeCANR_b_N_PDU_7C_FD5TO: category=VALUE, sw-calibration-access=READ-ONLY, type=ADTSBoolean, init-value=VeCANR_b_N_PDU_7C_FD5TOValue:0
    VeCANR_b_N_PDU_7E_FD11TO: service-kind=ANY-STANDARDIZED, invalidation-policy{data-element=VeCANR_b_N_PDU_7E_FD11TO, handle-invalid=DONT-INVALIDATE}  # Time Out
      data VeCANR_b_N_PDU_7E_FD11TO: category=VALUE, sw-calibration-access=READ-ONLY, type=ADTSBoolean, init-value=VeCANR_b_N_PDU_7E_FD11TOValue:0
    VeCANR_b_N_PDU_7E_FD3TO: service-kind=ANY-STANDARDIZED, invalidation-policy{data-element=VeCANR_b_N_PDU_7E_FD3TO, handle-invalid=DONT-INVALIDATE}  # Time Out
      data VeCANR_b_N_PDU_7E_FD3TO: category=VALUE, sw-calibration-access=READ-ONLY, type=ADTSBoolean, init-value=VeCANR_b_N_PDU_7E_FD3TOValue:0
    VeCANR_b_N_PDU_7F_FD11TO: service-kind=ANY-STANDARDIZED, invalidation-policy{data-element=VeCANR_b_N_PDU_7F_FD11TO, handle-invalid=DONT-INVALIDATE}  # Time Out
      data VeCANR_b_N_PDU_7F_FD11TO: category=VALUE, sw-calibration-access=READ-ONLY, type=ADTSBoolean, init-value=VeCANR_b_N_PDU_7F_FD11TOValue:0
    VeCANR_b_N_PDU_7F_FD3TO: service-kind=ANY-STANDARDIZED, invalidation-policy{data-element=VeCANR_b_N_PDU_7F_FD3TO, handle-invalid=DONT-INVALIDATE}  # Time Out
      data VeCANR_b_N_PDU_7F_FD3TO: category=VALUE, sw-calibration-access=READ-ONLY, type=ADTSBoolean, init-value=VeCANR_b_N_PDU_7F_FD3TOValue:0
    VeCANR_b_N_PDU_81_FD11TO: service-kind=ANY-STANDARDIZED, invalidation-policy{data-element=VeCANR_b_N_PDU_81_FD11TO, handle-invalid=DONT-INVALIDATE}  # Time Out
      data VeCANR_b_N_PDU_81_FD11TO: category=VALUE, sw-calibration-access=READ-ONLY, type=ADTSBoolean, init-value=VeCANR_b_N_PDU_81_FD11TOValue:0
    VeCANR_b_N_PDU_86_FD16TO: service-kind=ANY-STANDARDIZED, invalidation-policy{data-element=VeCANR_b_N_PDU_86_FD16TO, handle-invalid=DONT-INVALIDATE}  # Time Out
      data VeCANR_b_N_PDU_86_FD16TO: category=VALUE, sw-calibration-access=READ-ONLY, type=ADTSBoolean, init-value=VeCANR_b_N_PDU_86_FD16TOValue:0
    VeCANR_b_OAT_PT_EstV_FD3: service-kind=ANY-STANDARDIZED, invalidation-policy{data-element=VeCANR_b_OAT_PT_EstV_FD3, handle-invalid=DONT-INVALIDATE}
      data VeCANR_b_OAT_PT_EstV_FD3: category=VALUE, sw-calibration-access=READ-ONLY, type=ADTSBoolean, init-value=VeCANR_b_OAT_PT_EstV_FD3Value:0
    VeCANR_b_OAT_PT_EstV_FD3TO: service-kind=ANY-STANDARDIZED, invalidation-policy{data-element=VeCANR_b_OAT_PT_EstV_FD3TO, handle-invalid=DONT-INVALIDATE}  # Time Out
      data VeCANR_b_OAT_PT_EstV_FD3TO: category=VALUE, sw-calibration-access=READ-ONLY, type=ADTSBoolean, init-value=VeCANR_b_OAT_PT_EstV_FD3TOValue:0
    VeCANR_b_OAT_PT_Est_FD3TO: service-kind=ANY-STANDARDIZED, invalidation-policy{data-element=VeCANR_b_OAT_PT_Est_FD3TO, handle-invalid=DONT-INVALIDATE}  # Time Out
      data VeCANR_b_OAT_PT_Est_FD3TO: category=VALUE, sw-calibration-access=READ-ONLY, type=ADTSBoolean, init-value=VeCANR_b_OAT_PT_Est_FD3TOValue:0
    VeCANR_b_OBCM_PrechargeSts_FD5TO: service-kind=ANY-STANDARDIZED, invalidation-policy{data-element=VeCANR_b_OBCM_PrechargeSts_FD5TO, handle-invalid=DONT-INVALIDATE}  # Time Out
      data VeCANR_b_OBCM_PrechargeSts_FD5TO: category=VALUE, sw-calibration-access=READ-ONLY, type=ADTSBoolean, init-value=VeCANR_b_OBCM_PrechargeSts_FD5TOValue:0
    VeCANR_b_OBC_CaptureEnvDataFD5: service-kind=ANY-STANDARDIZED, invalidation-policy{data-element=VeCANR_b_OBC_CaptureEnvDataFD5, handle-invalid=DONT-INVALIDATE}
      data VeCANR_b_OBC_CaptureEnvDataFD5: category=VALUE, sw-calibration-access=READ-ONLY, type=ADTSBoolean, init-value=VeCANR_b_OBC_CaptureEnvDataFD5Value:0
    VeCANR_b_OBC_CaptureEnvDataFD5TO: service-kind=ANY-STANDARDIZED, invalidation-policy{data-element=VeCANR_b_OBC_CaptureEnvDataFD5TO, handle-invalid=DONT-INVALIDATE}  # Time Out
      data VeCANR_b_OBC_CaptureEnvDataFD5TO: category=VALUE, sw-calibration-access=READ-ONLY, type=ADTSBoolean, init-value=VeCANR_b_OBC_CaptureEnvDataFD5TOValue:0
    VeCANR_b_OBC_ChargeFailure_FD5: service-kind=ANY-STANDARDIZED, invalidation-policy{data-element=VeCANR_b_OBC_ChargeFailure_FD5, handle-invalid=DONT-INVALIDATE}
      data VeCANR_b_OBC_ChargeFailure_FD5: category=VALUE, sw-calibration-access=READ-ONLY, type=ADTSBoolean, init-value=VeCANR_b_OBC_ChargeFailure_FD5Value:0
    VeCANR_b_OBC_ChargeFailure_FD5TO: service-kind=ANY-STANDARDIZED, invalidation-policy{data-element=VeCANR_b_OBC_ChargeFailure_FD5TO, handle-invalid=DONT-INVALIDATE}  # Time Out
      data VeCANR_b_OBC_ChargeFailure_FD5TO: category=VALUE, sw-calibration-access=READ-ONLY, type=ADTSBoolean, init-value=VeCANR_b_OBC_ChargeFailure_FD5TOValue:0
    VeCANR_b_OBC_ChargeTimeMin_FD5TO: service-kind=ANY-STANDARDIZED, invalidation-policy{data-element=VeCANR_b_OBC_ChargeTimeMin_FD5TO, handle-invalid=DONT-INVALIDATE}  # Time Out
      data VeCANR_b_OBC_ChargeTimeMin_FD5TO: category=VALUE, sw-calibration-access=READ-ONLY, type=ADTSBoolean, init-value=VeCANR_b_OBC_ChargeTimeMin_FD5TOValue:0
    VeCANR_b_OBC_ChargeTimeSec_FD5TO: service-kind=ANY-STANDARDIZED, invalidation-policy{data-element=VeCANR_b_OBC_ChargeTimeSec_FD5TO, handle-invalid=DONT-INVALIDATE}  # Time Out
      data VeCANR_b_OBC_ChargeTimeSec_FD5TO: category=VALUE, sw-calibration-access=READ-ONLY, type=ADTSBoolean, init-value=VeCANR_b_OBC_ChargeTimeSec_FD5TOValue:0
    VeCANR_b_OBC_ChrgnFaultSts_FD5TO: service-kind=ANY-STANDARDIZED, invalidation-policy{data-element=VeCANR_b_OBC_ChrgnFaultSts_FD5TO, handle-invalid=DONT-INVALIDATE}  # Time Out
      data VeCANR_b_OBC_ChrgnFaultSts_FD5TO: category=VALUE, sw-calibration-access=READ-ONLY, type=ADTSBoolean, init-value=VeCANR_b_OBC_ChrgnFaultSts_FD5TOValue:0
    VeCANR_b_OBC_CurrFailrSts_FD5: service-kind=ANY-STANDARDIZED, invalidation-policy{data-element=VeCANR_b_OBC_CurrFailrSts_FD5, handle-invalid=DONT-INVALIDATE}
      data VeCANR_b_OBC_CurrFailrSts_FD5: category=VALUE, sw-calibration-access=READ-ONLY, type=ADTSBoolean, init-value=VeCANR_b_OBC_CurrFailrSts_FD5Value:0
    VeCANR_b_OBC_CurrFailrSts_FD5TO: service-kind=ANY-STANDARDIZED, invalidation-policy{data-element=VeCANR_b_OBC_CurrFailrSts_FD5TO, handle-invalid=DONT-INVALIDATE}  # Time Out
      data VeCANR_b_OBC_CurrFailrSts_FD5TO: category=VALUE, sw-calibration-access=READ-ONLY, type=ADTSBoolean, init-value=VeCANR_b_OBC_CurrFailrSts_FD5TOValue:0
    VeCANR_b_OBC_EVServLampFls_FD5: service-kind=ANY-STANDARDIZED, invalidation-policy{data-element=VeCANR_b_OBC_EVServLampFls_FD5, handle-invalid=DONT-INVALIDATE}
      data VeCANR_b_OBC_EVServLampFls_FD5: category=VALUE, sw-calibration-access=READ-ONLY, type=ADTSBoolean, init-value=VeCANR_b_OBC_EVServLampFls_FD5Value:0
    VeCANR_b_OBC_EVServLampFls_FD5TO: service-kind=ANY-STANDARDIZED, invalidation-policy{data-element=VeCANR_b_OBC_EVServLampFls_FD5TO, handle-invalid=DONT-INVALIDATE}  # Time Out
      data VeCANR_b_OBC_EVServLampFls_FD5TO: category=VALUE, sw-calibration-access=READ-ONLY, type=ADTSBoolean, init-value=VeCANR_b_OBC_EVServLampFls_FD5TOValue:0
    VeCANR_b_OBC_EVServLampOn_FD5: service-kind=ANY-STANDARDIZED, invalidation-policy{data-element=VeCANR_b_OBC_EVServLampOn_FD5, handle-invalid=DONT-INVALIDATE}
      data VeCANR_b_OBC_EVServLampOn_FD5: category=VALUE, sw-calibration-access=READ-ONLY, type=ADTSBoolean, init-value=VeCANR_b_OBC_EVServLampOn_FD5Value:0
    VeCANR_b_OBC_EVServLampOn_FD5TO: service-kind=ANY-STANDARDIZED, invalidation-policy{data-element=VeCANR_b_OBC_EVServLampOn_FD5TO, handle-invalid=DONT-INVALIDATE}  # Time Out
      data VeCANR_b_OBC_EVServLampOn_FD5TO: category=VALUE, sw-calibration-access=READ-ONLY, type=ADTSBoolean, init-value=VeCANR_b_OBC_EVServLampOn_FD5TOValue:0
    VeCANR_b_OBC_FaultReason_FD5TO: service-kind=ANY-STANDARDIZED, invalidation-policy{data-element=VeCANR_b_OBC_FaultReason_FD5TO, handle-invalid=DONT-INVALIDATE}  # Time Out
      data VeCANR_b_OBC_FaultReason_FD5TO: category=VALUE, sw-calibration-access=READ-ONLY, type=ADTSBoolean, init-value=VeCANR_b_OBC_FaultReason_FD5TOValue:0
    VeCANR_b_OBC_GenericFailStsFD5: service-kind=ANY-STANDARDIZED, invalidation-policy{data-element=VeCANR_b_OBC_GenericFailStsFD5, handle-invalid=DONT-INVALIDATE}
      data VeCANR_b_OBC_GenericFailStsFD5: category=VALUE, sw-calibration-access=READ-ONLY, type=ADTSBoolean, init-value=VeCANR_b_OBC_GenericFailStsFD5Value:0
    VeCANR_b_OBC_GenericFailStsFD5TO: service-kind=ANY-STANDARDIZED, invalidation-policy{data-element=VeCANR_b_OBC_GenericFailStsFD5TO, handle-invalid=DONT-INVALIDATE}  # Time Out
      data VeCANR_b_OBC_GenericFailStsFD5TO: category=VALUE, sw-calibration-access=READ-ONLY, type=ADTSBoolean, init-value=VeCANR_b_OBC_GenericFailStsFD5TOValue:0
    VeCANR_b_OBC_IdleTimeMin_FD5TO: service-kind=ANY-STANDARDIZED, invalidation-policy{data-element=VeCANR_b_OBC_IdleTimeMin_FD5TO, handle-invalid=DONT-INVALIDATE}  # Time Out
      data VeCANR_b_OBC_IdleTimeMin_FD5TO: category=VALUE, sw-calibration-access=READ-ONLY, type=ADTSBoolean, init-value=VeCANR_b_OBC_IdleTimeMin_FD5TOValue:0
    VeCANR_b_OBC_IdleTimeSec_FD5TO: service-kind=ANY-STANDARDIZED, invalidation-policy{data-element=VeCANR_b_OBC_IdleTimeSec_FD5TO, handle-invalid=DONT-INVALIDATE}  # Time Out
      data VeCANR_b_OBC_IdleTimeSec_FD5TO: category=VALUE, sw-calibration-access=READ-ONLY, type=ADTSBoolean, init-value=VeCANR_b_OBC_IdleTimeSec_FD5TOValue:0
    VeCANR_b_OBC_Pilot_FD5TO: service-kind=ANY-STANDARDIZED, invalidation-policy{data-element=VeCANR_b_OBC_Pilot_FD5TO, handle-invalid=DONT-INVALIDATE}  # Time Out
      data VeCANR_b_OBC_Pilot_FD5TO: category=VALUE, sw-calibration-access=READ-ONLY, type=ADTSBoolean, init-value=VeCANR_b_OBC_Pilot_FD5TOValue:0
    VeCANR_b_OBC_Prox_FD5TO: service-kind=ANY-STANDARDIZED, invalidation-policy{data-element=VeCANR_b_OBC_Prox_FD5TO, handle-invalid=DONT-INVALIDATE}  # Time Out
      data VeCANR_b_OBC_Prox_FD5TO: category=VALUE, sw-calibration-access=READ-ONLY, type=ADTSBoolean, init-value=VeCANR_b_OBC_Prox_FD5TOValue:0
    VeCANR_b_OBC_Temp1_FD11TO: service-kind=ANY-STANDARDIZED, invalidation-policy{data-element=VeCANR_b_OBC_Temp1_FD11TO, handle-invalid=DONT-INVALIDATE}  # Time Out
      data VeCANR_b_OBC_Temp1_FD11TO: category=VALUE, sw-calibration-access=READ-ONLY, type=ADTSBoolean, init-value=VeCANR_b_OBC_Temp1_FD11TOValue:0
    VeCANR_b_OBC_Temp1_FD5TO: service-kind=ANY-STANDARDIZED, invalidation-policy{data-element=VeCANR_b_OBC_Temp1_FD5TO, handle-invalid=DONT-INVALIDATE}  # Time Out
      data VeCANR_b_OBC_Temp1_FD5TO: category=VALUE, sw-calibration-access=READ-ONLY, type=ADTSBoolean, init-value=VeCANR_b_OBC_Temp1_FD5TOValue:0
    VeCANR_b_OBC_Temp2_FD11TO: service-kind=ANY-STANDARDIZED, invalidation-policy{data-element=VeCANR_b_OBC_Temp2_FD11TO, handle-invalid=DONT-INVALIDATE}  # Time Out
      data VeCANR_b_OBC_Temp2_FD11TO: category=VALUE, sw-calibration-access=READ-ONLY, type=ADTSBoolean, init-value=VeCANR_b_OBC_Temp2_FD11TOValue:0
    VeCANR_b_OBC_Temp2_FD5TO: service-kind=ANY-STANDARDIZED, invalidation-policy{data-element=VeCANR_b_OBC_Temp2_FD5TO, handle-invalid=DONT-INVALIDATE}  # Time Out
      data VeCANR_b_OBC_Temp2_FD5TO: category=VALUE, sw-calibration-access=READ-ONLY, type=ADTSBoolean, init-value=VeCANR_b_OBC_Temp2_FD5TOValue:0
    VeCANR_b_OBC_Temp3_FD11TO: service-kind=ANY-STANDARDIZED, invalidation-policy{data-element=VeCANR_b_OBC_Temp3_FD11TO, handle-invalid=DONT-INVALIDATE}  # Time Out
      data VeCANR_b_OBC_Temp3_FD11TO: category=VALUE, sw-calibration-access=READ-ONLY, type=ADTSBoolean, init-value=VeCANR_b_OBC_Temp3_FD11TOValue:0
    VeCANR_b_OBC_Temp3_FD5TO: service-kind=ANY-STANDARDIZED, invalidation-policy{data-element=VeCANR_b_OBC_Temp3_FD5TO, handle-invalid=DONT-INVALIDATE}  # Time Out
      data VeCANR_b_OBC_Temp3_FD5TO: category=VALUE, sw-calibration-access=READ-ONLY, type=ADTSBoolean, init-value=VeCANR_b_OBC_Temp3_FD5TOValue:0
    VeCANR_b_OBC_Temp4_FD11TO: service-kind=ANY-STANDARDIZED, invalidation-policy{data-element=VeCANR_b_OBC_Temp4_FD11TO, handle-invalid=DONT-INVALIDATE}  # Time Out
      data VeCANR_b_OBC_Temp4_FD11TO: category=VALUE, sw-calibration-access=READ-ONLY, type=ADTSBoolean, init-value=VeCANR_b_OBC_Temp4_FD11TOValue:0
    VeCANR_b_OBC_Temp4_FD5TO: service-kind=ANY-STANDARDIZED, invalidation-policy{data-element=VeCANR_b_OBC_Temp4_FD5TO, handle-invalid=DONT-INVALIDATE}  # Time Out
      data VeCANR_b_OBC_Temp4_FD5TO: category=VALUE, sw-calibration-access=READ-ONLY, type=ADTSBoolean, init-value=VeCANR_b_OBC_Temp4_FD5TOValue:0
    VeCANR_b_OBC_WakeReason_FD5TO: service-kind=ANY-STANDARDIZED, invalidation-policy{data-element=VeCANR_b_OBC_WakeReason_FD5TO, handle-invalid=DONT-INVALIDATE}  # Time Out
      data VeCANR_b_OBC_WakeReason_FD5TO: category=VALUE, sw-calibration-access=READ-ONLY, type=ADTSBoolean, init-value=VeCANR_b_OBC_WakeReason_FD5TOValue:0
    VeCANR_b_OnboardChargerModeFD5TO: service-kind=ANY-STANDARDIZED, invalidation-policy{data-element=VeCANR_b_OnboardChargerModeFD5TO, handle-invalid=DONT-INVALIDATE}  # Time Out
      data VeCANR_b_OnboardChargerModeFD5TO: category=VALUE, sw-calibration-access=READ-ONLY, type=ADTSBoolean, init-value=VeCANR_b_OnboardChargerModeFD5TOValue:0
    VeCANR_b_OnboardChrgrReady_FD5TO: service-kind=ANY-STANDARDIZED, invalidation-policy{data-element=VeCANR_b_OnboardChrgrReady_FD5TO, handle-invalid=DONT-INVALIDATE}  # Time Out
      data VeCANR_b_OnboardChrgrReady_FD5TO: category=VALUE, sw-calibration-access=READ-ONLY, type=ADTSBoolean, init-value=VeCANR_b_OnboardChrgrReady_FD5TOValue:0
    VeCANR_b_PwrEffTO: service-kind=ANY-STANDARDIZED, invalidation-policy{data-element=VeCANR_b_PwrEffTO, handle-invalid=DONT-INVALIDATE}  # Time Out
      data VeCANR_b_PwrEffTO: category=VALUE, sw-calibration-access=READ-ONLY, type=ADTSBoolean, init-value=VeCANR_b_PwrEffTOValue:0
    VeCANR_b_QualifyDriveCycle_FD3: service-kind=ANY-STANDARDIZED, invalidation-policy{data-element=VeCANR_b_QualifyDriveCycle_FD3, handle-invalid=DONT-INVALIDATE}
      data VeCANR_b_QualifyDriveCycle_FD3: category=VALUE, sw-calibration-access=READ-ONLY, type=ADTSBoolean, init-value=VeCANR_b_QualifyDriveCycle_FD3Value:0
    VeCANR_b_QualifyDriveCycle_FD3TO: service-kind=ANY-STANDARDIZED, invalidation-policy{data-element=VeCANR_b_QualifyDriveCycle_FD3TO, handle-invalid=DONT-INVALIDATE}  # Time Out
      data VeCANR_b_QualifyDriveCycle_FD3TO: category=VALUE, sw-calibration-access=READ-ONLY, type=ADTSBoolean, init-value=VeCANR_b_QualifyDriveCycle_FD3TOValue:0
    VeCANR_b_RACE_CLDWN_ON_OFF_REQ: service-kind=ANY-STANDARDIZED, invalidation-policy{data-element=VeCANR_b_RACE_CLDWN_ON_OFF_REQ, handle-invalid=DONT-INVALIDATE}
      data VeCANR_b_RACE_CLDWN_ON_OFF_REQ: category=VALUE, sw-calibration-access=READ-ONLY, type=ADTSBoolean, init-value=VeCANR_b_RACE_CLDWN_ON_OFF_REQValue:0
    VeCANR_b_RACE_CLDWN_ON_OFF_REQ_TO: service-kind=ANY-STANDARDIZED, invalidation-policy{data-element=VeCANR_b_RACE_CLDWN_ON_OFF_REQ_TO, handle-invalid=DONT-INVALIDATE}  # Time Out
      data VeCANR_b_RACE_CLDWN_ON_OFF_REQ_TO: category=VALUE, sw-calibration-access=READ-ONLY, type=ADTSBoolean, init-value=VeCANR_b_RACE_CLDWN_ON_OFF_REQ_TOValue:0
    VeCANR_b_Remote_Chargeport_CmndTO: service-kind=ANY-STANDARDIZED, invalidation-policy{data-element=VeCANR_b_Remote_Chargeport_CmndTO, handle-invalid=DONT-INVALIDATE}  # Time Out
      data VeCANR_b_Remote_Chargeport_CmndTO: category=VALUE, sw-calibration-access=READ-ONLY, type=ADTSBoolean, init-value=VeCANR_b_Remote_Chargeport_CmndTOValue:0
    VeCANR_b_SGCPCtrlBoarTempP_FD16TO: service-kind=ANY-STANDARDIZED, invalidation-policy{data-element=VeCANR_b_SGCPCtrlBoarTempP_FD16TO, handle-invalid=DONT-INVALIDATE}  # Time Out
      data VeCANR_b_SGCPCtrlBoarTempP_FD16TO: category=VALUE, sw-calibration-access=READ-ONLY, type=ADTSBoolean, init-value=VeCANR_b_SGCPCtrlBoarTempP_FD16TOValue:0
    VeCANR_b_SGCPCtrlBoardTempP_FD5TO: service-kind=ANY-STANDARDIZED, invalidation-policy{data-element=VeCANR_b_SGCPCtrlBoardTempP_FD5TO, handle-invalid=DONT-INVALIDATE}  # Time Out
      data VeCANR_b_SGCPCtrlBoardTempP_FD5TO: category=VALUE, sw-calibration-access=READ-ONLY, type=ADTSBoolean, init-value=VeCANR_b_SGCPCtrlBoardTempP_FD5TOValue:0
    VeCANR_b_SGCPPIMACSdBusTempPFD5TO: service-kind=ANY-STANDARDIZED, invalidation-policy{data-element=VeCANR_b_SGCPPIMACSdBusTempPFD5TO, handle-invalid=DONT-INVALIDATE}  # Time Out
      data VeCANR_b_SGCPPIMACSdBusTempPFD5TO: category=VALUE, sw-calibration-access=READ-ONLY, type=ADTSBoolean, init-value=VeCANR_b_SGCPPIMACSdBusTempPFD5TOValue:0
    VeCANR_b_SGCPPIMACSdBusTmpPFD16TO: service-kind=ANY-STANDARDIZED, invalidation-policy{data-element=VeCANR_b_SGCPPIMACSdBusTmpPFD16TO, handle-invalid=DONT-INVALIDATE}  # Time Out
      data VeCANR_b_SGCPPIMACSdBusTmpPFD16TO: category=VALUE, sw-calibration-access=READ-ONLY, type=ADTSBoolean, init-value=VeCANR_b_SGCPPIMACSdBusTmpPFD16TOValue:0
    VeCANR_b_SGCPPIMDCSdBusTempPFD5TO: service-kind=ANY-STANDARDIZED, invalidation-policy{data-element=VeCANR_b_SGCPPIMDCSdBusTempPFD5TO, handle-invalid=DONT-INVALIDATE}  # Time Out
      data VeCANR_b_SGCPPIMDCSdBusTempPFD5TO: category=VALUE, sw-calibration-access=READ-ONLY, type=ADTSBoolean, init-value=VeCANR_b_SGCPPIMDCSdBusTempPFD5TOValue:0
    VeCANR_b_SGCPPIMDCSdBusTmpPFD16TO: service-kind=ANY-STANDARDIZED, invalidation-policy{data-element=VeCANR_b_SGCPPIMDCSdBusTmpPFD16TO, handle-invalid=DONT-INVALIDATE}  # Time Out
      data VeCANR_b_SGCPPIMDCSdBusTmpPFD16TO: category=VALUE, sw-calibration-access=READ-ONLY, type=ADTSBoolean, init-value=VeCANR_b_SGCPPIMDCSdBusTmpPFD16TOValue:0
    VeCANR_b_SGCPRotorTemp_P_FD16TO: service-kind=ANY-STANDARDIZED, invalidation-policy{data-element=VeCANR_b_SGCPRotorTemp_P_FD16TO, handle-invalid=DONT-INVALIDATE}  # Time Out
      data VeCANR_b_SGCPRotorTemp_P_FD16TO: category=VALUE, sw-calibration-access=READ-ONLY, type=ADTSBoolean, init-value=VeCANR_b_SGCPRotorTemp_P_FD16TOValue:0
    VeCANR_b_SGCPRotorTemp_P_FD5TO: service-kind=ANY-STANDARDIZED, invalidation-policy{data-element=VeCANR_b_SGCPRotorTemp_P_FD5TO, handle-invalid=DONT-INVALIDATE}  # Time Out
      data VeCANR_b_SGCPRotorTemp_P_FD5TO: category=VALUE, sw-calibration-access=READ-ONLY, type=ADTSBoolean, init-value=VeCANR_b_SGCPRotorTemp_P_FD5TOValue:0
    VeCANR_b_SGCPServLampReq_P_FD16: service-kind=ANY-STANDARDIZED, invalidation-policy{data-element=VeCANR_b_SGCPServLampReq_P_FD16, handle-invalid=DONT-INVALIDATE}
      data VeCANR_b_SGCPServLampReq_P_FD16: category=VALUE, sw-calibration-access=READ-ONLY, type=ADTSBoolean, init-value=VeCANR_b_SGCPServLampReq_P_FD16Value:0
    VeCANR_b_SGCPServLampReq_P_FD16TO: service-kind=ANY-STANDARDIZED, invalidation-policy{data-element=VeCANR_b_SGCPServLampReq_P_FD16TO, handle-invalid=DONT-INVALIDATE}  # Time Out
      data VeCANR_b_SGCPServLampReq_P_FD16TO: category=VALUE, sw-calibration-access=READ-ONLY, type=ADTSBoolean, init-value=VeCANR_b_SGCPServLampReq_P_FD16TOValue:0
    VeCANR_b_SGCPServLampReq_P_FD5: service-kind=ANY-STANDARDIZED, invalidation-policy{data-element=VeCANR_b_SGCPServLampReq_P_FD5, handle-invalid=DONT-INVALIDATE}
      data VeCANR_b_SGCPServLampReq_P_FD5: category=VALUE, sw-calibration-access=READ-ONLY, type=ADTSBoolean, init-value=VeCANR_b_SGCPServLampReq_P_FD5Value:0
    VeCANR_b_SGCPServLampReq_P_FD5TO: service-kind=ANY-STANDARDIZED, invalidation-policy{data-element=VeCANR_b_SGCPServLampReq_P_FD5TO, handle-invalid=DONT-INVALIDATE}  # Time Out
      data VeCANR_b_SGCPServLampReq_P_FD5TO: category=VALUE, sw-calibration-access=READ-ONLY, type=ADTSBoolean, init-value=VeCANR_b_SGCPServLampReq_P_FD5TOValue:0
    VeCANR_b_SGCP_CoolantTemp_P_FD5TO: service-kind=ANY-STANDARDIZED, invalidation-policy{data-element=VeCANR_b_SGCP_CoolantTemp_P_FD5TO, handle-invalid=DONT-INVALIDATE}  # Time Out
      data VeCANR_b_SGCP_CoolantTemp_P_FD5TO: category=VALUE, sw-calibration-access=READ-ONLY, type=ADTSBoolean, init-value=VeCANR_b_SGCP_CoolantTemp_P_FD5TOValue:0
    VeCANR_b_SGCP_CoolantTmp_P_FD16TO: service-kind=ANY-STANDARDIZED, invalidation-policy{data-element=VeCANR_b_SGCP_CoolantTmp_P_FD16TO, handle-invalid=DONT-INVALIDATE}  # Time Out
      data VeCANR_b_SGCP_CoolantTmp_P_FD16TO: category=VALUE, sw-calibration-access=READ-ONLY, type=ADTSBoolean, init-value=VeCANR_b_SGCP_CoolantTmp_P_FD16TOValue:0
    VeCANR_b_SGCP_DC_Crrent_V_P_FD5: service-kind=ANY-STANDARDIZED, invalidation-policy{data-element=VeCANR_b_SGCP_DC_Crrent_V_P_FD5, handle-invalid=DONT-INVALIDATE}
      data VeCANR_b_SGCP_DC_Crrent_V_P_FD5: category=VALUE, sw-calibration-access=READ-ONLY, type=ADTSBoolean, init-value=VeCANR_b_SGCP_DC_Crrent_V_P_FD5Value:0
    VeCANR_b_SGCP_DC_Crrent_V_P_FD5TO: service-kind=ANY-STANDARDIZED, invalidation-policy{data-element=VeCANR_b_SGCP_DC_Crrent_V_P_FD5TO, handle-invalid=DONT-INVALIDATE}  # Time Out
      data VeCANR_b_SGCP_DC_Crrent_V_P_FD5TO: category=VALUE, sw-calibration-access=READ-ONLY, type=ADTSBoolean, init-value=VeCANR_b_SGCP_DC_Crrent_V_P_FD5TOValue:0
    VeCANR_b_SGCP_DC_Crrnt_V_P_FD16: service-kind=ANY-STANDARDIZED, invalidation-policy{data-element=VeCANR_b_SGCP_DC_Crrnt_V_P_FD16, handle-invalid=DONT-INVALIDATE}
      data VeCANR_b_SGCP_DC_Crrnt_V_P_FD16: category=VALUE, sw-calibration-access=READ-ONLY, type=ADTSBoolean, init-value=VeCANR_b_SGCP_DC_Crrnt_V_P_FD16Value:0
    VeCANR_b_SGCP_DC_Crrnt_V_P_FD16TO: service-kind=ANY-STANDARDIZED, invalidation-policy{data-element=VeCANR_b_SGCP_DC_Crrnt_V_P_FD16TO, handle-invalid=DONT-INVALIDATE}  # Time Out
      data VeCANR_b_SGCP_DC_Crrnt_V_P_FD16TO: category=VALUE, sw-calibration-access=READ-ONLY, type=ADTSBoolean, init-value=VeCANR_b_SGCP_DC_Crrnt_V_P_FD16TOValue:0
    VeCANR_b_SGCP_DC_Current_P_FD16TO: service-kind=ANY-STANDARDIZED, invalidation-policy{data-element=VeCANR_b_SGCP_DC_Current_P_FD16TO, handle-invalid=DONT-INVALIDATE}  # Time Out
      data VeCANR_b_SGCP_DC_Current_P_FD16TO: category=VALUE, sw-calibration-access=READ-ONLY, type=ADTSBoolean, init-value=VeCANR_b_SGCP_DC_Current_P_FD16TOValue:0
    VeCANR_b_SGCP_DC_Current_P_FD5TO: service-kind=ANY-STANDARDIZED, invalidation-policy{data-element=VeCANR_b_SGCP_DC_Current_P_FD5TO, handle-invalid=DONT-INVALIDATE}  # Time Out
      data VeCANR_b_SGCP_DC_Current_P_FD5TO: category=VALUE, sw-calibration-access=READ-ONLY, type=ADTSBoolean, init-value=VeCANR_b_SGCP_DC_Current_P_FD5TOValue:0
    VeCANR_b_SGCP_DC_Volt_V_P_FD16: service-kind=ANY-STANDARDIZED, invalidation-policy{data-element=VeCANR_b_SGCP_DC_Volt_V_P_FD16, handle-invalid=DONT-INVALIDATE}
      data VeCANR_b_SGCP_DC_Volt_V_P_FD16: category=VALUE, sw-calibration-access=READ-ONLY, type=ADTSBoolean, init-value=VeCANR_b_SGCP_DC_Volt_V_P_FD16Value:0
    VeCANR_b_SGCP_DC_Volt_V_P_FD16TO: service-kind=ANY-STANDARDIZED, invalidation-policy{data-element=VeCANR_b_SGCP_DC_Volt_V_P_FD16TO, handle-invalid=DONT-INVALIDATE}  # Time Out
      data VeCANR_b_SGCP_DC_Volt_V_P_FD16TO: category=VALUE, sw-calibration-access=READ-ONLY, type=ADTSBoolean, init-value=VeCANR_b_SGCP_DC_Volt_V_P_FD16TOValue:0
    VeCANR_b_SGCP_DC_Volt_V_P_FD5: service-kind=ANY-STANDARDIZED, invalidation-policy{data-element=VeCANR_b_SGCP_DC_Volt_V_P_FD5, handle-invalid=DONT-INVALIDATE}
      data VeCANR_b_SGCP_DC_Volt_V_P_FD5: category=VALUE, sw-calibration-access=READ-ONLY, type=ADTSBoolean, init-value=VeCANR_b_SGCP_DC_Volt_V_P_FD5Value:0
    VeCANR_b_SGCP_DC_Volt_V_P_FD5TO: service-kind=ANY-STANDARDIZED, invalidation-policy{data-element=VeCANR_b_SGCP_DC_Volt_V_P_FD5TO, handle-invalid=DONT-INVALIDATE}  # Time Out
      data VeCANR_b_SGCP_DC_Volt_V_P_FD5TO: category=VALUE, sw-calibration-access=READ-ONLY, type=ADTSBoolean, init-value=VeCANR_b_SGCP_DC_Volt_V_P_FD5TOValue:0
    VeCANR_b_SGCP_DC_Voltage_P_FD16TO: service-kind=ANY-STANDARDIZED, invalidation-policy{data-element=VeCANR_b_SGCP_DC_Voltage_P_FD16TO, handle-invalid=DONT-INVALIDATE}  # Time Out
      data VeCANR_b_SGCP_DC_Voltage_P_FD16TO: category=VALUE, sw-calibration-access=READ-ONLY, type=ADTSBoolean, init-value=VeCANR_b_SGCP_DC_Voltage_P_FD16TOValue:0
    VeCANR_b_SGCP_DC_Voltage_P_FD5TO: service-kind=ANY-STANDARDIZED, invalidation-policy{data-element=VeCANR_b_SGCP_DC_Voltage_P_FD5TO, handle-invalid=DONT-INVALIDATE}  # Time Out
      data VeCANR_b_SGCP_DC_Voltage_P_FD5TO: category=VALUE, sw-calibration-access=READ-ONLY, type=ADTSBoolean, init-value=VeCANR_b_SGCP_DC_Voltage_P_FD5TOValue:0
    VeCANR_b_SGCP_DerateResn_P_FD16TO: service-kind=ANY-STANDARDIZED, invalidation-policy{data-element=VeCANR_b_SGCP_DerateResn_P_FD16TO, handle-invalid=DONT-INVALIDATE}  # Time Out
      data VeCANR_b_SGCP_DerateResn_P_FD16TO: category=VALUE, sw-calibration-access=READ-ONLY, type=ADTSBoolean, init-value=VeCANR_b_SGCP_DerateResn_P_FD16TOValue:0
    VeCANR_b_SGCP_DrateReason_P_FD5TO: service-kind=ANY-STANDARDIZED, invalidation-policy{data-element=VeCANR_b_SGCP_DrateReason_P_FD5TO, handle-invalid=DONT-INVALIDATE}  # Time Out
      data VeCANR_b_SGCP_DrateReason_P_FD5TO: category=VALUE, sw-calibration-access=READ-ONLY, type=ADTSBoolean, init-value=VeCANR_b_SGCP_DrateReason_P_FD5TOValue:0
    VeCANR_b_SGCP_InvertTemp_P_FD16TO: service-kind=ANY-STANDARDIZED, invalidation-policy{data-element=VeCANR_b_SGCP_InvertTemp_P_FD16TO, handle-invalid=DONT-INVALIDATE}  # Time Out
      data VeCANR_b_SGCP_InvertTemp_P_FD16TO: category=VALUE, sw-calibration-access=READ-ONLY, type=ADTSBoolean, init-value=VeCANR_b_SGCP_InvertTemp_P_FD16TOValue:0
    VeCANR_b_SGCP_Invert_Temp_P_FD5TO: service-kind=ANY-STANDARDIZED, invalidation-policy{data-element=VeCANR_b_SGCP_Invert_Temp_P_FD5TO, handle-invalid=DONT-INVALIDATE}  # Time Out
      data VeCANR_b_SGCP_Invert_Temp_P_FD5TO: category=VALUE, sw-calibration-access=READ-ONLY, type=ADTSBoolean, init-value=VeCANR_b_SGCP_Invert_Temp_P_FD5TOValue:0
    VeCANR_b_Schedule_Day1TO: service-kind=ANY-STANDARDIZED, invalidation-policy{data-element=VeCANR_b_Schedule_Day1TO, handle-invalid=DONT-INVALIDATE}  # Time Out
      data VeCANR_b_Schedule_Day1TO: category=VALUE, sw-calibration-access=READ-ONLY, type=ADTSBoolean, init-value=VeCANR_b_Schedule_Day1TOValue:0
    VeCANR_b_Schedule_Day2TO: service-kind=ANY-STANDARDIZED, invalidation-policy{data-element=VeCANR_b_Schedule_Day2TO, handle-invalid=DONT-INVALIDATE}  # Time Out
      data VeCANR_b_Schedule_Day2TO: category=VALUE, sw-calibration-access=READ-ONLY, type=ADTSBoolean, init-value=VeCANR_b_Schedule_Day2TOValue:0
    VeCANR_b_Start_Time_Hr1TO: service-kind=ANY-STANDARDIZED, invalidation-policy{data-element=VeCANR_b_Start_Time_Hr1TO, handle-invalid=DONT-INVALIDATE}  # Time Out
      data VeCANR_b_Start_Time_Hr1TO: category=VALUE, sw-calibration-access=READ-ONLY, type=ADTSBoolean, init-value=VeCANR_b_Start_Time_Hr1TOValue:0
    VeCANR_b_Start_Time_Hr2TO: service-kind=ANY-STANDARDIZED, invalidation-policy{data-element=VeCANR_b_Start_Time_Hr2TO, handle-invalid=DONT-INVALIDATE}  # Time Out
      data VeCANR_b_Start_Time_Hr2TO: category=VALUE, sw-calibration-access=READ-ONLY, type=ADTSBoolean, init-value=VeCANR_b_Start_Time_Hr2TOValue:0
    VeCANR_b_Start_Time_Min1TO: service-kind=ANY-STANDARDIZED, invalidation-policy{data-element=VeCANR_b_Start_Time_Min1TO, handle-invalid=DONT-INVALIDATE}  # Time Out
      data VeCANR_b_Start_Time_Min1TO: category=VALUE, sw-calibration-access=READ-ONLY, type=ADTSBoolean, init-value=VeCANR_b_Start_Time_Min1TOValue:0
    VeCANR_b_Start_Time_Min2TO: service-kind=ANY-STANDARDIZED, invalidation-policy{data-element=VeCANR_b_Start_Time_Min2TO, handle-invalid=DONT-INVALIDATE}  # Time Out
      data VeCANR_b_Start_Time_Min2TO: category=VALUE, sw-calibration-access=READ-ONLY, type=ADTSBoolean, init-value=VeCANR_b_Start_Time_Min2TOValue:0
    VeCANR_b_Submit_ClimateSchd1: service-kind=ANY-STANDARDIZED, invalidation-policy{data-element=VeCANR_b_Submit_ClimateSchd1, handle-invalid=DONT-INVALIDATE}
      data VeCANR_b_Submit_ClimateSchd1: category=VALUE, sw-calibration-access=READ-ONLY, type=ADTSBoolean, init-value=VeCANR_b_Submit_ClimateSchd1Value:0
    VeCANR_b_Submit_ClimateSchd1TO: service-kind=ANY-STANDARDIZED, invalidation-policy{data-element=VeCANR_b_Submit_ClimateSchd1TO, handle-invalid=DONT-INVALIDATE}  # Time Out
      data VeCANR_b_Submit_ClimateSchd1TO: category=VALUE, sw-calibration-access=READ-ONLY, type=ADTSBoolean, init-value=VeCANR_b_Submit_ClimateSchd1TOValue:0
    VeCANR_b_Submit_ClimateSchd2: service-kind=ANY-STANDARDIZED, invalidation-policy{data-element=VeCANR_b_Submit_ClimateSchd2, handle-invalid=DONT-INVALIDATE}
      data VeCANR_b_Submit_ClimateSchd2: category=VALUE, sw-calibration-access=READ-ONLY, type=ADTSBoolean, init-value=VeCANR_b_Submit_ClimateSchd2Value:0
    VeCANR_b_Submit_ClimateSchd2TO: service-kind=ANY-STANDARDIZED, invalidation-policy{data-element=VeCANR_b_Submit_ClimateSchd2TO, handle-invalid=DONT-INVALIDATE}  # Time Out
      data VeCANR_b_Submit_ClimateSchd2TO: category=VALUE, sw-calibration-access=READ-ONLY, type=ADTSBoolean, init-value=VeCANR_b_Submit_ClimateSchd2TOValue:0
    VeCANR_b_Submit_Schedule1: service-kind=ANY-STANDARDIZED, invalidation-policy{data-element=VeCANR_b_Submit_Schedule1, handle-invalid=DONT-INVALIDATE}
      data VeCANR_b_Submit_Schedule1: category=VALUE, sw-calibration-access=READ-ONLY, type=ADTSBoolean, init-value=VeCANR_b_Submit_Schedule1Value:0
    VeCANR_b_Submit_Schedule1TO: service-kind=ANY-STANDARDIZED, invalidation-policy{data-element=VeCANR_b_Submit_Schedule1TO, handle-invalid=DONT-INVALIDATE}  # Time Out
      data VeCANR_b_Submit_Schedule1TO: category=VALUE, sw-calibration-access=READ-ONLY, type=ADTSBoolean, init-value=VeCANR_b_Submit_Schedule1TOValue:0
    VeCANR_b_Submit_Schedule2: service-kind=ANY-STANDARDIZED, invalidation-policy{data-element=VeCANR_b_Submit_Schedule2, handle-invalid=DONT-INVALIDATE}
      data VeCANR_b_Submit_Schedule2: category=VALUE, sw-calibration-access=READ-ONLY, type=ADTSBoolean, init-value=VeCANR_b_Submit_Schedule2Value:0
    VeCANR_b_Submit_Schedule2TO: service-kind=ANY-STANDARDIZED, invalidation-policy{data-element=VeCANR_b_Submit_Schedule2TO, handle-invalid=DONT-INVALIDATE}  # Time Out
      data VeCANR_b_Submit_Schedule2TO: category=VALUE, sw-calibration-access=READ-ONLY, type=ADTSBoolean, init-value=VeCANR_b_Submit_Schedule2TOValue:0
    VeCANR_b_TBMChrgSchedulType1ReqTO: service-kind=ANY-STANDARDIZED, invalidation-policy{data-element=VeCANR_b_TBMChrgSchedulType1ReqTO, handle-invalid=DONT-INVALIDATE}  # Time Out
      data VeCANR_b_TBMChrgSchedulType1ReqTO: category=VALUE, sw-calibration-access=READ-ONLY, type=ADTSBoolean, init-value=VeCANR_b_TBMChrgSchedulType1ReqTOValue:0
    VeCANR_b_TBMChrgSchedulType2ReqTO: service-kind=ANY-STANDARDIZED, invalidation-policy{data-element=VeCANR_b_TBMChrgSchedulType2ReqTO, handle-invalid=DONT-INVALIDATE}  # Time Out
      data VeCANR_b_TBMChrgSchedulType2ReqTO: category=VALUE, sw-calibration-access=READ-ONLY, type=ADTSBoolean, init-value=VeCANR_b_TBMChrgSchedulType2ReqTOValue:0
    VeCANR_b_TBMCooperativeChrgCmndTO: service-kind=ANY-STANDARDIZED, invalidation-policy{data-element=VeCANR_b_TBMCooperativeChrgCmndTO, handle-invalid=DONT-INVALIDATE}  # Time Out
      data VeCANR_b_TBMCooperativeChrgCmndTO: category=VALUE, sw-calibration-access=READ-ONLY, type=ADTSBoolean, init-value=VeCANR_b_TBMCooperativeChrgCmndTOValue:0
    VeCANR_b_TBMExtrnlChrgTarget1TO: service-kind=ANY-STANDARDIZED, invalidation-policy{data-element=VeCANR_b_TBMExtrnlChrgTarget1TO, handle-invalid=DONT-INVALIDATE}  # Time Out
      data VeCANR_b_TBMExtrnlChrgTarget1TO: category=VALUE, sw-calibration-access=READ-ONLY, type=ADTSBoolean, init-value=VeCANR_b_TBMExtrnlChrgTarget1TOValue:0
    VeCANR_b_TBMImmediatChrgTarget1TO: service-kind=ANY-STANDARDIZED, invalidation-policy{data-element=VeCANR_b_TBMImmediatChrgTarget1TO, handle-invalid=DONT-INVALIDATE}  # Time Out
      data VeCANR_b_TBMImmediatChrgTarget1TO: category=VALUE, sw-calibration-access=READ-ONLY, type=ADTSBoolean, init-value=VeCANR_b_TBMImmediatChrgTarget1TOValue:0
    VeCANR_b_TBMImmediatChrgTarget2TO: service-kind=ANY-STANDARDIZED, invalidation-policy{data-element=VeCANR_b_TBMImmediatChrgTarget2TO, handle-invalid=DONT-INVALIDATE}  # Time Out
      data VeCANR_b_TBMImmediatChrgTarget2TO: category=VALUE, sw-calibration-access=READ-ONLY, type=ADTSBoolean, init-value=VeCANR_b_TBMImmediatChrgTarget2TOValue:0
    VeCANR_b_TBM_AllowClimateSchd1TO: service-kind=ANY-STANDARDIZED, invalidation-policy{data-element=VeCANR_b_TBM_AllowClimateSchd1TO, handle-invalid=DONT-INVALIDATE}  # Time Out
      data VeCANR_b_TBM_AllowClimateSchd1TO: category=VALUE, sw-calibration-access=READ-ONLY, type=ADTSBoolean, init-value=VeCANR_b_TBM_AllowClimateSchd1TOValue:0
    VeCANR_b_TBM_AllowClimateSchd2TO: service-kind=ANY-STANDARDIZED, invalidation-policy{data-element=VeCANR_b_TBM_AllowClimateSchd2TO, handle-invalid=DONT-INVALIDATE}  # Time Out
      data VeCANR_b_TBM_AllowClimateSchd2TO: category=VALUE, sw-calibration-access=READ-ONLY, type=ADTSBoolean, init-value=VeCANR_b_TBM_AllowClimateSchd2TOValue:0
    VeCANR_b_TBM_ChargeUntilFull1: service-kind=ANY-STANDARDIZED, invalidation-policy{data-element=VeCANR_b_TBM_ChargeUntilFull1, handle-invalid=DONT-INVALIDATE}
      data VeCANR_b_TBM_ChargeUntilFull1: category=VALUE, sw-calibration-access=READ-ONLY, type=ADTSBoolean, init-value=VeCANR_b_TBM_ChargeUntilFull1Value:0
    VeCANR_b_TBM_ChargeUntilFull1TO: service-kind=ANY-STANDARDIZED, invalidation-policy{data-element=VeCANR_b_TBM_ChargeUntilFull1TO, handle-invalid=DONT-INVALIDATE}  # Time Out
      data VeCANR_b_TBM_ChargeUntilFull1TO: category=VALUE, sw-calibration-access=READ-ONLY, type=ADTSBoolean, init-value=VeCANR_b_TBM_ChargeUntilFull1TOValue:0
    VeCANR_b_TBM_ChargeUntilFull2: service-kind=ANY-STANDARDIZED, invalidation-policy{data-element=VeCANR_b_TBM_ChargeUntilFull2, handle-invalid=DONT-INVALIDATE}
      data VeCANR_b_TBM_ChargeUntilFull2: category=VALUE, sw-calibration-access=READ-ONLY, type=ADTSBoolean, init-value=VeCANR_b_TBM_ChargeUntilFull2Value:0
    VeCANR_b_TBM_ChargeUntilFull2TO: service-kind=ANY-STANDARDIZED, invalidation-policy{data-element=VeCANR_b_TBM_ChargeUntilFull2TO, handle-invalid=DONT-INVALIDATE}  # Time Out
      data VeCANR_b_TBM_ChargeUntilFull2TO: category=VALUE, sw-calibration-access=READ-ONLY, type=ADTSBoolean, init-value=VeCANR_b_TBM_ChargeUntilFull2TOValue:0
    VeCANR_b_TBM_Charge_Now: service-kind=ANY-STANDARDIZED, invalidation-policy{data-element=VeCANR_b_TBM_Charge_Now, handle-invalid=DONT-INVALIDATE}
      data VeCANR_b_TBM_Charge_Now: category=VALUE, sw-calibration-access=READ-ONLY, type=ADTSBoolean, init-value=VeCANR_b_TBM_Charge_NowValue:0
    VeCANR_b_TBM_Charge_NowTO: service-kind=ANY-STANDARDIZED, invalidation-policy{data-element=VeCANR_b_TBM_Charge_NowTO, handle-invalid=DONT-INVALIDATE}  # Time Out
      data VeCANR_b_TBM_Charge_NowTO: category=VALUE, sw-calibration-access=READ-ONLY, type=ADTSBoolean, init-value=VeCANR_b_TBM_Charge_NowTOValue:0
    VeCANR_b_TBM_ClimSchd1DprtrHrTO: service-kind=ANY-STANDARDIZED, invalidation-policy{data-element=VeCANR_b_TBM_ClimSchd1DprtrHrTO, handle-invalid=DONT-INVALIDATE}  # Time Out
      data VeCANR_b_TBM_ClimSchd1DprtrHrTO: category=VALUE, sw-calibration-access=READ-ONLY, type=ADTSBoolean, init-value=VeCANR_b_TBM_ClimSchd1DprtrHrTOValue:0
    VeCANR_b_TBM_ClimSchd1DprtrMinTO: service-kind=ANY-STANDARDIZED, invalidation-policy{data-element=VeCANR_b_TBM_ClimSchd1DprtrMinTO, handle-invalid=DONT-INVALIDATE}  # Time Out
      data VeCANR_b_TBM_ClimSchd1DprtrMinTO: category=VALUE, sw-calibration-access=READ-ONLY, type=ADTSBoolean, init-value=VeCANR_b_TBM_ClimSchd1DprtrMinTOValue:0
    VeCANR_b_TBM_ClimSchd2DprtrHrTO: service-kind=ANY-STANDARDIZED, invalidation-policy{data-element=VeCANR_b_TBM_ClimSchd2DprtrHrTO, handle-invalid=DONT-INVALIDATE}  # Time Out
      data VeCANR_b_TBM_ClimSchd2DprtrHrTO: category=VALUE, sw-calibration-access=READ-ONLY, type=ADTSBoolean, init-value=VeCANR_b_TBM_ClimSchd2DprtrHrTOValue:0
    VeCANR_b_TBM_ClimSchd2DprtrMinTO: service-kind=ANY-STANDARDIZED, invalidation-policy{data-element=VeCANR_b_TBM_ClimSchd2DprtrMinTO, handle-invalid=DONT-INVALIDATE}  # Time Out
      data VeCANR_b_TBM_ClimSchd2DprtrMinTO: category=VALUE, sw-calibration-access=READ-ONLY, type=ADTSBoolean, init-value=VeCANR_b_TBM_ClimSchd2DprtrMinTOValue:0
    VeCANR_b_TBM_ClimateSchd1_DayTO: service-kind=ANY-STANDARDIZED, invalidation-policy{data-element=VeCANR_b_TBM_ClimateSchd1_DayTO, handle-invalid=DONT-INVALIDATE}  # Time Out
      data VeCANR_b_TBM_ClimateSchd1_DayTO: category=VALUE, sw-calibration-access=READ-ONLY, type=ADTSBoolean, init-value=VeCANR_b_TBM_ClimateSchd1_DayTOValue:0
    VeCANR_b_TBM_ClimateSchd2_DayTO: service-kind=ANY-STANDARDIZED, invalidation-policy{data-element=VeCANR_b_TBM_ClimateSchd2_DayTO, handle-invalid=DONT-INVALIDATE}  # Time Out
      data VeCANR_b_TBM_ClimateSchd2_DayTO: category=VALUE, sw-calibration-access=READ-ONLY, type=ADTSBoolean, init-value=VeCANR_b_TBM_ClimateSchd2_DayTOValue:0
    VeCANR_b_TBM_EnableClimateSchd1: service-kind=ANY-STANDARDIZED, invalidation-policy{data-element=VeCANR_b_TBM_EnableClimateSchd1, handle-invalid=DONT-INVALIDATE}
      data VeCANR_b_TBM_EnableClimateSchd1: category=VALUE, sw-calibration-access=READ-ONLY, type=ADTSBoolean, init-value=VeCANR_b_TBM_EnableClimateSchd1Value:0
    VeCANR_b_TBM_EnableClimateSchd1TO: service-kind=ANY-STANDARDIZED, invalidation-policy{data-element=VeCANR_b_TBM_EnableClimateSchd1TO, handle-invalid=DONT-INVALIDATE}  # Time Out
      data VeCANR_b_TBM_EnableClimateSchd1TO: category=VALUE, sw-calibration-access=READ-ONLY, type=ADTSBoolean, init-value=VeCANR_b_TBM_EnableClimateSchd1TOValue:0
    VeCANR_b_TBM_EnableClimateSchd2: service-kind=ANY-STANDARDIZED, invalidation-policy{data-element=VeCANR_b_TBM_EnableClimateSchd2, handle-invalid=DONT-INVALIDATE}
      data VeCANR_b_TBM_EnableClimateSchd2: category=VALUE, sw-calibration-access=READ-ONLY, type=ADTSBoolean, init-value=VeCANR_b_TBM_EnableClimateSchd2Value:0
    VeCANR_b_TBM_EnableClimateSchd2TO: service-kind=ANY-STANDARDIZED, invalidation-policy{data-element=VeCANR_b_TBM_EnableClimateSchd2TO, handle-invalid=DONT-INVALIDATE}  # Time Out
      data VeCANR_b_TBM_EnableClimateSchd2TO: category=VALUE, sw-calibration-access=READ-ONLY, type=ADTSBoolean, init-value=VeCANR_b_TBM_EnableClimateSchd2TOValue:0
    VeCANR_b_TBM_Enable_Schedule1: service-kind=ANY-STANDARDIZED, invalidation-policy{data-element=VeCANR_b_TBM_Enable_Schedule1, handle-invalid=DONT-INVALIDATE}
      data VeCANR_b_TBM_Enable_Schedule1: category=VALUE, sw-calibration-access=READ-ONLY, type=ADTSBoolean, init-value=VeCANR_b_TBM_Enable_Schedule1Value:0
    VeCANR_b_TBM_Enable_Schedule1TO: service-kind=ANY-STANDARDIZED, invalidation-policy{data-element=VeCANR_b_TBM_Enable_Schedule1TO, handle-invalid=DONT-INVALIDATE}  # Time Out
      data VeCANR_b_TBM_Enable_Schedule1TO: category=VALUE, sw-calibration-access=READ-ONLY, type=ADTSBoolean, init-value=VeCANR_b_TBM_Enable_Schedule1TOValue:0
    VeCANR_b_TBM_Enable_Schedule2: service-kind=ANY-STANDARDIZED, invalidation-policy{data-element=VeCANR_b_TBM_Enable_Schedule2, handle-invalid=DONT-INVALIDATE}
      data VeCANR_b_TBM_Enable_Schedule2: category=VALUE, sw-calibration-access=READ-ONLY, type=ADTSBoolean, init-value=VeCANR_b_TBM_Enable_Schedule2Value:0
    VeCANR_b_TBM_Enable_Schedule2TO: service-kind=ANY-STANDARDIZED, invalidation-policy{data-element=VeCANR_b_TBM_Enable_Schedule2TO, handle-invalid=DONT-INVALIDATE}  # Time Out
      data VeCANR_b_TBM_Enable_Schedule2TO: category=VALUE, sw-calibration-access=READ-ONLY, type=ADTSBoolean, init-value=VeCANR_b_TBM_Enable_Schedule2TOValue:0
    VeCANR_b_TBM_End_Time_Hr1TO: service-kind=ANY-STANDARDIZED, invalidation-policy{data-element=VeCANR_b_TBM_End_Time_Hr1TO, handle-invalid=DONT-INVALIDATE}  # Time Out
      data VeCANR_b_TBM_End_Time_Hr1TO: category=VALUE, sw-calibration-access=READ-ONLY, type=ADTSBoolean, init-value=VeCANR_b_TBM_End_Time_Hr1TOValue:0
    VeCANR_b_TBM_End_Time_Hr2TO: service-kind=ANY-STANDARDIZED, invalidation-policy{data-element=VeCANR_b_TBM_End_Time_Hr2TO, handle-invalid=DONT-INVALIDATE}  # Time Out
      data VeCANR_b_TBM_End_Time_Hr2TO: category=VALUE, sw-calibration-access=READ-ONLY, type=ADTSBoolean, init-value=VeCANR_b_TBM_End_Time_Hr2TOValue:0
    VeCANR_b_TBM_End_Time_Min1TO: service-kind=ANY-STANDARDIZED, invalidation-policy{data-element=VeCANR_b_TBM_End_Time_Min1TO, handle-invalid=DONT-INVALIDATE}  # Time Out
      data VeCANR_b_TBM_End_Time_Min1TO: category=VALUE, sw-calibration-access=READ-ONLY, type=ADTSBoolean, init-value=VeCANR_b_TBM_End_Time_Min1TOValue:0
    VeCANR_b_TBM_End_Time_Min2TO: service-kind=ANY-STANDARDIZED, invalidation-policy{data-element=VeCANR_b_TBM_End_Time_Min2TO, handle-invalid=DONT-INVALIDATE}  # Time Out
      data VeCANR_b_TBM_End_Time_Min2TO: category=VALUE, sw-calibration-access=READ-ONLY, type=ADTSBoolean, init-value=VeCANR_b_TBM_End_Time_Min2TOValue:0
    VeCANR_b_TBM_ExtrnlChargTarget2TO: service-kind=ANY-STANDARDIZED, invalidation-policy{data-element=VeCANR_b_TBM_ExtrnlChargTarget2TO, handle-invalid=DONT-INVALIDATE}  # Time Out
      data VeCANR_b_TBM_ExtrnlChargTarget2TO: category=VALUE, sw-calibration-access=READ-ONLY, type=ADTSBoolean, init-value=VeCANR_b_TBM_ExtrnlChargTarget2TOValue:0
    VeCANR_b_TBM_Schedule_Day1TO: service-kind=ANY-STANDARDIZED, invalidation-policy{data-element=VeCANR_b_TBM_Schedule_Day1TO, handle-invalid=DONT-INVALIDATE}  # Time Out
      data VeCANR_b_TBM_Schedule_Day1TO: category=VALUE, sw-calibration-access=READ-ONLY, type=ADTSBoolean, init-value=VeCANR_b_TBM_Schedule_Day1TOValue:0
    VeCANR_b_TBM_Schedule_Day2TO: service-kind=ANY-STANDARDIZED, invalidation-policy{data-element=VeCANR_b_TBM_Schedule_Day2TO, handle-invalid=DONT-INVALIDATE}  # Time Out
      data VeCANR_b_TBM_Schedule_Day2TO: category=VALUE, sw-calibration-access=READ-ONLY, type=ADTSBoolean, init-value=VeCANR_b_TBM_Schedule_Day2TOValue:0
    VeCANR_b_TBM_Start_Time_Hr1TO: service-kind=ANY-STANDARDIZED, invalidation-policy{data-element=VeCANR_b_TBM_Start_Time_Hr1TO, handle-invalid=DONT-INVALIDATE}  # Time Out
      data VeCANR_b_TBM_Start_Time_Hr1TO: category=VALUE, sw-calibration-access=READ-ONLY, type=ADTSBoolean, init-value=VeCANR_b_TBM_Start_Time_Hr1TOValue:0
    VeCANR_b_TBM_Start_Time_Hr2TO: service-kind=ANY-STANDARDIZED, invalidation-policy{data-element=VeCANR_b_TBM_Start_Time_Hr2TO, handle-invalid=DONT-INVALIDATE}  # Time Out
      data VeCANR_b_TBM_Start_Time_Hr2TO: category=VALUE, sw-calibration-access=READ-ONLY, type=ADTSBoolean, init-value=VeCANR_b_TBM_Start_Time_Hr2TOValue:0
    VeCANR_b_TBM_Start_Time_Min1TO: service-kind=ANY-STANDARDIZED, invalidation-policy{data-element=VeCANR_b_TBM_Start_Time_Min1TO, handle-invalid=DONT-INVALIDATE}  # Time Out
      data VeCANR_b_TBM_Start_Time_Min1TO: category=VALUE, sw-calibration-access=READ-ONLY, type=ADTSBoolean, init-value=VeCANR_b_TBM_Start_Time_Min1TOValue:0
    VeCANR_b_TBM_Start_Time_Min2TO: service-kind=ANY-STANDARDIZED, invalidation-policy{data-element=VeCANR_b_TBM_Start_Time_Min2TO, handle-invalid=DONT-INVALIDATE}  # Time Out
      data VeCANR_b_TBM_Start_Time_Min2TO: category=VALUE, sw-calibration-access=READ-ONLY, type=ADTSBoolean, init-value=VeCANR_b_TBM_Start_Time_Min2TOValue:0
    VeCANR_b_TBM_StopCharge: service-kind=ANY-STANDARDIZED, invalidation-policy{data-element=VeCANR_b_TBM_StopCharge, handle-invalid=DONT-INVALIDATE}
      data VeCANR_b_TBM_StopCharge: category=VALUE, sw-calibration-access=READ-ONLY, type=ADTSBoolean, init-value=VeCANR_b_TBM_StopChargeValue:0
    VeCANR_b_TBM_StopChargeTO: service-kind=ANY-STANDARDIZED, invalidation-policy{data-element=VeCANR_b_TBM_StopChargeTO, handle-invalid=DONT-INVALIDATE}  # Time Out
      data VeCANR_b_TBM_StopChargeTO: category=VALUE, sw-calibration-access=READ-ONLY, type=ADTSBoolean, init-value=VeCANR_b_TBM_StopChargeTOValue:0
    VeCANR_b_TBM_SubmitClimateSchd1: service-kind=ANY-STANDARDIZED, invalidation-policy{data-element=VeCANR_b_TBM_SubmitClimateSchd1, handle-invalid=DONT-INVALIDATE}
      data VeCANR_b_TBM_SubmitClimateSchd1: category=VALUE, sw-calibration-access=READ-ONLY, type=ADTSBoolean, init-value=VeCANR_b_TBM_SubmitClimateSchd1Value:0
    VeCANR_b_TBM_SubmitClimateSchd1TO: service-kind=ANY-STANDARDIZED, invalidation-policy{data-element=VeCANR_b_TBM_SubmitClimateSchd1TO, handle-invalid=DONT-INVALIDATE}  # Time Out
      data VeCANR_b_TBM_SubmitClimateSchd1TO: category=VALUE, sw-calibration-access=READ-ONLY, type=ADTSBoolean, init-value=VeCANR_b_TBM_SubmitClimateSchd1TOValue:0
    VeCANR_b_TBM_SubmitClimateSchd2: service-kind=ANY-STANDARDIZED, invalidation-policy{data-element=VeCANR_b_TBM_SubmitClimateSchd2, handle-invalid=DONT-INVALIDATE}
      data VeCANR_b_TBM_SubmitClimateSchd2: category=VALUE, sw-calibration-access=READ-ONLY, type=ADTSBoolean, init-value=VeCANR_b_TBM_SubmitClimateSchd2Value:0
    VeCANR_b_TBM_SubmitClimateSchd2TO: service-kind=ANY-STANDARDIZED, invalidation-policy{data-element=VeCANR_b_TBM_SubmitClimateSchd2TO, handle-invalid=DONT-INVALIDATE}  # Time Out
      data VeCANR_b_TBM_SubmitClimateSchd2TO: category=VALUE, sw-calibration-access=READ-ONLY, type=ADTSBoolean, init-value=VeCANR_b_TBM_SubmitClimateSchd2TOValue:0
    VeCANR_b_TBM_Submit_Schedule1: service-kind=ANY-STANDARDIZED, invalidation-policy{data-element=VeCANR_b_TBM_Submit_Schedule1, handle-invalid=DONT-INVALIDATE}
      data VeCANR_b_TBM_Submit_Schedule1: category=VALUE, sw-calibration-access=READ-ONLY, type=ADTSBoolean, init-value=VeCANR_b_TBM_Submit_Schedule1Value:0
    VeCANR_b_TBM_Submit_Schedule1TO: service-kind=ANY-STANDARDIZED, invalidation-policy{data-element=VeCANR_b_TBM_Submit_Schedule1TO, handle-invalid=DONT-INVALIDATE}  # Time Out
      data VeCANR_b_TBM_Submit_Schedule1TO: category=VALUE, sw-calibration-access=READ-ONLY, type=ADTSBoolean, init-value=VeCANR_b_TBM_Submit_Schedule1TOValue:0
    VeCANR_b_TBM_Submit_Schedule2: service-kind=ANY-STANDARDIZED, invalidation-policy{data-element=VeCANR_b_TBM_Submit_Schedule2, handle-invalid=DONT-INVALIDATE}
      data VeCANR_b_TBM_Submit_Schedule2: category=VALUE, sw-calibration-access=READ-ONLY, type=ADTSBoolean, init-value=VeCANR_b_TBM_Submit_Schedule2Value:0
    VeCANR_b_TBM_Submit_Schedule2TO: service-kind=ANY-STANDARDIZED, invalidation-policy{data-element=VeCANR_b_TBM_Submit_Schedule2TO, handle-invalid=DONT-INVALIDATE}  # Time Out
      data VeCANR_b_TBM_Submit_Schedule2TO: category=VALUE, sw-calibration-access=READ-ONLY, type=ADTSBoolean, init-value=VeCANR_b_TBM_Submit_Schedule2TOValue:0
    VeCANR_b_TerrainModeStat_ECM_TO: service-kind=ANY-STANDARDIZED, invalidation-policy{data-element=VeCANR_b_TerrainModeStat_ECM_TO, handle-invalid=DONT-INVALIDATE}  # Time Out
      data VeCANR_b_TerrainModeStat_ECM_TO: category=VALUE, sw-calibration-access=READ-ONLY, type=ADTSBoolean, init-value=VeCANR_b_TerrainModeStat_ECM_TOValue:0
    VeCANR_b_Trns_DrvMdReqTO: service-kind=ANY-STANDARDIZED, invalidation-policy{data-element=VeCANR_b_Trns_DrvMdReqTO, handle-invalid=DONT-INVALIDATE}  # Time Out
      data VeCANR_b_Trns_DrvMdReqTO: category=VALUE, sw-calibration-access=READ-ONLY, type=ADTSBoolean, init-value=VeCANR_b_Trns_DrvMdReqTOValue:0
    VeCANR_b_V2H_HVCMS_EVSEMxPLtFD5TO: service-kind=ANY-STANDARDIZED, invalidation-policy{data-element=VeCANR_b_V2H_HVCMS_EVSEMxPLtFD5TO, handle-invalid=DONT-INVALIDATE}  # Time Out
      data VeCANR_b_V2H_HVCMS_EVSEMxPLtFD5TO: category=VALUE, sw-calibration-access=READ-ONLY, type=ADTSBoolean, init-value=VeCANR_b_V2H_HVCMS_EVSEMxPLtFD5TOValue:0
    VeCANR_b_V2H_Mode_Req: service-kind=ANY-STANDARDIZED, invalidation-policy{data-element=VeCANR_b_V2H_Mode_Req, handle-invalid=DONT-INVALIDATE}
      data VeCANR_b_V2H_Mode_Req: category=VALUE, sw-calibration-access=READ-ONLY, type=ADTSBoolean, init-value=VeCANR_b_V2H_Mode_ReqValue:0
    VeCANR_b_V2H_Mode_ReqTO: service-kind=ANY-STANDARDIZED, invalidation-policy{data-element=VeCANR_b_V2H_Mode_ReqTO, handle-invalid=DONT-INVALIDATE}  # Time Out
      data VeCANR_b_V2H_Mode_ReqTO: category=VALUE, sw-calibration-access=READ-ONLY, type=ADTSBoolean, init-value=VeCANR_b_V2H_Mode_ReqTOValue:0
    VeCANR_b_V2H_Req: service-kind=ANY-STANDARDIZED, invalidation-policy{data-element=VeCANR_b_V2H_Req, handle-invalid=DONT-INVALIDATE}
      data VeCANR_b_V2H_Req: category=VALUE, sw-calibration-access=READ-ONLY, type=ADTSBoolean, init-value=VeCANR_b_V2H_ReqValue:0
    VeCANR_b_V2H_ReqTO: service-kind=ANY-STANDARDIZED, invalidation-policy{data-element=VeCANR_b_V2H_ReqTO, handle-invalid=DONT-INVALIDATE}  # Time Out
      data VeCANR_b_V2H_ReqTO: category=VALUE, sw-calibration-access=READ-ONLY, type=ADTSBoolean, init-value=VeCANR_b_V2H_ReqTOValue:0
    VeCANR_b_V2H_Reserve_BatteryTO: service-kind=ANY-STANDARDIZED, invalidation-policy{data-element=VeCANR_b_V2H_Reserve_BatteryTO, handle-invalid=DONT-INVALIDATE}  # Time Out
      data VeCANR_b_V2H_Reserve_BatteryTO: category=VALUE, sw-calibration-access=READ-ONLY, type=ADTSBoolean, init-value=VeCANR_b_V2H_Reserve_BatteryTOValue:0
    VeCANR_b_V2H_Submit: service-kind=ANY-STANDARDIZED, invalidation-policy{data-element=VeCANR_b_V2H_Submit, handle-invalid=DONT-INVALIDATE}
      data VeCANR_b_V2H_Submit: category=VALUE, sw-calibration-access=READ-ONLY, type=ADTSBoolean, init-value=VeCANR_b_V2H_SubmitValue:0
    VeCANR_b_V2H_SubmitTO: service-kind=ANY-STANDARDIZED, invalidation-policy{data-element=VeCANR_b_V2H_SubmitTO, handle-invalid=DONT-INVALIDATE}  # Time Out
      data VeCANR_b_V2H_SubmitTO: category=VALUE, sw-calibration-access=READ-ONLY, type=ADTSBoolean, init-value=VeCANR_b_V2H_SubmitTOValue:0
    VeCANR_b_V2L_All_Req: service-kind=ANY-STANDARDIZED, invalidation-policy{data-element=VeCANR_b_V2L_All_Req, handle-invalid=DONT-INVALIDATE}
      data VeCANR_b_V2L_All_Req: category=VALUE, sw-calibration-access=READ-ONLY, type=ADTSBoolean, init-value=VeCANR_b_V2L_All_ReqValue:0
    VeCANR_b_V2L_All_ReqTO: service-kind=ANY-STANDARDIZED, invalidation-policy{data-element=VeCANR_b_V2L_All_ReqTO, handle-invalid=DONT-INVALIDATE}  # Time Out
      data VeCANR_b_V2L_All_ReqTO: category=VALUE, sw-calibration-access=READ-ONLY, type=ADTSBoolean, init-value=VeCANR_b_V2L_All_ReqTOValue:0
    VeCANR_b_V2L_Frunk_Req: service-kind=ANY-STANDARDIZED, invalidation-policy{data-element=VeCANR_b_V2L_Frunk_Req, handle-invalid=DONT-INVALIDATE}
      data VeCANR_b_V2L_Frunk_Req: category=VALUE, sw-calibration-access=READ-ONLY, type=ADTSBoolean, init-value=VeCANR_b_V2L_Frunk_ReqValue:0
    VeCANR_b_V2L_Frunk_ReqTO: service-kind=ANY-STANDARDIZED, invalidation-policy{data-element=VeCANR_b_V2L_Frunk_ReqTO, handle-invalid=DONT-INVALIDATE}  # Time Out
      data VeCANR_b_V2L_Frunk_ReqTO: category=VALUE, sw-calibration-access=READ-ONLY, type=ADTSBoolean, init-value=VeCANR_b_V2L_Frunk_ReqTOValue:0
    VeCANR_b_V2L_Mode_Req: service-kind=ANY-STANDARDIZED, invalidation-policy{data-element=VeCANR_b_V2L_Mode_Req, handle-invalid=DONT-INVALIDATE}
      data VeCANR_b_V2L_Mode_Req: category=VALUE, sw-calibration-access=READ-ONLY, type=ADTSBoolean, init-value=VeCANR_b_V2L_Mode_ReqValue:0
    VeCANR_b_V2L_Mode_ReqTO: service-kind=ANY-STANDARDIZED, invalidation-policy{data-element=VeCANR_b_V2L_Mode_ReqTO, handle-invalid=DONT-INVALIDATE}  # Time Out
      data VeCANR_b_V2L_Mode_ReqTO: category=VALUE, sw-calibration-access=READ-ONLY, type=ADTSBoolean, init-value=VeCANR_b_V2L_Mode_ReqTOValue:0
    VeCANR_b_V2L_Reserve_BatteryTO: service-kind=ANY-STANDARDIZED, invalidation-policy{data-element=VeCANR_b_V2L_Reserve_BatteryTO, handle-invalid=DONT-INVALIDATE}  # Time Out
      data VeCANR_b_V2L_Reserve_BatteryTO: category=VALUE, sw-calibration-access=READ-ONLY, type=ADTSBoolean, init-value=VeCANR_b_V2L_Reserve_BatteryTOValue:0
    VeCANR_b_V2L_Submit: service-kind=ANY-STANDARDIZED, invalidation-policy{data-element=VeCANR_b_V2L_Submit, handle-invalid=DONT-INVALIDATE}
      data VeCANR_b_V2L_Submit: category=VALUE, sw-calibration-access=READ-ONLY, type=ADTSBoolean, init-value=VeCANR_b_V2L_SubmitValue:0
    VeCANR_b_V2L_SubmitTO: service-kind=ANY-STANDARDIZED, invalidation-policy{data-element=VeCANR_b_V2L_SubmitTO, handle-invalid=DONT-INVALIDATE}  # Time Out
      data VeCANR_b_V2L_SubmitTO: category=VALUE, sw-calibration-access=READ-ONLY, type=ADTSBoolean, init-value=VeCANR_b_V2L_SubmitTOValue:0
    VeCANR_b_V2L_Trunk_Req: service-kind=ANY-STANDARDIZED, invalidation-policy{data-element=VeCANR_b_V2L_Trunk_Req, handle-invalid=DONT-INVALIDATE}
      data VeCANR_b_V2L_Trunk_Req: category=VALUE, sw-calibration-access=READ-ONLY, type=ADTSBoolean, init-value=VeCANR_b_V2L_Trunk_ReqValue:0
    VeCANR_b_V2L_Trunk_ReqTO: service-kind=ANY-STANDARDIZED, invalidation-policy{data-element=VeCANR_b_V2L_Trunk_ReqTO, handle-invalid=DONT-INVALIDATE}  # Time Out
      data VeCANR_b_V2L_Trunk_ReqTO: category=VALUE, sw-calibration-access=READ-ONLY, type=ADTSBoolean, init-value=VeCANR_b_V2L_Trunk_ReqTOValue:0
    VeCANR_b_V2V_Mode_Req: service-kind=ANY-STANDARDIZED, invalidation-policy{data-element=VeCANR_b_V2V_Mode_Req, handle-invalid=DONT-INVALIDATE}
      data VeCANR_b_V2V_Mode_Req: category=VALUE, sw-calibration-access=READ-ONLY, type=ADTSBoolean, init-value=VeCANR_b_V2V_Mode_ReqValue:0
    VeCANR_b_V2V_Mode_ReqTO: service-kind=ANY-STANDARDIZED, invalidation-policy{data-element=VeCANR_b_V2V_Mode_ReqTO, handle-invalid=DONT-INVALIDATE}  # Time Out
      data VeCANR_b_V2V_Mode_ReqTO: category=VALUE, sw-calibration-access=READ-ONLY, type=ADTSBoolean, init-value=VeCANR_b_V2V_Mode_ReqTOValue:0
    VeCANR_b_V2V_Req: service-kind=ANY-STANDARDIZED, invalidation-policy{data-element=VeCANR_b_V2V_Req, handle-invalid=DONT-INVALIDATE}
      data VeCANR_b_V2V_Req: category=VALUE, sw-calibration-access=READ-ONLY, type=ADTSBoolean, init-value=VeCANR_b_V2V_ReqValue:0
    VeCANR_b_V2V_ReqTO: service-kind=ANY-STANDARDIZED, invalidation-policy{data-element=VeCANR_b_V2V_ReqTO, handle-invalid=DONT-INVALIDATE}  # Time Out
      data VeCANR_b_V2V_ReqTO: category=VALUE, sw-calibration-access=READ-ONLY, type=ADTSBoolean, init-value=VeCANR_b_V2V_ReqTOValue:0
    VeCANR_b_V2V_Reserve_BatteryTO: service-kind=ANY-STANDARDIZED, invalidation-policy{data-element=VeCANR_b_V2V_Reserve_BatteryTO, handle-invalid=DONT-INVALIDATE}  # Time Out
      data VeCANR_b_V2V_Reserve_BatteryTO: category=VALUE, sw-calibration-access=READ-ONLY, type=ADTSBoolean, init-value=VeCANR_b_V2V_Reserve_BatteryTOValue:0
    VeCANR_b_V2V_Submit: service-kind=ANY-STANDARDIZED, invalidation-policy{data-element=VeCANR_b_V2V_Submit, handle-invalid=DONT-INVALIDATE}
      data VeCANR_b_V2V_Submit: category=VALUE, sw-calibration-access=READ-ONLY, type=ADTSBoolean, init-value=VeCANR_b_V2V_SubmitValue:0
    VeCANR_b_V2V_SubmitTO: service-kind=ANY-STANDARDIZED, invalidation-policy{data-element=VeCANR_b_V2V_SubmitTO, handle-invalid=DONT-INVALIDATE}  # Time Out
      data VeCANR_b_V2V_SubmitTO: category=VALUE, sw-calibration-access=READ-ONLY, type=ADTSBoolean, init-value=VeCANR_b_V2V_SubmitTOValue:0
    VeCANR_b_VIN_DATA_TO: service-kind=ANY-STANDARDIZED, invalidation-policy{data-element=VeCANR_b_VIN_DATA_TO, handle-invalid=DONT-INVALIDATE}  # Time Out
      data VeCANR_b_VIN_DATA_TO: category=VALUE, sw-calibration-access=READ-ONLY, type=ADTSBoolean, init-value=VeCANR_b_VIN_DATA_TOValue:0
    VeCANR_b_VIN_MSG_TO: service-kind=ANY-STANDARDIZED, invalidation-policy{data-element=VeCANR_b_VIN_MSG_TO, handle-invalid=DONT-INVALIDATE}  # Time Out
      data VeCANR_b_VIN_MSG_TO: category=VALUE, sw-calibration-access=READ-ONLY, type=ADTSBoolean, init-value=VeCANR_b_VIN_MSG_TOValue:0
    VeCANR_b_VltgChgEVSE_TO: service-kind=ANY-STANDARDIZED, invalidation-policy{data-element=VeCANR_b_VltgChgEVSE_TO, handle-invalid=DONT-INVALIDATE}  # Time Out
      data VeCANR_b_VltgChgEVSE_TO: category=VALUE, sw-calibration-access=READ-ONLY, type=ADTSBoolean, init-value=VeCANR_b_VltgChgEVSE_TOValue:0
    VeCANR_b_VltgChgIntTO: service-kind=ANY-STANDARDIZED, invalidation-policy{data-element=VeCANR_b_VltgChgIntTO, handle-invalid=DONT-INVALIDATE}  # Time Out
      data VeCANR_b_VltgChgIntTO: category=VALUE, sw-calibration-access=READ-ONLY, type=ADTSBoolean, init-value=VeCANR_b_VltgChgIntTOValue:0
    VeCANR_b_Wrng_PackTempHigh_FD11: service-kind=ANY-STANDARDIZED, invalidation-policy{data-element=VeCANR_b_Wrng_PackTempHigh_FD11, handle-invalid=DONT-INVALIDATE}
      data VeCANR_b_Wrng_PackTempHigh_FD11: category=VALUE, sw-calibration-access=READ-ONLY, type=ADTSBoolean, init-value=VeCANR_b_Wrng_PackTempHigh_FD11Value:0
    VeCANR_b_Wrng_PackTempHigh_FD11TO: service-kind=ANY-STANDARDIZED, invalidation-policy{data-element=VeCANR_b_Wrng_PackTempHigh_FD11TO, handle-invalid=DONT-INVALIDATE}  # Time Out
      data VeCANR_b_Wrng_PackTempHigh_FD11TO: category=VALUE, sw-calibration-access=READ-ONLY, type=ADTSBoolean, init-value=VeCANR_b_Wrng_PackTempHigh_FD11TOValue:0
    VeCANR_b_Year1_TLM_TO: service-kind=ANY-STANDARDIZED, invalidation-policy{data-element=VeCANR_b_Year1_TLM_TO, handle-invalid=DONT-INVALIDATE}  # Time Out
      data VeCANR_b_Year1_TLM_TO: category=VALUE, sw-calibration-access=READ-ONLY, type=ADTSBoolean, init-value=VeCANR_b_Year1_TLM_TOValue:0
    VeCANR_b_Year2_TLM_TO: service-kind=ANY-STANDARDIZED, invalidation-policy{data-element=VeCANR_b_Year2_TLM_TO, handle-invalid=DONT-INVALIDATE}  # Time Out
      data VeCANR_b_Year2_TLM_TO: category=VALUE, sw-calibration-access=READ-ONLY, type=ADTSBoolean, init-value=VeCANR_b_Year2_TLM_TOValue:0
    VeCANR_b_Year3_TLM_TO: service-kind=ANY-STANDARDIZED, invalidation-policy{data-element=VeCANR_b_Year3_TLM_TO, handle-invalid=DONT-INVALIDATE}  # Time Out
      data VeCANR_b_Year3_TLM_TO: category=VALUE, sw-calibration-access=READ-ONLY, type=ADTSBoolean, init-value=VeCANR_b_Year3_TLM_TOValue:0
    VeCANR_b_Year4_TLM_TO: service-kind=ANY-STANDARDIZED, invalidation-policy{data-element=VeCANR_b_Year4_TLM_TO, handle-invalid=DONT-INVALIDATE}  # Time Out
      data VeCANR_b_Year4_TLM_TO: category=VALUE, sw-calibration-access=READ-ONLY, type=ADTSBoolean, init-value=VeCANR_b_Year4_TLM_TOValue:0
    VeCANR_cmp_Charging_WHr_FD5: service-kind=ANY-STANDARDIZED, invalidation-policy{data-element=VeCANR_cmp_Charging_WHr_FD5, handle-invalid=KEEP}
      data VeCANR_cmp_Charging_WHr_FD5: category=VALUE, sw-calibration-access=READ-ONLY, type=ADTSCharging_WHr_FD5, init-value=VeCANR_cmp_Charging_WHr_FD5Value:0
    VeCANR_cmp_GPS_Date_Month: service-kind=ANY-STANDARDIZED, invalidation-policy{data-element=VeCANR_cmp_GPS_Date_Month, handle-invalid=KEEP}
      data VeCANR_cmp_GPS_Date_Month: category=VALUE, sw-calibration-access=READ-ONLY, type=ADTSGPS_Date_Month, init-value=VeCANR_cmp_GPS_Date_MonthValue:255
    VeCANR_cmp_N_PDU_343_FD11: service-kind=ANY-STANDARDIZED, invalidation-policy{data-element=VeCANR_cmp_N_PDU_343_FD11, handle-invalid=DONT-INVALIDATE}
      data VeCANR_cmp_N_PDU_343_FD11: category=VALUE, sw-calibration-access=READ-ONLY, type=ADTSN_PDU_343_FD11, init-value=VeCANR_cmp_N_PDU_343_FD11Value:0
    VeCANR_cmp_N_PDU_343_FD3: service-kind=ANY-STANDARDIZED, invalidation-policy{data-element=VeCANR_cmp_N_PDU_343_FD3, handle-invalid=DONT-INVALIDATE}
      data VeCANR_cmp_N_PDU_343_FD3: category=VALUE, sw-calibration-access=READ-ONLY, type=ADTSN_PDU_343_FD3, init-value=VeCANR_cmp_N_PDU_343_FD3Value:0
    VeCANR_cmp_N_PDU_7B_FD16: service-kind=ANY-STANDARDIZED, invalidation-policy{data-element=VeCANR_cmp_N_PDU_7B_FD16, handle-invalid=DONT-INVALIDATE}
      data VeCANR_cmp_N_PDU_7B_FD16: category=VALUE, sw-calibration-access=READ-ONLY, type=ADTSN_PDU_7B_FD16, init-value=VeCANR_cmp_N_PDU_7B_FD16Value:0
    VeCANR_cmp_N_PDU_7B_FD5: service-kind=ANY-STANDARDIZED, invalidation-policy{data-element=VeCANR_cmp_N_PDU_7B_FD5, handle-invalid=DONT-INVALIDATE}
      data VeCANR_cmp_N_PDU_7B_FD5: category=VALUE, sw-calibration-access=READ-ONLY, type=ADTSN_PDU_7B_FD5, init-value=VeCANR_cmp_N_PDU_7B_FD5Value:0
    VeCANR_cmp_N_PDU_7C_FD16: service-kind=ANY-STANDARDIZED, invalidation-policy{data-element=VeCANR_cmp_N_PDU_7C_FD16, handle-invalid=DONT-INVALIDATE}
      data VeCANR_cmp_N_PDU_7C_FD16: category=VALUE, sw-calibration-access=READ-ONLY, type=ADTSN_PDU_7C_FD16, init-value=VeCANR_cmp_N_PDU_7C_FD16Value:0
    VeCANR_cmp_N_PDU_7C_FD5: service-kind=ANY-STANDARDIZED, invalidation-policy{data-element=VeCANR_cmp_N_PDU_7C_FD5, handle-invalid=DONT-INVALIDATE}
      data VeCANR_cmp_N_PDU_7C_FD5: category=VALUE, sw-calibration-access=READ-ONLY, type=ADTSN_PDU_7C_FD5, init-value=VeCANR_cmp_N_PDU_7C_FD5Value:0
    VeCANR_cmp_N_PDU_7E_FD11: service-kind=ANY-STANDARDIZED, invalidation-policy{data-element=VeCANR_cmp_N_PDU_7E_FD11, handle-invalid=DONT-INVALIDATE}
      data VeCANR_cmp_N_PDU_7E_FD11: category=VALUE, sw-calibration-access=READ-ONLY, type=ADTSN_PDU_7E_FD11, init-value=VeCANR_cmp_N_PDU_7E_FD11Value:0
    VeCANR_cmp_N_PDU_7E_FD3: service-kind=ANY-STANDARDIZED, invalidation-policy{data-element=VeCANR_cmp_N_PDU_7E_FD3, handle-invalid=DONT-INVALIDATE}
      data VeCANR_cmp_N_PDU_7E_FD3: category=VALUE, sw-calibration-access=READ-ONLY, type=ADTSN_PDU_7E_FD3, init-value=VeCANR_cmp_N_PDU_7E_FD3Value:0
    VeCANR_cmp_N_PDU_7F_FD11: service-kind=ANY-STANDARDIZED, invalidation-policy{data-element=VeCANR_cmp_N_PDU_7F_FD11, handle-invalid=DONT-INVALIDATE}
      data VeCANR_cmp_N_PDU_7F_FD11: category=VALUE, sw-calibration-access=READ-ONLY, type=ADTSN_PDU_7F_FD11, init-value=VeCANR_cmp_N_PDU_7F_FD11Value:0
    VeCANR_cmp_N_PDU_7F_FD3: service-kind=ANY-STANDARDIZED, invalidation-policy{data-element=VeCANR_cmp_N_PDU_7F_FD3, handle-invalid=DONT-INVALIDATE}
      data VeCANR_cmp_N_PDU_7F_FD3: category=VALUE, sw-calibration-access=READ-ONLY, type=ADTSN_PDU_7F_FD3, init-value=VeCANR_cmp_N_PDU_7F_FD3Value:0
    VeCANR_cmp_N_PDU_81_FD11: service-kind=ANY-STANDARDIZED, invalidation-policy{data-element=VeCANR_cmp_N_PDU_81_FD11, handle-invalid=DONT-INVALIDATE}
      data VeCANR_cmp_N_PDU_81_FD11: category=VALUE, sw-calibration-access=READ-ONLY, type=ADTSN_PDU_81_FD11, init-value=VeCANR_cmp_N_PDU_81_FD11Value:0
    VeCANR_cmp_N_PDU_86_FD16: service-kind=ANY-STANDARDIZED, invalidation-policy{data-element=VeCANR_cmp_N_PDU_86_FD16, handle-invalid=DONT-INVALIDATE}
      data VeCANR_cmp_N_PDU_86_FD16: category=VALUE, sw-calibration-access=READ-ONLY, type=ADTSN_PDU_86_FD16, init-value=VeCANR_cmp_N_PDU_86_FD16Value:0
    VeCANR_d_HVBatCelVoltHiThrsFD11: service-kind=ANY-STANDARDIZED, invalidation-policy{data-element=VeCANR_d_HVBatCelVoltHiThrsFD11, handle-invalid=DONT-INVALIDATE}
      data VeCANR_d_HVBatCelVoltHiThrsFD11: category=VALUE, sw-calibration-access=READ-ONLY, type=ADTSHVBatCelVoltHiThrsFD11, init-value=VeCANR_d_HVBatCelVoltHiThrsFD11Value:0
    VeCANR_d_HVBatCelVoltHiThrsFD5: service-kind=ANY-STANDARDIZED, invalidation-policy{data-element=VeCANR_d_HVBatCelVoltHiThrsFD5, handle-invalid=DONT-INVALIDATE}
      data VeCANR_d_HVBatCelVoltHiThrsFD5: category=VALUE, sw-calibration-access=READ-ONLY, type=ADTSHVBatCelVoltHiThrsFD5, init-value=VeCANR_d_HVBatCelVoltHiThrsFD5Value:0
    VeCANR_d_HVBatCelVoltLoThrsFD5: service-kind=ANY-STANDARDIZED, invalidation-policy{data-element=VeCANR_d_HVBatCelVoltLoThrsFD5, handle-invalid=DONT-INVALIDATE}
      data VeCANR_d_HVBatCelVoltLoThrsFD5: category=VALUE, sw-calibration-access=READ-ONLY, type=ADTSHVBatCelVoltLoThrsFD5, init-value=VeCANR_d_HVBatCelVoltLoThrsFD5Value:0
    VeCANR_e_APM2InterlockSts: service-kind=ANY-STANDARDIZED, invalidation-policy{data-element=VeCANR_e_APM2InterlockSts, handle-invalid=DONT-INVALIDATE}
      data VeCANR_e_APM2InterlockSts: category=VALUE, sw-calibration-access=READ-ONLY, type=ADTSAPM2InterlockSts, init-value=VeCANR_e_APM2InterlockStsValue:0
    VeCANR_e_APM2_ContactorFault: service-kind=ANY-STANDARDIZED, invalidation-policy{data-element=VeCANR_e_APM2_ContactorFault, handle-invalid=KEEP}
      data VeCANR_e_APM2_ContactorFault: category=VALUE, sw-calibration-access=READ-ONLY, type=ADTSAPM2_ContactorFault, init-value=VeCANR_e_APM2_ContactorFaultValue:2
    VeCANR_e_APM2_DeratRsnSts: service-kind=ANY-STANDARDIZED, invalidation-policy{data-element=VeCANR_e_APM2_DeratRsnSts, handle-invalid=DONT-INVALIDATE}
      data VeCANR_e_APM2_DeratRsnSts: category=VALUE, sw-calibration-access=READ-ONLY, type=ADTSAPM2_DeratRsnSts, init-value=VeCANR_e_APM2_DeratRsnStsValue:0
    VeCANR_e_APM2_FaultSts: service-kind=ANY-STANDARDIZED, invalidation-policy{data-element=VeCANR_e_APM2_FaultSts, handle-invalid=KEEP}
      data VeCANR_e_APM2_FaultSts: category=VALUE, sw-calibration-access=READ-ONLY, type=ADTSAPM2_FaultSts, init-value=VeCANR_e_APM2_FaultStsValue:0
    VeCANR_e_APM2_K6_WldgDtnSts: service-kind=ANY-STANDARDIZED, invalidation-policy{data-element=VeCANR_e_APM2_K6_WldgDtnSts, handle-invalid=DONT-INVALIDATE}
      data VeCANR_e_APM2_K6_WldgDtnSts: category=VALUE, sw-calibration-access=READ-ONLY, type=ADTSAPM2_K6_WldgDtnSts, init-value=VeCANR_e_APM2_K6_WldgDtnStsValue:0
    VeCANR_e_APM2_K7_WldgDtnSts: service-kind=ANY-STANDARDIZED, invalidation-policy{data-element=VeCANR_e_APM2_K7_WldgDtnSts, handle-invalid=DONT-INVALIDATE}
      data VeCANR_e_APM2_K7_WldgDtnSts: category=VALUE, sw-calibration-access=READ-ONLY, type=ADTSAPM2_K7_WldgDtnSts, init-value=VeCANR_e_APM2_K7_WldgDtnStsValue:0
    VeCANR_e_APM2_ModeSts_Fbk: service-kind=ANY-STANDARDIZED, invalidation-policy{data-element=VeCANR_e_APM2_ModeSts_Fbk, handle-invalid=KEEP}
      data VeCANR_e_APM2_ModeSts_Fbk: category=VALUE, sw-calibration-access=READ-ONLY, type=ADTSAPM2_ModeSts_Fbk, init-value=VeCANR_e_APM2_ModeSts_FbkValue:0
    VeCANR_e_APM2_RecoveryAction: service-kind=ANY-STANDARDIZED, invalidation-policy{data-element=VeCANR_e_APM2_RecoveryAction, handle-invalid=KEEP}
      data VeCANR_e_APM2_RecoveryAction: category=VALUE, sw-calibration-access=READ-ONLY, type=ADTSAPM2_RecoveryAction, init-value=VeCANR_e_APM2_RecoveryActionValue:0
    VeCANR_e_AllowClimateSchd1: service-kind=ANY-STANDARDIZED, invalidation-policy{data-element=VeCANR_e_AllowClimateSchd1, handle-invalid=KEEP}
      data VeCANR_e_AllowClimateSchd1: category=VALUE, sw-calibration-access=READ-ONLY, type=ADTSAllowClimateSchd1, init-value=VeCANR_e_AllowClimateSchd1Value:0
    VeCANR_e_AllowClimateSchd2: service-kind=ANY-STANDARDIZED, invalidation-policy{data-element=VeCANR_e_AllowClimateSchd2, handle-invalid=KEEP}
      data VeCANR_e_AllowClimateSchd2: category=VALUE, sw-calibration-access=READ-ONLY, type=ADTSAllowClimateSchd2, init-value=VeCANR_e_AllowClimateSchd2Value:0
    VeCANR_e_BMS_HV_SOCAcrcyStsFD11: service-kind=ANY-STANDARDIZED, invalidation-policy{data-element=VeCANR_e_BMS_HV_SOCAcrcyStsFD11, handle-invalid=KEEP}
      data VeCANR_e_BMS_HV_SOCAcrcyStsFD11: category=VALUE, sw-calibration-access=READ-ONLY, type=ADTSBMS_HV_SOCAcrcyStsFD11, init-value=VeCANR_e_BMS_HV_SOCAcrcyStsFD11Value:0
    VeCANR_e_BMS_HV_SOCAcrcyStsFD5: service-kind=ANY-STANDARDIZED, invalidation-policy{data-element=VeCANR_e_BMS_HV_SOCAcrcyStsFD5, handle-invalid=KEEP}
      data VeCANR_e_BMS_HV_SOCAcrcyStsFD5: category=VALUE, sw-calibration-access=READ-ONLY, type=ADTSBMS_HV_SOCAcrcyStsFD5, init-value=VeCANR_e_BMS_HV_SOCAcrcyStsFD5Value:0
    VeCANR_e_Charge_Schedule_Type1: service-kind=ANY-STANDARDIZED, invalidation-policy{data-element=VeCANR_e_Charge_Schedule_Type1, handle-invalid=DONT-INVALIDATE}
      data VeCANR_e_Charge_Schedule_Type1: category=VALUE, sw-calibration-access=READ-ONLY, type=ADTSCharge_Schedule_Type1, init-value=VeCANR_e_Charge_Schedule_Type1Value:0
    VeCANR_e_Charge_Schedule_Type2: service-kind=ANY-STANDARDIZED, invalidation-policy{data-element=VeCANR_e_Charge_Schedule_Type2, handle-invalid=DONT-INVALIDATE}
      data VeCANR_e_Charge_Schedule_Type2: category=VALUE, sw-calibration-access=READ-ONLY, type=ADTSCharge_Schedule_Type2, init-value=VeCANR_e_Charge_Schedule_Type2Value:0
    VeCANR_e_ChrgFailSts_FD5: service-kind=ANY-STANDARDIZED, invalidation-policy{data-element=VeCANR_e_ChrgFailSts_FD5, handle-invalid=KEEP}
      data VeCANR_e_ChrgFailSts_FD5: category=VALUE, sw-calibration-access=READ-ONLY, type=ADTSChrgFailSts_FD5, init-value=VeCANR_e_ChrgFailSts_FD5Value:0
    VeCANR_e_ClimateSchd1_Day: service-kind=ANY-STANDARDIZED, invalidation-policy{data-element=VeCANR_e_ClimateSchd1_Day, handle-invalid=KEEP}
      data VeCANR_e_ClimateSchd1_Day: category=VALUE, sw-calibration-access=READ-ONLY, type=ADTSClimateSchd1_Day, init-value=VeCANR_e_ClimateSchd1_DayValue:0
    VeCANR_e_ClimateSchd2_Day: service-kind=ANY-STANDARDIZED, invalidation-policy{data-element=VeCANR_e_ClimateSchd2_Day, handle-invalid=KEEP}
      data VeCANR_e_ClimateSchd2_Day: category=VALUE, sw-calibration-access=READ-ONLY, type=ADTSClimateSchd2_Day, init-value=VeCANR_e_ClimateSchd2_DayValue:0
    VeCANR_e_Command_15Sts: service-kind=ANY-STANDARDIZED, invalidation-policy{data-element=VeCANR_e_Command_15Sts, handle-invalid=KEEP}
      data VeCANR_e_Command_15Sts: category=VALUE, sw-calibration-access=READ-ONLY, type=ADTSCommand_15Sts, init-value=VeCANR_e_Command_15StsValue:0
    VeCANR_e_EVSE_CHAdeMOProtocol: service-kind=ANY-STANDARDIZED, invalidation-policy{data-element=VeCANR_e_EVSE_CHAdeMOProtocol, handle-invalid=KEEP}
      data VeCANR_e_EVSE_CHAdeMOProtocol: category=VALUE, sw-calibration-access=READ-ONLY, type=ADTSEVSE_CHAdeMOProtocol, init-value=VeCANR_e_EVSE_CHAdeMOProtocolValue:0
    VeCANR_e_External_ChargeTarget1: service-kind=ANY-STANDARDIZED, invalidation-policy{data-element=VeCANR_e_External_ChargeTarget1, handle-invalid=DONT-INVALIDATE}
      data VeCANR_e_External_ChargeTarget1: category=VALUE, sw-calibration-access=READ-ONLY, type=ADTSExternal_ChargeTarget1, init-value=VeCANR_e_External_ChargeTarget1Value:125
    VeCANR_e_External_ChargeTarget2: service-kind=ANY-STANDARDIZED, invalidation-policy{data-element=VeCANR_e_External_ChargeTarget2, handle-invalid=DONT-INVALIDATE}
      data VeCANR_e_External_ChargeTarget2: category=VALUE, sw-calibration-access=READ-ONLY, type=ADTSExternal_ChargeTarget2, init-value=VeCANR_e_External_ChargeTarget2Value:125
    VeCANR_e_FOTA_Status: service-kind=ANY-STANDARDIZED, invalidation-policy{data-element=VeCANR_e_FOTA_Status, handle-invalid=DONT-INVALIDATE}
      data VeCANR_e_FOTA_Status: category=VALUE, sw-calibration-access=READ-ONLY, type=ADTSFOTA_Status, init-value=VeCANR_e_FOTA_StatusValue:0
    VeCANR_e_HAS_TelltaleSts: service-kind=ANY-STANDARDIZED, invalidation-policy{data-element=VeCANR_e_HAS_TelltaleSts, handle-invalid=KEEP}
      data VeCANR_e_HAS_TelltaleSts: category=VALUE, sw-calibration-access=READ-ONLY, type=ADTSHAS_TelltaleSts, init-value=VeCANR_e_HAS_TelltaleStsValue:0
    VeCANR_e_IDCM_DTC_Stat1: service-kind=ANY-STANDARDIZED, invalidation-policy{data-element=VeCANR_e_IDCM_DTC_Stat1, handle-invalid=DONT-INVALIDATE}
      data VeCANR_e_IDCM_DTC_Stat1: category=VALUE, sw-calibration-access=READ-ONLY, type=ADTSIDCM_DTC_Stat1, init-value=VeCANR_e_IDCM_DTC_Stat1Value:0
    VeCANR_e_IDCM_DTC_Stat2: service-kind=ANY-STANDARDIZED, invalidation-policy{data-element=VeCANR_e_IDCM_DTC_Stat2, handle-invalid=DONT-INVALIDATE}
      data VeCANR_e_IDCM_DTC_Stat2: category=VALUE, sw-calibration-access=READ-ONLY, type=ADTSIDCM_DTC_Stat2, init-value=VeCANR_e_IDCM_DTC_Stat2Value:0
    VeCANR_e_IDCM_DTC_Stat3: service-kind=ANY-STANDARDIZED, invalidation-policy{data-element=VeCANR_e_IDCM_DTC_Stat3, handle-invalid=DONT-INVALIDATE}
      data VeCANR_e_IDCM_DTC_Stat3: category=VALUE, sw-calibration-access=READ-ONLY, type=ADTSIDCM_DTC_Stat3, init-value=VeCANR_e_IDCM_DTC_Stat3Value:0
    VeCANR_e_IDCM_DTC_Stat4: service-kind=ANY-STANDARDIZED, invalidation-policy{data-element=VeCANR_e_IDCM_DTC_Stat4, handle-invalid=DONT-INVALIDATE}
      data VeCANR_e_IDCM_DTC_Stat4: category=VALUE, sw-calibration-access=READ-ONLY, type=ADTSIDCM_DTC_Stat4, init-value=VeCANR_e_IDCM_DTC_Stat4Value:0
    VeCANR_e_IDCM_DTC_Stat5: service-kind=ANY-STANDARDIZED, invalidation-policy{data-element=VeCANR_e_IDCM_DTC_Stat5, handle-invalid=DONT-INVALIDATE}
      data VeCANR_e_IDCM_DTC_Stat5: category=VALUE, sw-calibration-access=READ-ONLY, type=ADTSIDCM_DTC_Stat5, init-value=VeCANR_e_IDCM_DTC_Stat5Value:0
    VeCANR_e_IDCM_DTC_Stat6: service-kind=ANY-STANDARDIZED, invalidation-policy{data-element=VeCANR_e_IDCM_DTC_Stat6, handle-invalid=DONT-INVALIDATE}
      data VeCANR_e_IDCM_DTC_Stat6: category=VALUE, sw-calibration-access=READ-ONLY, type=ADTSIDCM_DTC_Stat6, init-value=VeCANR_e_IDCM_DTC_Stat6Value:0
    VeCANR_e_IDCM_DTC_Stat7: service-kind=ANY-STANDARDIZED, invalidation-policy{data-element=VeCANR_e_IDCM_DTC_Stat7, handle-invalid=DONT-INVALIDATE}
      data VeCANR_e_IDCM_DTC_Stat7: category=VALUE, sw-calibration-access=READ-ONLY, type=ADTSIDCM_DTC_Stat7, init-value=VeCANR_e_IDCM_DTC_Stat7Value:0
    VeCANR_e_IDCM_DTC_Stat8: service-kind=ANY-STANDARDIZED, invalidation-policy{data-element=VeCANR_e_IDCM_DTC_Stat8, handle-invalid=DONT-INVALIDATE}
      data VeCANR_e_IDCM_DTC_Stat8: category=VALUE, sw-calibration-access=READ-ONLY, type=ADTSIDCM_DTC_Stat8, init-value=VeCANR_e_IDCM_DTC_Stat8Value:0
    VeCANR_e_ITBM_TrlrStat: service-kind=ANY-STANDARDIZED, invalidation-policy{data-element=VeCANR_e_ITBM_TrlrStat, handle-invalid=KEEP}
      data VeCANR_e_ITBM_TrlrStat: category=VALUE, sw-calibration-access=READ-ONLY, type=ADTSITBM_TrlrStat, init-value=VeCANR_e_ITBM_TrlrStatValue:0
    VeCANR_e_ImmediateChargeTarget1: service-kind=ANY-STANDARDIZED, invalidation-policy{data-element=VeCANR_e_ImmediateChargeTarget1, handle-invalid=DONT-INVALIDATE}
      data VeCANR_e_ImmediateChargeTarget1: category=VALUE, sw-calibration-access=READ-ONLY, type=ADTSImmediateChargeTarget1, init-value=VeCANR_e_ImmediateChargeTarget1Value:75
    VeCANR_e_ImmediateChargeTarget2: service-kind=ANY-STANDARDIZED, invalidation-policy{data-element=VeCANR_e_ImmediateChargeTarget2, handle-invalid=DONT-INVALIDATE}
      data VeCANR_e_ImmediateChargeTarget2: category=VALUE, sw-calibration-access=READ-ONLY, type=ADTSImmediateChargeTarget2, init-value=VeCANR_e_ImmediateChargeTarget2Value:75
    VeCANR_e_MCPA_DerateResn_P_FD16: service-kind=ANY-STANDARDIZED, invalidation-policy{data-element=VeCANR_e_MCPA_DerateResn_P_FD16, handle-invalid=DONT-INVALIDATE}
      data VeCANR_e_MCPA_DerateResn_P_FD16: category=VALUE, sw-calibration-access=READ-ONLY, type=ADTSMCPA_DerateResn_P_FD16, init-value=VeCANR_e_MCPA_DerateResn_P_FD16Value:0
    VeCANR_e_MCPA_DrateReason_P_FD5: service-kind=ANY-STANDARDIZED, invalidation-policy{data-element=VeCANR_e_MCPA_DrateReason_P_FD5, handle-invalid=DONT-INVALIDATE}
      data VeCANR_e_MCPA_DrateReason_P_FD5: category=VALUE, sw-calibration-access=READ-ONLY, type=ADTSMCPA_DrateReason_P_FD5, init-value=VeCANR_e_MCPA_DrateReason_P_FD5Value:0
    VeCANR_e_MCPB_DerateResn_P_FD16: service-kind=ANY-STANDARDIZED, invalidation-policy{data-element=VeCANR_e_MCPB_DerateResn_P_FD16, handle-invalid=DONT-INVALIDATE}
      data VeCANR_e_MCPB_DerateResn_P_FD16: category=VALUE, sw-calibration-access=READ-ONLY, type=ADTSMCPB_DerateResn_P_FD16, init-value=VeCANR_e_MCPB_DerateResn_P_FD16Value:0
    VeCANR_e_MCPB_DrateReason_P_FD5: service-kind=ANY-STANDARDIZED, invalidation-policy{data-element=VeCANR_e_MCPB_DrateReason_P_FD5, handle-invalid=DONT-INVALIDATE}
      data VeCANR_e_MCPB_DrateReason_P_FD5: category=VALUE, sw-calibration-access=READ-ONLY, type=ADTSMCPB_DrateReason_P_FD5, init-value=VeCANR_e_MCPB_DrateReason_P_FD5Value:0
    VeCANR_e_OBCM_PrechargeSts_FD5: service-kind=ANY-STANDARDIZED, invalidation-policy{data-element=VeCANR_e_OBCM_PrechargeSts_FD5, handle-invalid=DONT-INVALIDATE}
      data VeCANR_e_OBCM_PrechargeSts_FD5: category=VALUE, sw-calibration-access=READ-ONLY, type=ADTSOBCM_PrechargeSts_FD5, init-value=VeCANR_e_OBCM_PrechargeSts_FD5Value:0
    VeCANR_e_OBC_ChrgnFaultSts_FD5: service-kind=ANY-STANDARDIZED, invalidation-policy{data-element=VeCANR_e_OBC_ChrgnFaultSts_FD5, handle-invalid=DONT-INVALIDATE}
      data VeCANR_e_OBC_ChrgnFaultSts_FD5: category=VALUE, sw-calibration-access=READ-ONLY, type=ADTSOBC_ChrgnFaultSts_FD5, init-value=VeCANR_e_OBC_ChrgnFaultSts_FD5Value:0
    VeCANR_e_OBC_FaultReason_FD5: service-kind=ANY-STANDARDIZED, invalidation-policy{data-element=VeCANR_e_OBC_FaultReason_FD5, handle-invalid=KEEP}
      data VeCANR_e_OBC_FaultReason_FD5: category=VALUE, sw-calibration-access=READ-ONLY, type=ADTSOBC_FaultReason_FD5, init-value=VeCANR_e_OBC_FaultReason_FD5Value:0
    VeCANR_e_OBC_WakeReason_FD5: service-kind=ANY-STANDARDIZED, invalidation-policy{data-element=VeCANR_e_OBC_WakeReason_FD5, handle-invalid=DONT-INVALIDATE}
      data VeCANR_e_OBC_WakeReason_FD5: category=VALUE, sw-calibration-access=READ-ONLY, type=ADTSOBC_WakeReason_FD5, init-value=VeCANR_e_OBC_WakeReason_FD5Value:0
    VeCANR_e_OnboardChargerModeFD5: service-kind=ANY-STANDARDIZED, invalidation-policy{data-element=VeCANR_e_OnboardChargerModeFD5, handle-invalid=DONT-INVALIDATE}
      data VeCANR_e_OnboardChargerModeFD5: category=VALUE, sw-calibration-access=READ-ONLY, type=ADTSOnboardChargerModeFD5, init-value=VeCANR_e_OnboardChargerModeFD5Value:0
    VeCANR_e_OnboardChrgrReady_FD5: service-kind=ANY-STANDARDIZED, invalidation-policy{data-element=VeCANR_e_OnboardChrgrReady_FD5, handle-invalid=KEEP}
      data VeCANR_e_OnboardChrgrReady_FD5: category=VALUE, sw-calibration-access=READ-ONLY, type=ADTSOnboardChrgrReady_FD5, init-value=VeCANR_e_OnboardChrgrReady_FD5Value:1
    VeCANR_e_Remote_Chargeport_Cmnd: service-kind=ANY-STANDARDIZED, invalidation-policy{data-element=VeCANR_e_Remote_Chargeport_Cmnd, handle-invalid=KEEP}
      data VeCANR_e_Remote_Chargeport_Cmnd: category=VALUE, sw-calibration-access=READ-ONLY, type=ADTSRemote_Chargeport_Cmnd, init-value=VeCANR_e_Remote_Chargeport_CmndValue:0
    VeCANR_e_SGCP_DerateResn_P_FD16: service-kind=ANY-STANDARDIZED, invalidation-policy{data-element=VeCANR_e_SGCP_DerateResn_P_FD16, handle-invalid=DONT-INVALIDATE}
      data VeCANR_e_SGCP_DerateResn_P_FD16: category=VALUE, sw-calibration-access=READ-ONLY, type=ADTSSGCP_DerateResn_P_FD16, init-value=VeCANR_e_SGCP_DerateResn_P_FD16Value:0
    VeCANR_e_SGCP_DrateReason_P_FD5: service-kind=ANY-STANDARDIZED, invalidation-policy{data-element=VeCANR_e_SGCP_DrateReason_P_FD5, handle-invalid=DONT-INVALIDATE}
      data VeCANR_e_SGCP_DrateReason_P_FD5: category=VALUE, sw-calibration-access=READ-ONLY, type=ADTSSGCP_DrateReason_P_FD5, init-value=VeCANR_e_SGCP_DrateReason_P_FD5Value:0
    VeCANR_e_Schedule_Day1: service-kind=ANY-STANDARDIZED, invalidation-policy{data-element=VeCANR_e_Schedule_Day1, handle-invalid=KEEP}
      data VeCANR_e_Schedule_Day1: category=VALUE, sw-calibration-access=READ-ONLY, type=ADTSSchedule_Day1, init-value=VeCANR_e_Schedule_Day1Value:0
    VeCANR_e_Schedule_Day2: service-kind=ANY-STANDARDIZED, invalidation-policy{data-element=VeCANR_e_Schedule_Day2, handle-invalid=KEEP}
      data VeCANR_e_Schedule_Day2: category=VALUE, sw-calibration-access=READ-ONLY, type=ADTSSchedule_Day2, init-value=VeCANR_e_Schedule_Day2Value:0
    VeCANR_e_TBMChrgSchedulType1Req: service-kind=ANY-STANDARDIZED, invalidation-policy{data-element=VeCANR_e_TBMChrgSchedulType1Req, handle-invalid=DONT-INVALIDATE}
      data VeCANR_e_TBMChrgSchedulType1Req: category=VALUE, sw-calibration-access=READ-ONLY, type=ADTSTBMChrgSchedulType1Req, init-value=VeCANR_e_TBMChrgSchedulType1ReqValue:0
    VeCANR_e_TBMChrgSchedulType2Req: service-kind=ANY-STANDARDIZED, invalidation-policy{data-element=VeCANR_e_TBMChrgSchedulType2Req, handle-invalid=DONT-INVALIDATE}
      data VeCANR_e_TBMChrgSchedulType2Req: category=VALUE, sw-calibration-access=READ-ONLY, type=ADTSTBMChrgSchedulType2Req, init-value=VeCANR_e_TBMChrgSchedulType2ReqValue:0
    VeCANR_e_TBMCooperativeChrgCmnd: service-kind=ANY-STANDARDIZED, invalidation-policy{data-element=VeCANR_e_TBMCooperativeChrgCmnd, handle-invalid=KEEP}
      data VeCANR_e_TBMCooperativeChrgCmnd: category=VALUE, sw-calibration-access=READ-ONLY, type=ADTSTBMCooperativeChrgCmnd, init-value=VeCANR_e_TBMCooperativeChrgCmndValue:0
    VeCANR_e_TBMExtrnlChrgTarget1: service-kind=ANY-STANDARDIZED, invalidation-policy{data-element=VeCANR_e_TBMExtrnlChrgTarget1, handle-invalid=DONT-INVALIDATE}
      data VeCANR_e_TBMExtrnlChrgTarget1: category=VALUE, sw-calibration-access=READ-ONLY, type=ADTSTBMExtrnlChrgTarget1, init-value=VeCANR_e_TBMExtrnlChrgTarget1Value:125
    VeCANR_e_TBMImmediatChrgTarget1: service-kind=ANY-STANDARDIZED, invalidation-policy{data-element=VeCANR_e_TBMImmediatChrgTarget1, handle-invalid=DONT-INVALIDATE}
      data VeCANR_e_TBMImmediatChrgTarget1: category=VALUE, sw-calibration-access=READ-ONLY, type=ADTSTBMImmediatChrgTarget1, init-value=VeCANR_e_TBMImmediatChrgTarget1Value:75
    VeCANR_e_TBMImmediatChrgTarget2: service-kind=ANY-STANDARDIZED, invalidation-policy{data-element=VeCANR_e_TBMImmediatChrgTarget2, handle-invalid=DONT-INVALIDATE}
      data VeCANR_e_TBMImmediatChrgTarget2: category=VALUE, sw-calibration-access=READ-ONLY, type=ADTSTBMImmediatChrgTarget2, init-value=VeCANR_e_TBMImmediatChrgTarget2Value:75
    VeCANR_e_TBM_AllowClimateSchd1: service-kind=ANY-STANDARDIZED, invalidation-policy{data-element=VeCANR_e_TBM_AllowClimateSchd1, handle-invalid=KEEP}
      data VeCANR_e_TBM_AllowClimateSchd1: category=VALUE, sw-calibration-access=READ-ONLY, type=ADTSTBM_AllowClimateSchd1, init-value=VeCANR_e_TBM_AllowClimateSchd1Value:0
    VeCANR_e_TBM_AllowClimateSchd2: service-kind=ANY-STANDARDIZED, invalidation-policy{data-element=VeCANR_e_TBM_AllowClimateSchd2, handle-invalid=KEEP}
      data VeCANR_e_TBM_AllowClimateSchd2: category=VALUE, sw-calibration-access=READ-ONLY, type=ADTSTBM_AllowClimateSchd2, init-value=VeCANR_e_TBM_AllowClimateSchd2Value:0
    VeCANR_e_TBM_ClimateSchd1_Day: service-kind=ANY-STANDARDIZED, invalidation-policy{data-element=VeCANR_e_TBM_ClimateSchd1_Day, handle-invalid=KEEP}
      data VeCANR_e_TBM_ClimateSchd1_Day: category=VALUE, sw-calibration-access=READ-ONLY, type=ADTSTBM_ClimateSchd1_Day, init-value=VeCANR_e_TBM_ClimateSchd1_DayValue:0
    VeCANR_e_TBM_ClimateSchd2_Day: service-kind=ANY-STANDARDIZED, invalidation-policy{data-element=VeCANR_e_TBM_ClimateSchd2_Day, handle-invalid=KEEP}
      data VeCANR_e_TBM_ClimateSchd2_Day: category=VALUE, sw-calibration-access=READ-ONLY, type=ADTSTBM_ClimateSchd2_Day, init-value=VeCANR_e_TBM_ClimateSchd2_DayValue:0
    VeCANR_e_TBM_ExtrnlChargTarget2: service-kind=ANY-STANDARDIZED, invalidation-policy{data-element=VeCANR_e_TBM_ExtrnlChargTarget2, handle-invalid=DONT-INVALIDATE}
      data VeCANR_e_TBM_ExtrnlChargTarget2: category=VALUE, sw-calibration-access=READ-ONLY, type=ADTSTBM_ExtrnlChargTarget2, init-value=VeCANR_e_TBM_ExtrnlChargTarget2Value:125
    VeCANR_e_TBM_Schedule_Day1: service-kind=ANY-STANDARDIZED, invalidation-policy{data-element=VeCANR_e_TBM_Schedule_Day1, handle-invalid=KEEP}
      data VeCANR_e_TBM_Schedule_Day1: category=VALUE, sw-calibration-access=READ-ONLY, type=ADTSTBM_Schedule_Day1, init-value=VeCANR_e_TBM_Schedule_Day1Value:0
    VeCANR_e_TBM_Schedule_Day2: service-kind=ANY-STANDARDIZED, invalidation-policy{data-element=VeCANR_e_TBM_Schedule_Day2, handle-invalid=KEEP}
      data VeCANR_e_TBM_Schedule_Day2: category=VALUE, sw-calibration-access=READ-ONLY, type=ADTSTBM_Schedule_Day2, init-value=VeCANR_e_TBM_Schedule_Day2Value:0
    VeCANR_e_TerrainModeStat_ECM: service-kind=ANY-STANDARDIZED, invalidation-policy{data-element=VeCANR_e_TerrainModeStat_ECM, handle-invalid=KEEP}
      data VeCANR_e_TerrainModeStat_ECM: category=VALUE, sw-calibration-access=READ-ONLY, type=ADTSTerrainModeStat_ECM, init-value=VeCANR_e_TerrainModeStat_ECMValue:31
    VeCANR_e_Trns_DrvMdReq: service-kind=ANY-STANDARDIZED, invalidation-policy{data-element=VeCANR_e_Trns_DrvMdReq, handle-invalid=KEEP}
      data VeCANR_e_Trns_DrvMdReq: category=VALUE, sw-calibration-access=READ-ONLY, type=ADTSTrns_DrvMdReq, init-value=VeCANR_e_Trns_DrvMdReqValue:0
    VeCANR_e_VIN_MSG: service-kind=ANY-STANDARDIZED, invalidation-policy{data-element=VeCANR_e_VIN_MSG, handle-invalid=KEEP}
      data VeCANR_e_VIN_MSG: category=VALUE, sw-calibration-access=READ-ONLY, type=ADTSVIN_MSG, init-value=VeCANR_e_VIN_MSGValue:3
    VeCANR_g_APM2_ErrorWord: service-kind=ANY-STANDARDIZED, invalidation-policy{data-element=VeCANR_g_APM2_ErrorWord, handle-invalid=DONT-INVALIDATE}
      data VeCANR_g_APM2_ErrorWord: category=VALUE, sw-calibration-access=READ-ONLY, type=ADTSAPM2_ErrorWord, init-value=VeCANR_g_APM2_ErrorWordValue:0
    VeCANR_h_HVBatCelVoltLoThrsFD11: service-kind=ANY-STANDARDIZED, invalidation-policy{data-element=VeCANR_h_HVBatCelVoltLoThrsFD11, handle-invalid=DONT-INVALIDATE}
      data VeCANR_h_HVBatCelVoltLoThrsFD11: category=VALUE, sw-calibration-access=READ-ONLY, type=ADTSHVBatCelVoltLoThrsFD11, init-value=VeCANR_h_HVBatCelVoltLoThrsFD11Value:0
    VeCANR_h_VIN_DATA: service-kind=ANY-STANDARDIZED, invalidation-policy{data-element=VeCANR_h_VIN_DATA, handle-invalid=DONT-INVALIDATE}
      data VeCANR_h_VIN_DATA: category=VALUE, sw-calibration-access=READ-ONLY, type=ADTSVIN_DATA, init-value=VeCANR_h_VIN_DATAValue:0
    VeCANR_p_BarPrsAbs: service-kind=ANY-STANDARDIZED, invalidation-policy{data-element=VeCANR_p_BarPrsAbs, handle-invalid=DONT-INVALIDATE}
      data VeCANR_p_BarPrsAbs: category=VALUE, sw-calibration-access=READ-ONLY, type=ADTSBarPrsAbs, init-value=VeCANR_p_BarPrsAbsValue:0
    VeCANR_t_ClimateSchd1_Dprtr_Hr: service-kind=ANY-STANDARDIZED, invalidation-policy{data-element=VeCANR_t_ClimateSchd1_Dprtr_Hr, handle-invalid=KEEP}
      data VeCANR_t_ClimateSchd1_Dprtr_Hr: category=VALUE, sw-calibration-access=READ-ONLY, type=ADTSClimateSchd1_Dprtr_Hr, init-value=VeCANR_t_ClimateSchd1_Dprtr_HrValue:0
    VeCANR_t_ClimateSchd1_Dprtr_Min: service-kind=ANY-STANDARDIZED, invalidation-policy{data-element=VeCANR_t_ClimateSchd1_Dprtr_Min, handle-invalid=KEEP}
      data VeCANR_t_ClimateSchd1_Dprtr_Min: category=VALUE, sw-calibration-access=READ-ONLY, type=ADTSClimateSchd1_Dprtr_Min, init-value=VeCANR_t_ClimateSchd1_Dprtr_MinValue:0
    VeCANR_t_ClimateSchd2_Dprtr_Hr: service-kind=ANY-STANDARDIZED, invalidation-policy{data-element=VeCANR_t_ClimateSchd2_Dprtr_Hr, handle-invalid=KEEP}
      data VeCANR_t_ClimateSchd2_Dprtr_Hr: category=VALUE, sw-calibration-access=READ-ONLY, type=ADTSClimateSchd2_Dprtr_Hr, init-value=VeCANR_t_ClimateSchd2_Dprtr_HrValue:0
    VeCANR_t_ClimateSchd2_Dprtr_Min: service-kind=ANY-STANDARDIZED, invalidation-policy{data-element=VeCANR_t_ClimateSchd2_Dprtr_Min, handle-invalid=KEEP}
      data VeCANR_t_ClimateSchd2_Dprtr_Min: category=VALUE, sw-calibration-access=READ-ONLY, type=ADTSClimateSchd2_Dprtr_Min, init-value=VeCANR_t_ClimateSchd2_Dprtr_MinValue:0
    VeCANR_t_EVSE_RemainingMin: service-kind=ANY-STANDARDIZED, invalidation-policy{data-element=VeCANR_t_EVSE_RemainingMin, handle-invalid=DONT-INVALIDATE}
      data VeCANR_t_EVSE_RemainingMin: category=VALUE, sw-calibration-access=READ-ONLY, type=ADTSEVSE_RemainingMin, init-value=VeCANR_t_EVSE_RemainingMinValue:0
    VeCANR_t_EVSE_RemainingSec: service-kind=ANY-STANDARDIZED, invalidation-policy{data-element=VeCANR_t_EVSE_RemainingSec, handle-invalid=DONT-INVALIDATE}
      data VeCANR_t_EVSE_RemainingSec: category=VALUE, sw-calibration-access=READ-ONLY, type=ADTSEVSE_RemainingSec, init-value=VeCANR_t_EVSE_RemainingSecValue:0
    VeCANR_t_End_Time_Hr1: service-kind=ANY-STANDARDIZED, invalidation-policy{data-element=VeCANR_t_End_Time_Hr1, handle-invalid=KEEP}
      data VeCANR_t_End_Time_Hr1: category=VALUE, sw-calibration-access=READ-ONLY, type=ADTSEnd_Time_Hr1, init-value=VeCANR_t_End_Time_Hr1Value:0
    VeCANR_t_End_Time_Hr2: service-kind=ANY-STANDARDIZED, invalidation-policy{data-element=VeCANR_t_End_Time_Hr2, handle-invalid=KEEP}
      data VeCANR_t_End_Time_Hr2: category=VALUE, sw-calibration-access=READ-ONLY, type=ADTSEnd_Time_Hr2, init-value=VeCANR_t_End_Time_Hr2Value:0
    VeCANR_t_End_Time_Min1: service-kind=ANY-STANDARDIZED, invalidation-policy{data-element=VeCANR_t_End_Time_Min1, handle-invalid=KEEP}
      data VeCANR_t_End_Time_Min1: category=VALUE, sw-calibration-access=READ-ONLY, type=ADTSEnd_Time_Min1, init-value=VeCANR_t_End_Time_Min1Value:0
    VeCANR_t_End_Time_Min2: service-kind=ANY-STANDARDIZED, invalidation-policy{data-element=VeCANR_t_End_Time_Min2, handle-invalid=KEEP}
      data VeCANR_t_End_Time_Min2: category=VALUE, sw-calibration-access=READ-ONLY, type=ADTSEnd_Time_Min2, init-value=VeCANR_t_End_Time_Min2Value:0
    VeCANR_t_GPS_Date_Day: service-kind=ANY-STANDARDIZED, invalidation-policy{data-element=VeCANR_t_GPS_Date_Day, handle-invalid=KEEP}
      data VeCANR_t_GPS_Date_Day: category=VALUE, sw-calibration-access=READ-ONLY, type=ADTSGPS_Date_Day, init-value=VeCANR_t_GPS_Date_DayValue:255
    VeCANR_t_GPS_Date_Year: service-kind=ANY-STANDARDIZED, invalidation-policy{data-element=VeCANR_t_GPS_Date_Year, handle-invalid=KEEP}
      data VeCANR_t_GPS_Date_Year: category=VALUE, sw-calibration-access=READ-ONLY, type=ADTSGPS_Date_Year, init-value=VeCANR_t_GPS_Date_YearValue:65535
    VeCANR_t_GPS_UTC_Hour: service-kind=ANY-STANDARDIZED, invalidation-policy{data-element=VeCANR_t_GPS_UTC_Hour, handle-invalid=KEEP}
      data VeCANR_t_GPS_UTC_Hour: category=VALUE, sw-calibration-access=READ-ONLY, type=ADTSGPS_UTC_Hour, init-value=VeCANR_t_GPS_UTC_HourValue:255
    VeCANR_t_GPS_UTC_Minute: service-kind=ANY-STANDARDIZED, invalidation-policy{data-element=VeCANR_t_GPS_UTC_Minute, handle-invalid=KEEP}
      data VeCANR_t_GPS_UTC_Minute: category=VALUE, sw-calibration-access=READ-ONLY, type=ADTSGPS_UTC_Minute, init-value=VeCANR_t_GPS_UTC_MinuteValue:255
    VeCANR_t_GPS_UTC_Second: service-kind=ANY-STANDARDIZED, invalidation-policy{data-element=VeCANR_t_GPS_UTC_Second, handle-invalid=KEEP}
      data VeCANR_t_GPS_UTC_Second: category=VALUE, sw-calibration-access=READ-ONLY, type=ADTSGPS_UTC_Second, init-value=VeCANR_t_GPS_UTC_SecondValue:655.35
    VeCANR_t_HVBatSleepTime_FD11: service-kind=ANY-STANDARDIZED, invalidation-policy{data-element=VeCANR_t_HVBatSleepTime_FD11, handle-invalid=KEEP}
      data VeCANR_t_HVBatSleepTime_FD11: category=VALUE, sw-calibration-access=READ-ONLY, type=ADTSHVBatSleepTime_FD11, init-value=VeCANR_t_HVBatSleepTime_FD11Value:0
    VeCANR_t_HVBatSleepTime_FD5: service-kind=ANY-STANDARDIZED, invalidation-policy{data-element=VeCANR_t_HVBatSleepTime_FD5, handle-invalid=KEEP}
      data VeCANR_t_HVBatSleepTime_FD5: category=VALUE, sw-calibration-access=READ-ONLY, type=ADTSHVBatSleepTime_FD5, init-value=VeCANR_t_HVBatSleepTime_FD5Value:0
    VeCANR_t_HVBattRealTimeClkFD11: service-kind=ANY-STANDARDIZED, invalidation-policy{data-element=VeCANR_t_HVBattRealTimeClkFD11, handle-invalid=KEEP}
      data VeCANR_t_HVBattRealTimeClkFD11: category=VALUE, sw-calibration-access=READ-ONLY, type=ADTSHVBattRealTimeClkFD11, init-value=VeCANR_t_HVBattRealTimeClkFD11Value:0
    VeCANR_t_OBC_ChargeTimeMin_FD5: service-kind=ANY-STANDARDIZED, invalidation-policy{data-element=VeCANR_t_OBC_ChargeTimeMin_FD5, handle-invalid=KEEP}
      data VeCANR_t_OBC_ChargeTimeMin_FD5: category=VALUE, sw-calibration-access=READ-ONLY, type=ADTSOBC_ChargeTimeMin_FD5, init-value=VeCANR_t_OBC_ChargeTimeMin_FD5Value:0
    VeCANR_t_OBC_ChargeTimeSec_FD5: service-kind=ANY-STANDARDIZED, invalidation-policy{data-element=VeCANR_t_OBC_ChargeTimeSec_FD5, handle-invalid=KEEP}
      data VeCANR_t_OBC_ChargeTimeSec_FD5: category=VALUE, sw-calibration-access=READ-ONLY, type=ADTSOBC_ChargeTimeSec_FD5, init-value=VeCANR_t_OBC_ChargeTimeSec_FD5Value:0
    VeCANR_t_OBC_IdleTimeMin_FD5: service-kind=ANY-STANDARDIZED, invalidation-policy{data-element=VeCANR_t_OBC_IdleTimeMin_FD5, handle-invalid=KEEP}
      data VeCANR_t_OBC_IdleTimeMin_FD5: category=VALUE, sw-calibration-access=READ-ONLY, type=ADTSOBC_IdleTimeMin_FD5, init-value=VeCANR_t_OBC_IdleTimeMin_FD5Value:0
    VeCANR_t_OBC_IdleTimeSec_FD5: service-kind=ANY-STANDARDIZED, invalidation-policy{data-element=VeCANR_t_OBC_IdleTimeSec_FD5, handle-invalid=KEEP}
      data VeCANR_t_OBC_IdleTimeSec_FD5: category=VALUE, sw-calibration-access=READ-ONLY, type=ADTSOBC_IdleTimeSec_FD5, init-value=VeCANR_t_OBC_IdleTimeSec_FD5Value:0
    VeCANR_t_Start_Time_Hr1: service-kind=ANY-STANDARDIZED, invalidation-policy{data-element=VeCANR_t_Start_Time_Hr1, handle-invalid=KEEP}
      data VeCANR_t_Start_Time_Hr1: category=VALUE, sw-calibration-access=READ-ONLY, type=ADTSStart_Time_Hr1, init-value=VeCANR_t_Start_Time_Hr1Value:0
    VeCANR_t_Start_Time_Hr2: service-kind=ANY-STANDARDIZED, invalidation-policy{data-element=VeCANR_t_Start_Time_Hr2, handle-invalid=KEEP}
      data VeCANR_t_Start_Time_Hr2: category=VALUE, sw-calibration-access=READ-ONLY, type=ADTSStart_Time_Hr2, init-value=VeCANR_t_Start_Time_Hr2Value:0
    VeCANR_t_Start_Time_Min1: service-kind=ANY-STANDARDIZED, invalidation-policy{data-element=VeCANR_t_Start_Time_Min1, handle-invalid=KEEP}
      data VeCANR_t_Start_Time_Min1: category=VALUE, sw-calibration-access=READ-ONLY, type=ADTSStart_Time_Min1, init-value=VeCANR_t_Start_Time_Min1Value:0
    VeCANR_t_Start_Time_Min2: service-kind=ANY-STANDARDIZED, invalidation-policy{data-element=VeCANR_t_Start_Time_Min2, handle-invalid=KEEP}
      data VeCANR_t_Start_Time_Min2: category=VALUE, sw-calibration-access=READ-ONLY, type=ADTSStart_Time_Min2, init-value=VeCANR_t_Start_Time_Min2Value:0
    VeCANR_t_TBM_ClimSchd1DprtrHr: service-kind=ANY-STANDARDIZED, invalidation-policy{data-element=VeCANR_t_TBM_ClimSchd1DprtrHr, handle-invalid=KEEP}
      data VeCANR_t_TBM_ClimSchd1DprtrHr: category=VALUE, sw-calibration-access=READ-ONLY, type=ADTSTBM_ClimSchd1DprtrHr, init-value=VeCANR_t_TBM_ClimSchd1DprtrHrValue:0
    VeCANR_t_TBM_ClimSchd1DprtrMin: service-kind=ANY-STANDARDIZED, invalidation-policy{data-element=VeCANR_t_TBM_ClimSchd1DprtrMin, handle-invalid=KEEP}
      data VeCANR_t_TBM_ClimSchd1DprtrMin: category=VALUE, sw-calibration-access=READ-ONLY, type=ADTSTBM_ClimSchd1DprtrMin, init-value=VeCANR_t_TBM_ClimSchd1DprtrMinValue:0
    VeCANR_t_TBM_ClimSchd2DprtrHr: service-kind=ANY-STANDARDIZED, invalidation-policy{data-element=VeCANR_t_TBM_ClimSchd2DprtrHr, handle-invalid=KEEP}
      data VeCANR_t_TBM_ClimSchd2DprtrHr: category=VALUE, sw-calibration-access=READ-ONLY, type=ADTSTBM_ClimSchd2DprtrHr, init-value=VeCANR_t_TBM_ClimSchd2DprtrHrValue:0
    VeCANR_t_TBM_ClimSchd2DprtrMin: service-kind=ANY-STANDARDIZED, invalidation-policy{data-element=VeCANR_t_TBM_ClimSchd2DprtrMin, handle-invalid=KEEP}
      data VeCANR_t_TBM_ClimSchd2DprtrMin: category=VALUE, sw-calibration-access=READ-ONLY, type=ADTSTBM_ClimSchd2DprtrMin, init-value=VeCANR_t_TBM_ClimSchd2DprtrMinValue:0
    VeCANR_t_TBM_End_Time_Hr1: service-kind=ANY-STANDARDIZED, invalidation-policy{data-element=VeCANR_t_TBM_End_Time_Hr1, handle-invalid=KEEP}
      data VeCANR_t_TBM_End_Time_Hr1: category=VALUE, sw-calibration-access=READ-ONLY, type=ADTSTBM_End_Time_Hr1, init-value=VeCANR_t_TBM_End_Time_Hr1Value:0
    VeCANR_t_TBM_End_Time_Hr2: service-kind=ANY-STANDARDIZED, invalidation-policy{data-element=VeCANR_t_TBM_End_Time_Hr2, handle-invalid=KEEP}
      data VeCANR_t_TBM_End_Time_Hr2: category=VALUE, sw-calibration-access=READ-ONLY, type=ADTSTBM_End_Time_Hr2, init-value=VeCANR_t_TBM_End_Time_Hr2Value:0
    VeCANR_t_TBM_End_Time_Min1: service-kind=ANY-STANDARDIZED, invalidation-policy{data-element=VeCANR_t_TBM_End_Time_Min1, handle-invalid=KEEP}
      data VeCANR_t_TBM_End_Time_Min1: category=VALUE, sw-calibration-access=READ-ONLY, type=ADTSTBM_End_Time_Min1, init-value=VeCANR_t_TBM_End_Time_Min1Value:0
    VeCANR_t_TBM_End_Time_Min2: service-kind=ANY-STANDARDIZED, invalidation-policy{data-element=VeCANR_t_TBM_End_Time_Min2, handle-invalid=KEEP}
      data VeCANR_t_TBM_End_Time_Min2: category=VALUE, sw-calibration-access=READ-ONLY, type=ADTSTBM_End_Time_Min2, init-value=VeCANR_t_TBM_End_Time_Min2Value:0
    VeCANR_t_TBM_Start_Time_Hr1: service-kind=ANY-STANDARDIZED, invalidation-policy{data-element=VeCANR_t_TBM_Start_Time_Hr1, handle-invalid=KEEP}
      data VeCANR_t_TBM_Start_Time_Hr1: category=VALUE, sw-calibration-access=READ-ONLY, type=ADTSTBM_Start_Time_Hr1, init-value=VeCANR_t_TBM_Start_Time_Hr1Value:0
    VeCANR_t_TBM_Start_Time_Hr2: service-kind=ANY-STANDARDIZED, invalidation-policy{data-element=VeCANR_t_TBM_Start_Time_Hr2, handle-invalid=KEEP}
      data VeCANR_t_TBM_Start_Time_Hr2: category=VALUE, sw-calibration-access=READ-ONLY, type=ADTSTBM_Start_Time_Hr2, init-value=VeCANR_t_TBM_Start_Time_Hr2Value:0
    VeCANR_t_TBM_Start_Time_Min1: service-kind=ANY-STANDARDIZED, invalidation-policy{data-element=VeCANR_t_TBM_Start_Time_Min1, handle-invalid=KEEP}
      data VeCANR_t_TBM_Start_Time_Min1: category=VALUE, sw-calibration-access=READ-ONLY, type=ADTSTBM_Start_Time_Min1, init-value=VeCANR_t_TBM_Start_Time_Min1Value:0
    VeCANR_t_TBM_Start_Time_Min2: service-kind=ANY-STANDARDIZED, invalidation-policy{data-element=VeCANR_t_TBM_Start_Time_Min2, handle-invalid=KEEP}
      data VeCANR_t_TBM_Start_Time_Min2: category=VALUE, sw-calibration-access=READ-ONLY, type=ADTSTBM_Start_Time_Min2, init-value=VeCANR_t_TBM_Start_Time_Min2Value:0
    VeCANR_y_AUD_LVL: service-kind=ANY-STANDARDIZED, invalidation-policy{data-element=VeCANR_y_AUD_LVL, handle-invalid=KEEP}
      data VeCANR_y_AUD_LVL: category=VALUE, sw-calibration-access=READ-ONLY, type=ADTSAUD_LVL, init-value=VeCANR_y_AUD_LVLValue:0
    VeCANR_y_CRC_FOTA_MASTER: service-kind=ANY-STANDARDIZED, invalidation-policy{data-element=VeCANR_y_CRC_FOTA_MASTER, handle-invalid=DONT-INVALIDATE}
      data VeCANR_y_CRC_FOTA_MASTER: category=VALUE, sw-calibration-access=READ-ONLY, type=ADTSCRC_FOTA_MASTER, init-value=VeCANR_y_CRC_FOTA_MASTERValue:0
    VeCANR_y_CRC_IDCM_OBD_DTC: service-kind=ANY-STANDARDIZED, invalidation-policy{data-element=VeCANR_y_CRC_IDCM_OBD_DTC, handle-invalid=DONT-INVALIDATE}
      data VeCANR_y_CRC_IDCM_OBD_DTC: category=VALUE, sw-calibration-access=READ-ONLY, type=ADTSCRC_IDCM_OBD_DTC, init-value=VeCANR_y_CRC_IDCM_OBD_DTCValue:0
    VeCANR_y_CRC_MCPA_STATUS_FD16: service-kind=ANY-STANDARDIZED, invalidation-policy{data-element=VeCANR_y_CRC_MCPA_STATUS_FD16, handle-invalid=DONT-INVALIDATE}
      data VeCANR_y_CRC_MCPA_STATUS_FD16: category=VALUE, sw-calibration-access=READ-ONLY, type=ADTSCRC_MCPA_STATUS_FD16, init-value=VeCANR_y_CRC_MCPA_STATUS_FD16Value:0
    VeCANR_y_CRC_MCPA_STATUS_FD5: service-kind=ANY-STANDARDIZED, invalidation-policy{data-element=VeCANR_y_CRC_MCPA_STATUS_FD5, handle-invalid=DONT-INVALIDATE}
      data VeCANR_y_CRC_MCPA_STATUS_FD5: category=VALUE, sw-calibration-access=READ-ONLY, type=ADTSCRC_MCPA_STATUS_FD5, init-value=VeCANR_y_CRC_MCPA_STATUS_FD5Value:0
    VeCANR_y_CRC_MCPB_STATUS_FD16: service-kind=ANY-STANDARDIZED, invalidation-policy{data-element=VeCANR_y_CRC_MCPB_STATUS_FD16, handle-invalid=DONT-INVALIDATE}
      data VeCANR_y_CRC_MCPB_STATUS_FD16: category=VALUE, sw-calibration-access=READ-ONLY, type=ADTSCRC_MCPB_STATUS_FD16, init-value=VeCANR_y_CRC_MCPB_STATUS_FD16Value:0
    VeCANR_y_CRC_MCPB_STATUS_FD5: service-kind=ANY-STANDARDIZED, invalidation-policy{data-element=VeCANR_y_CRC_MCPB_STATUS_FD5, handle-invalid=DONT-INVALIDATE}
      data VeCANR_y_CRC_MCPB_STATUS_FD5: category=VALUE, sw-calibration-access=READ-ONLY, type=ADTSCRC_MCPB_STATUS_FD5, init-value=VeCANR_y_CRC_MCPB_STATUS_FD5Value:0
    VeCANR_y_CRC_SGCP_STATUS_FD16: service-kind=ANY-STANDARDIZED, invalidation-policy{data-element=VeCANR_y_CRC_SGCP_STATUS_FD16, handle-invalid=DONT-INVALIDATE}
      data VeCANR_y_CRC_SGCP_STATUS_FD16: category=VALUE, sw-calibration-access=READ-ONLY, type=ADTSCRC_SGCP_STATUS_FD16, init-value=VeCANR_y_CRC_SGCP_STATUS_FD16Value:0
    VeCANR_y_CRC_SGCP_STATUS_FD5: service-kind=ANY-STANDARDIZED, invalidation-policy{data-element=VeCANR_y_CRC_SGCP_STATUS_FD5, handle-invalid=DONT-INVALIDATE}
      data VeCANR_y_CRC_SGCP_STATUS_FD5: category=VALUE, sw-calibration-access=READ-ONLY, type=ADTSCRC_SGCP_STATUS_FD5, init-value=VeCANR_y_CRC_SGCP_STATUS_FD5Value:0
    VeCANR_y_Day1_TLM: service-kind=ANY-STANDARDIZED, invalidation-policy{data-element=VeCANR_y_Day1_TLM, handle-invalid=DONT-INVALIDATE}
      data VeCANR_y_Day1_TLM: category=VALUE, sw-calibration-access=READ-ONLY, type=ADTSDay1_TLM, init-value=VeCANR_y_Day1_TLMValue:0
    VeCANR_y_Day2_TLM: service-kind=ANY-STANDARDIZED, invalidation-policy{data-element=VeCANR_y_Day2_TLM, handle-invalid=DONT-INVALIDATE}
      data VeCANR_y_Day2_TLM: category=VALUE, sw-calibration-access=READ-ONLY, type=ADTSDay2_TLM, init-value=VeCANR_y_Day2_TLMValue:0
    VeCANR_y_Digit_01: service-kind=ANY-STANDARDIZED, invalidation-policy{data-element=VeCANR_y_Digit_01, handle-invalid=DONT-INVALIDATE}
      data VeCANR_y_Digit_01: category=VALUE, sw-calibration-access=READ-ONLY, type=ADTSDigit_01, init-value=VeCANR_y_Digit_01Value:0
    VeCANR_y_Digit_02: service-kind=ANY-STANDARDIZED, invalidation-policy{data-element=VeCANR_y_Digit_02, handle-invalid=DONT-INVALIDATE}
      data VeCANR_y_Digit_02: category=VALUE, sw-calibration-access=READ-ONLY, type=ADTSDigit_02, init-value=VeCANR_y_Digit_02Value:0
    VeCANR_y_Digit_03: service-kind=ANY-STANDARDIZED, invalidation-policy{data-element=VeCANR_y_Digit_03, handle-invalid=DONT-INVALIDATE}
      data VeCANR_y_Digit_03: category=VALUE, sw-calibration-access=READ-ONLY, type=ADTSDigit_03, init-value=VeCANR_y_Digit_03Value:0
    VeCANR_y_Digit_04: service-kind=ANY-STANDARDIZED, invalidation-policy{data-element=VeCANR_y_Digit_04, handle-invalid=DONT-INVALIDATE}
      data VeCANR_y_Digit_04: category=VALUE, sw-calibration-access=READ-ONLY, type=ADTSDigit_04, init-value=VeCANR_y_Digit_04Value:0
    VeCANR_y_Digit_05: service-kind=ANY-STANDARDIZED, invalidation-policy{data-element=VeCANR_y_Digit_05, handle-invalid=DONT-INVALIDATE}
      data VeCANR_y_Digit_05: category=VALUE, sw-calibration-access=READ-ONLY, type=ADTSDigit_05, init-value=VeCANR_y_Digit_05Value:0
    VeCANR_y_Digit_06: service-kind=ANY-STANDARDIZED, invalidation-policy{data-element=VeCANR_y_Digit_06, handle-invalid=DONT-INVALIDATE}
      data VeCANR_y_Digit_06: category=VALUE, sw-calibration-access=READ-ONLY, type=ADTSDigit_06, init-value=VeCANR_y_Digit_06Value:0
    VeCANR_y_Digit_07: service-kind=ANY-STANDARDIZED, invalidation-policy{data-element=VeCANR_y_Digit_07, handle-invalid=DONT-INVALIDATE}
      data VeCANR_y_Digit_07: category=VALUE, sw-calibration-access=READ-ONLY, type=ADTSDigit_07, init-value=VeCANR_y_Digit_07Value:0
    VeCANR_y_Digit_08: service-kind=ANY-STANDARDIZED, invalidation-policy{data-element=VeCANR_y_Digit_08, handle-invalid=DONT-INVALIDATE}
      data VeCANR_y_Digit_08: category=VALUE, sw-calibration-access=READ-ONLY, type=ADTSDigit_08, init-value=VeCANR_y_Digit_08Value:0
    VeCANR_y_Digit_09: service-kind=ANY-STANDARDIZED, invalidation-policy{data-element=VeCANR_y_Digit_09, handle-invalid=DONT-INVALIDATE}
      data VeCANR_y_Digit_09: category=VALUE, sw-calibration-access=READ-ONLY, type=ADTSDigit_09, init-value=VeCANR_y_Digit_09Value:0
    VeCANR_y_Digit_10: service-kind=ANY-STANDARDIZED, invalidation-policy{data-element=VeCANR_y_Digit_10, handle-invalid=DONT-INVALIDATE}
      data VeCANR_y_Digit_10: category=VALUE, sw-calibration-access=READ-ONLY, type=ADTSDigit_10, init-value=VeCANR_y_Digit_10Value:0
    VeCANR_y_Digit_11: service-kind=ANY-STANDARDIZED, invalidation-policy{data-element=VeCANR_y_Digit_11, handle-invalid=DONT-INVALIDATE}
      data VeCANR_y_Digit_11: category=VALUE, sw-calibration-access=READ-ONLY, type=ADTSDigit_11, init-value=VeCANR_y_Digit_11Value:0
    VeCANR_y_EngMaxRPM_W: service-kind=ANY-STANDARDIZED, invalidation-policy{data-element=VeCANR_y_EngMaxRPM_W, handle-invalid=KEEP}
      data VeCANR_y_EngMaxRPM_W: category=VALUE, sw-calibration-access=READ-ONLY, type=ADTSEngMaxRPM_W, init-value=VeCANR_y_EngMaxRPM_WValue:12750
    VeCANR_y_Hour1_TLM: service-kind=ANY-STANDARDIZED, invalidation-policy{data-element=VeCANR_y_Hour1_TLM, handle-invalid=DONT-INVALIDATE}
      data VeCANR_y_Hour1_TLM: category=VALUE, sw-calibration-access=READ-ONLY, type=ADTSHour1_TLM, init-value=VeCANR_y_Hour1_TLMValue:0
    VeCANR_y_Hour2_TLM: service-kind=ANY-STANDARDIZED, invalidation-policy{data-element=VeCANR_y_Hour2_TLM, handle-invalid=DONT-INVALIDATE}
      data VeCANR_y_Hour2_TLM: category=VALUE, sw-calibration-access=READ-ONLY, type=ADTSHour2_TLM, init-value=VeCANR_y_Hour2_TLMValue:0
    VeCANR_y_IDCM_CAL_ID: service-kind=ANY-STANDARDIZED, invalidation-policy{data-element=VeCANR_y_IDCM_CAL_ID, handle-invalid=KEEP}
      data VeCANR_y_IDCM_CAL_ID: category=VALUE, sw-calibration-access=READ-ONLY, type=ADTSIDCM_CAL_ID, init-value=VeCANR_y_IDCM_CAL_IDValue:0
    VeCANR_y_IDCM_CAL_VN: service-kind=ANY-STANDARDIZED, invalidation-policy{data-element=VeCANR_y_IDCM_CAL_VN, handle-invalid=KEEP}
      data VeCANR_y_IDCM_CAL_VN: category=VALUE, sw-calibration-access=READ-ONLY, type=ADTSIDCM_CAL_VN, init-value=VeCANR_y_IDCM_CAL_VNValue:0
    VeCANR_y_IDCM_DTC_Idx1: service-kind=ANY-STANDARDIZED, invalidation-policy{data-element=VeCANR_y_IDCM_DTC_Idx1, handle-invalid=KEEP}
      data VeCANR_y_IDCM_DTC_Idx1: category=VALUE, sw-calibration-access=READ-ONLY, type=ADTSIDCM_DTC_Idx1, init-value=VeCANR_y_IDCM_DTC_Idx1Value:0
    VeCANR_y_IDCM_DTC_Idx2: service-kind=ANY-STANDARDIZED, invalidation-policy{data-element=VeCANR_y_IDCM_DTC_Idx2, handle-invalid=KEEP}
      data VeCANR_y_IDCM_DTC_Idx2: category=VALUE, sw-calibration-access=READ-ONLY, type=ADTSIDCM_DTC_Idx2, init-value=VeCANR_y_IDCM_DTC_Idx2Value:0
    VeCANR_y_IDCM_DTC_Idx3: service-kind=ANY-STANDARDIZED, invalidation-policy{data-element=VeCANR_y_IDCM_DTC_Idx3, handle-invalid=KEEP}
      data VeCANR_y_IDCM_DTC_Idx3: category=VALUE, sw-calibration-access=READ-ONLY, type=ADTSIDCM_DTC_Idx3, init-value=VeCANR_y_IDCM_DTC_Idx3Value:0
    VeCANR_y_IDCM_DTC_Idx4: service-kind=ANY-STANDARDIZED, invalidation-policy{data-element=VeCANR_y_IDCM_DTC_Idx4, handle-invalid=KEEP}
      data VeCANR_y_IDCM_DTC_Idx4: category=VALUE, sw-calibration-access=READ-ONLY, type=ADTSIDCM_DTC_Idx4, init-value=VeCANR_y_IDCM_DTC_Idx4Value:0
    VeCANR_y_IDCM_DTC_Idx5: service-kind=ANY-STANDARDIZED, invalidation-policy{data-element=VeCANR_y_IDCM_DTC_Idx5, handle-invalid=KEEP}
      data VeCANR_y_IDCM_DTC_Idx5: category=VALUE, sw-calibration-access=READ-ONLY, type=ADTSIDCM_DTC_Idx5, init-value=VeCANR_y_IDCM_DTC_Idx5Value:0
    VeCANR_y_IDCM_DTC_Idx6: service-kind=ANY-STANDARDIZED, invalidation-policy{data-element=VeCANR_y_IDCM_DTC_Idx6, handle-invalid=KEEP}
      data VeCANR_y_IDCM_DTC_Idx6: category=VALUE, sw-calibration-access=READ-ONLY, type=ADTSIDCM_DTC_Idx6, init-value=VeCANR_y_IDCM_DTC_Idx6Value:0
    VeCANR_y_IDCM_DTC_Idx7: service-kind=ANY-STANDARDIZED, invalidation-policy{data-element=VeCANR_y_IDCM_DTC_Idx7, handle-invalid=KEEP}
      data VeCANR_y_IDCM_DTC_Idx7: category=VALUE, sw-calibration-access=READ-ONLY, type=ADTSIDCM_DTC_Idx7, init-value=VeCANR_y_IDCM_DTC_Idx7Value:0
    VeCANR_y_IDCM_DTC_Idx8: service-kind=ANY-STANDARDIZED, invalidation-policy{data-element=VeCANR_y_IDCM_DTC_Idx8, handle-invalid=KEEP}
      data VeCANR_y_IDCM_DTC_Idx8: category=VALUE, sw-calibration-access=READ-ONLY, type=ADTSIDCM_DTC_Idx8, init-value=VeCANR_y_IDCM_DTC_Idx8Value:0
    VeCANR_y_IDCM_RBM_Idx: service-kind=ANY-STANDARDIZED, invalidation-policy{data-element=VeCANR_y_IDCM_RBM_Idx, handle-invalid=KEEP}
      data VeCANR_y_IDCM_RBM_Idx: category=VALUE, sw-calibration-access=READ-ONLY, type=ADTSIDCM_RBM_Idx, init-value=VeCANR_y_IDCM_RBM_IdxValue:0
    VeCANR_y_IDCM_RBM_Stat: service-kind=ANY-STANDARDIZED, invalidation-policy{data-element=VeCANR_y_IDCM_RBM_Stat, handle-invalid=KEEP}
      data VeCANR_y_IDCM_RBM_Stat: category=VALUE, sw-calibration-access=READ-ONLY, type=ADTSIDCM_RBM_Stat, init-value=VeCANR_y_IDCM_RBM_StatValue:0
    VeCANR_y_MCIDCMOBDDTC: service-kind=ANY-STANDARDIZED, invalidation-policy{data-element=VeCANR_y_MCIDCMOBDDTC, handle-invalid=DONT-INVALIDATE}
      data VeCANR_y_MCIDCMOBDDTC: category=VALUE, sw-calibration-access=READ-ONLY, type=ADTSMCIDCMOBDDTC, init-value=VeCANR_y_MCIDCMOBDDTCValue:0
    VeCANR_y_MCPBCtrlBoarTempP_FD16: service-kind=ANY-STANDARDIZED, invalidation-policy{data-element=VeCANR_y_MCPBCtrlBoarTempP_FD16, handle-invalid=KEEP}
      data VeCANR_y_MCPBCtrlBoarTempP_FD16: category=VALUE, sw-calibration-access=READ-ONLY, type=ADTSMCPBCtrlBoarTempP_FD16, init-value=VeCANR_y_MCPBCtrlBoarTempP_FD16Value:-40
    VeCANR_y_MCPBCtrlBoardTempP_FD5: service-kind=ANY-STANDARDIZED, invalidation-policy{data-element=VeCANR_y_MCPBCtrlBoardTempP_FD5, handle-invalid=KEEP}
      data VeCANR_y_MCPBCtrlBoardTempP_FD5: category=VALUE, sw-calibration-access=READ-ONLY, type=ADTSMCPBCtrlBoardTempP_FD5, init-value=VeCANR_y_MCPBCtrlBoardTempP_FD5Value:-40
    VeCANR_y_MC_FOTA_MASTER: service-kind=ANY-STANDARDIZED, invalidation-policy{data-element=VeCANR_y_MC_FOTA_MASTER, handle-invalid=DONT-INVALIDATE}
      data VeCANR_y_MC_FOTA_MASTER: category=VALUE, sw-calibration-access=READ-ONLY, type=ADTSMC_FOTA_MASTER, init-value=VeCANR_y_MC_FOTA_MASTERValue:0
    VeCANR_y_MC_MCPA_STATUS_FD16: service-kind=ANY-STANDARDIZED, invalidation-policy{data-element=VeCANR_y_MC_MCPA_STATUS_FD16, handle-invalid=DONT-INVALIDATE}
      data VeCANR_y_MC_MCPA_STATUS_FD16: category=VALUE, sw-calibration-access=READ-ONLY, type=ADTSMC_MCPA_STATUS_FD16, init-value=VeCANR_y_MC_MCPA_STATUS_FD16Value:0
    VeCANR_y_MC_MCPA_STATUS_FD5: service-kind=ANY-STANDARDIZED, invalidation-policy{data-element=VeCANR_y_MC_MCPA_STATUS_FD5, handle-invalid=DONT-INVALIDATE}
      data VeCANR_y_MC_MCPA_STATUS_FD5: category=VALUE, sw-calibration-access=READ-ONLY, type=ADTSMC_MCPA_STATUS_FD5, init-value=VeCANR_y_MC_MCPA_STATUS_FD5Value:0
    VeCANR_y_MC_MCPB_STATUS_FD16: service-kind=ANY-STANDARDIZED, invalidation-policy{data-element=VeCANR_y_MC_MCPB_STATUS_FD16, handle-invalid=DONT-INVALIDATE}
      data VeCANR_y_MC_MCPB_STATUS_FD16: category=VALUE, sw-calibration-access=READ-ONLY, type=ADTSMC_MCPB_STATUS_FD16, init-value=VeCANR_y_MC_MCPB_STATUS_FD16Value:0
    VeCANR_y_MC_MCPB_STATUS_FD5: service-kind=ANY-STANDARDIZED, invalidation-policy{data-element=VeCANR_y_MC_MCPB_STATUS_FD5, handle-invalid=DONT-INVALIDATE}
      data VeCANR_y_MC_MCPB_STATUS_FD5: category=VALUE, sw-calibration-access=READ-ONLY, type=ADTSMC_MCPB_STATUS_FD5, init-value=VeCANR_y_MC_MCPB_STATUS_FD5Value:0
    VeCANR_y_MC_SGCP_STATUS_FD16: service-kind=ANY-STANDARDIZED, invalidation-policy{data-element=VeCANR_y_MC_SGCP_STATUS_FD16, handle-invalid=DONT-INVALIDATE}
      data VeCANR_y_MC_SGCP_STATUS_FD16: category=VALUE, sw-calibration-access=READ-ONLY, type=ADTSMC_SGCP_STATUS_FD16, init-value=VeCANR_y_MC_SGCP_STATUS_FD16Value:0
    VeCANR_y_MC_SGCP_STATUS_FD5: service-kind=ANY-STANDARDIZED, invalidation-policy{data-element=VeCANR_y_MC_SGCP_STATUS_FD5, handle-invalid=DONT-INVALIDATE}
      data VeCANR_y_MC_SGCP_STATUS_FD5: category=VALUE, sw-calibration-access=READ-ONLY, type=ADTSMC_SGCP_STATUS_FD5, init-value=VeCANR_y_MC_SGCP_STATUS_FD5Value:0
    VeCANR_y_Minute1_TLM: service-kind=ANY-STANDARDIZED, invalidation-policy{data-element=VeCANR_y_Minute1_TLM, handle-invalid=DONT-INVALIDATE}
      data VeCANR_y_Minute1_TLM: category=VALUE, sw-calibration-access=READ-ONLY, type=ADTSMinute1_TLM, init-value=VeCANR_y_Minute1_TLMValue:0
    VeCANR_y_Minute2_TLM: service-kind=ANY-STANDARDIZED, invalidation-policy{data-element=VeCANR_y_Minute2_TLM, handle-invalid=DONT-INVALIDATE}
      data VeCANR_y_Minute2_TLM: category=VALUE, sw-calibration-access=READ-ONLY, type=ADTSMinute2_TLM, init-value=VeCANR_y_Minute2_TLMValue:0
    VeCANR_y_Month1_TLM: service-kind=ANY-STANDARDIZED, invalidation-policy{data-element=VeCANR_y_Month1_TLM, handle-invalid=DONT-INVALIDATE}
      data VeCANR_y_Month1_TLM: category=VALUE, sw-calibration-access=READ-ONLY, type=ADTSMonth1_TLM, init-value=VeCANR_y_Month1_TLMValue:0
    VeCANR_y_Month2_TLM: service-kind=ANY-STANDARDIZED, invalidation-policy{data-element=VeCANR_y_Month2_TLM, handle-invalid=DONT-INVALIDATE}
      data VeCANR_y_Month2_TLM: category=VALUE, sw-calibration-access=READ-ONLY, type=ADTSMonth2_TLM, init-value=VeCANR_y_Month2_TLMValue:0
    VeCANR_y_SGCPPIMACSdBusTempPFD5: service-kind=ANY-STANDARDIZED, invalidation-policy{data-element=VeCANR_y_SGCPPIMACSdBusTempPFD5, handle-invalid=KEEP}
      data VeCANR_y_SGCPPIMACSdBusTempPFD5: category=VALUE, sw-calibration-access=READ-ONLY, type=ADTSSGCPPIMACSdBusTempPFD5, init-value=VeCANR_y_SGCPPIMACSdBusTempPFD5Value:-40
    VeCANR_y_SGCPPIMACSdBusTmpPFD16: service-kind=ANY-STANDARDIZED, invalidation-policy{data-element=VeCANR_y_SGCPPIMACSdBusTmpPFD16, handle-invalid=KEEP}
      data VeCANR_y_SGCPPIMACSdBusTmpPFD16: category=VALUE, sw-calibration-access=READ-ONLY, type=ADTSSGCPPIMACSdBusTmpPFD16, init-value=VeCANR_y_SGCPPIMACSdBusTmpPFD16Value:-40
    VeCANR_y_Year1_TLM: service-kind=ANY-STANDARDIZED, invalidation-policy{data-element=VeCANR_y_Year1_TLM, handle-invalid=DONT-INVALIDATE}
      data VeCANR_y_Year1_TLM: category=VALUE, sw-calibration-access=READ-ONLY, type=ADTSYear1_TLM, init-value=VeCANR_y_Year1_TLMValue:0
    VeCANR_y_Year2_TLM: service-kind=ANY-STANDARDIZED, invalidation-policy{data-element=VeCANR_y_Year2_TLM, handle-invalid=DONT-INVALIDATE}
      data VeCANR_y_Year2_TLM: category=VALUE, sw-calibration-access=READ-ONLY, type=ADTSYear2_TLM, init-value=VeCANR_y_Year2_TLMValue:0
    VeCANR_y_Year3_TLM: service-kind=ANY-STANDARDIZED, invalidation-policy{data-element=VeCANR_y_Year3_TLM, handle-invalid=DONT-INVALIDATE}
      data VeCANR_y_Year3_TLM: category=VALUE, sw-calibration-access=READ-ONLY, type=ADTSYear3_TLM, init-value=VeCANR_y_Year3_TLMValue:0
    VeCANR_y_Year4_TLM: service-kind=ANY-STANDARDIZED, invalidation-policy{data-element=VeCANR_y_Year4_TLM, handle-invalid=DONT-INVALIDATE}
      data VeCANR_y_Year4_TLM: category=VALUE, sw-calibration-access=READ-ONLY, type=ADTSYear4_TLM, init-value=VeCANR_y_Year4_TLMValue:0
