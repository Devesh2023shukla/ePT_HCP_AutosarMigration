AUTOSAR XML (schema 00044)
package /ARPackage_0
  impl type BswM_ESH_Mode: implementation-data-type=uint8
  impl type BswM_Rte_Mode: implementation-data-type=uint8
package /BswMDataMappingSet
  data type mapping set BswMMappingSet
    mode-request-type-maps:
      implementation-data-type=BswM_Rte_Mode, mode-group=BswMEcuModes
      implementation-data-type=BswM_ESH_Mode, mode-group=BswMEcuIntSts
      implementation-data-type=uint8, mode-group=DemInitSts
      implementation-data-type=uint8, mode-group=MDG_MdulInit
      implementation-data-type=uint8, mode-group=MDG_LinSMComMod
      implementation-data-type=uint8, mode-group=MDG_Lin{1..3}Equid
package /FCASharedInterfaces/IFCOEs/IFPlatform_Srv
  sender receiver interface CntrlrPwrHold_SR
  20 x client server interface:
    GetLLTR_b_FreeRunTiExpired: service-kind=ANY-STANDARDIZED  # None | Status of CPU free running counter time expired with reference to a start count
      operation GetLLTR_b_FreeRunTiExpired  # Has Free RunExpired | Status of CPU free running counter time expired with reference to a start count
        arg StrtTi: type=uint32, direction=IN, server-argument-impl-policy=USE-ARGUMENT-TYPE  # None
        arg MaxWaitCount: type=uint32, direction=IN, server-argument-impl-policy=USE-ARGUMENT-TYPE  # None
        arg Result: type=boolean, direction=INOUT, server-argument-impl-policy=USE-ARGUMENT-TYPE  # None
    GetLLTR_t_EngOffTiMins: service-kind=ANY-STANDARDIZED  # None | Total engine off time in minutes - Could include the engine off time from last key on.
      operation GetLLTR_t_EngOffTiMins  # Get Engine Off Time Minute | Total engine off time in minutes - Could include the engine off time from last key on.
        arg EngOffTiMins: type=float32, direction=OUT, server-argument-impl-policy=USE-ARGUMENT-TYPE  # None
    GetLLTR_t_EngOffTiSec: service-kind=ANY-STANDARDIZED  # None | Total engine off time in seconds - Could include the engine off time from last key on.
      operation GetLLTR_t_EngOffTiSec  # Get Engine Off TimeSecs | Total engine off time in seconds - Could include the engine off time from last key on.
        arg EngOffTiSecs: type=float32, direction=OUT, server-argument-impl-policy=USE-ARGUMENT-TYPE  # None
    GetLLTR_t_EngStlTmr: service-kind=ANY-STANDARDIZED  # None | Engine stall time since key on in 10ms per bit
      operation GetLLTR_t_EngStlTmr  # Get EngineStall Timer | Engine stall time since key on in 10ms per bit
        arg EngStallTmr: type=uint32, direction=OUT, server-argument-impl-policy=USE-ARGUMENT-TYPE  # None | Engine stall time in 10ms per bit
    GetLLTR_t_FreeRunTmr: service-kind=ANY-STANDARDIZED  # None | CPU free running counter value in system clock - 1/240MHz per bit.
      operation GetLLTR_t_FreeRunTmr  # Get Free Run Timer | CPU free running counter value in system clock - 1/240MHz per bit.
        arg FreeRunTmr: type=uint32, direction=OUT, server-argument-impl-policy=USE-ARGUMENT-TYPE  # None | CPU free running counter value in system clock - 1/240MHz per bit.
    GetLLTR_t_KeyOffToKeyOnSec  # Time from ignition key off to key on in seconds
      operation GetLLTR_t_KeyOffToKeyOnSec
        arg KeyOffToKeyOnSec: type=float32, direction=OUT, server-argument-impl-policy=USE-ARGUMENT-TYPE
    GetLLTR_t_SysUpTmr: service-kind=ANY-STANDARDIZED  # None | System timer in 1ms resolution counting since module is up.
      operation GetLLTR_t_SysUpTmr  # Get System Up Timer | System timer in 1ms resolution counting since module is up.
        arg SysUpTmr: type=uint32, direction=OUT, server-argument-impl-policy=USE-ARGUMENT-TYPE  # None
    GetMODR_b_InPostRunMode: service-kind=ANY-STANDARDIZED  # None
      operation GetMODR_b_InPostRunMode  # In Post Run
        arg InPostRun: type=boolean, direction=OUT, server-argument-impl-policy=USE-ARGUMENT-TYPE  # None
    GetMODR_b_InRunMode: service-kind=ANY-STANDARDIZED  # None
      operation GetMODR_b_InRunMode  # In Run
        arg InRun: type=boolean, direction=OUT, server-argument-impl-policy=USE-ARGUMENT-TYPE  # None
    GetMODR_b_InShtDwnMode: service-kind=ANY-STANDARDIZED  # None
      operation GetMODR_b_InShtDwnMode  # In Shut
        arg InShutDown: type=boolean, direction=OUT, server-argument-impl-policy=USE-ARGUMENT-TYPE  # None
    GetMODR_b_InStrtUpMode: service-kind=ANY-STANDARDIZED  # None
      operation GetMODR_b_InStrtUpMode  # In Up
        arg InStartUp: type=boolean, direction=OUT, server-argument-impl-policy=USE-ARGUMENT-TYPE  # None
    GetMODR_b_InWakeUpMode: service-kind=ANY-STANDARDIZED  # None
      operation GetMODR_b_InWakeUpMode  # In Wake Up
        arg InWakeUp: type=boolean, direction=OUT, server-argument-impl-policy=USE-ARGUMENT-TYPE  # None
    GetMODR_e_CurrRTE_Mode: service-kind=ANY-STANDARDIZED  # None
      operation GetMODR_e_CurrRTE_Mode  # GetCurrent RTE
        arg CurrentMode: type=BswM_Rte_Mode, direction=OUT, server-argument-impl-policy=USE-ARGUMENT-TYPE  # None
    GetPRTR_Cnt_NrOfVlvPerCyl
      operation GetPRTR_Cnt_NrOfVlvPerCyl
        arg GetPRTR_Cnt_NrOfVlvPerCyl: type=uint8, direction=OUT, server-argument-impl-policy=USE-ARGUMENT-TYPE
    GetPRTR_b_ETC_Prsnt
      operation GetPRTR_b_ETC_Prsnt
        arg GetPRTR_b_ETC_Prsnt: type=boolean, direction=OUT, server-argument-impl-policy=USE-ARGUMENT-TYPE
    GetPRTR_b_TransTyp
      operation GetPRTR_b_TransTyp
        arg GetPRTR_b_TransTyp: type=boolean, direction=OUT, server-argument-impl-policy=USE-ARGUMENT-TYPE
    GetPRTR_y_EngAspirationMethod
      operation GetPRTR_y_EngAspirationMethod
        arg GetPRTR_y_EngAspirationMethod: type=uint8, direction=OUT, server-argument-impl-policy=USE-ARGUMENT-TYPE
    GetPRTR_y_EngMfr
      operation GetPRTR_y_EngMfr
        arg GetPRTR_y_EngMfr: type=uint8, direction=OUT, server-argument-impl-policy=USE-ARGUMENT-TYPE
    GetPRTR_y_EngOutpVer
      operation GetPRTR_y_EngOutpVer
        arg GetPRTR_y_EngOutpVer: type=uint8, direction=OUT, server-argument-impl-policy=USE-ARGUMENT-TYPE
    GetPRTR_y_FuTyp
      operation GetPRTR_y_FuTyp
        arg GetPRTR_y_FuTyp: type=uint8, direction=OUT, server-argument-impl-policy=USE-ARGUMENT-TYPE
  6 x port interface mapping set:
    RteModeToGetCurrentRteModeIfMap
      port-interface-mappings:
        client server interface mapping RteModeToGetCurrentRteModeIfMap: client-server-operation-mapping{first-operation=GetMODR_e_CurrRTE_Mode, second-operation=GetMODR_e_CurrRTE_Mode}
    RteModeToInPostRunModeIfMap
      port-interface-mappings:
        client server interface mapping RteModeToInPostRunModeIfMapping: client-server-operation-mapping{first-operation=GetMODR_b_InPostRunMode, second-operation=GetMODR_b_InPostRunMode}
    RteModeToInRunModeIfMap
      port-interface-mappings:
        client server interface mapping RteModeToInRunModeIfMapping: client-server-operation-mapping{first-operation=GetMODR_b_InRunMode, second-operation=GetMODR_b_InRunMode}
    RteModeToInShutDownModeIfMap
      port-interface-mappings:
        client server interface mapping RteModeToInShutDownModeIfMapping: client-server-operation-mapping{first-operation=GetMODR_b_InShtDwnMode, second-operation=GetMODR_b_InShtDwnMode}
    RteModeToInStartUpModeIfMap
      port-interface-mappings:
        client server interface mapping RteModeToInStartUpModeIfMapping: client-server-operation-mapping{first-operation=GetMODR_b_InStrtUpMode, second-operation=GetMODR_b_InStrtUpMode}
    RteModeToInWakeUpModeIfMap
      port-interface-mappings:
        client server interface mapping RteModeToInWakeUpModeIfMapping: client-server-operation-mapping{first-operation=GetMODR_b_InWakeUpMode, second-operation=GetMODR_b_InWakeUpMode}
  7 x sender receiver interface:
    VeDIDR_Cnt_Mode4Rst
      data VeDIDR_Cnt_Mode4Rst: sw-calibration-access=READ-ONLY, type=uint8
    VeLLTR_t_EngOffTiMins: service-kind=ANY-STANDARDIZED  # Environment SwitchClosure Time | Total engine off time in minutes - Could include the engine off time from last key on.
      data VeLLTR_t_EngOffTiMins: type=float32  # Total engine off time in minutes - Could include the engine off time from last key on.
    VeLLTR_t_EngOffTiSec: service-kind=ANY-STANDARDIZED  # Environment SwitchClosure Time | Total engine off time in seconds - Could include the engine off time from last key on.
      data VeLLTR_t_EngOffTiSec: type=float32  # Total engine off time in seconds - Could include the engine off time from last key on.
    VeLLTR_t_KeyOffToKeyOnMins: service-kind=ANY-STANDARDIZED, invalidation-policy{data-element=VeLLTR_t_KeyOffToKeyOnMins, handle-invalid=DONT-INVALIDATE}  # Keyoff ToKeyon Minute | Time from ignition key off to key on in minutes
      data VeLLTR_t_KeyOffToKeyOnMins: category=VALUE, sw-calibration-access=READ-ONLY, type=float32, init-value=KeyoffToKeyonMinsValue:0  # Time from ignition key off to key on in minutes
    VeLLTR_t_KeyOffToKeyOnSec  # Time from ignition key off to key on in seconds
      data VeLLTR_t_KeyOffToKeyOnSec: type=float32  # Time from ignition key off to key on in seconds
    VeLLTR_t_SysUpTmr  # System timer in 1ms resolution counting since module is up.
      data VeLLTR_t_SysUpTmr: type=uint32  # System timer in 1ms resolution counting since module is up.
    VeSPLR_b_PostRunRqrdSt: service-kind=ANY-STANDARDIZED, invalidation-policy{data-element=VeSPLR_b_PostRunRqrdSt, handle-invalid=DONT-INVALIDATE}  # InValid
      data VeSPLR_b_PostRunRqrdSt: category=VALUE, type=ADTSPostRunRqrd, init-value=1
package /MSI_ShutDown
  data type mapping set MG_Shutdown_Mapping: mode-request-type-map{implementation-data-type=uint8, mode-group=MDG_ShutDown}
  mode switch interface MSI_ShutDown: is-service=true
    mode group MDGP_MSI_ShutDown: type=MDG_ShutDown
package /MSI_ShutDown/MDG
  mode declaration group MDG_ShutDown: category=EXPLICIT_ORDER, initial-mode=MDG_ShutDown/RUN, on-transition-value=2
    11 x mode:
      SHUT_DOWN: category=EXPLICIT_ORDER, value=0
      RUN: category=EXPLICIT_ORDER, value=1
      LIN_SCHEDULE_TABLE_Lin0_BEV_COMMON_RUN: value=3
      LIN_SCHEDULE_TABLE_Lin1_BEV_COMMON_RUN: value=4
      LIN_SCHEDULE_TABLE_Lin2_BEV_COMMON_RUN: value=5
      LIN_SCHEDULE_TABLE_Lin0_DT_REPB_RUN: value=6
      LIN_SCHEDULE_TABLE_Lin1_DT_REPB_RUN: value=7
      LIN_SCHEDULE_TABLE_Lin2_DT_REPB_RUN: value=8
      LIN_SCHEDULE_TABLE_Lin0_WS_REPB_RUN: value=9
      LIN_SCHEDULE_TABLE_Lin1_WS_REPB_RUN: value=10
      LIN_SCHEDULE_TABLE_Lin2_WS_REPB_RUN: value=11
package /ModeSwitchInterfaces
  mode declaration group BswMEcuIntSts: category=EXPLICIT_ORDER, initial-mode=St_INIT, on-transition-value=8
    8 x mode:
      St_PREP_SHUTDOWN: value=4
      St_WAIT_FOR_NVM: value=5
      St_NVM_CANCELED: value=6
      St_INIT: value=0
      St_WAKEUP: value=1
      St_RUN: value=2
      St_POSTRUN: value=3
      St_SHUTDOWN: value=7
  mode declaration group BswMEcuModes: category=ALPHABETIC_ORDER, initial-mode=STARTUP
    5 x mode, all with category=EXPLICIT_ORDER:
      RUN
      POSTRUN
      STARTUP
      SHUTDOWN
      WAKEUP
  mode declaration group DemInitSts: category=EXPLICIT_ORDER, initial-mode=DEM_NOT_INITIALIZED
    mode DEM_INITIALIZED: value=0
    mode DEM_NOT_INITIALIZED: value=1
  mode switch interface DemInit_Mode: is-service=true
    mode group DemInitDclGroups: type=DemInitSts
  mode switch interface Ecu_InternalState: is-service=true
    mode group BswMEcuStateDclGroups: type=BswMEcuIntSts
  mode switch interface Ecu_Mode: is-service=true
    mode group BswMEcuModeDclGroups: type=BswMEcuModes
  mode declaration group MDG_MdulInit: category=ALPHABETIC_ORDER, initial-mode=MDUL_NOINIT
    mode MDUL_INIT
    mode MDUL_NOINIT
