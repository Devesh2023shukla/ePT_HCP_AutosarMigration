AUTOSAR XML (schema 00050)
package /STLASharedInterfaces/IFCOEs/IFPlatform_Can
  client server interface GetDMRR_g_EnblCondSts
    operation GetDMRR_g_EnblCondSts
      arg EnaCdnStates: type=uint32, direction=OUT, server-argument-impl-policy=USE-ARGUMENT-TYPE
  13 x parameter interface:
    KeCFGR_b_AGSM_equid  # AGSM equipped cal
      parameter data prototype KeCFGR_b_AGSM_equid: type=boolean  # AGSM equipped cal. 1(TRUE) = equipped, 0(FALSE) = not equipped
    KeCFGR_b_BCM_equid  # BCM equipped cal
      parameter data prototype KeCFGR_b_BCM_equid: type=boolean  # BCM equipped cal. 1(TRUE) = equipped, 0(FALSE) = not equipped
    KeCFGR_b_BPCM_equid  # BPCM equipped cal
      parameter data prototype KeCFGR_b_BPCM_equid: type=boolean  # BPCM equipped cal. 1(TRUE) = equipped, 0(FALSE) = not equipped
    KeCFGR_b_BSM_equid  # BSM equipped cal
      parameter data prototype KeCFGR_b_BSM_equid: type=boolean  # BSM equipped cal. 1(TRUE) = equipped, 0(FALSE) = not equipped
    KeCFGR_b_EPS_equid  # EPS equipped cal
      parameter data prototype KeCFGR_b_EPS_equid: type=boolean  # EPS equipped cal. 1(TRUE) = equipped, 0(FALSE) = not equipped
    KeCFGR_b_FD11_equid  # FD11 bus equipped cal
      parameter data prototype KeCFGR_b_FD11_equid: type=boolean  # Bit used to determine if vehicle is configured with FD11 bus
    KeCFGR_b_FD14_equid  # FD14 bus equipped cal
      parameter data prototype KeCFGR_b_FD14_equid: type=boolean  # Bit used to determine if vehicle is configured with FD14 bus
    KeCFGR_b_FD16_equid
      parameter data prototype KeCFGR_b_FD16_equid: type=boolean  # Bit used to determine if vehicle is configured with FD16 bus
    KeCFGR_b_FD3_equid  # FD3 bus equipped cal
      parameter data prototype KeCFGR_b_FD3_equid: type=boolean  # Bit used to determine if vehicle is configured with FD3 bus
    KeCFGR_b_FD5_equid  # FD5 bus equipped cal
      parameter data prototype KeCFGR_b_FD5_equid: type=boolean  # Bit used to determine if vehicle is configured with FD5 bus
    KeCFGR_b_IDCM_equid  # IDCM equipped cal
      parameter data prototype KeCFGR_b_IDCM_equid: type=boolean  # IDCM equipped cal. 1(TRUE) = equipped, 0(FALSE) = not equipped
    KeCFGR_b_MCPA_equid  # MPCA equipped cal
      parameter data prototype KeCFGR_b_MCPA_equid: type=boolean  # MPCA equipped cal. 1(TRUE) = equipped, 0(FALSE) = not equipped
    KeCFGR_b_MCPB_equid  # MCPB equipped cal
      parameter data prototype KeCFGR_b_MCPB_equid: type=boolean  # MCPB equipped cal. 1(TRUE) = equipped, 0(FALSE) = not equipped
  91 x sender receiver interface:
    VeBATR_U_12VoltSys: invalidation-policy{data-element=VeBATR_U_12VoltSys, handle-invalid=DONT-INVALIDATE}
      data VeBATR_U_12VoltSys: type=ADTSFloat32_Volts
    VeCANR_b_CurrBusOffSt_FD11  # FD11 CAN bus off state
      data VeCANR_b_CurrBusOffSt_FD11: type=ADTSBoolean  # Current busoff state: Busoff = TRUE(1), not busoff = FALSE(0)
    VeCANR_b_CurrBusOffSt_FD14  # CAN FD14 bus off state
      data VeCANR_b_CurrBusOffSt_FD14: type=ADTSBoolean  # Current busoff state: Busoff = TRUE(1), not busoff = FALSE(0)
    VeCANR_b_CurrBusOffSt_FD16  # CAN FD16 bus off state
      data VeCANR_b_CurrBusOffSt_FD16: type=ADTSBoolean  # Current busoff state: Busoff = TRUE(1), not busoff = FALSE(0)
    VeCANR_b_CurrBusOffSt_FD3  # CAN FD3 bus off state
      data VeCANR_b_CurrBusOffSt_FD3: type=ADTSBoolean  # Current busoff state: Busoff = TRUE(1), not busoff = FALSE(0)
    VeCANR_b_CurrBusOffSt_FD5  # FD5 CAN bus off state
      data VeCANR_b_CurrBusOffSt_FD5: type=ADTSBoolean  # Current busoff state: Busoff = TRUE(1), not busoff = FALSE(0)
    VeCANR_b_CurrBusOpenSt_FD11  # CAN FD11 bus open state
      data VeCANR_b_CurrBusOpenSt_FD11: type=ADTSBoolean  # Current bus open state: Bus open = TRUE(1), not bus open = FALSE(0)
    VeCANR_b_CurrBusOpenSt_FD14  # CAN FD14 bus open state
      data VeCANR_b_CurrBusOpenSt_FD14: type=ADTSBoolean  # Current bus open state: Bus open = TRUE(1), not bus open = FALSE(0)
    VeCANR_b_CurrBusOpenSt_FD16  # CAN FD16 bus open state
      data VeCANR_b_CurrBusOpenSt_FD16: type=ADTSBoolean  # Current bus open state: Bus open = TRUE(1), not bus open = FALSE(0)
    VeCANR_b_CurrBusOpenSt_FD3  # CAN FD3 bus open state
      data VeCANR_b_CurrBusOpenSt_FD3: type=ADTSBoolean  # Current bus open state: Bus open = TRUE(1), not bus open = FALSE(0)
    VeCANR_b_CurrBusOpenSt_FD5  # CAN FD5 bus open state
      data VeCANR_b_CurrBusOpenSt_FD5: type=ADTSBoolean  # Current bus open state: Bus open = TRUE(1), not bus open = FALSE(0)
    VeCANR_b_LOC_AAD: service-kind=ANY-STANDARDIZED, invalidation-policy{data-element=VeCANR_b_LOC_AAD, handle-invalid=DONT-INVALIDATE}
      data VeCANR_b_LOC_AAD: category=VALUE, sw-calibration-access=READ-ONLY, type=ADTSBoolean, init-value=0
    VeCANR_b_LOC_AGS: service-kind=ANY-STANDARDIZED, invalidation-policy{data-element=VeCANR_b_LOC_AGS, handle-invalid=DONT-INVALIDATE}
      data VeCANR_b_LOC_AGS: category=VALUE, sw-calibration-access=READ-ONLY, type=ADTSBoolean, init-value=0
    VeCANR_b_LOC_AGS2: service-kind=ANY-STANDARDIZED, invalidation-policy{data-element=VeCANR_b_LOC_AGS2, handle-invalid=DONT-INVALIDATE}
      data VeCANR_b_LOC_AGS2: category=VALUE, sw-calibration-access=READ-ONLY, type=ADTSBoolean, init-value=0
    VeCANR_b_LOC_AGSM_FD16: service-kind=ANY-STANDARDIZED, invalidation-policy{data-element=VeCANR_b_LOC_AGSM_FD16, handle-invalid=DONT-INVALIDATE}
      data VeCANR_b_LOC_AGSM_FD16: category=VALUE, sw-calibration-access=READ-ONLY, type=ADTSBoolean, init-value=VeCANR_b_LOC_AGSM_FD16Value:0
    VeCANR_b_LOC_AGSM_FD3: service-kind=ANY-STANDARDIZED, invalidation-policy{data-element=VeCANR_b_LOC_AGSM_FD3, handle-invalid=DONT-INVALIDATE}
      data VeCANR_b_LOC_AGSM_FD3: category=VALUE, sw-calibration-access=READ-ONLY, type=ADTSBoolean, init-value=VeCANR_b_LOC_AGSM_FD3Value:0
    VeCANR_b_LOC_AHP: service-kind=ANY-STANDARDIZED, invalidation-policy{data-element=VeCANR_b_LOC_AHP, handle-invalid=DONT-INVALIDATE}
      data VeCANR_b_LOC_AHP: category=VALUE, sw-calibration-access=READ-ONLY, type=ADTSBoolean, init-value=0
    VeCANR_b_LOC_BCM_FD3: service-kind=ANY-STANDARDIZED, invalidation-policy{data-element=VeCANR_b_LOC_BCM_FD3, handle-invalid=DONT-INVALIDATE}
      data VeCANR_b_LOC_BCM_FD3: category=VALUE, sw-calibration-access=READ-ONLY, type=ADTSBoolean, init-value=VeCANR_b_LOC_BCM_FD3Value:0
    VeCANR_b_LOC_BCP: service-kind=ANY-STANDARDIZED, invalidation-policy{data-element=VeCANR_b_LOC_BCP, handle-invalid=DONT-INVALIDATE}
      data VeCANR_b_LOC_BCP: category=VALUE, sw-calibration-access=READ-ONLY, type=ADTSBoolean, init-value=0
    VeCANR_b_LOC_BHV: service-kind=ANY-STANDARDIZED, invalidation-policy{data-element=VeCANR_b_LOC_BHV, handle-invalid=DONT-INVALIDATE}
      data VeCANR_b_LOC_BHV: category=VALUE, sw-calibration-access=READ-ONLY, type=ADTSBoolean, init-value=0
    VeCANR_b_LOC_BPCM_FD11: service-kind=ANY-STANDARDIZED, invalidation-policy{data-element=VeCANR_b_LOC_BPCM_FD11, handle-invalid=DONT-INVALIDATE}
      data VeCANR_b_LOC_BPCM_FD11: category=VALUE, sw-calibration-access=READ-ONLY, type=ADTSBoolean, init-value=VeCANR_b_LOC_BPCM_FD11Value:0
    VeCANR_b_LOC_BPCM_FD5: service-kind=ANY-STANDARDIZED, invalidation-policy{data-element=VeCANR_b_LOC_BPCM_FD5, handle-invalid=DONT-INVALIDATE}
      data VeCANR_b_LOC_BPCM_FD5: category=VALUE, sw-calibration-access=READ-ONLY, type=ADTSBoolean, init-value=VeCANR_b_LOC_BPCM_FD5Value:0
    VeCANR_b_LOC_BSM_FD14: service-kind=ANY-STANDARDIZED, invalidation-policy{data-element=VeCANR_b_LOC_BSM_FD14, handle-invalid=DONT-INVALIDATE}
      data VeCANR_b_LOC_BSM_FD14: category=VALUE, sw-calibration-access=READ-ONLY, type=ADTSBoolean, init-value=VeCANR_b_LOC_BSM_FD14Value:0
    VeCANR_b_LOC_BSM_FD3: service-kind=ANY-STANDARDIZED, invalidation-policy{data-element=VeCANR_b_LOC_BSM_FD3, handle-invalid=DONT-INVALIDATE}
      data VeCANR_b_LOC_BSM_FD3: category=VALUE, sw-calibration-access=READ-ONLY, type=ADTSBoolean, init-value=VeCANR_b_LOC_BSM_FD3Value:0
    VeCANR_b_LOC_CADM_FD14: service-kind=ANY-STANDARDIZED, invalidation-policy{data-element=VeCANR_b_LOC_CADM_FD14, handle-invalid=DONT-INVALIDATE}
      data VeCANR_b_LOC_CADM_FD14: category=VALUE, sw-calibration-access=READ-ONLY, type=ADTSBoolean, init-value=0
    VeCANR_b_LOC_CEXV: service-kind=ANY-STANDARDIZED, invalidation-policy{data-element=VeCANR_b_LOC_CEXV, handle-invalid=DONT-INVALIDATE}
      data VeCANR_b_LOC_CEXV: category=VALUE, sw-calibration-access=READ-ONLY, type=ADTSBoolean, init-value=0
    VeCANR_b_LOC_CPIM: service-kind=ANY-STANDARDIZED, invalidation-policy{data-element=VeCANR_b_LOC_CPIM, handle-invalid=DONT-INVALIDATE}
      data VeCANR_b_LOC_CPIM: category=VALUE, sw-calibration-access=READ-ONLY, type=ADTSBoolean, init-value=0
    VeCANR_b_LOC_CPV: service-kind=ANY-STANDARDIZED, invalidation-policy{data-element=VeCANR_b_LOC_CPV, handle-invalid=DONT-INVALIDATE}
      data VeCANR_b_LOC_CPV: category=VALUE, sw-calibration-access=READ-ONLY, type=ADTSBoolean, init-value=0
    VeCANR_b_LOC_EAC: service-kind=ANY-STANDARDIZED, invalidation-policy{data-element=VeCANR_b_LOC_EAC, handle-invalid=DONT-INVALIDATE}
      data VeCANR_b_LOC_EAC: category=VALUE, sw-calibration-access=READ-ONLY, type=ADTSBoolean, init-value=0
    VeCANR_b_LOC_EAH: service-kind=ANY-STANDARDIZED, invalidation-policy{data-element=VeCANR_b_LOC_EAH, handle-invalid=DONT-INVALIDATE}
      data VeCANR_b_LOC_EAH: category=VALUE, sw-calibration-access=READ-ONLY, type=ADTSBoolean, init-value=0
    VeCANR_b_LOC_ECH: service-kind=ANY-STANDARDIZED, invalidation-policy{data-element=VeCANR_b_LOC_ECH, handle-invalid=DONT-INVALIDATE}
      data VeCANR_b_LOC_ECH: category=VALUE, sw-calibration-access=READ-ONLY, type=ADTSBoolean, init-value=0
    VeCANR_b_LOC_ECM_FD16: service-kind=ANY-STANDARDIZED, invalidation-policy{data-element=VeCANR_b_LOC_ECM_FD16, handle-invalid=DONT-INVALIDATE}
      data VeCANR_b_LOC_ECM_FD16: category=VALUE, sw-calibration-access=READ-ONLY, type=ADTSBoolean, init-value=VeCANR_b_LOC_ECM_FD16Value:0
    VeCANR_b_LOC_ECM_FD3: service-kind=ANY-STANDARDIZED, invalidation-policy{data-element=VeCANR_b_LOC_ECM_FD3, handle-invalid=DONT-INVALIDATE}
      data VeCANR_b_LOC_ECM_FD3: category=VALUE, sw-calibration-access=READ-ONLY, type=ADTSBoolean, init-value=VeCANR_b_LOC_ECM_FD3Value:0
    VeCANR_b_LOC_ECM_FD5: service-kind=ANY-STANDARDIZED, invalidation-policy{data-element=VeCANR_b_LOC_ECM_FD5, handle-invalid=DONT-INVALIDATE}
      data VeCANR_b_LOC_ECM_FD5: category=VALUE, sw-calibration-access=READ-ONLY, type=ADTSBoolean, init-value=VeCANR_b_LOC_ECM_FD5Value:0
    VeCANR_b_LOC_EOPA: service-kind=ANY-STANDARDIZED, invalidation-policy{data-element=VeCANR_b_LOC_EOPA, handle-invalid=DONT-INVALIDATE}
      data VeCANR_b_LOC_EOPA: category=VALUE, sw-calibration-access=READ-ONLY, type=ADTSBoolean, init-value=0
    VeCANR_b_LOC_EOPB: service-kind=ANY-STANDARDIZED, invalidation-policy{data-element=VeCANR_b_LOC_EOPB, handle-invalid=DONT-INVALIDATE}
      data VeCANR_b_LOC_EOPB: category=VALUE, sw-calibration-access=READ-ONLY, type=ADTSBoolean, init-value=0
    VeCANR_b_LOC_EPS: service-kind=ANY-STANDARDIZED, invalidation-policy{data-element=VeCANR_b_LOC_EPS, handle-invalid=DONT-INVALIDATE}
      data VeCANR_b_LOC_EPS: category=VALUE, sw-calibration-access=READ-ONLY, type=ADTSBoolean, init-value=VeCANR_b_LOC_EPSValue:0
    VeCANR_b_LOC_ESBM: service-kind=ANY-STANDARDIZED, invalidation-policy{data-element=VeCANR_b_LOC_ESBM, handle-invalid=DONT-INVALIDATE}
      data VeCANR_b_LOC_ESBM: category=VALUE, sw-calibration-access=READ-ONLY, type=ADTSBoolean, init-value=0
    VeCANR_b_LOC_EXV: service-kind=ANY-STANDARDIZED, invalidation-policy{data-element=VeCANR_b_LOC_EXV, handle-invalid=DONT-INVALIDATE}
      data VeCANR_b_LOC_EXV: category=VALUE, sw-calibration-access=READ-ONLY, type=ADTSBoolean, init-value=0
    VeCANR_b_LOC_EXVM: service-kind=ANY-STANDARDIZED, invalidation-policy{data-element=VeCANR_b_LOC_EXVM, handle-invalid=DONT-INVALIDATE}
      data VeCANR_b_LOC_EXVM: category=VALUE, sw-calibration-access=READ-ONLY, type=ADTSBoolean, init-value=0
    VeCANR_b_LOC_HTLBV: service-kind=ANY-STANDARDIZED, invalidation-policy{data-element=VeCANR_b_LOC_HTLBV, handle-invalid=DONT-INVALIDATE}
      data VeCANR_b_LOC_HTLBV: category=VALUE, sw-calibration-access=READ-ONLY, type=ADTSBoolean, init-value=0
    VeCANR_b_LOC_IDCM_FD11: service-kind=ANY-STANDARDIZED, invalidation-policy{data-element=VeCANR_b_LOC_IDCM_FD11, handle-invalid=DONT-INVALIDATE}
      data VeCANR_b_LOC_IDCM_FD11: category=VALUE, sw-calibration-access=READ-ONLY, type=ADTSBoolean, init-value=VeCANR_b_LOC_IDCM_FD11Value:0
    VeCANR_b_LOC_IDCM_FD5: service-kind=ANY-STANDARDIZED, invalidation-policy{data-element=VeCANR_b_LOC_IDCM_FD5, handle-invalid=DONT-INVALIDATE}
      data VeCANR_b_LOC_IDCM_FD5: category=VALUE, sw-calibration-access=READ-ONLY, type=ADTSBoolean, init-value=VeCANR_b_LOC_IDCM_FD5Value:0
    VeCANR_b_LOC_IPC_FD3: service-kind=ANY-STANDARDIZED, invalidation-policy{data-element=VeCANR_b_LOC_IPC_FD3, handle-invalid=DONT-INVALIDATE}
      data VeCANR_b_LOC_IPC_FD3: category=VALUE, sw-calibration-access=READ-ONLY, type=ADTSBoolean, init-value=VeCANR_b_LOC_IPC_FD3Value:0
    VeCANR_b_LOC_LTRBV: service-kind=ANY-STANDARDIZED, invalidation-policy{data-element=VeCANR_b_LOC_LTRBV, handle-invalid=DONT-INVALIDATE}
      data VeCANR_b_LOC_LTRBV: category=VALUE, sw-calibration-access=READ-ONLY, type=ADTSBoolean, init-value=0
    VeCANR_b_LOC_MCPA_FD16: service-kind=ANY-STANDARDIZED, invalidation-policy{data-element=VeCANR_b_LOC_MCPA_FD16, handle-invalid=DONT-INVALIDATE}
      data VeCANR_b_LOC_MCPA_FD16: category=VALUE, sw-calibration-access=READ-ONLY, type=ADTSBoolean, init-value=VeCANR_b_LOC_MCPA_FD16Value:0
    VeCANR_b_LOC_MCPA_FD5: service-kind=ANY-STANDARDIZED, invalidation-policy{data-element=VeCANR_b_LOC_MCPA_FD5, handle-invalid=DONT-INVALIDATE}
      data VeCANR_b_LOC_MCPA_FD5: category=VALUE, sw-calibration-access=READ-ONLY, type=ADTSBoolean, init-value=VeCANR_b_LOC_MCPA_FD5Value:0
    VeCANR_b_LOC_MCPB_FD16: service-kind=ANY-STANDARDIZED, invalidation-policy{data-element=VeCANR_b_LOC_MCPB_FD16, handle-invalid=DONT-INVALIDATE}
      data VeCANR_b_LOC_MCPB_FD16: category=VALUE, sw-calibration-access=READ-ONLY, type=ADTSBoolean, init-value=VeCANR_b_LOC_MCPB_FD16Value:0
    VeCANR_b_LOC_MCPB_FD5: service-kind=ANY-STANDARDIZED, invalidation-policy{data-element=VeCANR_b_LOC_MCPB_FD5, handle-invalid=DONT-INVALIDATE}
      data VeCANR_b_LOC_MCPB_FD5: category=VALUE, sw-calibration-access=READ-ONLY, type=ADTSBoolean, init-value=VeCANR_b_LOC_MCPB_FD5Value:0
    VeCANR_b_LOC_ORC: service-kind=ANY-STANDARDIZED, invalidation-policy{data-element=VeCANR_b_LOC_ORC, handle-invalid=DONT-INVALIDATE}
      data VeCANR_b_LOC_ORC: category=VALUE, sw-calibration-access=READ-ONLY, type=ADTSBoolean, init-value=VeCANR_b_LOC_ORCValue:0
    VeCANR_b_LOC_PECP: service-kind=ANY-STANDARDIZED, invalidation-policy{data-element=VeCANR_b_LOC_PECP, handle-invalid=DONT-INVALIDATE}
      data VeCANR_b_LOC_PECP: category=VALUE, sw-calibration-access=READ-ONLY, type=ADTSBoolean, init-value=0
    VeCANR_b_LOC_PECP2: service-kind=ANY-STANDARDIZED, invalidation-policy{data-element=VeCANR_b_LOC_PECP2, handle-invalid=DONT-INVALIDATE}
      data VeCANR_b_LOC_PECP2: category=VALUE, sw-calibration-access=READ-ONLY, type=ADTSBoolean, init-value=0
    VeCANR_b_LOC_PPIM: service-kind=ANY-STANDARDIZED, invalidation-policy{data-element=VeCANR_b_LOC_PPIM, handle-invalid=DONT-INVALIDATE}
      data VeCANR_b_LOC_PPIM: category=VALUE, sw-calibration-access=READ-ONLY, type=ADTSBoolean, init-value=VeCANR_b_LOC_PPIMValue:0
    VeCANR_b_LOC_RFHM: service-kind=ANY-STANDARDIZED, invalidation-policy{data-element=VeCANR_b_LOC_RFHM, handle-invalid=DONT-INVALIDATE}
      data VeCANR_b_LOC_RFHM: category=VALUE, sw-calibration-access=READ-ONLY, type=ADTSBoolean, init-value=VeCANR_b_LOC_RFHMValue:0
    VeCANR_b_LOC_SGCP_FD16: service-kind=ANY-STANDARDIZED, invalidation-policy{data-element=VeCANR_b_LOC_SGCP_FD16, handle-invalid=DONT-INVALIDATE}
      data VeCANR_b_LOC_SGCP_FD16: category=VALUE, sw-calibration-access=READ-ONLY, type=ADTSBoolean, init-value=VeCANR_b_LOC_SGCP_FD16Value:0
    VeCANR_b_LOC_SGCP_FD5: service-kind=ANY-STANDARDIZED, invalidation-policy{data-element=VeCANR_b_LOC_SGCP_FD5, handle-invalid=DONT-INVALIDATE}
      data VeCANR_b_LOC_SGCP_FD5: category=VALUE, sw-calibration-access=READ-ONLY, type=ADTSBoolean, init-value=VeCANR_b_LOC_SGCP_FD5Value:0
    VeCANR_b_LOC_SGW_FD11: service-kind=ANY-STANDARDIZED, invalidation-policy{data-element=VeCANR_b_LOC_SGW_FD11, handle-invalid=DONT-INVALIDATE}
      data VeCANR_b_LOC_SGW_FD11: category=VALUE, sw-calibration-access=READ-ONLY, type=ADTSBoolean, init-value=VeCANR_b_LOC_SGW_FD11Value:0
    VeCANR_b_LOC_SGW_FD3: service-kind=ANY-STANDARDIZED, invalidation-policy{data-element=VeCANR_b_LOC_SGW_FD3, handle-invalid=DONT-INVALIDATE}
      data VeCANR_b_LOC_SGW_FD3: category=VALUE, sw-calibration-access=READ-ONLY, type=ADTSBoolean, init-value=VeCANR_b_LOC_SGW_FD3Value:0
    VeCANR_b_LOC_SPP: service-kind=ANY-STANDARDIZED, invalidation-policy{data-element=VeCANR_b_LOC_SPP, handle-invalid=DONT-INVALIDATE}
      data VeCANR_b_LOC_SPP: category=VALUE, sw-calibration-access=READ-ONLY, type=ADTSBoolean, init-value=0
    VeCANR_b_LOC_SPP2: service-kind=ANY-STANDARDIZED, invalidation-policy{data-element=VeCANR_b_LOC_SPP2, handle-invalid=DONT-INVALIDATE}
      data VeCANR_b_LOC_SPP2: category=VALUE, sw-calibration-access=READ-ONLY, type=ADTSBoolean, init-value=0
    VeCANR_e_CanLocEnblStatus  # CAN LoC Status
      data VeCANR_e_CanLocEnblStatus: category=VALUE, sw-calibration-access=READ-ONLY, type=UInt8  # CAN LoC Status
    VeCANR_e_ComPrsntMode_FD11: invalidation-policy{data-element=VeCANR_e_ComPrsntMode_FD11, handle-invalid=DONT-INVALIDATE}  # This interface provides the information about the present Communication mode for FD11 bus. GPECx equivalent - COM_STATE Possible values: 0 - COMM_NO_COMMUNICATION - Transmission and reception of CAN messages is switched off 2 - COMM_FULL_COMMUNICATION - Transmission and reception of CAN messages is switched On 1 - COMM_SILENT_COMMUNICATION - Transmission of CAN messages is switched off, reception of CAN messages is switched On
      data VeCANR_e_ComPrsntMode_FD11: sw-calibration-access=READ-ONLY, type=ComM_ModeType  # This Data Element provides the information about the present Communication mode for FD11 bus. GPECx equivalent - COM_STATE Possible values: 0 - COMM_NO_COMMUNICATION - Transmission and reception of CAN messages is switched off 2 - COMM_FULL_COMMUNICATION - Transmission and reception of CAN messages is switched On 1 - COMM_SILENT_COMMUNICATION - Transmission of CAN messages is switched off, reception of CAN messages is switched On
    VeCANR_e_ComPrsntMode_FD16: invalidation-policy{data-element=VeCANR_e_ComPrsntMode_FD16, handle-invalid=DONT-INVALIDATE}  # This interface provides the information about the present Communication mode for FD16 bus. GPECx equivalent - COM_STATE Possible values: 0 - COMM_NO_COMMUNICATION - Transmission and reception of CAN messages is switched off 2 - COMM_FULL_COMMUNICATION - Transmission and reception of CAN messages is switched On 1 - COMM_SILENT_COMMUNICATION - Transmission of CAN messages is switched off, reception of CAN messages is switched On
      data VeCANR_e_ComPrsntMode_FD16: type=ComM_ModeType  # This interface provides the information about the present Communication mode for FD16 bus. GPECx equivalent - COM_STATE Possible values: 0 - COMM_NO_COMMUNICATION - Transmission and reception of CAN messages is switched off 2 - COMM_FULL_COMMUNICATION - Transmission and reception of CAN messages is switched On 1 - COMM_SILENT_COMMUNICATION - Transmission of CAN messages is switched off, reception of CAN messages is switched On
    VeCANR_e_ComPrsntMode_FD3: invalidation-policy{data-element=VeCANR_e_ComPrsntMode_FD3, handle-invalid=DONT-INVALIDATE}  # This interface provides the information about the present Communication mode for FD3 bus. GPECx equivalent - COM_STATE Possible values: 0 - COMM_NO_COMMUNICATION - Transmission and reception of CAN messages is switched off 2 - COMM_FULL_COMMUNICATION - Transmission and reception of CAN messages is switched On 1 - COMM_SILENT_COMMUNICATION - Transmission of CAN messages is switched off, reception of CAN messages is switched On
      data VeCANR_e_ComPrsntMode_FD3: sw-calibration-access=READ-ONLY, type=ComM_ModeType  # This Data Element provides the information about the present Communication mode for FD3 bus. GPECx equivalent - COM_STATE Possible values: 0 - COMM_NO_COMMUNICATION - Transmission and reception of CAN messages is switched off 2 - COMM_FULL_COMMUNICATION - Transmission and reception of CAN messages is switched On 1 - COMM_SILENT_COMMUNICATION - Transmission of CAN messages is switched off, reception of CAN messages is switched On
    VeCANR_e_ComPrsntMode_FD5: invalidation-policy{data-element=VeCANR_e_ComPrsntMode_FD5, handle-invalid=DONT-INVALIDATE}  # This interface provides the information about the present Communication mode for FD5 bus. GPECx equivalent - COM_STATE Possible values: 0 - COMM_NO_COMMUNICATION - Transmission and reception of CAN messages is switched off 2 - COMM_FULL_COMMUNICATION - Transmission and reception of CAN messages is switched On 1 - COMM_SILENT_COMMUNICATION - Transmission of CAN messages is switched off, reception of CAN messages is switched On
      data VeCANR_e_ComPrsntMode_FD5: type=ComM_ModeType  # This interface provides the information about the present Communication mode for FD5 bus. GPECx equivalent - COM_STATE Possible values: 0 - COMM_NO_COMMUNICATION - Transmission and reception of CAN messages is switched off 2 - COMM_FULL_COMMUNICATION - Transmission and reception of CAN messages is switched On 1 - COMM_SILENT_COMMUNICATION - Transmission of CAN messages is switched off, reception of CAN messages is switched On
    VeKEYR_e_IgnSwSt
      data VeKEYR_e_IgnSwSt: type=ADTSIgnSwtStEnum
    VeLRNR_b_AGSM_FD16: service-kind=ANY-STANDARDIZED, invalidation-policy{data-element=VeLRNR_b_AGSM_FD16, handle-invalid=DONT-INVALIDATE}
      data VeLRNR_b_AGSM_FD16: category=VALUE, sw-calibration-access=READ-ONLY, type=ADTSBoolean, init-value=0
    VeLRNR_b_AGSM_FD3: service-kind=ANY-STANDARDIZED, invalidation-policy{data-element=VeLRNR_b_AGSM_FD3, handle-invalid=DONT-INVALIDATE}
      data VeLRNR_b_AGSM_FD3: category=VALUE, sw-calibration-access=READ-ONLY, type=ADTSBoolean, init-value=0
    VeLRNR_b_BCM: service-kind=ANY-STANDARDIZED, invalidation-policy{data-element=VeLRNR_b_BCM, handle-invalid=DONT-INVALIDATE}
      data VeLRNR_b_BCM: category=VALUE, sw-calibration-access=READ-ONLY, type=ADTSBoolean, init-value=0
    VeLRNR_b_BPCM_FD11: service-kind=ANY-STANDARDIZED, invalidation-policy{data-element=VeLRNR_b_BPCM_FD11, handle-invalid=DONT-INVALIDATE}
      data VeLRNR_b_BPCM_FD11: category=VALUE, sw-calibration-access=READ-ONLY, type=ADTSBoolean, init-value=0
    VeLRNR_b_BPCM_FD5: service-kind=ANY-STANDARDIZED, invalidation-policy{data-element=VeLRNR_b_BPCM_FD5, handle-invalid=DONT-INVALIDATE}
      data VeLRNR_b_BPCM_FD5: category=VALUE, sw-calibration-access=READ-ONLY, type=ADTSBoolean, init-value=0
    VeLRNR_b_BSM_FD14: service-kind=ANY-STANDARDIZED, invalidation-policy{data-element=VeLRNR_b_BSM_FD14, handle-invalid=DONT-INVALIDATE}
      data VeLRNR_b_BSM_FD14: category=VALUE, sw-calibration-access=READ-ONLY, type=ADTSBoolean, init-value=0
    VeLRNR_b_BSM_FD3: service-kind=ANY-STANDARDIZED, invalidation-policy{data-element=VeLRNR_b_BSM_FD3, handle-invalid=DONT-INVALIDATE}
      data VeLRNR_b_BSM_FD3: category=VALUE, sw-calibration-access=READ-ONLY, type=ADTSBoolean, init-value=0
    VeLRNR_b_ECM_FD16: service-kind=ANY-STANDARDIZED, invalidation-policy{data-element=VeLRNR_b_ECM_FD16, handle-invalid=DONT-INVALIDATE}
      data VeLRNR_b_ECM_FD16: category=VALUE, sw-calibration-access=READ-ONLY, type=ADTSBoolean, init-value=0
    VeLRNR_b_ECM_FD3: service-kind=ANY-STANDARDIZED, invalidation-policy{data-element=VeLRNR_b_ECM_FD3, handle-invalid=DONT-INVALIDATE}
      data VeLRNR_b_ECM_FD3: category=VALUE, sw-calibration-access=READ-ONLY, type=ADTSBoolean, init-value=0
    VeLRNR_b_EPS_FD14: service-kind=ANY-STANDARDIZED, invalidation-policy{data-element=VeLRNR_b_EPS_FD14, handle-invalid=DONT-INVALIDATE}
      data VeLRNR_b_EPS_FD14: category=VALUE, sw-calibration-access=READ-ONLY, type=ADTSBoolean, init-value=0
    VeLRNR_b_IDCM_FD11: service-kind=ANY-STANDARDIZED, invalidation-policy{data-element=VeLRNR_b_IDCM_FD11, handle-invalid=DONT-INVALIDATE}
      data VeLRNR_b_IDCM_FD11: category=VALUE, sw-calibration-access=READ-ONLY, type=ADTSBoolean, init-value=0
    VeLRNR_b_IDCM_FD5: service-kind=ANY-STANDARDIZED, invalidation-policy{data-element=VeLRNR_b_IDCM_FD5, handle-invalid=DONT-INVALIDATE}
      data VeLRNR_b_IDCM_FD5: category=VALUE, sw-calibration-access=READ-ONLY, type=ADTSBoolean, init-value=0
    VeLRNR_b_IPC: service-kind=ANY-STANDARDIZED, invalidation-policy{data-element=VeLRNR_b_IPC, handle-invalid=DONT-INVALIDATE}
      data VeLRNR_b_IPC: category=VALUE, sw-calibration-access=READ-ONLY, type=ADTSBoolean, init-value=0
    VeLRNR_b_MCPA_FD16: service-kind=ANY-STANDARDIZED, invalidation-policy{data-element=VeLRNR_b_MCPA_FD16, handle-invalid=DONT-INVALIDATE}
      data VeLRNR_b_MCPA_FD16: category=VALUE, sw-calibration-access=READ-ONLY, type=ADTSBoolean, init-value=0
    VeLRNR_b_MCPA_FD5: service-kind=ANY-STANDARDIZED, invalidation-policy{data-element=VeLRNR_b_MCPA_FD5, handle-invalid=DONT-INVALIDATE}
      data VeLRNR_b_MCPA_FD5: category=VALUE, sw-calibration-access=READ-ONLY, type=ADTSBoolean, init-value=0
    VeLRNR_b_MCPB_FD16: service-kind=ANY-STANDARDIZED, invalidation-policy{data-element=VeLRNR_b_MCPB_FD16, handle-invalid=DONT-INVALIDATE}
      data VeLRNR_b_MCPB_FD16: category=VALUE, sw-calibration-access=READ-ONLY, type=ADTSBoolean, init-value=0
    VeLRNR_b_MCPB_FD5: service-kind=ANY-STANDARDIZED, invalidation-policy{data-element=VeLRNR_b_MCPB_FD5, handle-invalid=DONT-INVALIDATE}
      data VeLRNR_b_MCPB_FD5: category=VALUE, sw-calibration-access=READ-ONLY, type=ADTSBoolean, init-value=0
    VeLRNR_b_ORC_FD14: service-kind=ANY-STANDARDIZED, invalidation-policy{data-element=VeLRNR_b_ORC_FD14, handle-invalid=DONT-INVALIDATE}
      data VeLRNR_b_ORC_FD14: category=VALUE, sw-calibration-access=READ-ONLY, type=ADTSBoolean, init-value=0
    VeLRNR_b_SGCP_FD16: service-kind=ANY-STANDARDIZED, invalidation-policy{data-element=VeLRNR_b_SGCP_FD16, handle-invalid=DONT-INVALIDATE}
      data VeLRNR_b_SGCP_FD16: category=VALUE, sw-calibration-access=READ-ONLY, type=ADTSBoolean, init-value=0
    VeLRNR_b_SGCP_FD5: service-kind=ANY-STANDARDIZED, invalidation-policy{data-element=VeLRNR_b_SGCP_FD5, handle-invalid=DONT-INVALIDATE}
      data VeLRNR_b_SGCP_FD5: category=VALUE, sw-calibration-access=READ-ONLY, type=ADTSBoolean, init-value=0
    VeLRNR_b_SGW_FD11: service-kind=ANY-STANDARDIZED, invalidation-policy{data-element=VeLRNR_b_SGW_FD11, handle-invalid=DONT-INVALIDATE}
      data VeLRNR_b_SGW_FD11: category=VALUE, sw-calibration-access=READ-ONLY, type=ADTSBoolean, init-value=0
    VeLRNR_b_SGW_FD3: service-kind=ANY-STANDARDIZED, invalidation-policy{data-element=VeLRNR_b_SGW_FD3, handle-invalid=DONT-INVALIDATE}
      data VeLRNR_b_SGW_FD3: category=VALUE, sw-calibration-access=READ-ONLY, type=ADTSBoolean, init-value=0
    VeVSPR_v_VehSpd
      data VeVSPR_v_VehSpd: category=VALUE, type=ADTSVehSpdKiloMtrPerHr  # Vehicle Speed Estimator
    VeCANR_b_LOC_APM_FD14: invalidation-policy{data-element=VeCANR_b_LOC_APM_FD14, handle-invalid=DONT-INVALIDATE}
      data VeCANR_b_LOC_APM_FD14: sw-calibration-access=READ-ONLY, type=ADTSBoolean, init-value=NumericalValueSpecification_0:0
    VeCANR_b_LOC_RFHM_FD3: invalidation-policy{data-element=VeCANR_b_LOC_RFHM_FD3, handle-invalid=DONT-INVALIDATE}
      data VeCANR_b_LOC_RFHM_FD3: sw-calibration-access=READ-ONLY, type=ADTSBoolean, init-value=NumericalValueSpecification_0:0
