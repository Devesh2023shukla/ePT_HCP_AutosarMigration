[part 3 of 3: packages /STLASWCs to /STLASWCs/ComSwCpts/ComPrivateInterfaces]
AUTOSAR XML (schema 4-3-0)
package /STLASWCs  (continued)
  complex device driver sw component type ApplCanComAb_FD11  (continued)
    behavior IBApplCanComAb_FD11: data-type-mapping=ADTtoIDTMapping, handle-termination-and-restart=NO-SUPPORT  (continued)
      310 x runnable:  (continued)
        SendCANR_LID_Status_240V_Socket: can-be-invoked-concurrently=true, symbol=ApplCanComAb_FD11_SendCANR_LID_Status_240V_Socket  # Transmit
          data-receive-point-by-arguments:
            access DRP_SendCANR_LID_Status_240V_Socket_SendCANR_LID_Status_240V_Socket: accessed-variable=SendCANR_LID_Status_240V_Socket.SendCANR_LID_Status_240V_Socket
            access DRP_SendCANR_LID_Status_240V_SocketVld_SendCANR_LID_Status_240V_SocketVld: accessed-variable=SendCANR_LID_Status_240V_SocketVld.SendCANR_LID_Status_240V_SocketVld
          data-send-points:
            access DSP_CanCom_FD11TxSignalsSR_COMTX_LID_Status_240V_Socket_HYBRID_DISPLAY2_FD11: accessed-variable=CanCom_FD11TxSignalsSR.COMTX_LID_Status_240V_Socket_HYBRID_DISPLAY2_FD11
        SendCANR_Max_AllwdACOutputCurL1: can-be-invoked-concurrently=true, symbol=ApplCanComAb_FD11_SendCANR_Max_AllwdACOutputCurL1  # Transmit
          data-receive-point-by-arguments:
            access DRP_SendCANR_Max_AllwdACOutputCurL1_SendCANR_Max_AllwdACOutputCurL1: accessed-variable=SendCANR_Max_AllwdACOutputCurL1.SendCANR_Max_AllwdACOutputCurL1
            access DRP_SendCANR_Max_AllwdACOutputCurL1Vld_SendCANR_Max_AllwdACOutputCurL1Vld: accessed-variable=SendCANR_Max_AllwdACOutputCurL1Vld.SendCANR_Max_AllwdACOutputCurL1Vld
          data-send-points:
            access DSP_CanCom_FD11TxSignalsSR_COMTX_Max_Allwd_AC_Output_Current_L1_HYBRID_DISPLAY2_FD11: accessed-variable=CanCom_FD11TxSignalsSR.COMTX_Max_Allwd_AC_Output_Current_L1_HYBRID_DISPLAY2_FD11
        SendCANR_Max_AllwdACOutputVltL1: can-be-invoked-concurrently=true, symbol=ApplCanComAb_FD11_SendCANR_Max_AllwdACOutputVltL1  # Transmit
          data-receive-point-by-arguments:
            access DRP_SendCANR_Max_AllwdACOutputVltL1_SendCANR_Max_AllwdACOutputVltL1: accessed-variable=SendCANR_Max_AllwdACOutputVltL1.SendCANR_Max_AllwdACOutputVltL1
            access DRP_SendCANR_Max_AllwdACOutputVltL1Vld_SendCANR_Max_AllwdACOutputVltL1Vld: accessed-variable=SendCANR_Max_AllwdACOutputVltL1Vld.SendCANR_Max_AllwdACOutputVltL1Vld
          data-send-points:
            access DSP_CanCom_FD11TxSignalsSR_COMTX_Max_Allwd_AC_Output_Voltage_L1_HYBRID_DISPLAY2_FD11: accessed-variable=CanCom_FD11TxSignalsSR.COMTX_Max_Allwd_AC_Output_Voltage_L1_HYBRID_DISPLAY2_FD11
        SendCANR_MC_HYBRID_DISPLAY2: can-be-invoked-concurrently=true, symbol=ApplCanComAb_FD11_SendCANR_MC_HYBRID_DISPLAY2  # Transmit
          data-receive-point-by-arguments:
            access DRP_SendCANR_MC_HYBRID_DISPLAY2_SendCANR_MC_HYBRID_DISPLAY2: accessed-variable=SendCANR_MC_HYBRID_DISPLAY2.SendCANR_MC_HYBRID_DISPLAY2
            access DRP_SendCANR_MC_HYBRID_DISPLAY2Vld_SendCANR_MC_HYBRID_DISPLAY2Vld: accessed-variable=SendCANR_MC_HYBRID_DISPLAY2Vld.SendCANR_MC_HYBRID_DISPLAY2Vld
          data-send-points:
            access DSP_CanCom_FD11TxSignalsSR_COMTX_MC_HYBRID_DISPLAY2_HYBRID_DISPLAY2_FD11: accessed-variable=CanCom_FD11TxSignalsSR.COMTX_MC_HYBRID_DISPLAY2_HYBRID_DISPLAY2_FD11
        SendCANR_CRC_HYBRID_SYSTEM_EPT1: can-be-invoked-concurrently=true, symbol=ApplCanComAb_FD11_SendCANR_CRC_HYBRID_SYSTEM_EPT1  # Transmit
          data-receive-point-by-arguments:
            access DRP_SendCANR_CRC_HYBRID_SYSTEM_EPT1_SendCANR_CRC_HYBRID_SYSTEM_EPT1: accessed-variable=SendCANR_CRC_HYBRID_SYSTEM_EPT1.SendCANR_CRC_HYBRID_SYSTEM_EPT1
            access DRP_SendCANR_CRC_HYBRID_SYSTEM_EPT1Vld_SendCANR_CRC_HYBRID_SYSTEM_EPT1Vld: accessed-variable=SendCANR_CRC_HYBRID_SYSTEM_EPT1Vld.SendCANR_CRC_HYBRID_SYSTEM_EPT1Vld
          data-send-points:
            access DSP_CanCom_FD11TxSignalsSR_COMTX_CRC_HYBRID_SYSTEM_EPT1_HYBRID_SYSTEM_EPT1_FD11: accessed-variable=CanCom_FD11TxSignalsSR.COMTX_CRC_HYBRID_SYSTEM_EPT1_HYBRID_SYSTEM_EPT1_FD11
        SendCANR_HCP_ShutdownCommand: can-be-invoked-concurrently=true, symbol=ApplCanComAb_FD11_SendCANR_HCP_ShutdownCommand  # Transmit
          data-receive-point-by-arguments:
            access DRP_SendCANR_HCP_ShutdownCommand_SendCANR_HCP_ShutdownCommand: accessed-variable=SendCANR_HCP_ShutdownCommand.SendCANR_HCP_ShutdownCommand
            access DRP_SendCANR_HCP_ShutdownCommandVld_SendCANR_HCP_ShutdownCommandVld: accessed-variable=SendCANR_HCP_ShutdownCommandVld.SendCANR_HCP_ShutdownCommandVld
          data-send-points:
            access DSP_CanCom_FD11TxSignalsSR_COMTX_HCP_ShutdownCommand_HYBRID_SYSTEM_EPT1_FD11: accessed-variable=CanCom_FD11TxSignalsSR.COMTX_HCP_ShutdownCommand_HYBRID_SYSTEM_EPT1_FD11
        SendCANR_HybridDriveModeSts: can-be-invoked-concurrently=true, symbol=ApplCanComAb_FD11_SendCANR_HybridDriveModeSts  # Transmit
          data-receive-point-by-arguments:
            access DRP_SendCANR_HybridDriveModeSts_SendCANR_HybridDriveModeSts: accessed-variable=SendCANR_HybridDriveModeSts.SendCANR_HybridDriveModeSts
            access DRP_SendCANR_HybridDriveModeStsVld_SendCANR_HybridDriveModeStsVld: accessed-variable=SendCANR_HybridDriveModeStsVld.SendCANR_HybridDriveModeStsVld
          data-send-points:
            access DSP_CanCom_FD11TxSignalsSR_COMTX_HybridDriveModeSts_HYBRID_SYSTEM_EPT1_FD11: accessed-variable=CanCom_FD11TxSignalsSR.COMTX_HybridDriveModeSts_HYBRID_SYSTEM_EPT1_FD11
        SendCANR_LOC_DiagEnable_ePT: can-be-invoked-concurrently=true, symbol=ApplCanComAb_FD11_SendCANR_LOC_DiagEnable_ePT  # Transmit
          data-receive-point-by-arguments:
            access DRP_SendCANR_LOC_DiagEnable_ePT_SendCANR_LOC_DiagEnable_ePT: accessed-variable=SendCANR_LOC_DiagEnable_ePT.SendCANR_LOC_DiagEnable_ePT
            access DRP_SendCANR_LOC_DiagEnable_ePT_Vld_SendCANR_LOC_DiagEnable_ePT_Vld: accessed-variable=SendCANR_LOC_DiagEnable_ePT_Vld.SendCANR_LOC_DiagEnable_ePT_Vld
          data-send-points:
            access DSP_CanCom_FD11TxSignalsSR_COMTX_LOC_DiagEnable_ePT_HYBRID_SYSTEM_EPT1_FD11: accessed-variable=CanCom_FD11TxSignalsSR.COMTX_LOC_DiagEnable_ePT_HYBRID_SYSTEM_EPT1_FD11
        SendCANR_MsgCtrHYB_SYSTEM_EPT1: can-be-invoked-concurrently=true, symbol=ApplCanComAb_FD11_SendCANR_MsgCtrHYB_SYSTEM_EPT1  # Transmit
          data-receive-point-by-arguments:
            access DRP_SendCANR_MsgCtrHYB_SYSTEM_EPT1_SendCANR_MsgCtrHYB_SYSTEM_EPT1: accessed-variable=SendCANR_MsgCtrHYB_SYSTEM_EPT1.SendCANR_MsgCtrHYB_SYSTEM_EPT1
            access DRP_SendCANR_MsgCtrHYB_SYSTEM_EPT1Vld_SendCANR_MsgCtrHYB_SYSTEM_EPT1Vld: accessed-variable=SendCANR_MsgCtrHYB_SYSTEM_EPT1Vld.SendCANR_MsgCtrHYB_SYSTEM_EPT1Vld
          data-send-points:
            access DSP_CanCom_FD11TxSignalsSR_COMTX_MessageCounter_HYBRID_SYSTEM_EPT1_HYBRID_SYSTEM_EPT1_FD11: accessed-variable=CanCom_FD11TxSignalsSR.COMTX_MessageCounter_HYBRID_SYSTEM_EPT1_HYBRID_SYSTEM_EPT1_FD11
        SendCANR_PerWakeUp_Diag_FD11: can-be-invoked-concurrently=true, symbol=ApplCanComAb_FD11_SendCANR_PerWakeUp_Diag_FD11  # Transmit
          data-receive-point-by-arguments:
            access DRP_SendCANR_PerWakeUp_Diag_FD11_SendCANR_PerWakeUp_Diag_FD11: accessed-variable=SendCANR_PerWakeUp_Diag_FD11.SendCANR_PerWakeUp_Diag_FD11
            access DRP_SendCANR_PerWakeUp_Diag_FD11Vld_SendCANR_PerWakeUp_Diag_FD11Vld: accessed-variable=SendCANR_PerWakeUp_Diag_FD11Vld.SendCANR_PerWakeUp_Diag_FD11Vld
          data-send-points:
            access DSP_CanCom_FD11TxSignalsSR_COMTX_PerWakeUp_Diag_HYBRID_SYSTEM_EPT1_FD11: accessed-variable=CanCom_FD11TxSignalsSR.COMTX_PerWakeUp_Diag_HYBRID_SYSTEM_EPT1_FD11
        SendCANR_PrplsnSysActive_10B: can-be-invoked-concurrently=true, symbol=ApplCanComAb_FD11_SendCANR_PrplsnSysActive_10B  # Transmit
          data-receive-point-by-arguments:
            access DRP_SendCANR_PrplsnSysActive_10B_SendCANR_PrplsnSysActive_10B: accessed-variable=SendCANR_PrplsnSysActive_10B.SendCANR_PrplsnSysActive_10B
            access DRP_SendCANR_PrplsnSysActive_10B_Vld_SendCANR_PrplsnSysActive_10B_Vld: accessed-variable=SendCANR_PrplsnSysActive_10B_Vld.SendCANR_PrplsnSysActive_10B_Vld
          data-send-points:
            access DSP_CanCom_FD11TxSignalsSR_COMTX_PropulsionSystemActive_10B_HYBRID_SYSTEM_EPT1_FD11: accessed-variable=CanCom_FD11TxSignalsSR.COMTX_PropulsionSystemActive_10B_HYBRID_SYSTEM_EPT1_FD11
        SendCANR_WU_Timer_Value_FD11: can-be-invoked-concurrently=true, symbol=ApplCanComAb_FD11_SendCANR_WU_Timer_Value_FD11  # Transmit
          data-receive-point-by-arguments:
            access DRP_SendCANR_WU_Timer_Value_FD11_SendCANR_WU_Timer_Value_FD11: accessed-variable=SendCANR_WU_Timer_Value_FD11.SendCANR_WU_Timer_Value_FD11
            access DRP_SendCANR_WU_Timer_Value_FD11Vld_SendCANR_WU_Timer_Value_FD11Vld: accessed-variable=SendCANR_WU_Timer_Value_FD11Vld.SendCANR_WU_Timer_Value_FD11Vld
          data-send-points:
            access DSP_CanCom_FD11TxSignalsSR_COMTX_WU_Timer_Value_HYBRID_SYSTEM_EPT1_FD11: accessed-variable=CanCom_FD11TxSignalsSR.COMTX_WU_Timer_Value_HYBRID_SYSTEM_EPT1_FD11
        SendCANR_IMPACTCommand_FD11: can-be-invoked-concurrently=true, symbol=ApplCanComAb_FD11_SendCANR_IMPACTCommand_FD11  # Transmit
          data-receive-point-by-arguments:
            access DRP_SendCANR_IMPACTCommand_FD11_SendCANR_IMPACTCommand_FD11: accessed-variable=SendCANR_IMPACTCommand_FD11.SendCANR_IMPACTCommand_FD11
            access DRP_SendCANR_IMPACTCommand_FD11Vld_SendCANR_IMPACTCommand_FD11Vld: accessed-variable=SendCANR_IMPACTCommand_FD11Vld.SendCANR_IMPACTCommand_FD11Vld
          data-send-points:
            access DSP_CanCom_FD11TxSignalsSR_COMTX_IMPACTCommand_IMPACT_INFO_FD11: accessed-variable=CanCom_FD11TxSignalsSR.COMTX_IMPACTCommand_IMPACT_INFO_FD11
        SendCANR_IMPACTConfirm_FD11: can-be-invoked-concurrently=true, symbol=ApplCanComAb_FD11_SendCANR_IMPACTConfirm_FD11  # Transmit
          data-receive-point-by-arguments:
            access DRP_SendCANR_IMPACTConfirm_FD11_SendCANR_IMPACTConfirm_FD11: accessed-variable=SendCANR_IMPACTConfirm_FD11.SendCANR_IMPACTConfirm_FD11
            access DRP_SendCANR_IMPACTConfirm_FD11Vld_SendCANR_IMPACTConfirm_FD11Vld: accessed-variable=SendCANR_IMPACTConfirm_FD11Vld.SendCANR_IMPACTConfirm_FD11Vld
          data-send-points:
            access DSP_CanCom_FD11TxSignalsSR_COMTX_IMPACTConfirm_IMPACT_INFO_FD11: accessed-variable=CanCom_FD11TxSignalsSR.COMTX_IMPACTConfirm_IMPACT_INFO_FD11
        SendCANR_TotalOdometer_FD11: can-be-invoked-concurrently=true, symbol=ApplCanComAb_FD11_SendCANR_TotalOdometer_FD11  # Transmit
          data-receive-point-by-arguments:
            access DRP_SendCANR_TotalOdometer_FD11_SendCANR_TotalOdometer_FD11: accessed-variable=SendCANR_TotalOdometer_FD11.SendCANR_TotalOdometer_FD11
            access DRP_SendCANR_TotalOdometer_FD11Vld_SendCANR_TotalOdometer_FD11Vld: accessed-variable=SendCANR_TotalOdometer_FD11Vld.SendCANR_TotalOdometer_FD11Vld
          data-send-points:
            access DSP_CanCom_FD11TxSignalsSR_COMTX_TotalOdometer_IPC_FD_1_FD11: accessed-variable=CanCom_FD11TxSignalsSR.COMTX_TotalOdometer_IPC_FD_1_FD11
        SendCANR_MCPA_Temp_FD11: can-be-invoked-concurrently=true, symbol=ApplCanComAb_FD11_SendCANR_MCPA_Temp_FD11  # Transmit
          data-receive-point-by-arguments:
            access DRP_SendCANR_MCPA_Temp_FD11_SendCANR_MCPA_Temp_FD11: accessed-variable=SendCANR_MCPA_Temp_FD11.SendCANR_MCPA_Temp_FD11
            access DRP_SendCANR_MCPA_Temp_FD11Vld_SendCANR_MCPA_Temp_FD11Vld: accessed-variable=SendCANR_MCPA_Temp_FD11Vld.SendCANR_MCPA_Temp_FD11Vld
          data-send-points:
            access DSP_CanCom_FD11TxSignalsSR_COMTX_MCPA_Temp_MCPA_DATA2_FD11: accessed-variable=CanCom_FD11TxSignalsSR.COMTX_MCPA_Temp_MCPA_DATA2_FD11
        SendCANR_CRC_MCPA_STATUS_FD11: can-be-invoked-concurrently=true, symbol=ApplCanComAb_FD11_SendCANR_CRC_MCPA_STATUS_FD11  # Transmit
          data-receive-point-by-arguments:
            access DRP_SendCANR_CRC_MCPA_STATUS_FD11_SendCANR_CRC_MCPA_STATUS_FD11: accessed-variable=SendCANR_CRC_MCPA_STATUS_FD11.SendCANR_CRC_MCPA_STATUS_FD11
            access DRP_SendCANR_CRC_MCPA_STATUS_FD11Vld_SendCANR_CRC_MCPA_STATUS_FD11Vld: accessed-variable=SendCANR_CRC_MCPA_STATUS_FD11Vld.SendCANR_CRC_MCPA_STATUS_FD11Vld
          data-send-points:
            access DSP_CanCom_FD11TxSignalsSR_COMTX_CRC_MCPA_STATUS_MCPA_STATUS_FD11: accessed-variable=CanCom_FD11TxSignalsSR.COMTX_CRC_MCPA_STATUS_MCPA_STATUS_FD11
        SendCANR_MC_MCPA_STATUS_FD11: can-be-invoked-concurrently=true, symbol=ApplCanComAb_FD11_SendCANR_MC_MCPA_STATUS_FD11  # Transmit
          data-receive-point-by-arguments:
            access DRP_SendCANR_MC_MCPA_STATUS_FD11_SendCANR_MC_MCPA_STATUS_FD11: accessed-variable=SendCANR_MC_MCPA_STATUS_FD11.SendCANR_MC_MCPA_STATUS_FD11
            access DRP_SendCANR_MC_MCPA_STATUS_FD11Vld_SendCANR_MC_MCPA_STATUS_FD11Vld: accessed-variable=SendCANR_MC_MCPA_STATUS_FD11Vld.SendCANR_MC_MCPA_STATUS_FD11Vld
          data-send-points:
            access DSP_CanCom_FD11TxSignalsSR_COMTX_MC_MCPA_STATUS_MCPA_STATUS_FD11: accessed-variable=CanCom_FD11TxSignalsSR.COMTX_MC_MCPA_STATUS_MCPA_STATUS_FD11
        SendCANR_MCPA_DC_Current_P_FD11: can-be-invoked-concurrently=true, symbol=ApplCanComAb_FD11_SendCANR_MCPA_DC_Current_P_FD11  # Transmit
          data-receive-point-by-arguments:
            access DRP_SendCANR_MCPA_DC_Current_P_FD11_SendCANR_MCPA_DC_Current_P_FD11: accessed-variable=SendCANR_MCPA_DC_Current_P_FD11.SendCANR_MCPA_DC_Current_P_FD11
            access DRP_SendCANR_MCPA_DC_Current_P_FD11Vld_SendCANR_MCPA_DC_Current_P_FD11Vld: accessed-variable=SendCANR_MCPA_DC_Current_P_FD11Vld.SendCANR_MCPA_DC_Current_P_FD11Vld
          data-send-points:
            access DSP_CanCom_FD11TxSignalsSR_COMTX_MCPA_DC_Current_P_MCPA_STATUS_FD11: accessed-variable=CanCom_FD11TxSignalsSR.COMTX_MCPA_DC_Current_P_MCPA_STATUS_FD11
        SendCANR_MCPB_Temp_FD11: can-be-invoked-concurrently=true, symbol=ApplCanComAb_FD11_SendCANR_MCPB_Temp_FD11  # Transmit
          data-receive-point-by-arguments:
            access DRP_SendCANR_MCPB_Temp_FD11_SendCANR_MCPB_Temp_FD11: accessed-variable=SendCANR_MCPB_Temp_FD11.SendCANR_MCPB_Temp_FD11
            access DRP_SendCANR_MCPB_Temp_FD11Vld_SendCANR_MCPB_Temp_FD11Vld: accessed-variable=SendCANR_MCPB_Temp_FD11Vld.SendCANR_MCPB_Temp_FD11Vld
          data-send-points:
            access DSP_CanCom_FD11TxSignalsSR_COMTX_MCPB_Temp_MCPB_DATA2_FD11: accessed-variable=CanCom_FD11TxSignalsSR.COMTX_MCPB_Temp_MCPB_DATA2_FD11
        SendCANR_CRC_MCPB_STATUS_FD11: can-be-invoked-concurrently=true, symbol=ApplCanComAb_FD11_SendCANR_CRC_MCPB_STATUS_FD11  # Transmit
          data-receive-point-by-arguments:
            access DRP_SendCANR_CRC_MCPB_STATUS_FD11_SendCANR_CRC_MCPB_STATUS_FD11: accessed-variable=SendCANR_CRC_MCPB_STATUS_FD11.SendCANR_CRC_MCPB_STATUS_FD11
            access DRP_SendCANR_CRC_MCPB_STATUS_FD11Vld_SendCANR_CRC_MCPB_STATUS_FD11Vld: accessed-variable=SendCANR_CRC_MCPB_STATUS_FD11Vld.SendCANR_CRC_MCPB_STATUS_FD11Vld
          data-send-points:
            access DSP_CanCom_FD11TxSignalsSR_COMTX_CRC_MCPB_STATUS_MCPB_STATUS_FD11: accessed-variable=CanCom_FD11TxSignalsSR.COMTX_CRC_MCPB_STATUS_MCPB_STATUS_FD11
        SendCANR_MC_MCPB_STATUS_FD11: can-be-invoked-concurrently=true, symbol=ApplCanComAb_FD11_SendCANR_MC_MCPB_STATUS_FD11  # Transmit
          data-receive-point-by-arguments:
            access DRP_SendCANR_MC_MCPB_STATUS_FD11_SendCANR_MC_MCPB_STATUS_FD11: accessed-variable=SendCANR_MC_MCPB_STATUS_FD11.SendCANR_MC_MCPB_STATUS_FD11
            access DRP_SendCANR_MC_MCPB_STATUS_FD11Vld_SendCANR_MC_MCPB_STATUS_FD11Vld: accessed-variable=SendCANR_MC_MCPB_STATUS_FD11Vld.SendCANR_MC_MCPB_STATUS_FD11Vld
          data-send-points:
            access DSP_CanCom_FD11TxSignalsSR_COMTX_MC_MCPB_STATUS_MCPB_STATUS_FD11: accessed-variable=CanCom_FD11TxSignalsSR.COMTX_MC_MCPB_STATUS_MCPB_STATUS_FD11
        SendCANR_MCPB_DC_Current_P_FD11: can-be-invoked-concurrently=true, symbol=ApplCanComAb_FD11_SendCANR_MCPB_DC_Current_P_FD11  # Transmit
          data-receive-point-by-arguments:
            access DRP_SendCANR_MCPB_DC_Current_P_FD11_SendCANR_MCPB_DC_Current_P_FD11: accessed-variable=SendCANR_MCPB_DC_Current_P_FD11.SendCANR_MCPB_DC_Current_P_FD11
            access DRP_SendCANR_MCPB_DC_Current_P_FD11Vld_SendCANR_MCPB_DC_Current_P_FD11Vld: accessed-variable=SendCANR_MCPB_DC_Current_P_FD11Vld.SendCANR_MCPB_DC_Current_P_FD11Vld
          data-send-points:
            access DSP_CanCom_FD11TxSignalsSR_COMTX_MCPB_DC_Current_P_MCPB_STATUS_FD11: accessed-variable=CanCom_FD11TxSignalsSR.COMTX_MCPB_DC_Current_P_MCPB_STATUS_FD11
        SendCANR_CrCanNMStFD03EVCU2FD11: can-be-invoked-concurrently=true, symbol=ApplCanComAb_FD11_SendCANR_CrCanNMStFD03EVCU2FD11  # Transmit
          data-receive-point-by-arguments:
            access DRP_SendCANR_CrCanNMStFD03EVCU2FD11_SendCANR_CrCanNMStFD03EVCU2FD11: accessed-variable=SendCANR_CrCanNMStFD03EVCU2FD11.SendCANR_CrCanNMStFD03EVCU2FD11
            access DRP_SendCANR_CrCanNMStFD03EVCU2FD11Vld_SendCANR_CrCanNMStFD03EVCU2FD11Vld: accessed-variable=SendCANR_CrCanNMStFD03EVCU2FD11Vld.SendCANR_CrCanNMStFD03EVCU2FD11Vld
          data-send-points:
            access DSP_CanCom_FD11TxSignalsSR_COMTX_CurrentCanNMState_FD03_EVCU2_PDC_INFO_FD_EVCU2_FD11: accessed-variable=CanCom_FD11TxSignalsSR.COMTX_CurrentCanNMState_FD03_EVCU2_PDC_INFO_FD_EVCU2_FD11
        SendCANR_CrCanNMStFD05EVCU2FD11: can-be-invoked-concurrently=true, symbol=ApplCanComAb_FD11_SendCANR_CrCanNMStFD05EVCU2FD11  # Transmit
          data-receive-point-by-arguments:
            access DRP_SendCANR_CrCanNMStFD05EVCU2FD11_SendCANR_CrCanNMStFD05EVCU2FD11: accessed-variable=SendCANR_CrCanNMStFD05EVCU2FD11.SendCANR_CrCanNMStFD05EVCU2FD11
            access DRP_SendCANR_CrCanNMStFD05EVCU2FD11Vld_SendCANR_CrCanNMStFD05EVCU2FD11Vld: accessed-variable=SendCANR_CrCanNMStFD05EVCU2FD11Vld.SendCANR_CrCanNMStFD05EVCU2FD11Vld
          data-send-points:
            access DSP_CanCom_FD11TxSignalsSR_COMTX_CurrentCanNMState_FD05_EVCU2_PDC_INFO_FD_EVCU2_FD11: accessed-variable=CanCom_FD11TxSignalsSR.COMTX_CurrentCanNMState_FD05_EVCU2_PDC_INFO_FD_EVCU2_FD11
        SendCANR_CrCanNMStFD11EVCU2FD11: can-be-invoked-concurrently=true, symbol=ApplCanComAb_FD11_SendCANR_CrCanNMStFD11EVCU2FD11  # Transmit
          data-receive-point-by-arguments:
            access DRP_SendCANR_CrCanNMStFD11EVCU2FD11_SendCANR_CrCanNMStFD11EVCU2FD11: accessed-variable=SendCANR_CrCanNMStFD11EVCU2FD11.SendCANR_CrCanNMStFD11EVCU2FD11
            access DRP_SendCANR_CrCanNMStFD11EVCU2FD11Vld_SendCANR_CrCanNMStFD11EVCU2FD11Vld: accessed-variable=SendCANR_CrCanNMStFD11EVCU2FD11Vld.SendCANR_CrCanNMStFD11EVCU2FD11Vld
          data-send-points:
            access DSP_CanCom_FD11TxSignalsSR_COMTX_CurrentCanNMState_FD11_EVCU2_PDC_INFO_FD_EVCU2_FD11: accessed-variable=CanCom_FD11TxSignalsSR.COMTX_CurrentCanNMState_FD11_EVCU2_PDC_INFO_FD_EVCU2_FD11
        SendCANR_CrCanNMStFD16EVCU2FD11: can-be-invoked-concurrently=true, symbol=ApplCanComAb_FD11_SendCANR_CrCanNMStFD16EVCU2FD11  # Transmit
          data-receive-point-by-arguments:
            access DRP_SendCANR_CrCanNMStFD16EVCU2FD11_SendCANR_CrCanNMStFD16EVCU2FD11: accessed-variable=SendCANR_CrCanNMStFD16EVCU2FD11.SendCANR_CrCanNMStFD16EVCU2FD11
            access DRP_SendCANR_CrCanNMStFD16EVCU2FD11Vld_SendCANR_CrCanNMStFD16EVCU2FD11Vld: accessed-variable=SendCANR_CrCanNMStFD16EVCU2FD11Vld.SendCANR_CrCanNMStFD16EVCU2FD11Vld
          data-send-points:
            access DSP_CanCom_FD11TxSignalsSR_COMTX_CurrentCanNMState_FD16_EVCU2_PDC_INFO_FD_EVCU2_FD11: accessed-variable=CanCom_FD11TxSignalsSR.COMTX_CurrentCanNMState_FD16_EVCU2_PDC_INFO_FD_EVCU2_FD11
        SendCANR_CurFailStFD03EVCU2FD11: can-be-invoked-concurrently=true, symbol=ApplCanComAb_FD11_SendCANR_CurFailStFD03EVCU2FD11  # Transmit
          data-receive-point-by-arguments:
            access DRP_SendCANR_CurFailStFD03EVCU2FD11_SendCANR_CurFailStFD03EVCU2FD11: accessed-variable=SendCANR_CurFailStFD03EVCU2FD11.SendCANR_CurFailStFD03EVCU2FD11
            access DRP_SendCANR_CurFailStFD03EVCU2FD11Vld_SendCANR_CurFailStFD03EVCU2FD11Vld: accessed-variable=SendCANR_CurFailStFD03EVCU2FD11Vld.SendCANR_CurFailStFD03EVCU2FD11Vld
          data-send-points:
            access DSP_CanCom_FD11TxSignalsSR_COMTX_CurrentFailSts_FD03_EVCU2_PDC_INFO_FD_EVCU2_FD11: accessed-variable=CanCom_FD11TxSignalsSR.COMTX_CurrentFailSts_FD03_EVCU2_PDC_INFO_FD_EVCU2_FD11
        SendCANR_CurFailStFD05EVCU2FD11: can-be-invoked-concurrently=true, symbol=ApplCanComAb_FD11_SendCANR_CurFailStFD05EVCU2FD11  # Transmit
          data-receive-point-by-arguments:
            access DRP_SendCANR_CurFailStFD05EVCU2FD11_SendCANR_CurFailStFD05EVCU2FD11: accessed-variable=SendCANR_CurFailStFD05EVCU2FD11.SendCANR_CurFailStFD05EVCU2FD11
            access DRP_SendCANR_CurFailStFD05EVCU2FD11Vld_SendCANR_CurFailStFD05EVCU2FD11Vld: accessed-variable=SendCANR_CurFailStFD05EVCU2FD11Vld.SendCANR_CurFailStFD05EVCU2FD11Vld
          data-send-points:
            access DSP_CanCom_FD11TxSignalsSR_COMTX_CurrentFailSts_FD05_EVCU2_PDC_INFO_FD_EVCU2_FD11: accessed-variable=CanCom_FD11TxSignalsSR.COMTX_CurrentFailSts_FD05_EVCU2_PDC_INFO_FD_EVCU2_FD11
        SendCANR_CurFailStFD11EVCU2FD11: can-be-invoked-concurrently=true, symbol=ApplCanComAb_FD11_SendCANR_CurFailStFD11EVCU2FD11  # Transmit
          data-receive-point-by-arguments:
            access DRP_SendCANR_CurFailStFD11EVCU2FD11_SendCANR_CurFailStFD11EVCU2FD11: accessed-variable=SendCANR_CurFailStFD11EVCU2FD11.SendCANR_CurFailStFD11EVCU2FD11
            access DRP_SendCANR_CurFailStFD11EVCU2FD11Vld_SendCANR_CurFailStFD11EVCU2FD11Vld: accessed-variable=SendCANR_CurFailStFD11EVCU2FD11Vld.SendCANR_CurFailStFD11EVCU2FD11Vld
          data-send-points:
            access DSP_CanCom_FD11TxSignalsSR_COMTX_CurrentFailSts_FD11_EVCU2_PDC_INFO_FD_EVCU2_FD11: accessed-variable=CanCom_FD11TxSignalsSR.COMTX_CurrentFailSts_FD11_EVCU2_PDC_INFO_FD_EVCU2_FD11
        SendCANR_CurFailStFD16EVCU2FD11: can-be-invoked-concurrently=true, symbol=ApplCanComAb_FD11_SendCANR_CurFailStFD16EVCU2FD11  # Transmit
          data-receive-point-by-arguments:
            access DRP_SendCANR_CurFailStFD16EVCU2FD11_SendCANR_CurFailStFD16EVCU2FD11: accessed-variable=SendCANR_CurFailStFD16EVCU2FD11.SendCANR_CurFailStFD16EVCU2FD11
            access DRP_SendCANR_CurFailStFD16EVCU2FD11Vld_SendCANR_CurFailStFD16EVCU2FD11Vld: accessed-variable=SendCANR_CurFailStFD16EVCU2FD11Vld.SendCANR_CurFailStFD16EVCU2FD11Vld
          data-send-points:
            access DSP_CanCom_FD11TxSignalsSR_COMTX_CurrentFailSts_FD16_EVCU2_PDC_INFO_FD_EVCU2_FD11: accessed-variable=CanCom_FD11TxSignalsSR.COMTX_CurrentFailSts_FD16_EVCU2_PDC_INFO_FD_EVCU2_FD11
        SendCANR_DES_FD03_EVCU2_FD11: can-be-invoked-concurrently=true, symbol=ApplCanComAb_FD11_SendCANR_DES_FD03_EVCU2_FD11  # Transmit
          data-receive-point-by-arguments:
            access DRP_SendCANR_DES_FD03_EVCU2_FD11_SendCANR_DES_FD03_EVCU2_FD11: accessed-variable=SendCANR_DES_FD03_EVCU2_FD11.SendCANR_DES_FD03_EVCU2_FD11
            access DRP_SendCANR_DES_FD03_EVCU2_FD11Vld_SendCANR_DES_FD03_EVCU2_FD11Vld: accessed-variable=SendCANR_DES_FD03_EVCU2_FD11Vld.SendCANR_DES_FD03_EVCU2_FD11Vld
          data-send-points:
            access DSP_CanCom_FD11TxSignalsSR_COMTX_DES_FD03_EVCU2_PDC_INFO_FD_EVCU2_FD11: accessed-variable=CanCom_FD11TxSignalsSR.COMTX_DES_FD03_EVCU2_PDC_INFO_FD_EVCU2_FD11
        SendCANR_DES_FD05_EVCU2_FD11: can-be-invoked-concurrently=true, symbol=ApplCanComAb_FD11_SendCANR_DES_FD05_EVCU2_FD11  # Transmit
          data-receive-point-by-arguments:
            access DRP_SendCANR_DES_FD05_EVCU2_FD11_SendCANR_DES_FD05_EVCU2_FD11: accessed-variable=SendCANR_DES_FD05_EVCU2_FD11.SendCANR_DES_FD05_EVCU2_FD11
            access DRP_SendCANR_DES_FD05_EVCU2_FD11Vld_SendCANR_DES_FD05_EVCU2_FD11Vld: accessed-variable=SendCANR_DES_FD05_EVCU2_FD11Vld.SendCANR_DES_FD05_EVCU2_FD11Vld
          data-send-points:
            access DSP_CanCom_FD11TxSignalsSR_COMTX_DES_FD05_EVCU2_PDC_INFO_FD_EVCU2_FD11: accessed-variable=CanCom_FD11TxSignalsSR.COMTX_DES_FD05_EVCU2_PDC_INFO_FD_EVCU2_FD11
        SendCANR_DES_FD11_EVCU2_FD11: can-be-invoked-concurrently=true, symbol=ApplCanComAb_FD11_SendCANR_DES_FD11_EVCU2_FD11  # Transmit
          data-receive-point-by-arguments:
            access DRP_SendCANR_DES_FD11_EVCU2_FD11_SendCANR_DES_FD11_EVCU2_FD11: accessed-variable=SendCANR_DES_FD11_EVCU2_FD11.SendCANR_DES_FD11_EVCU2_FD11
            access DRP_SendCANR_DES_FD11_EVCU2_FD11Vld_SendCANR_DES_FD11_EVCU2_FD11Vld: accessed-variable=SendCANR_DES_FD11_EVCU2_FD11Vld.SendCANR_DES_FD11_EVCU2_FD11Vld
          data-send-points:
            access DSP_CanCom_FD11TxSignalsSR_COMTX_DES_FD11_EVCU2_PDC_INFO_FD_EVCU2_FD11: accessed-variable=CanCom_FD11TxSignalsSR.COMTX_DES_FD11_EVCU2_PDC_INFO_FD_EVCU2_FD11
        SendCANR_DES_FD16_EVCU2_FD11: can-be-invoked-concurrently=true, symbol=ApplCanComAb_FD11_SendCANR_DES_FD16_EVCU2_FD11  # Transmit
          data-receive-point-by-arguments:
            access DRP_SendCANR_DES_FD16_EVCU2_FD11_SendCANR_DES_FD16_EVCU2_FD11: accessed-variable=SendCANR_DES_FD16_EVCU2_FD11.SendCANR_DES_FD16_EVCU2_FD11
            access DRP_SendCANR_DES_FD16_EVCU2_FD11Vld_SendCANR_DES_FD16_EVCU2_FD11Vld: accessed-variable=SendCANR_DES_FD16_EVCU2_FD11Vld.SendCANR_DES_FD16_EVCU2_FD11Vld
          data-send-points:
            access DSP_CanCom_FD11TxSignalsSR_COMTX_DES_FD16_EVCU2_PDC_INFO_FD_EVCU2_FD11: accessed-variable=CanCom_FD11TxSignalsSR.COMTX_DES_FD16_EVCU2_PDC_INFO_FD_EVCU2_FD11
        SendCANR_EOL_FD03_EVCU2_FD11: can-be-invoked-concurrently=true, symbol=ApplCanComAb_FD11_SendCANR_EOL_FD03_EVCU2_FD11  # Transmit
          data-receive-point-by-arguments:
            access DRP_SendCANR_EOL_FD03_EVCU2_FD11_SendCANR_EOL_FD03_EVCU2_FD11: accessed-variable=SendCANR_EOL_FD03_EVCU2_FD11.SendCANR_EOL_FD03_EVCU2_FD11
            access DRP_SendCANR_EOL_FD03_EVCU2_FD11Vld_SendCANR_EOL_FD03_EVCU2_FD11Vld: accessed-variable=SendCANR_EOL_FD03_EVCU2_FD11Vld.SendCANR_EOL_FD03_EVCU2_FD11Vld
          data-send-points:
            access DSP_CanCom_FD11TxSignalsSR_COMTX_EOL_FD03_EVCU2_PDC_INFO_FD_EVCU2_FD11: accessed-variable=CanCom_FD11TxSignalsSR.COMTX_EOL_FD03_EVCU2_PDC_INFO_FD_EVCU2_FD11
        SendCANR_EOL_FD05_EVCU2_FD11: can-be-invoked-concurrently=true, symbol=ApplCanComAb_FD11_SendCANR_EOL_FD05_EVCU2_FD11  # Transmit
          data-receive-point-by-arguments:
            access DRP_SendCANR_EOL_FD05_EVCU2_FD11_SendCANR_EOL_FD05_EVCU2_FD11: accessed-variable=SendCANR_EOL_FD05_EVCU2_FD11.SendCANR_EOL_FD05_EVCU2_FD11
            access DRP_SendCANR_EOL_FD05_EVCU2_FD11Vld_SendCANR_EOL_FD05_EVCU2_FD11Vld: accessed-variable=SendCANR_EOL_FD05_EVCU2_FD11Vld.SendCANR_EOL_FD05_EVCU2_FD11Vld
          data-send-points:
            access DSP_CanCom_FD11TxSignalsSR_COMTX_EOL_FD05_EVCU2_PDC_INFO_FD_EVCU2_FD11: accessed-variable=CanCom_FD11TxSignalsSR.COMTX_EOL_FD05_EVCU2_PDC_INFO_FD_EVCU2_FD11
        SendCANR_EOL_FD11_EVCU2_FD11: can-be-invoked-concurrently=true, symbol=ApplCanComAb_FD11_SendCANR_EOL_FD11_EVCU2_FD11  # Transmit
          data-receive-point-by-arguments:
            access DRP_SendCANR_EOL_FD11_EVCU2_FD11_SendCANR_EOL_FD11_EVCU2_FD11: accessed-variable=SendCANR_EOL_FD11_EVCU2_FD11.SendCANR_EOL_FD11_EVCU2_FD11
            access DRP_SendCANR_EOL_FD11_EVCU2_FD11Vld_SendCANR_EOL_FD11_EVCU2_FD11Vld: accessed-variable=SendCANR_EOL_FD11_EVCU2_FD11Vld.SendCANR_EOL_FD11_EVCU2_FD11Vld
          data-send-points:
            access DSP_CanCom_FD11TxSignalsSR_COMTX_EOL_FD11_EVCU2_PDC_INFO_FD_EVCU2_FD11: accessed-variable=CanCom_FD11TxSignalsSR.COMTX_EOL_FD11_EVCU2_PDC_INFO_FD_EVCU2_FD11
        SendCANR_EOL_FD16_EVCU2_FD11: can-be-invoked-concurrently=true, symbol=ApplCanComAb_FD11_SendCANR_EOL_FD16_EVCU2_FD11  # Transmit
          data-receive-point-by-arguments:
            access DRP_SendCANR_EOL_FD16_EVCU2_FD11_SendCANR_EOL_FD16_EVCU2_FD11: accessed-variable=SendCANR_EOL_FD16_EVCU2_FD11.SendCANR_EOL_FD16_EVCU2_FD11
            access DRP_SendCANR_EOL_FD16_EVCU2_FD11Vld_SendCANR_EOL_FD16_EVCU2_FD11Vld: accessed-variable=SendCANR_EOL_FD16_EVCU2_FD11Vld.SendCANR_EOL_FD16_EVCU2_FD11Vld
          data-send-points:
            access DSP_CanCom_FD11TxSignalsSR_COMTX_EOL_FD16_EVCU2_PDC_INFO_FD_EVCU2_FD11: accessed-variable=CanCom_FD11TxSignalsSR.COMTX_EOL_FD16_EVCU2_PDC_INFO_FD_EVCU2_FD11
        SendCANR_GenFailStFD03EVCU2FD11: can-be-invoked-concurrently=true, symbol=ApplCanComAb_FD11_SendCANR_GenFailStFD03EVCU2FD11  # Transmit
          data-receive-point-by-arguments:
            access DRP_SendCANR_GenFailStFD03EVCU2FD11_SendCANR_GenFailStFD03EVCU2FD11: accessed-variable=SendCANR_GenFailStFD03EVCU2FD11.SendCANR_GenFailStFD03EVCU2FD11
            access DRP_SendCANR_GenFailStFD03EVCU2FD11Vld_SendCANR_GenFailStFD03EVCU2FD11Vld: accessed-variable=SendCANR_GenFailStFD03EVCU2FD11Vld.SendCANR_GenFailStFD03EVCU2FD11Vld
          data-send-points:
            access DSP_CanCom_FD11TxSignalsSR_COMTX_GenericFailSts_FD03_EVCU2_PDC_INFO_FD_EVCU2_FD11: accessed-variable=CanCom_FD11TxSignalsSR.COMTX_GenericFailSts_FD03_EVCU2_PDC_INFO_FD_EVCU2_FD11
        SendCANR_GenFailStFD05EVCU2FD11: can-be-invoked-concurrently=true, symbol=ApplCanComAb_FD11_SendCANR_GenFailStFD05EVCU2FD11  # Transmit
          data-receive-point-by-arguments:
            access DRP_SendCANR_GenFailStFD05EVCU2FD11_SendCANR_GenFailStFD05EVCU2FD11: accessed-variable=SendCANR_GenFailStFD05EVCU2FD11.SendCANR_GenFailStFD05EVCU2FD11
            access DRP_SendCANR_GenFailStFD05EVCU2FD11Vld_SendCANR_GenFailStFD05EVCU2FD11Vld: accessed-variable=SendCANR_GenFailStFD05EVCU2FD11Vld.SendCANR_GenFailStFD05EVCU2FD11Vld
          data-send-points:
            access DSP_CanCom_FD11TxSignalsSR_COMTX_GenericFailSts_FD05_EVCU2_PDC_INFO_FD_EVCU2_FD11: accessed-variable=CanCom_FD11TxSignalsSR.COMTX_GenericFailSts_FD05_EVCU2_PDC_INFO_FD_EVCU2_FD11
        SendCANR_GenFailStFD11EVCU2FD11: can-be-invoked-concurrently=true, symbol=ApplCanComAb_FD11_SendCANR_GenFailStFD11EVCU2FD11  # Transmit
          data-receive-point-by-arguments:
            access DRP_SendCANR_GenFailStFD11EVCU2FD11_SendCANR_GenFailStFD11EVCU2FD11: accessed-variable=SendCANR_GenFailStFD11EVCU2FD11.SendCANR_GenFailStFD11EVCU2FD11
            access DRP_SendCANR_GenFailStFD11EVCU2FD11Vld_SendCANR_GenFailStFD11EVCU2FD11Vld: accessed-variable=SendCANR_GenFailStFD11EVCU2FD11Vld.SendCANR_GenFailStFD11EVCU2FD11Vld
          data-send-points:
            access DSP_CanCom_FD11TxSignalsSR_COMTX_GenericFailSts_FD11_EVCU2_PDC_INFO_FD_EVCU2_FD11: accessed-variable=CanCom_FD11TxSignalsSR.COMTX_GenericFailSts_FD11_EVCU2_PDC_INFO_FD_EVCU2_FD11
        SendCANR_GenFailStFD16EVCU2FD11: can-be-invoked-concurrently=true, symbol=ApplCanComAb_FD11_SendCANR_GenFailStFD16EVCU2FD11  # Transmit
          data-receive-point-by-arguments:
            access DRP_SendCANR_GenFailStFD16EVCU2FD11_SendCANR_GenFailStFD16EVCU2FD11: accessed-variable=SendCANR_GenFailStFD16EVCU2FD11.SendCANR_GenFailStFD16EVCU2FD11
            access DRP_SendCANR_GenFailStFD16EVCU2FD11Vld_SendCANR_GenFailStFD16EVCU2FD11Vld: accessed-variable=SendCANR_GenFailStFD16EVCU2FD11Vld.SendCANR_GenFailStFD16EVCU2FD11Vld
          data-send-points:
            access DSP_CanCom_FD11TxSignalsSR_COMTX_GenericFailSts_FD16_EVCU2_PDC_INFO_FD_EVCU2_FD11: accessed-variable=CanCom_FD11TxSignalsSR.COMTX_GenericFailSts_FD16_EVCU2_PDC_INFO_FD_EVCU2_FD11
        SendCANR_PvCanNMStFD03EVCU2FD11: can-be-invoked-concurrently=true, symbol=ApplCanComAb_FD11_SendCANR_PvCanNMStFD03EVCU2FD11  # Transmit
          data-receive-point-by-arguments:
            access DRP_SendCANR_PvCanNMStFD03EVCU2FD11_SendCANR_PvCanNMStFD03EVCU2FD11: accessed-variable=SendCANR_PvCanNMStFD03EVCU2FD11.SendCANR_PvCanNMStFD03EVCU2FD11
            access DRP_SendCANR_PvCanNMStFD03EVCU2FD11Vld_SendCANR_PvCanNMStFD03EVCU2FD11Vld: accessed-variable=SendCANR_PvCanNMStFD03EVCU2FD11Vld.SendCANR_PvCanNMStFD03EVCU2FD11Vld
          data-send-points:
            access DSP_CanCom_FD11TxSignalsSR_COMTX_PreviousCanNMState_FD03_EVCU2_PDC_INFO_FD_EVCU2_FD11: accessed-variable=CanCom_FD11TxSignalsSR.COMTX_PreviousCanNMState_FD03_EVCU2_PDC_INFO_FD_EVCU2_FD11
        SendCANR_PvCanNMStFD05EVCU2FD11: can-be-invoked-concurrently=true, symbol=ApplCanComAb_FD11_SendCANR_PvCanNMStFD05EVCU2FD11  # Transmit
          data-receive-point-by-arguments:
            access DRP_SendCANR_PvCanNMStFD05EVCU2FD11_SendCANR_PvCanNMStFD05EVCU2FD11: accessed-variable=SendCANR_PvCanNMStFD05EVCU2FD11.SendCANR_PvCanNMStFD05EVCU2FD11
            access DRP_SendCANR_PvCanNMStFD05EVCU2FD11Vld_SendCANR_PvCanNMStFD05EVCU2FD11Vld: accessed-variable=SendCANR_PvCanNMStFD05EVCU2FD11Vld.SendCANR_PvCanNMStFD05EVCU2FD11Vld
          data-send-points:
            access DSP_CanCom_FD11TxSignalsSR_COMTX_PreviousCanNMState_FD05_EVCU2_PDC_INFO_FD_EVCU2_FD11: accessed-variable=CanCom_FD11TxSignalsSR.COMTX_PreviousCanNMState_FD05_EVCU2_PDC_INFO_FD_EVCU2_FD11
        SendCANR_PvCanNMStFD11EVCU2FD11: can-be-invoked-concurrently=true, symbol=ApplCanComAb_FD11_SendCANR_PvCanNMStFD11EVCU2FD11  # Transmit
          data-receive-point-by-arguments:
            access DRP_SendCANR_PvCanNMStFD11EVCU2FD11_SendCANR_PvCanNMStFD11EVCU2FD11: accessed-variable=SendCANR_PvCanNMStFD11EVCU2FD11.SendCANR_PvCanNMStFD11EVCU2FD11
            access DRP_SendCANR_PvCanNMStFD11EVCU2FD11Vld_SendCANR_PvCanNMStFD11EVCU2FD11Vld: accessed-variable=SendCANR_PvCanNMStFD11EVCU2FD11Vld.SendCANR_PvCanNMStFD11EVCU2FD11Vld
          data-send-points:
            access DSP_CanCom_FD11TxSignalsSR_COMTX_PreviousCanNMState_FD11_EVCU2_PDC_INFO_FD_EVCU2_FD11: accessed-variable=CanCom_FD11TxSignalsSR.COMTX_PreviousCanNMState_FD11_EVCU2_PDC_INFO_FD_EVCU2_FD11
        SendCANR_PvCanNMStFD16EVCU2FD11: can-be-invoked-concurrently=true, symbol=ApplCanComAb_FD11_SendCANR_PvCanNMStFD16EVCU2FD11  # Transmit
          data-receive-point-by-arguments:
            access DRP_SendCANR_PvCanNMStFD16EVCU2FD11_SendCANR_PvCanNMStFD16EVCU2FD11: accessed-variable=SendCANR_PvCanNMStFD16EVCU2FD11.SendCANR_PvCanNMStFD16EVCU2FD11
            access DRP_SendCANR_PvCanNMStFD16EVCU2FD11Vld_SendCANR_PvCanNMStFD16EVCU2FD11Vld: accessed-variable=SendCANR_PvCanNMStFD16EVCU2FD11Vld.SendCANR_PvCanNMStFD16EVCU2FD11Vld
          data-send-points:
            access DSP_CanCom_FD11TxSignalsSR_COMTX_PreviousCanNMState_FD16_EVCU2_PDC_INFO_FD_EVCU2_FD11: accessed-variable=CanCom_FD11TxSignalsSR.COMTX_PreviousCanNMState_FD16_EVCU2_PDC_INFO_FD_EVCU2_FD11
        SendCANR_StyActSrcFD03EVCU2FD11: can-be-invoked-concurrently=true, symbol=ApplCanComAb_FD11_SendCANR_StyActSrcFD03EVCU2FD11  # Transmit
          data-receive-point-by-arguments:
            access DRP_SendCANR_StyActSrcFD03EVCU2FD11_SendCANR_StyActSrcFD03EVCU2FD11: accessed-variable=SendCANR_StyActSrcFD03EVCU2FD11.SendCANR_StyActSrcFD03EVCU2FD11
            access DRP_SendCANR_StyActSrcFD03EVCU2FD11Vld_SendCANR_StyActSrcFD03EVCU2FD11Vld: accessed-variable=SendCANR_StyActSrcFD03EVCU2FD11Vld.SendCANR_StyActSrcFD03EVCU2FD11Vld
          data-send-points:
            access DSP_CanCom_FD11TxSignalsSR_COMTX_StayActiveSource_FD03_EVCU2_PDC_INFO_FD_EVCU2_FD11: accessed-variable=CanCom_FD11TxSignalsSR.COMTX_StayActiveSource_FD03_EVCU2_PDC_INFO_FD_EVCU2_FD11
        SendCANR_StyActSrcFD05EVCU2FD11: can-be-invoked-concurrently=true, symbol=ApplCanComAb_FD11_SendCANR_StyActSrcFD05EVCU2FD11  # Transmit
          data-receive-point-by-arguments:
            access DRP_SendCANR_StyActSrcFD05EVCU2FD11_SendCANR_StyActSrcFD05EVCU2FD11: accessed-variable=SendCANR_StyActSrcFD05EVCU2FD11.SendCANR_StyActSrcFD05EVCU2FD11
            access DRP_SendCANR_StyActSrcFD05EVCU2FD11Vld_SendCANR_StyActSrcFD05EVCU2FD11Vld: accessed-variable=SendCANR_StyActSrcFD05EVCU2FD11Vld.SendCANR_StyActSrcFD05EVCU2FD11Vld
          data-send-points:
            access DSP_CanCom_FD11TxSignalsSR_COMTX_StayActiveSource_FD05_EVCU2_PDC_INFO_FD_EVCU2_FD11: accessed-variable=CanCom_FD11TxSignalsSR.COMTX_StayActiveSource_FD05_EVCU2_PDC_INFO_FD_EVCU2_FD11
        SendCANR_StyActSrcFD11EVCU2FD11: can-be-invoked-concurrently=true, symbol=ApplCanComAb_FD11_SendCANR_StyActSrcFD11EVCU2FD11  # Transmit
          data-receive-point-by-arguments:
            access DRP_SendCANR_StyActSrcFD11EVCU2FD11_SendCANR_StyActSrcFD11EVCU2FD11: accessed-variable=SendCANR_StyActSrcFD11EVCU2FD11.SendCANR_StyActSrcFD11EVCU2FD11
            access DRP_SendCANR_StyActSrcFD11EVCU2FD11Vld_SendCANR_StyActSrcFD11EVCU2FD11Vld: accessed-variable=SendCANR_StyActSrcFD11EVCU2FD11Vld.SendCANR_StyActSrcFD11EVCU2FD11Vld
          data-send-points:
            access DSP_CanCom_FD11TxSignalsSR_COMTX_StayActiveSource_FD11_EVCU2_PDC_INFO_FD_EVCU2_FD11: accessed-variable=CanCom_FD11TxSignalsSR.COMTX_StayActiveSource_FD11_EVCU2_PDC_INFO_FD_EVCU2_FD11
        SendCANR_StyActSrcFD16EVCU2FD11: can-be-invoked-concurrently=true, symbol=ApplCanComAb_FD11_SendCANR_StyActSrcFD16EVCU2FD11  # Transmit
          data-receive-point-by-arguments:
            access DRP_SendCANR_StyActSrcFD16EVCU2FD11_SendCANR_StyActSrcFD16EVCU2FD11: accessed-variable=SendCANR_StyActSrcFD16EVCU2FD11.SendCANR_StyActSrcFD16EVCU2FD11
            access DRP_SendCANR_StyActSrcFD16EVCU2FD11Vld_SendCANR_StyActSrcFD16EVCU2FD11Vld: accessed-variable=SendCANR_StyActSrcFD16EVCU2FD11Vld.SendCANR_StyActSrcFD16EVCU2FD11Vld
          data-send-points:
            access DSP_CanCom_FD11TxSignalsSR_COMTX_StayActiveSource_FD16_EVCU2_PDC_INFO_FD_EVCU2_FD11: accessed-variable=CanCom_FD11TxSignalsSR.COMTX_StayActiveSource_FD16_EVCU2_PDC_INFO_FD_EVCU2_FD11
        SendCANR_WkeupSrcFD03_EVCU2FD11: can-be-invoked-concurrently=true, symbol=ApplCanComAb_FD11_SendCANR_WkeupSrcFD03_EVCU2FD11  # Transmit
          data-receive-point-by-arguments:
            access DRP_SendCANR_WkeupSrcFD03_EVCU2FD11_SendCANR_WkeupSrcFD03_EVCU2FD11: accessed-variable=SendCANR_WkeupSrcFD03_EVCU2FD11.SendCANR_WkeupSrcFD03_EVCU2FD11
            access DRP_SendCANR_WkeupSrcFD03_EVCU2FD11Vld_SendCANR_WkeupSrcFD03_EVCU2FD11Vld: accessed-variable=SendCANR_WkeupSrcFD03_EVCU2FD11Vld.SendCANR_WkeupSrcFD03_EVCU2FD11Vld
          data-send-points:
            access DSP_CanCom_FD11TxSignalsSR_COMTX_WakeupSource_FD03_EVCU2_PDC_INFO_FD_EVCU2_FD11: accessed-variable=CanCom_FD11TxSignalsSR.COMTX_WakeupSource_FD03_EVCU2_PDC_INFO_FD_EVCU2_FD11
        SendCANR_WkeupSrcFD05_EVCU2FD11: can-be-invoked-concurrently=true, symbol=ApplCanComAb_FD11_SendCANR_WkeupSrcFD05_EVCU2FD11  # Transmit
          data-receive-point-by-arguments:
            access DRP_SendCANR_WkeupSrcFD05_EVCU2FD11_SendCANR_WkeupSrcFD05_EVCU2FD11: accessed-variable=SendCANR_WkeupSrcFD05_EVCU2FD11.SendCANR_WkeupSrcFD05_EVCU2FD11
            access DRP_SendCANR_WkeupSrcFD05_EVCU2FD11Vld_SendCANR_WkeupSrcFD05_EVCU2FD11Vld: accessed-variable=SendCANR_WkeupSrcFD05_EVCU2FD11Vld.SendCANR_WkeupSrcFD05_EVCU2FD11Vld
          data-send-points:
            access DSP_CanCom_FD11TxSignalsSR_COMTX_WakeupSource_FD05_EVCU2_PDC_INFO_FD_EVCU2_FD11: accessed-variable=CanCom_FD11TxSignalsSR.COMTX_WakeupSource_FD05_EVCU2_PDC_INFO_FD_EVCU2_FD11
        SendCANR_WkeupSrcFD11_EVCU2FD11: can-be-invoked-concurrently=true, symbol=ApplCanComAb_FD11_SendCANR_WkeupSrcFD11_EVCU2FD11  # Transmit
          data-receive-point-by-arguments:
            access DRP_SendCANR_WkeupSrcFD11_EVCU2FD11_SendCANR_WkeupSrcFD11_EVCU2FD11: accessed-variable=SendCANR_WkeupSrcFD11_EVCU2FD11.SendCANR_WkeupSrcFD11_EVCU2FD11
            access DRP_SendCANR_WkeupSrcFD11_EVCU2FD11Vld_SendCANR_WkeupSrcFD11_EVCU2FD11Vld: accessed-variable=SendCANR_WkeupSrcFD11_EVCU2FD11Vld.SendCANR_WkeupSrcFD11_EVCU2FD11Vld
          data-send-points:
            access DSP_CanCom_FD11TxSignalsSR_COMTX_WakeupSource_FD11_EVCU2_PDC_INFO_FD_EVCU2_FD11: accessed-variable=CanCom_FD11TxSignalsSR.COMTX_WakeupSource_FD11_EVCU2_PDC_INFO_FD_EVCU2_FD11
        SendCANR_WkeupSrcFD16_EVCU2FD11: can-be-invoked-concurrently=true, symbol=ApplCanComAb_FD11_SendCANR_WkeupSrcFD16_EVCU2FD11  # Transmit
          data-receive-point-by-arguments:
            access DRP_SendCANR_WkeupSrcFD16_EVCU2FD11_SendCANR_WkeupSrcFD16_EVCU2FD11: accessed-variable=SendCANR_WkeupSrcFD16_EVCU2FD11.SendCANR_WkeupSrcFD16_EVCU2FD11
            access DRP_SendCANR_WkeupSrcFD16_EVCU2FD11Vld_SendCANR_WkeupSrcFD16_EVCU2FD11Vld: accessed-variable=SendCANR_WkeupSrcFD16_EVCU2FD11Vld.SendCANR_WkeupSrcFD16_EVCU2FD11Vld
          data-send-points:
            access DSP_CanCom_FD11TxSignalsSR_COMTX_WakeupSource_FD16_EVCU2_PDC_INFO_FD_EVCU2_FD11: accessed-variable=CanCom_FD11TxSignalsSR.COMTX_WakeupSource_FD16_EVCU2_PDC_INFO_FD_EVCU2_FD11
        SendCANR_DriveReady_PT_FD11: can-be-invoked-concurrently=true, symbol=ApplCanComAb_FD11_SendCANR_DriveReady_PT_FD11  # Transmit
          data-receive-point-by-arguments:
            access DRP_SendCANR_DriveReady_PT_FD11_SendCANR_DriveReady_PT_FD11: accessed-variable=SendCANR_DriveReady_PT_FD11.SendCANR_DriveReady_PT_FD11
            access DRP_SendCANR_DriveReady_PT_FD11Vld_SendCANR_DriveReady_PT_FD11Vld: accessed-variable=SendCANR_DriveReady_PT_FD11Vld.SendCANR_DriveReady_PT_FD11Vld
          data-send-points:
            access DSP_CanCom_FD11TxSignalsSR_COMTX_DriveReady_PT_PT_SYSTEM_FD_1_FD11: accessed-variable=CanCom_FD11TxSignalsSR.COMTX_DriveReady_PT_PT_SYSTEM_FD_1_FD11
        SendCANR_GearEngaged_PT_FD11: can-be-invoked-concurrently=true, symbol=ApplCanComAb_FD11_SendCANR_GearEngaged_PT_FD11  # Transmit
          data-receive-point-by-arguments:
            access DRP_SendCANR_GearEngaged_PT_FD11_SendCANR_GearEngaged_PT_FD11: accessed-variable=SendCANR_GearEngaged_PT_FD11.SendCANR_GearEngaged_PT_FD11
            access DRP_SendCANR_GearEngaged_PT_FD11Vld_SendCANR_GearEngaged_PT_FD11Vld: accessed-variable=SendCANR_GearEngaged_PT_FD11Vld.SendCANR_GearEngaged_PT_FD11Vld
          data-send-points:
            access DSP_CanCom_FD11TxSignalsSR_COMTX_GearEngaged_PT_PT_SYSTEM_FD_1_FD11: accessed-variable=CanCom_FD11TxSignalsSR.COMTX_GearEngaged_PT_PT_SYSTEM_FD_1_FD11
        SendCANR_GearEngdForDispPTFD11: can-be-invoked-concurrently=true, symbol=ApplCanComAb_FD11_SendCANR_GearEngdForDispPTFD11  # Transmit
          data-receive-point-by-arguments:
            access DRP_SendCANR_GearEngdForDispPTFD11_SendCANR_GearEngdForDispPTFD11: accessed-variable=SendCANR_GearEngdForDispPTFD11.SendCANR_GearEngdForDispPTFD11
            access DRP_SendCANR_GearEngdForDispPTFD11Vld_SendCANR_GearEngdForDispPTFD11Vld: accessed-variable=SendCANR_GearEngdForDispPTFD11Vld.SendCANR_GearEngdForDispPTFD11Vld
          data-send-points:
            access DSP_CanCom_FD11TxSignalsSR_COMTX_GearEngagedForDisplay_PT_PT_SYSTEM_FD_1_FD11: accessed-variable=CanCom_FD11TxSignalsSR.COMTX_GearEngagedForDisplay_PT_PT_SYSTEM_FD_1_FD11
        SendCANR_PtrainPrplsnActvPTFD11: can-be-invoked-concurrently=true, symbol=ApplCanComAb_FD11_SendCANR_PtrainPrplsnActvPTFD11  # Transmit
          data-receive-point-by-arguments:
            access DRP_SendCANR_PtrainPrplsnActvPTFD11_SendCANR_PtrainPrplsnActvPTFD11: accessed-variable=SendCANR_PtrainPrplsnActvPTFD11.SendCANR_PtrainPrplsnActvPTFD11
            access DRP_SendCANR_PtrainPrplsnActvPTFD11Vld_SendCANR_PtrainPrplsnActvPTFD11Vld: accessed-variable=SendCANR_PtrainPrplsnActvPTFD11Vld.SendCANR_PtrainPrplsnActvPTFD11Vld
          data-send-points:
            access DSP_CanCom_FD11TxSignalsSR_COMTX_PowertrainPrplsnActv_PT_PT_SYSTEM_FD_1_FD11: accessed-variable=CanCom_FD11TxSignalsSR.COMTX_PowertrainPrplsnActv_PT_PT_SYSTEM_FD_1_FD11
        SendCANR_SGCP_Temp_FD11: can-be-invoked-concurrently=true, symbol=ApplCanComAb_FD11_SendCANR_SGCP_Temp_FD11  # Transmit
          data-receive-point-by-arguments:
            access DRP_SendCANR_SGCP_Temp_FD11_SendCANR_SGCP_Temp_FD11: accessed-variable=SendCANR_SGCP_Temp_FD11.SendCANR_SGCP_Temp_FD11
            access DRP_SendCANR_SGCP_Temp_FD11Vld_SendCANR_SGCP_Temp_FD11Vld: accessed-variable=SendCANR_SGCP_Temp_FD11Vld.SendCANR_SGCP_Temp_FD11Vld
          data-send-points:
            access DSP_CanCom_FD11TxSignalsSR_COMTX_SGCP_Temp_SGCP_DATA2_FD11: accessed-variable=CanCom_FD11TxSignalsSR.COMTX_SGCP_Temp_SGCP_DATA2_FD11
        SendCANR_SGCP_DC_Current_P_FD11: can-be-invoked-concurrently=true, symbol=ApplCanComAb_FD11_SendCANR_SGCP_DC_Current_P_FD11  # Transmit
          data-receive-point-by-arguments:
            access DRP_SendCANR_SGCP_DC_Current_P_FD11_SendCANR_SGCP_DC_Current_P_FD11: accessed-variable=SendCANR_SGCP_DC_Current_P_FD11.SendCANR_SGCP_DC_Current_P_FD11
            access DRP_SendCANR_SGCP_DC_Current_P_FD11Vld_SendCANR_SGCP_DC_Current_P_FD11Vld: accessed-variable=SendCANR_SGCP_DC_Current_P_FD11Vld.SendCANR_SGCP_DC_Current_P_FD11Vld
          data-send-points:
            access DSP_CanCom_FD11TxSignalsSR_COMTX_SGCP_DC_Current_P_SGCP_STATUS_FD11: accessed-variable=CanCom_FD11TxSignalsSR.COMTX_SGCP_DC_Current_P_SGCP_STATUS_FD11
        SendCANR_QualifyDriveCycle_FD11: can-be-invoked-concurrently=true, symbol=ApplCanComAb_FD11_SendCANR_QualifyDriveCycle_FD11  # Transmit
          data-receive-point-by-arguments:
            access DRP_SendCANR_QualifyDriveCycle_FD11_SendCANR_QualifyDriveCycle_FD11: accessed-variable=SendCANR_QualifyDriveCycle_FD11.SendCANR_QualifyDriveCycle_FD11
            access DRP_SendCANR_QualifyDriveCycle_FD11Vld_SendCANR_QualifyDriveCycle_FD11Vld: accessed-variable=SendCANR_QualifyDriveCycle_FD11Vld.SendCANR_QualifyDriveCycle_FD11Vld
          data-send-points:
            access DSP_CanCom_FD11TxSignalsSR_COMTX_QualifyDriveCycle_SYNCHRO_DC_GLOBAL_FD11: accessed-variable=CanCom_FD11TxSignalsSR.COMTX_QualifyDriveCycle_SYNCHRO_DC_GLOBAL_FD11
        SendCANR_GPS_Date_Day_FD11: can-be-invoked-concurrently=true, symbol=ApplCanComAb_FD11_SendCANR_GPS_Date_Day_FD11  # Transmit
          data-receive-point-by-arguments:
            access DRP_SendCANR_GPS_Date_Day_FD11_SendCANR_GPS_Date_Day_FD11: accessed-variable=SendCANR_GPS_Date_Day_FD11.SendCANR_GPS_Date_Day_FD11
            access DRP_SendCANR_GPS_Date_Day_FD11Vld_SendCANR_GPS_Date_Day_FD11Vld: accessed-variable=SendCANR_GPS_Date_Day_FD11Vld.SendCANR_GPS_Date_Day_FD11Vld
          data-send-points:
            access DSP_CanCom_FD11TxSignalsSR_COMTX_GPS_Date_Day_TELEMATIC_FD_1_FD11: accessed-variable=CanCom_FD11TxSignalsSR.COMTX_GPS_Date_Day_TELEMATIC_FD_1_FD11
        SendCANR_GPS_Date_Month_FD11: can-be-invoked-concurrently=true, symbol=ApplCanComAb_FD11_SendCANR_GPS_Date_Month_FD11  # Transmit
          data-receive-point-by-arguments:
            access DRP_SendCANR_GPS_Date_Month_FD11_SendCANR_GPS_Date_Month_FD11: accessed-variable=SendCANR_GPS_Date_Month_FD11.SendCANR_GPS_Date_Month_FD11
            access DRP_SendCANR_GPS_Date_Month_FD11Vld_SendCANR_GPS_Date_Month_FD11Vld: accessed-variable=SendCANR_GPS_Date_Month_FD11Vld.SendCANR_GPS_Date_Month_FD11Vld
          data-send-points:
            access DSP_CanCom_FD11TxSignalsSR_COMTX_GPS_Date_Month_TELEMATIC_FD_1_FD11: accessed-variable=CanCom_FD11TxSignalsSR.COMTX_GPS_Date_Month_TELEMATIC_FD_1_FD11
        SendCANR_GPS_Date_Year_FD11: can-be-invoked-concurrently=true, symbol=ApplCanComAb_FD11_SendCANR_GPS_Date_Year_FD11  # Transmit
          data-receive-point-by-arguments:
            access DRP_SendCANR_GPS_Date_Year_FD11_SendCANR_GPS_Date_Year_FD11: accessed-variable=SendCANR_GPS_Date_Year_FD11.SendCANR_GPS_Date_Year_FD11
            access DRP_SendCANR_GPS_Date_Year_FD11Vld_SendCANR_GPS_Date_Year_FD11Vld: accessed-variable=SendCANR_GPS_Date_Year_FD11Vld.SendCANR_GPS_Date_Year_FD11Vld
          data-send-points:
            access DSP_CanCom_FD11TxSignalsSR_COMTX_GPS_Date_Year_TELEMATIC_FD_1_FD11: accessed-variable=CanCom_FD11TxSignalsSR.COMTX_GPS_Date_Year_TELEMATIC_FD_1_FD11
        SendCANR_GPS_UTC_Hour_FD11: can-be-invoked-concurrently=true, symbol=ApplCanComAb_FD11_SendCANR_GPS_UTC_Hour_FD11  # Transmit
          data-receive-point-by-arguments:
            access DRP_SendCANR_GPS_UTC_Hour_FD11_SendCANR_GPS_UTC_Hour_FD11: accessed-variable=SendCANR_GPS_UTC_Hour_FD11.SendCANR_GPS_UTC_Hour_FD11
            access DRP_SendCANR_GPS_UTC_Hour_FD11Vld_SendCANR_GPS_UTC_Hour_FD11Vld: accessed-variable=SendCANR_GPS_UTC_Hour_FD11Vld.SendCANR_GPS_UTC_Hour_FD11Vld
          data-send-points:
            access DSP_CanCom_FD11TxSignalsSR_COMTX_GPS_UTC_Hour_TELEMATIC_FD_1_FD11: accessed-variable=CanCom_FD11TxSignalsSR.COMTX_GPS_UTC_Hour_TELEMATIC_FD_1_FD11
        SendCANR_GPS_UTC_Minute_FD11: can-be-invoked-concurrently=true, symbol=ApplCanComAb_FD11_SendCANR_GPS_UTC_Minute_FD11  # Transmit
          data-receive-point-by-arguments:
            access DRP_SendCANR_GPS_UTC_Minute_FD11_SendCANR_GPS_UTC_Minute_FD11: accessed-variable=SendCANR_GPS_UTC_Minute_FD11.SendCANR_GPS_UTC_Minute_FD11
            access DRP_SendCANR_GPS_UTC_Minute_FD11Vld_SendCANR_GPS_UTC_Minute_FD11Vld: accessed-variable=SendCANR_GPS_UTC_Minute_FD11Vld.SendCANR_GPS_UTC_Minute_FD11Vld
          data-send-points:
            access DSP_CanCom_FD11TxSignalsSR_COMTX_GPS_UTC_Minute_TELEMATIC_FD_1_FD11: accessed-variable=CanCom_FD11TxSignalsSR.COMTX_GPS_UTC_Minute_TELEMATIC_FD_1_FD11
        SendCANR_GPS_UTC_Second_FD11: can-be-invoked-concurrently=true, symbol=ApplCanComAb_FD11_SendCANR_GPS_UTC_Second_FD11  # Transmit
          data-receive-point-by-arguments:
            access DRP_SendCANR_GPS_UTC_Second_FD11_SendCANR_GPS_UTC_Second_FD11: accessed-variable=SendCANR_GPS_UTC_Second_FD11.SendCANR_GPS_UTC_Second_FD11
            access DRP_SendCANR_GPS_UTC_Second_FD11Vld_SendCANR_GPS_UTC_Second_FD11Vld: accessed-variable=SendCANR_GPS_UTC_Second_FD11Vld.SendCANR_GPS_UTC_Second_FD11Vld
          data-send-points:
            access DSP_CanCom_FD11TxSignalsSR_COMTX_GPS_UTC_Second_TELEMATIC_FD_1_FD11: accessed-variable=CanCom_FD11TxSignalsSR.COMTX_GPS_UTC_Second_TELEMATIC_FD_1_FD11
        SendCANR_GearEngagedForDisplay: can-be-invoked-concurrently=true, symbol=ApplCanComAb_FD11_SendCANR_GearEngagedForDisplay  # Transmit
          data-receive-point-by-arguments:
            access DRP_SendCANR_GearEngagedForDisplay_SendCANR_GearEngagedForDisplay: accessed-variable=SendCANR_GearEngagedForDisplay.SendCANR_GearEngagedForDisplay
            access DRP_SendCANR_GearEngagedForDisplayVld_SendCANR_GearEngagedForDisplayVld: accessed-variable=SendCANR_GearEngagedForDisplayVld.SendCANR_GearEngagedForDisplayVld
          data-send-points:
            access DSP_CanCom_FD11TxSignalsSR_COMTX_GearEngagedForDisplay_TRANSM_FD_2_FD11: accessed-variable=CanCom_FD11TxSignalsSR.COMTX_GearEngagedForDisplay_TRANSM_FD_2_FD11
        SendCANR_HVCMS_BulChrgnCmplFD11: can-be-invoked-concurrently=true, symbol=ApplCanComAb_FD11_SendCANR_HVCMS_BulChrgnCmplFD11  # Transmit
          data-receive-point-by-arguments:
            access DRP_SendCANR_HVCMS_BulChrgnCmplFD11_SendCANR_HVCMS_BulChrgnCmplFD11: accessed-variable=SendCANR_HVCMS_BulChrgnCmplFD11.SendCANR_HVCMS_BulChrgnCmplFD11
            access DRP_SendCANR_HVCMS_BulChrgnCmplFD11Vld_SendCANR_HVCMS_BulChrgnCmplFD11Vld: accessed-variable=SendCANR_HVCMS_BulChrgnCmplFD11Vld.SendCANR_HVCMS_BulChrgnCmplFD11Vld
          data-send-points:
            access DSP_CanCom_FD11TxSignalsSR_COMTX_HVCMS_BulkChargingComplete_VDCM_OBCM_FD11: accessed-variable=CanCom_FD11TxSignalsSR.COMTX_HVCMS_BulkChargingComplete_VDCM_OBCM_FD11
        SendCANR_HVCMS_ChrgnCmpl_FD11: can-be-invoked-concurrently=true, symbol=ApplCanComAb_FD11_SendCANR_HVCMS_ChrgnCmpl_FD11  # Transmit
          data-receive-point-by-arguments:
            access DRP_SendCANR_HVCMS_ChrgnCmpl_FD11_SendCANR_HVCMS_ChrgnCmpl_FD11: accessed-variable=SendCANR_HVCMS_ChrgnCmpl_FD11.SendCANR_HVCMS_ChrgnCmpl_FD11
            access DRP_SendCANR_HVCMS_ChrgnCmpl_FD11Vld_SendCANR_HVCMS_ChrgnCmpl_FD11Vld: accessed-variable=SendCANR_HVCMS_ChrgnCmpl_FD11Vld.SendCANR_HVCMS_ChrgnCmpl_FD11Vld
          data-send-points:
            access DSP_CanCom_FD11TxSignalsSR_COMTX_HVCMS_ChargingComplete_VDCM_OBCM_FD11: accessed-variable=CanCom_FD11TxSignalsSR.COMTX_HVCMS_ChargingComplete_VDCM_OBCM_FD11
        SendCANR_HVCMS_EVEgyCap_FD11: can-be-invoked-concurrently=true, symbol=ApplCanComAb_FD11_SendCANR_HVCMS_EVEgyCap_FD11  # Transmit
          data-receive-point-by-arguments:
            access DRP_SendCANR_HVCMS_EVEgyCap_FD11_SendCANR_HVCMS_EVEgyCap_FD11: accessed-variable=SendCANR_HVCMS_EVEgyCap_FD11.SendCANR_HVCMS_EVEgyCap_FD11
            access DRP_SendCANR_HVCMS_EVEgyCap_FD11Vld_SendCANR_HVCMS_EVEgyCap_FD11Vld: accessed-variable=SendCANR_HVCMS_EVEgyCap_FD11Vld.SendCANR_HVCMS_EVEgyCap_FD11Vld
          data-send-points:
            access DSP_CanCom_FD11TxSignalsSR_COMTX_HVCMS_EVEnergyCapacity_VDCM_OBCM_FD11: accessed-variable=CanCom_FD11TxSignalsSR.COMTX_HVCMS_EVEnergyCapacity_VDCM_OBCM_FD11
        SendCANR_HVCMS_EVEgyReq_FD11: can-be-invoked-concurrently=true, symbol=ApplCanComAb_FD11_SendCANR_HVCMS_EVEgyReq_FD11  # Transmit
          data-receive-point-by-arguments:
            access DRP_SendCANR_HVCMS_EVEgyReq_FD11_SendCANR_HVCMS_EVEgyReq_FD11: accessed-variable=SendCANR_HVCMS_EVEgyReq_FD11.SendCANR_HVCMS_EVEgyReq_FD11
            access DRP_SendCANR_HVCMS_EVEgyReq_FD11Vld_SendCANR_HVCMS_EVEgyReq_FD11Vld: accessed-variable=SendCANR_HVCMS_EVEgyReq_FD11Vld.SendCANR_HVCMS_EVEgyReq_FD11Vld
          data-send-points:
            access DSP_CanCom_FD11TxSignalsSR_COMTX_HVCMS_EVEnergyRequest_VDCM_OBCM_FD11: accessed-variable=CanCom_FD11TxSignalsSR.COMTX_HVCMS_EVEnergyRequest_VDCM_OBCM_FD11
        SendCANR_HVCMS_EVErrorCode_FD11: can-be-invoked-concurrently=true, symbol=ApplCanComAb_FD11_SendCANR_HVCMS_EVErrorCode_FD11  # Transmit
          data-receive-point-by-arguments:
            access DRP_SendCANR_HVCMS_EVErrorCode_FD11_SendCANR_HVCMS_EVErrorCode_FD11: accessed-variable=SendCANR_HVCMS_EVErrorCode_FD11.SendCANR_HVCMS_EVErrorCode_FD11
            access DRP_SendCANR_HVCMS_EVErrorCode_FD11Vld_SendCANR_HVCMS_EVErrorCode_FD11Vld: accessed-variable=SendCANR_HVCMS_EVErrorCode_FD11Vld.SendCANR_HVCMS_EVErrorCode_FD11Vld
          data-send-points:
            access DSP_CanCom_FD11TxSignalsSR_COMTX_HVCMS_EVErrorCode_VDCM_OBCM_FD11: accessed-variable=CanCom_FD11TxSignalsSR.COMTX_HVCMS_EVErrorCode_VDCM_OBCM_FD11
        SendCANR_HVCMS_EVMaxILimit_FD11: can-be-invoked-concurrently=true, symbol=ApplCanComAb_FD11_SendCANR_HVCMS_EVMaxILimit_FD11  # Transmit
          data-receive-point-by-arguments:
            access DRP_SendCANR_HVCMS_EVMaxILimit_FD11_SendCANR_HVCMS_EVMaxILimit_FD11: accessed-variable=SendCANR_HVCMS_EVMaxILimit_FD11.SendCANR_HVCMS_EVMaxILimit_FD11
            access DRP_SendCANR_HVCMS_EVMaxILimit_FD11Vld_SendCANR_HVCMS_EVMaxILimit_FD11Vld: accessed-variable=SendCANR_HVCMS_EVMaxILimit_FD11Vld.SendCANR_HVCMS_EVMaxILimit_FD11Vld
          data-send-points:
            access DSP_CanCom_FD11TxSignalsSR_COMTX_HVCMS_EVMax_I_Limit_VDCM_OBCM_FD11: accessed-variable=CanCom_FD11TxSignalsSR.COMTX_HVCMS_EVMax_I_Limit_VDCM_OBCM_FD11
        SendCANR_HVCMS_EVMaxPLimit_FD11: can-be-invoked-concurrently=true, symbol=ApplCanComAb_FD11_SendCANR_HVCMS_EVMaxPLimit_FD11  # Transmit
          data-receive-point-by-arguments:
            access DRP_SendCANR_HVCMS_EVMaxPLimit_FD11_SendCANR_HVCMS_EVMaxPLimit_FD11: accessed-variable=SendCANR_HVCMS_EVMaxPLimit_FD11.SendCANR_HVCMS_EVMaxPLimit_FD11
            access DRP_SendCANR_HVCMS_EVMaxPLimit_FD11Vld_SendCANR_HVCMS_EVMaxPLimit_FD11Vld: accessed-variable=SendCANR_HVCMS_EVMaxPLimit_FD11Vld.SendCANR_HVCMS_EVMaxPLimit_FD11Vld
          data-send-points:
            access DSP_CanCom_FD11TxSignalsSR_COMTX_HVCMS_EVMax_P_Limit_VDCM_OBCM_FD11: accessed-variable=CanCom_FD11TxSignalsSR.COMTX_HVCMS_EVMax_P_Limit_VDCM_OBCM_FD11
        SendCANR_HVCMSEVMaxVLimit_FD11: can-be-invoked-concurrently=true, symbol=ApplCanComAb_FD11_SendCANR_HVCMSEVMaxVLimit_FD11  # Transmit
          data-receive-point-by-arguments:
            access DRP_SendCANR_HVCMSEVMaxVLimit_FD11_SendCANR_HVCMSEVMaxVLimit_FD11: accessed-variable=SendCANR_HVCMSEVMaxVLimit_FD11.SendCANR_HVCMSEVMaxVLimit_FD11
            access DRP_SendCANR_HVCMSEVMaxVLimit_FD11Vld_SendCANR_HVCMSEVMaxVLimit_FD11Vld: accessed-variable=SendCANR_HVCMSEVMaxVLimit_FD11Vld.SendCANR_HVCMSEVMaxVLimit_FD11Vld
          data-send-points:
            access DSP_CanCom_FD11TxSignalsSR_COMTX_HVCMS_EVMax_V_Limit_VDCM_OBCM_FD11: accessed-variable=CanCom_FD11TxSignalsSR.COMTX_HVCMS_EVMax_V_Limit_VDCM_OBCM_FD11
        SendCANR_HVCMS_EVReady_FD11: can-be-invoked-concurrently=true, symbol=ApplCanComAb_FD11_SendCANR_HVCMS_EVReady_FD11  # Transmit
          data-receive-point-by-arguments:
            access DRP_SendCANR_HVCMS_EVReady_FD11_SendCANR_HVCMS_EVReady_FD11: accessed-variable=SendCANR_HVCMS_EVReady_FD11.SendCANR_HVCMS_EVReady_FD11
            access DRP_SendCANR_HVCMS_EVReady_FD11Vld_SendCANR_HVCMS_EVReady_FD11Vld: accessed-variable=SendCANR_HVCMS_EVReady_FD11Vld.SendCANR_HVCMS_EVReady_FD11Vld
          data-send-points:
            access DSP_CanCom_FD11TxSignalsSR_COMTX_HVCMS_EVReady_VDCM_OBCM_FD11: accessed-variable=CanCom_FD11TxSignalsSR.COMTX_HVCMS_EVReady_VDCM_OBCM_FD11
        SendCANR_HVCMS_EVRESS_SOC_FD11: can-be-invoked-concurrently=true, symbol=ApplCanComAb_FD11_SendCANR_HVCMS_EVRESS_SOC_FD11  # Transmit
          data-receive-point-by-arguments:
            access DRP_SendCANR_HVCMS_EVRESS_SOC_FD11_SendCANR_HVCMS_EVRESS_SOC_FD11: accessed-variable=SendCANR_HVCMS_EVRESS_SOC_FD11.SendCANR_HVCMS_EVRESS_SOC_FD11
            access DRP_SendCANR_HVCMS_EVRESS_SOC_FD11Vld_SendCANR_HVCMS_EVRESS_SOC_FD11Vld: accessed-variable=SendCANR_HVCMS_EVRESS_SOC_FD11Vld.SendCANR_HVCMS_EVRESS_SOC_FD11Vld
          data-send-points:
            access DSP_CanCom_FD11TxSignalsSR_COMTX_HVCMS_EVRESS_SOC_VDCM_OBCM_FD11: accessed-variable=CanCom_FD11TxSignalsSR.COMTX_HVCMS_EVRESS_SOC_VDCM_OBCM_FD11
        SendCANR_HVCMS_EVRESSCdng_FD11: can-be-invoked-concurrently=true, symbol=ApplCanComAb_FD11_SendCANR_HVCMS_EVRESSCdng_FD11  # Transmit
          data-receive-point-by-arguments:
            access DRP_SendCANR_HVCMS_EVRESSCdng_FD11_SendCANR_HVCMS_EVRESSCdng_FD11: accessed-variable=SendCANR_HVCMS_EVRESSCdng_FD11.SendCANR_HVCMS_EVRESSCdng_FD11
            access DRP_SendCANR_HVCMS_EVRESSCdng_FD11Vld_SendCANR_HVCMS_EVRESSCdng_FD11Vld: accessed-variable=SendCANR_HVCMS_EVRESSCdng_FD11Vld.SendCANR_HVCMS_EVRESSCdng_FD11Vld
          data-send-points:
            access DSP_CanCom_FD11TxSignalsSR_COMTX_HVCMS_EVRESSConditioning_VDCM_OBCM_FD11: accessed-variable=CanCom_FD11TxSignalsSR.COMTX_HVCMS_EVRESSConditioning_VDCM_OBCM_FD11
        SendCANR_HVCMS_EVTarCurr_FD11: can-be-invoked-concurrently=true, symbol=ApplCanComAb_FD11_SendCANR_HVCMS_EVTarCurr_FD11  # Transmit
          data-receive-point-by-arguments:
            access DRP_SendCANR_HVCMS_EVTarCurr_FD11_SendCANR_HVCMS_EVTarCurr_FD11: accessed-variable=SendCANR_HVCMS_EVTarCurr_FD11.SendCANR_HVCMS_EVTarCurr_FD11
            access DRP_SendCANR_HVCMS_EVTarCurr_FD11Vld_SendCANR_HVCMS_EVTarCurr_FD11Vld: accessed-variable=SendCANR_HVCMS_EVTarCurr_FD11Vld.SendCANR_HVCMS_EVTarCurr_FD11Vld
          data-send-points:
            access DSP_CanCom_FD11TxSignalsSR_COMTX_HVCMS_EVTargetCurrent_VDCM_OBCM_FD11: accessed-variable=CanCom_FD11TxSignalsSR.COMTX_HVCMS_EVTargetCurrent_VDCM_OBCM_FD11
        SendCANR_HVCMS_EVTarVolt_FD11: can-be-invoked-concurrently=true, symbol=ApplCanComAb_FD11_SendCANR_HVCMS_EVTarVolt_FD11  # Transmit
          data-receive-point-by-arguments:
            access DRP_SendCANR_HVCMS_EVTarVolt_FD11_SendCANR_HVCMS_EVTarVolt_FD11: accessed-variable=SendCANR_HVCMS_EVTarVolt_FD11.SendCANR_HVCMS_EVTarVolt_FD11
            access DRP_SendCANR_HVCMS_EVTarVolt_FD11Vld_SendCANR_HVCMS_EVTarVolt_FD11Vld: accessed-variable=SendCANR_HVCMS_EVTarVolt_FD11Vld.SendCANR_HVCMS_EVTarVolt_FD11Vld
          data-send-points:
            access DSP_CanCom_FD11TxSignalsSR_COMTX_HVCMS_EVTargetVoltage_VDCM_OBCM_FD11: accessed-variable=CanCom_FD11TxSignalsSR.COMTX_HVCMS_EVTargetVoltage_VDCM_OBCM_FD11
        SendCANR_HVCMS_PrtclEntry1_FD11: can-be-invoked-concurrently=true, symbol=ApplCanComAb_FD11_SendCANR_HVCMS_PrtclEntry1_FD11  # Transmit
          data-receive-point-by-arguments:
            access DRP_SendCANR_HVCMS_PrtclEntry1_FD11_SendCANR_HVCMS_PrtclEntry1_FD11: accessed-variable=SendCANR_HVCMS_PrtclEntry1_FD11.SendCANR_HVCMS_PrtclEntry1_FD11
            access DRP_SendCANR_HVCMS_PrtclEntry1_FD11Vld_SendCANR_HVCMS_PrtclEntry1_FD11Vld: accessed-variable=SendCANR_HVCMS_PrtclEntry1_FD11Vld.SendCANR_HVCMS_PrtclEntry1_FD11Vld
          data-send-points:
            access DSP_CanCom_FD11TxSignalsSR_COMTX_HVCMS_Protocol_Entry1_VDCM_OBCM_FD11: accessed-variable=CanCom_FD11TxSignalsSR.COMTX_HVCMS_Protocol_Entry1_VDCM_OBCM_FD11
        SendCANR_HVCMS_PrtclEntry2_FD11: can-be-invoked-concurrently=true, symbol=ApplCanComAb_FD11_SendCANR_HVCMS_PrtclEntry2_FD11  # Transmit
          data-receive-point-by-arguments:
            access DRP_SendCANR_HVCMS_PrtclEntry2_FD11_SendCANR_HVCMS_PrtclEntry2_FD11: accessed-variable=SendCANR_HVCMS_PrtclEntry2_FD11.SendCANR_HVCMS_PrtclEntry2_FD11
            access DRP_SendCANR_HVCMS_PrtclEntry2_FD11Vld_SendCANR_HVCMS_PrtclEntry2_FD11Vld: accessed-variable=SendCANR_HVCMS_PrtclEntry2_FD11Vld.SendCANR_HVCMS_PrtclEntry2_FD11Vld
          data-send-points:
            access DSP_CanCom_FD11TxSignalsSR_COMTX_HVCMS_Protocol_Entry2_VDCM_OBCM_FD11: accessed-variable=CanCom_FD11TxSignalsSR.COMTX_HVCMS_Protocol_Entry2_VDCM_OBCM_FD11
        SendCANR_HVCMS_PrtclEntry3_FD11: can-be-invoked-concurrently=true, symbol=ApplCanComAb_FD11_SendCANR_HVCMS_PrtclEntry3_FD11  # Transmit
          data-receive-point-by-arguments:
            access DRP_SendCANR_HVCMS_PrtclEntry3_FD11_SendCANR_HVCMS_PrtclEntry3_FD11: accessed-variable=SendCANR_HVCMS_PrtclEntry3_FD11.SendCANR_HVCMS_PrtclEntry3_FD11
            access DRP_SendCANR_HVCMS_PrtclEntry3_FD11Vld_SendCANR_HVCMS_PrtclEntry3_FD11Vld: accessed-variable=SendCANR_HVCMS_PrtclEntry3_FD11Vld.SendCANR_HVCMS_PrtclEntry3_FD11Vld
          data-send-points:
            access DSP_CanCom_FD11TxSignalsSR_COMTX_HVCMS_Protocol_Entry3_VDCM_OBCM_FD11: accessed-variable=CanCom_FD11TxSignalsSR.COMTX_HVCMS_Protocol_Entry3_VDCM_OBCM_FD11
        SendCANR_HVCMS_RdyToChrgSt_FD11: can-be-invoked-concurrently=true, symbol=ApplCanComAb_FD11_SendCANR_HVCMS_RdyToChrgSt_FD11  # Transmit
          data-receive-point-by-arguments:
            access DRP_SendCANR_HVCMS_RdyToChrgSt_FD11_SendCANR_HVCMS_RdyToChrgSt_FD11: accessed-variable=SendCANR_HVCMS_RdyToChrgSt_FD11.SendCANR_HVCMS_RdyToChrgSt_FD11
            access DRP_SendCANR_HVCMS_RdyToChrgSt_FD11Vld_SendCANR_HVCMS_RdyToChrgSt_FD11Vld: accessed-variable=SendCANR_HVCMS_RdyToChrgSt_FD11Vld.SendCANR_HVCMS_RdyToChrgSt_FD11Vld
          data-send-points:
            access DSP_CanCom_FD11TxSignalsSR_COMTX_HVCMS_ReadyToChargeState_VDCM_OBCM_FD11: accessed-variable=CanCom_FD11TxSignalsSR.COMTX_HVCMS_ReadyToChargeState_VDCM_OBCM_FD11
        SendCANR_HVCMS_RmnTiToBuSOCFD11: can-be-invoked-concurrently=true, symbol=ApplCanComAb_FD11_SendCANR_HVCMS_RmnTiToBuSOCFD11  # Transmit
          data-receive-point-by-arguments:
            access DRP_SendCANR_HVCMS_RmnTiToBuSOCFD11_SendCANR_HVCMS_RmnTiToBuSOCFD11: accessed-variable=SendCANR_HVCMS_RmnTiToBuSOCFD11.SendCANR_HVCMS_RmnTiToBuSOCFD11
            access DRP_SendCANR_HVCMS_RmnTiToBuSOCFD11Vld_SendCANR_HVCMS_RmnTiToBuSOCFD11Vld: accessed-variable=SendCANR_HVCMS_RmnTiToBuSOCFD11Vld.SendCANR_HVCMS_RmnTiToBuSOCFD11Vld
          data-send-points:
            access DSP_CanCom_FD11TxSignalsSR_COMTX_HVCMS_RemaningTimeToBulkSOC_VDCM_OBCM_FD11: accessed-variable=CanCom_FD11TxSignalsSR.COMTX_HVCMS_RemaningTimeToBulkSOC_VDCM_OBCM_FD11
        SendCANR_HVCMS_RmnTiToFuSOCFD11: can-be-invoked-concurrently=true, symbol=ApplCanComAb_FD11_SendCANR_HVCMS_RmnTiToFuSOCFD11  # Transmit
          data-receive-point-by-arguments:
            access DRP_SendCANR_HVCMS_RmnTiToFuSOCFD11_SendCANR_HVCMS_RmnTiToFuSOCFD11: accessed-variable=SendCANR_HVCMS_RmnTiToFuSOCFD11.SendCANR_HVCMS_RmnTiToFuSOCFD11
            access DRP_SendCANR_HVCMS_RmnTiToFuSOCFD11Vld_SendCANR_HVCMS_RmnTiToFuSOCFD11Vld: accessed-variable=SendCANR_HVCMS_RmnTiToFuSOCFD11Vld.SendCANR_HVCMS_RmnTiToFuSOCFD11Vld
          data-send-points:
            access DSP_CanCom_FD11TxSignalsSR_COMTX_HVCMS_RemaningTimeToFullSOC_VDCM_OBCM_FD11: accessed-variable=CanCom_FD11TxSignalsSR.COMTX_HVCMS_RemaningTimeToFullSOC_VDCM_OBCM_FD11
        SendCANR_HVCMS_SelEgyTrfTypFD11: can-be-invoked-concurrently=true, symbol=ApplCanComAb_FD11_SendCANR_HVCMS_SelEgyTrfTypFD11  # Transmit
          data-receive-point-by-arguments:
            access DRP_SendCANR_HVCMS_SelEgyTrfTypFD11_SendCANR_HVCMS_SelEgyTrfTypFD11: accessed-variable=SendCANR_HVCMS_SelEgyTrfTypFD11.SendCANR_HVCMS_SelEgyTrfTypFD11
            access DRP_SendCANR_HVCMS_SelEgyTrfTypFD11Vld_SendCANR_HVCMS_SelEgyTrfTypFD11Vld: accessed-variable=SendCANR_HVCMS_SelEgyTrfTypFD11Vld.SendCANR_HVCMS_SelEgyTrfTypFD11Vld
          data-send-points:
            access DSP_CanCom_FD11TxSignalsSR_COMTX_HVCMS_SelectedEnergyTransferType_VDCM_OBCM_FD11: accessed-variable=CanCom_FD11TxSignalsSR.COMTX_HVCMS_SelectedEnergyTransferType_VDCM_OBCM_FD11
        SendCANR_HVCMS_SelPmtOptn_FD11: can-be-invoked-concurrently=true, symbol=ApplCanComAb_FD11_SendCANR_HVCMS_SelPmtOptn_FD11  # Transmit
          data-receive-point-by-arguments:
            access DRP_SendCANR_HVCMS_SelPmtOptn_FD11_SendCANR_HVCMS_SelPmtOptn_FD11: accessed-variable=SendCANR_HVCMS_SelPmtOptn_FD11.SendCANR_HVCMS_SelPmtOptn_FD11
            access DRP_SendCANR_HVCMS_SelPmtOptn_FD11Vld_SendCANR_HVCMS_SelPmtOptn_FD11Vld: accessed-variable=SendCANR_HVCMS_SelPmtOptn_FD11Vld.SendCANR_HVCMS_SelPmtOptn_FD11Vld
          data-send-points:
            access DSP_CanCom_FD11TxSignalsSR_COMTX_HVCMS_SelectedPaymentOptn_VDCM_OBCM_FD11: accessed-variable=CanCom_FD11TxSignalsSR.COMTX_HVCMS_SelectedPaymentOptn_VDCM_OBCM_FD11
        SendCANR_HVCMS_SelServId_FD11: can-be-invoked-concurrently=true, symbol=ApplCanComAb_FD11_SendCANR_HVCMS_SelServId_FD11  # Transmit
          data-receive-point-by-arguments:
            access DRP_SendCANR_HVCMS_SelServId_FD11_SendCANR_HVCMS_SelServId_FD11: accessed-variable=SendCANR_HVCMS_SelServId_FD11.SendCANR_HVCMS_SelServId_FD11
            access DRP_SendCANR_HVCMS_SelServId_FD11Vld_SendCANR_HVCMS_SelServId_FD11Vld: accessed-variable=SendCANR_HVCMS_SelServId_FD11Vld.SendCANR_HVCMS_SelServId_FD11Vld
          data-send-points:
            access DSP_CanCom_FD11TxSignalsSR_COMTX_HVCMS_SelectedServiceId_VDCM_OBCM_FD11: accessed-variable=CanCom_FD11TxSignalsSR.COMTX_HVCMS_SelectedServiceId_VDCM_OBCM_FD11
        SendCANR_HVCMS_ServCtgy_FD11: can-be-invoked-concurrently=true, symbol=ApplCanComAb_FD11_SendCANR_HVCMS_ServCtgy_FD11  # Transmit
          data-receive-point-by-arguments:
            access DRP_SendCANR_HVCMS_ServCtgy_FD11_SendCANR_HVCMS_ServCtgy_FD11: accessed-variable=SendCANR_HVCMS_ServCtgy_FD11.SendCANR_HVCMS_ServCtgy_FD11
            access DRP_SendCANR_HVCMS_ServCtgy_FD11Vld_SendCANR_HVCMS_ServCtgy_FD11Vld: accessed-variable=SendCANR_HVCMS_ServCtgy_FD11Vld.SendCANR_HVCMS_ServCtgy_FD11Vld
          data-send-points:
            access DSP_CanCom_FD11TxSignalsSR_COMTX_HVCMS_ServiceCategory_VDCM_OBCM_FD11: accessed-variable=CanCom_FD11TxSignalsSR.COMTX_HVCMS_ServiceCategory_VDCM_OBCM_FD11
        SendCANR_HVCMS_ServScope_FD11: can-be-invoked-concurrently=true, symbol=ApplCanComAb_FD11_SendCANR_HVCMS_ServScope_FD11  # Transmit
          data-receive-point-by-arguments:
            access DRP_SendCANR_HVCMS_ServScope_FD11_SendCANR_HVCMS_ServScope_FD11: accessed-variable=SendCANR_HVCMS_ServScope_FD11.SendCANR_HVCMS_ServScope_FD11
            access DRP_SendCANR_HVCMS_ServScope_FD11Vld_SendCANR_HVCMS_ServScope_FD11Vld: accessed-variable=SendCANR_HVCMS_ServScope_FD11Vld.SendCANR_HVCMS_ServScope_FD11Vld
          data-send-points:
            access DSP_CanCom_FD11TxSignalsSR_COMTX_HVCMS_ServiceScope_VDCM_OBCM_FD11: accessed-variable=CanCom_FD11TxSignalsSR.COMTX_HVCMS_ServiceScope_VDCM_OBCM_FD11
        SendCANR_OBCMOutVoltSyncTgtFD11: can-be-invoked-concurrently=true, symbol=ApplCanComAb_FD11_SendCANR_OBCMOutVoltSyncTgtFD11  # Transmit
          data-receive-point-by-arguments:
            access DRP_SendCANR_OBCMOutVoltSyncTgtFD11_SendCANR_OBCMOutVoltSyncTgtFD11: accessed-variable=SendCANR_OBCMOutVoltSyncTgtFD11.SendCANR_OBCMOutVoltSyncTgtFD11
            access DRP_SendCANR_OBCMOutVoltSyncTgtFD11Vld_SendCANR_OBCMOutVoltSyncTgtFD11Vld: accessed-variable=SendCANR_OBCMOutVoltSyncTgtFD11Vld.SendCANR_OBCMOutVoltSyncTgtFD11Vld
          data-send-points:
            access DSP_CanCom_FD11TxSignalsSR_COMTX_OBCM_OutVoltageSyncTgt_VDCM_OBCM_FD11: accessed-variable=CanCom_FD11TxSignalsSR.COMTX_OBCM_OutVoltageSyncTgt_VDCM_OBCM_FD11
        SendCANR_V2X_HVCMSSltdEngTrfTyp: can-be-invoked-concurrently=true, symbol=ApplCanComAb_FD11_SendCANR_V2X_HVCMSSltdEngTrfTyp  # Transmit
          data-receive-point-by-arguments:
            access DRP_SendCANR_V2X_HVCMSSltdEngTrfTyp_SendCANR_V2X_HVCMSSltdEngTrfTyp: accessed-variable=SendCANR_V2X_HVCMSSltdEngTrfTyp.SendCANR_V2X_HVCMSSltdEngTrfTyp
            access DRP_SendCANR_V2X_HVCMSSltdEngTrfTypVld_SendCANR_V2X_HVCMSSltdEngTrfTypVld: accessed-variable=SendCANR_V2X_HVCMSSltdEngTrfTypVld.SendCANR_V2X_HVCMSSltdEngTrfTypVld
          data-send-points:
            access DSP_CanCom_FD11TxSignalsSR_COMTX_V2X_HVCMS_SlctdEnergyTransfType_VDCM_OBCM_FD11: accessed-variable=CanCom_FD11TxSignalsSR.COMTX_V2X_HVCMS_SlctdEnergyTransfType_VDCM_OBCM_FD11
        SendCANR_VDCM_BattBulkSOC_FD11: can-be-invoked-concurrently=true, symbol=ApplCanComAb_FD11_SendCANR_VDCM_BattBulkSOC_FD11  # Transmit
          data-receive-point-by-arguments:
            access DRP_SendCANR_VDCM_BattBulkSOC_FD11_SendCANR_VDCM_BattBulkSOC_FD11: accessed-variable=SendCANR_VDCM_BattBulkSOC_FD11.SendCANR_VDCM_BattBulkSOC_FD11
            access DRP_SendCANR_VDCM_BattBulkSOC_FD11Vld_SendCANR_VDCM_BattBulkSOC_FD11Vld: accessed-variable=SendCANR_VDCM_BattBulkSOC_FD11Vld.SendCANR_VDCM_BattBulkSOC_FD11Vld
          data-send-points:
            access DSP_CanCom_FD11TxSignalsSR_COMTX_VDCM_BattBulkSOC_VDCM_OBCM_FD11: accessed-variable=CanCom_FD11TxSignalsSR.COMTX_VDCM_BattBulkSOC_VDCM_OBCM_FD11
        SendCANR_VDCMCntrtAuthentIDFD11: can-be-invoked-concurrently=true, symbol=ApplCanComAb_FD11_SendCANR_VDCMCntrtAuthentIDFD11  # Transmit
          data-receive-point-by-arguments:
            access DRP_SendCANR_VDCMCntrtAuthentIDFD11_SendCANR_VDCMCntrtAuthentIDFD11: accessed-variable=SendCANR_VDCMCntrtAuthentIDFD11.SendCANR_VDCMCntrtAuthentIDFD11
            access DRP_SendCANR_VDCMCntrtAuthentIDFD11Vld_SendCANR_VDCMCntrtAuthentIDFD11Vld: accessed-variable=SendCANR_VDCMCntrtAuthentIDFD11Vld.SendCANR_VDCMCntrtAuthentIDFD11Vld
          data-send-points:
            access DSP_CanCom_FD11TxSignalsSR_COMTX_VDCM_ContractAuthenticationID_VDCM_OBCM_FD11: accessed-variable=CanCom_FD11TxSignalsSR.COMTX_VDCM_ContractAuthenticationID_VDCM_OBCM_FD11
        SendCANR_VDCM_GenChallenge_FD11: can-be-invoked-concurrently=true, symbol=ApplCanComAb_FD11_SendCANR_VDCM_GenChallenge_FD11  # Transmit
          data-receive-point-by-arguments:
            access DRP_SendCANR_VDCM_GenChallenge_FD11_SendCANR_VDCM_GenChallenge_FD11: accessed-variable=SendCANR_VDCM_GenChallenge_FD11.SendCANR_VDCM_GenChallenge_FD11
            access DRP_SendCANR_VDCM_GenChallenge_FD11Vld_SendCANR_VDCM_GenChallenge_FD11Vld: accessed-variable=SendCANR_VDCM_GenChallenge_FD11Vld.SendCANR_VDCM_GenChallenge_FD11Vld
          data-send-points:
            access DSP_CanCom_FD11TxSignalsSR_COMTX_VDCM_GenChallenge_VDCM_OBCM_FD11: accessed-variable=CanCom_FD11TxSignalsSR.COMTX_VDCM_GenChallenge_VDCM_OBCM_FD11
        SendCANR_VDCMOBCDchaCurrLimFD11: can-be-invoked-concurrently=true, symbol=ApplCanComAb_FD11_SendCANR_VDCMOBCDchaCurrLimFD11  # Transmit
          data-receive-point-by-arguments:
            access DRP_SendCANR_VDCMOBCDchaCurrLimFD11_SendCANR_VDCMOBCDchaCurrLimFD11: accessed-variable=SendCANR_VDCMOBCDchaCurrLimFD11.SendCANR_VDCMOBCDchaCurrLimFD11
            access DRP_SendCANR_VDCMOBCDchaCurrLimFD11Vld_SendCANR_VDCMOBCDchaCurrLimFD11Vld: accessed-variable=SendCANR_VDCMOBCDchaCurrLimFD11Vld.SendCANR_VDCMOBCDchaCurrLimFD11Vld
          data-send-points:
            access DSP_CanCom_FD11TxSignalsSR_COMTX_VDCM_OBCDischCurrentLim_VDCM_OBCM_FD11: accessed-variable=CanCom_FD11TxSignalsSR.COMTX_VDCM_OBCDischCurrentLim_VDCM_OBCM_FD11
        SendCANR_VDCMTypeCNegotnStsFD11: can-be-invoked-concurrently=true, symbol=ApplCanComAb_FD11_SendCANR_VDCMTypeCNegotnStsFD11  # Transmit
          data-receive-point-by-arguments:
            access DRP_SendCANR_VDCMTypeCNegotnStsFD11_SendCANR_VDCMTypeCNegotnStsFD11: accessed-variable=SendCANR_VDCMTypeCNegotnStsFD11.SendCANR_VDCMTypeCNegotnStsFD11
            access DRP_SendCANR_VDCMTypeCNegotnStsFD11Vld_SendCANR_VDCMTypeCNegotnStsFD11Vld: accessed-variable=SendCANR_VDCMTypeCNegotnStsFD11Vld.SendCANR_VDCMTypeCNegotnStsFD11Vld
          data-send-points:
            access DSP_CanCom_FD11TxSignalsSR_COMTX_VDCM_TypeCNegotiationSts_VDCM_OBCM_FD11: accessed-variable=CanCom_FD11TxSignalsSR.COMTX_VDCM_TypeCNegotiationSts_VDCM_OBCM_FD11
        SendCANR_ClrLgsDiagInfo_FD11: can-be-invoked-concurrently=true, symbol=ApplCanComAb_FD11_SendCANR_ClrLgsDiagInfo_FD11  # Transmit
          data-receive-point-by-arguments:
            access DRP_SendCANR_ClrLgsDiagInfo_FD11_SendCANR_ClrLgsDiagInfo_FD11: accessed-variable=SendCANR_ClrLgsDiagInfo_FD11.SendCANR_ClrLgsDiagInfo_FD11
            access DRP_SendCANR_ClrLgsDiagInfo_FD11Vld_SendCANR_ClrLgsDiagInfo_FD11Vld: accessed-variable=SendCANR_ClrLgsDiagInfo_FD11Vld.SendCANR_ClrLgsDiagInfo_FD11Vld
          data-send-points:
            access DSP_CanCom_FD11TxSignalsSR_COMTX_ClrLgsDiagInfo_VDCM_PWT3_FD11: accessed-variable=CanCom_FD11TxSignalsSR.COMTX_ClrLgsDiagInfo_VDCM_PWT3_FD11
        SendCANR_VIN_DATA_FD11: can-be-invoked-concurrently=true, symbol=ApplCanComAb_FD11_SendCANR_VIN_DATA_FD11  # Transmit
          data-receive-point-by-arguments:
            access DRP_SendCANR_VIN_DATA_FD11_SendCANR_VIN_DATA_FD11: accessed-variable=SendCANR_VIN_DATA_FD11.SendCANR_VIN_DATA_FD11
            access DRP_SendCANR_VIN_DATA_FD11Vld_SendCANR_VIN_DATA_FD11Vld: accessed-variable=SendCANR_VIN_DATA_FD11Vld.SendCANR_VIN_DATA_FD11Vld
          data-send-points:
            access DSP_CanCom_FD11TxSignalsSR_COMTX_VIN_DATA_VIN_FD11: accessed-variable=CanCom_FD11TxSignalsSR.COMTX_VIN_DATA_VIN_FD11
        SendCANR_VIN_MSG_FD11: can-be-invoked-concurrently=true, symbol=ApplCanComAb_FD11_SendCANR_VIN_MSG_FD11  # Transmit
          data-receive-point-by-arguments:
            access DRP_SendCANR_VIN_MSG_FD11_SendCANR_VIN_MSG_FD11: accessed-variable=SendCANR_VIN_MSG_FD11.SendCANR_VIN_MSG_FD11
            access DRP_SendCANR_VIN_MSG_FD11Vld_SendCANR_VIN_MSG_FD11Vld: accessed-variable=SendCANR_VIN_MSG_FD11Vld.SendCANR_VIN_MSG_FD11Vld
          data-send-points:
            access DSP_CanCom_FD11TxSignalsSR_COMTX_VIN_MSG_VIN_FD11: accessed-variable=CanCom_FD11TxSignalsSR.COMTX_VIN_MSG_VIN_FD11
      shared-parameters:
        39 x parameter data prototype, all with type=ADTSBoolean, init-value=1:
          KeCANR_b_ComTxMsg_BCM_FD_10_FD11_Enbld
          KeCANR_b_ComTxMsg_BCM_FD_2_FD11_Enbld
          KeCANR_b_ComTxMsg_BCM_FD_3_FD11_Enbld
          KeCANR_b_ComTxMsg_BCM_FD_7_FD11_Enbld
          KeCANR_b_ComTxMsg_BCM_FD_9_FD11_Enbld
          KeCANR_b_ComTxMsg_BRAKE_FD_2_FD11_Enbld
          KeCANR_b_ComTxMsg_BRAKE_FD_4_FD11_Enbld
          KeCANR_b_ComTxMsg_ENGINE_FD_2_FD11_Enbld
          KeCANR_b_ComTxMsg_EVCU_CHADEMO_STATUS1_FD11_Enbld
          KeCANR_b_ComTxMsg_EVCU_ISO15118_STATUS1_FD11_Enbld
          KeCANR_b_ComTxMsg_GLIWA_MCPA_TX_FD11_Enbld
          KeCANR_b_ComTxMsg_GLIWA_MCPB_TX_FD11_Enbld
          KeCANR_b_ComTxMsg_GLIWA_SGCP_TX_FD11_Enbld
          KeCANR_b_ComTxMsg_GLIWA_T1_TX_FD11_Enbld
          KeCANR_b_ComTxMsg_HYBRID_CHARGING_COMMAND_FD11_Enbld
          KeCANR_b_ComTxMsg_HYBRID_CHARGING_STATUS_FD11_Enbld
          KeCANR_b_ComTxMsg_HYBRID_DISPLAY2_FD11_Enbld
          KeCANR_b_ComTxMsg_HYBRID_POWERTRAIN1_FD11_Enbld
          KeCANR_b_ComTxMsg_HYBRID_SYSTEM_EPT1_FD11_Enbld
          KeCANR_b_ComTxMsg_IMPACT_INFO_FD11_Enbld
          KeCANR_b_ComTxMsg_IPC_FD_1_FD11_Enbld
          KeCANR_b_ComTxMsg_MCPA_DATA2_FD11_Enbld
          KeCANR_b_ComTxMsg_MCPA_STATUS_FD11_Enbld
          KeCANR_b_ComTxMsg_MCPB_DATA2_FD11_Enbld
          KeCANR_b_ComTxMsg_MCPB_STATUS_FD11_Enbld
          KeCANR_b_ComTxMsg_PDC_INFO_FD_EVCU2_FD11_Enbld
          KeCANR_b_ComTxMsg_PT_ENERGY_FD_1_FD11_Enbld
          KeCANR_b_ComTxMsg_PT_SYSTEM_FD_1_FD11_Enbld
          KeCANR_b_ComTxMsg_RPF_FD_3_FD11_Enbld
          KeCANR_b_ComTxMsg_SGCP_DATA2_FD11_Enbld
          KeCANR_b_ComTxMsg_SGCP_STATUS_FD11_Enbld
          KeCANR_b_ComTxMsg_SYNCHRO_DC_GLOBAL_FD11_Enbld
          KeCANR_b_ComTxMsg_TELEMATIC_FD_1_FD11_Enbld
          KeCANR_b_ComTxMsg_TRANSM_FD_2_FD11_Enbld
          KeCANR_b_ComTxMsg_VDCM_OBCM_FD11_Enbld
          KeCANR_b_ComTxMsg_VDCM_OBCM2_FD11_Enbld
          KeCANR_b_ComTxMsg_VDCM_PWT3_FD11_Enbld
          KeCANR_b_ComTxMsg_VIN_FD11_Enbld
          KeCANR_b_ComTxMsg_CFG_DATA_CODE_REQUEST_FD11_Enbld
package /STLASWCs/ComSwCpts/ComDataDefinition/ComConstSpec
  223 x constant specification:
    COMRX_APM2InterlockSts_APM2_VDCM_FD11_Init: value-spec=Value:0
    COMRX_APM2_BoostSwitchSts_APM2_VDCM_FD11_Init: value-spec=Value:0
    COMRX_APM2_ContactorFault_APM2_VDCM_FD11_Init: value-spec=Value:2
    COMRX_APM2_DcChEnaSts_Fdbk_APM2_VDCM_FD11_Init: value-spec=Value:0
    COMRX_APM2_DeratRsnSts_APM2_VDCM_FD11_Init: value-spec=Value:0
    COMRX_APM2_DisChargedSts_Fdbk_APM2_VDCM_FD11_Init: value-spec=Value:0
    COMRX_APM2_ErrorWord_APM2_VDCM_FD11_Init: value-spec=Value:0
    COMRX_APM2_FaultSts_APM2_VDCM_FD11_Init: value-spec=Value:0
    COMRX_APM2_HVChrgBusCurrent_APM2_VDCM_FD11_Init: value-spec=Value:8150
    COMRX_APM2_HVChrgBusVoltage_APM2_VDCM_FD11_Init: value-spec=Value:0
    COMRX_APM2_IInpMaxCnvr_APM2_VDCM_FD11_Init: value-spec=Value:8150
    COMRX_APM2_K6_WldgDtnSts_APM2_VDCM_FD11_Init: value-spec=Value:0
    COMRX_APM2_K7_WldgDtnSts_APM2_VDCM_FD11_Init: value-spec=Value:0
    COMRX_APM2_ModeSts_Fbk_APM2_VDCM_FD11_Init: value-spec=Value:0
    COMRX_APM2_RecoveryAction_APM2_VDCM_FD11_Init: value-spec=Value:0
    COMRX_APM2_Service_Lamp_Request_APM2_VDCM_FD11_Init: value-spec=Value:0
    COMRX_APM2_TempFET1_APM2_VDCM_FD11_Init: value-spec=Value:60
    COMRX_APM2_TempFET2_APM2_VDCM_FD11_Init: value-spec=Value:60
    COMRX_APM2_TempInlet_APM2_VDCM_FD11_Init: value-spec=Value:0
    COMRX_APM2_TempInt_APM2_VDCM_FD11_Init: value-spec=Value:60
    COMRX_APM2_TempL1_APM2_VDCM_FD11_Init: value-spec=Value:60
    COMRX_APM2_TempL2_APM2_VDCM_FD11_Init: value-spec=Value:60
    COMRX_APM2_TempMargin_APM2_VDCM_FD11_Init: value-spec=Value:64
    COMRX_BMS_HV_High_Temp_Thrsh_BATTERY_HV2_FD11_Init: value-spec=Value:0
    COMRX_BMS_HV_Low_Temp_Thrsh_BATTERY_HV2_FD11_Init: value-spec=Value:0
    COMRX_BMS_HV_SOC_AccuracySts_BATTERY_HV2_FD11_Init: value-spec=Value:0
    COMRX_BMS_HV_SOC_Max_BATTERY_HV2_FD11_Init: value-spec=Value:50
    COMRX_BMS_HV_SOC_Min_BATTERY_HV2_FD11_Init: value-spec=Value:50
    COMRX_CRC_FOTA_MASTER_FOTA_MASTER_FD11_Init: value-spec=Value:0
    COMRX_CRC_IDCM_OBD_DTC_IDCM_OBD_DTC_FD11_Init: value-spec=Value:0
    COMRX_CdM_Avail_output_current_EXT_IDCM_CHADEMO_STATUS1_FD11_Init: value-spec=Value:0
    COMRX_CdM_Charger_connector_lock_IDCM_CHADEMO_STATUS1_FD11_Init: value-spec=Value:0
    COMRX_CdM_ExtFun_Thres_Volt_IDCM_CHADEMO_STATUS1_FD11_Init: value-spec=Value:0
    COMRX_CurrEVSE_APM2_VDCM_FD11_Init: value-spec=Value:8150
    COMRX_EVSE_BatteryCompatibilty_IDCM_CHADEMO_STATUS1_FD11_Init: value-spec=Value:0
    COMRX_EVSE_CHAdeMOProtocol_IDCM_CHADEMO_STATUS1_FD11_Init: value-spec=Value:0
    COMRX_EVSE_ChargingSystemError_IDCM_CHADEMO_STATUS1_FD11_Init: value-spec=Value:0
    COMRX_EVSE_EnergizingState_IDCM_CHADEMO_STATUS1_FD11_Init: value-spec=Value:0
    COMRX_EVSE_RemainingMin_IDCM_CHADEMO_STATUS1_FD11_Init: value-spec=Value:0
    COMRX_EVSE_RemainingSec_IDCM_CHADEMO_STATUS1_FD11_Init: value-spec=Value:0
    COMRX_EVSE_ThrshldVoltage_IDCM_CHADEMO_STATUS1_FD11_Init: value-spec=Value:0
    COMRX_FOTA_Status_FOTA_MASTER_FD11_Init: value-spec=Value:0
    COMRX_HEV_OnRq_BPCM_BATTERY_HV2_FD11_Init: value-spec=Value:0
    COMRX_HVBatCell_Voltage_High_Thrsh_BATTERY_HV2_FD11_Init: value-spec=Value:0
    COMRX_HVBatCell_Voltage_Low_Thrsh_BATTERY_HV2_FD11_Init: value-spec=Value:0
    COMRX_HVBatSleepTime_HVBATTERY_THERMAL_FD11_Init: value-spec=Value:0
    COMRX_HVBatteryMILRequest_HVBATTERY2_FD11_Init: value-spec=Value:0
    COMRX_HVBattery_RealTimeClockV_HVBATTERY5_FD11_Init: value-spec=Value:0
    COMRX_HVBattery_RealTimeClock_HVBATTERY5_FD11_Init: value-spec=Value:0
    COMRX_IDCM_CAL_ID_IDCM_OBD_DTC_FD11_Init: value-spec=Value:0
    COMRX_IDCM_CAL_VN_IDCM_OBD_DTC_FD11_Init: value-spec=Value:0
    COMRX_IDCM_DTC_Idx{1..8}_IDCM_OBD_DTC_FD11_Init: value-spec=Value:0
    COMRX_IDCM_DTC_Stat{1..8}_IDCM_OBD_DTC_FD11_Init: value-spec=Value:0
    COMRX_IDCM_RBM_Idx_IDCM_OBD_DTC_FD11_Init: value-spec=Value:0
    COMRX_IDCM_RBM_Stat_IDCM_OBD_DTC_FD11_Init: value-spec=Value:0
    COMRX_IDCM_Wakeup_HCP_LV_CHARGER1_FD11_Init: value-spec=Value:0
    COMRX_ImpactHardwireV_BATTERY_HV_FD11_Init: value-spec=Value:0
    COMRX_ImpactHardwire_BATTERY_HV_FD11_Init: value-spec=Value:0
    COMRX_MessageCounter_FOTA_MASTER_FOTA_MASTER_FD11_Init: value-spec=Value:0
    COMRX_MessageCounter_IDCM_OBD_DTC_IDCM_OBD_DTC_FD11_Init: value-spec=Value:0
    COMRX_N_PDU_343_GLIWA_T1_RX_FD11_Init: value-spec=Value:0
    COMRX_N_PDU_7E_GLIWA_MCPA_RX_FD11_Init: value-spec=Value:0
    COMRX_N_PDU_7F_GLIWA_MCPB_RX_FD11_Init: value-spec=Value:0
    COMRX_N_PDU_81_GLIWA_SGCP_RX_FD11_Init: value-spec=Value:0
    COMRX_OBC_Temp{1..4}_DUALCHARGER_THERMAL_FD11_Init: value-spec=Value:0
    COMRX_PwrEff_APM2_VDCM_FD11_Init: value-spec=Value:0
    COMRX_VltgChgEVSE_APM2_VDCM_FD11_Init: value-spec=Value:0
    COMRX_VltgChgInt_APM2_VDCM_FD11_Init: value-spec=Value:0
    COMRX_Warning_PackTempHigh_HVBATTERY_RM_CHARGING1_FD11_Init: value-spec=Value:0
    COMTX_BattVoltDeviationErr_EVCU_CHADEMO_STATUS1_FD11_Init: value-spec=0
    COMTX_Battery_Volt_1_BCM_FD_3_FD11_Init: value-spec=0
    COMTX_CHAdeMOProtocol_EVCU_CHADEMO_STATUS1_FD11_Init: value-spec=0
    COMTX_CRC_HYBRID_DISPLAY2_HYBRID_DISPLAY2_FD11_Init: value-spec=0
    COMTX_CRC_HYBRID_SYSTEM_EPT1_HYBRID_SYSTEM_EPT1_FD11_Init: value-spec=0
    COMTX_CRC_MCPA_STATUS_MCPA_STATUS_FD11_Init: value-spec=0
    COMTX_CRC_MCPB_STATUS_MCPB_STATUS_FD11_Init: value-spec=0
    COMTX_CdM_Chrg_current_req_ext_EVCU_CHADEMO_STATUS1_FD11_Init: value-spec=0
    COMTX_CdM_ExtFun_Min_Batt_Volt_EVCU_CHADEMO_STATUS1_FD11_Init: value-spec=0
    COMTX_CdM_ExtFun_Veh_Dyn_Control_Comp_EVCU_CHADEMO_STATUS1_FD11_Init: value-spec=0
    COMTX_CdM_ExtFun_Veh_HC_Control_Comp_EVCU_CHADEMO_STATUS1_FD11_Init: value-spec=0
    COMTX_CdM_Remained_batt_capacity_EVCU_CHADEMO_STATUS1_FD11_Init: value-spec=0
    COMTX_ChargedCurrentMin_EVCU_CHADEMO_STATUS1_FD11_Init: value-spec=0
    COMTX_ChargedReferenceConstant_EVCU_CHADEMO_STATUS1_FD11_Init: value-spec=0
    COMTX_ClrLgsDiagInfo_VDCM_PWT3_FD11_Init: value-spec=0
    COMTX_CmdIgnSts_BCM_FD_10_FD11_Init: value-spec=0
    COMTX_CurrentCanNMState_FD03_EVCU2_PDC_INFO_FD_EVCU2_FD11_Init: value-spec=0
    COMTX_CurrentCanNMState_FD05_EVCU2_PDC_INFO_FD_EVCU2_FD11_Init: value-spec=0
    COMTX_CurrentCanNMState_FD11_EVCU2_PDC_INFO_FD_EVCU2_FD11_Init: value-spec=0
    COMTX_CurrentCanNMState_FD16_EVCU2_PDC_INFO_FD_EVCU2_FD11_Init: value-spec=0
    COMTX_CurrentFailSts_FD03_EVCU2_PDC_INFO_FD_EVCU2_FD11_Init: value-spec=0
    COMTX_CurrentFailSts_FD05_EVCU2_PDC_INFO_FD_EVCU2_FD11_Init: value-spec=0
    COMTX_CurrentFailSts_FD11_EVCU2_PDC_INFO_FD_EVCU2_FD11_Init: value-spec=0
    COMTX_CurrentFailSts_FD16_EVCU2_PDC_INFO_FD_EVCU2_FD11_Init: value-spec=0
    COMTX_DES_FD03_EVCU2_PDC_INFO_FD_EVCU2_FD11_Init: value-spec=0
    COMTX_DES_FD05_EVCU2_PDC_INFO_FD_EVCU2_FD11_Init: value-spec=0
    COMTX_DES_FD11_EVCU2_PDC_INFO_FD_EVCU2_FD11_Init: value-spec=0
    COMTX_DES_FD16_EVCU2_PDC_INFO_FD_EVCU2_FD11_Init: value-spec=0
    COMTX_DischargingSysStatus_HYBRID_DISPLAY2_FD11_Init: value-spec=0
    COMTX_DisplaySOC_EVCU_CHADEMO_STATUS1_FD11_Init: value-spec=0
    COMTX_DriveReady_PT_PT_SYSTEM_FD_1_FD11_Init: value-spec=0
    COMTX_EOL_FD03_EVCU2_PDC_INFO_FD_EVCU2_FD11_Init: value-spec=0
    COMTX_EOL_FD05_EVCU2_PDC_INFO_FD_EVCU2_FD11_Init: value-spec=0
    COMTX_EOL_FD11_EVCU2_PDC_INFO_FD_EVCU2_FD11_Init: value-spec=0
    COMTX_EOL_FD16_EVCU2_PDC_INFO_FD_EVCU2_FD11_Init: value-spec=0
    COMTX_EPBSts_BRAKE_FD_4_FD11_Init: value-spec=0
    COMTX_EVCU_CP3Cmd_EVCU_CHADEMO_STATUS1_FD11_Init: value-spec=0
    COMTX_EVContactorSts_EVCU_CHADEMO_STATUS1_FD11_Init: value-spec=0
    COMTX_EngineSpeed_W_ENGINE_FD_2_FD11_Init: value-spec=0
    COMTX_ExternalTemperatureC_BCM_FD_10_FD11_Init: value-spec=511
    COMTX_ExternalTemperature_BCM_FD_9_FD11_Init: value-spec=0
    COMTX_GPS_Date_Day_TELEMATIC_FD_1_FD11_Init: value-spec=255
    COMTX_GPS_Date_Month_TELEMATIC_FD_1_FD11_Init: value-spec=255
    COMTX_GPS_Date_Year_TELEMATIC_FD_1_FD11_Init: value-spec=65535
    COMTX_GPS_UTC_Hour_TELEMATIC_FD_1_FD11_Init: value-spec=255
    COMTX_GPS_UTC_Minute_TELEMATIC_FD_1_FD11_Init: value-spec=255
    COMTX_GPS_UTC_Second_TELEMATIC_FD_1_FD11_Init: value-spec=65535
    COMTX_GearEngagedForDisplay_PT_PT_SYSTEM_FD_1_FD11_Init: value-spec=0
    COMTX_GearEngagedForDisplay_TRANSM_FD_2_FD11_Init: value-spec=31
    COMTX_GearEngaged_PT_PT_SYSTEM_FD_1_FD11_Init: value-spec=0
    COMTX_GenericFailSts_FD03_EVCU2_PDC_INFO_FD_EVCU2_FD11_Init: value-spec=0
    COMTX_GenericFailSts_FD05_EVCU2_PDC_INFO_FD_EVCU2_FD11_Init: value-spec=0
    COMTX_GenericFailSts_FD11_EVCU2_PDC_INFO_FD_EVCU2_FD11_Init: value-spec=0
    COMTX_GenericFailSts_FD16_EVCU2_PDC_INFO_FD_EVCU2_FD11_Init: value-spec=0
    COMTX_HCP_ShutdownCommand_HYBRID_SYSTEM_EPT1_FD11_Init: value-spec=0
    COMTX_HVCMS_BulkChargingComplete_VDCM_OBCM_FD11_Init: value-spec=0
    COMTX_HVCMS_ChargingComplete_VDCM_OBCM_FD11_Init: value-spec=0
    COMTX_HVCMS_EVEnergyCapacity_VDCM_OBCM_FD11_Init: value-spec=0
    COMTX_HVCMS_EVEnergyRequest_VDCM_OBCM_FD11_Init: value-spec=131071
    COMTX_HVCMS_EVErrorCode_VDCM_OBCM_FD11_Init: value-spec=0
    COMTX_HVCMS_EVMax_I_Limit_VDCM_OBCM_FD11_Init: value-spec=0
    COMTX_HVCMS_EVMax_P_Limit_VDCM_OBCM_FD11_Init: value-spec=0
    COMTX_HVCMS_EVMax_V_Limit_VDCM_OBCM_FD11_Init: value-spec=0
    COMTX_HVCMS_EVRESSConditioning_VDCM_OBCM_FD11_Init: value-spec=0
    COMTX_HVCMS_EVRESS_SOC_VDCM_OBCM_FD11_Init: value-spec=0
    COMTX_HVCMS_EVReady_VDCM_OBCM_FD11_Init: value-spec=0
    COMTX_HVCMS_EVTargetCurrent_VDCM_OBCM_FD11_Init: value-spec=0
    COMTX_HVCMS_EVTargetVoltage_VDCM_OBCM_FD11_Init: value-spec=0
    COMTX_HVCMS_Protocol_Entry{1..3}_VDCM_OBCM_FD11_Init: value-spec=0
    COMTX_HVCMS_ReadyToChargeState_VDCM_OBCM_FD11_Init: value-spec=0
    COMTX_HVCMS_RemaningTimeToBulkSOC_VDCM_OBCM_FD11_Init: value-spec=0
    COMTX_HVCMS_RemaningTimeToFullSOC_VDCM_OBCM_FD11_Init: value-spec=0
    COMTX_HVCMS_SelectedEnergyTransferType_VDCM_OBCM_FD11_Init: value-spec=0
    COMTX_HVCMS_SelectedPaymentOptn_VDCM_OBCM_FD11_Init: value-spec=0
    COMTX_HVCMS_SelectedServiceId_VDCM_OBCM_FD11_Init: value-spec=0
    COMTX_HVCMS_ServiceCategory_VDCM_OBCM_FD11_Init: value-spec=0
    COMTX_HVCMS_ServiceScope_VDCM_OBCM_FD11_Init: value-spec=0
    COMTX_HybridDriveModeSts_HYBRID_SYSTEM_EPT1_FD11_Init: value-spec=0
    COMTX_IMPACTCommand_IMPACT_INFO_FD11_Init: value-spec=0
    COMTX_IMPACTConfirm_IMPACT_INFO_FD11_Init: value-spec=1
    COMTX_IgnitionOnCounter_BCM_FD_7_FD11_Init: value-spec=0
    COMTX_LID_Status_120V_Socket_A_HYBRID_DISPLAY2_FD11_Init: value-spec=0
    COMTX_LID_Status_120V_Socket_B_HYBRID_DISPLAY2_FD11_Init: value-spec=0
    COMTX_LID_Status_240V_Socket_HYBRID_DISPLAY2_FD11_Init: value-spec=0
    COMTX_LOC_DiagEnable_ePT_HYBRID_SYSTEM_EPT1_FD11_Init: value-spec=0
    COMTX_MCPA_DC_Current_P_MCPA_STATUS_FD11_Init: value-spec=16384
    COMTX_MCPA_Temp_MCPA_DATA2_FD11_Init: value-spec=40
    COMTX_MCPB_DC_Current_P_MCPB_STATUS_FD11_Init: value-spec=16384
    COMTX_MCPB_Temp_MCPB_DATA2_FD11_Init: value-spec=40
    COMTX_MC_HYBRID_DISPLAY2_HYBRID_DISPLAY2_FD11_Init: value-spec=0
    COMTX_MC_MCPA_STATUS_MCPA_STATUS_FD11_Init: value-spec=0
    COMTX_MC_MCPB_STATUS_MCPB_STATUS_FD11_Init: value-spec=0
    COMTX_Max_Allwd_AC_Output_Current_L1_HYBRID_DISPLAY2_FD11_Init: value-spec=0
    COMTX_Max_Allwd_AC_Output_Voltage_L1_HYBRID_DISPLAY2_FD11_Init: value-spec=0
    COMTX_MessageCounter_HYBRID_SYSTEM_EPT1_HYBRID_SYSTEM_EPT1_FD11_Init: value-spec=0
    COMTX_MinBatteryPackVoltage_EVCU_CHADEMO_STATUS1_FD11_Init: value-spec=0
    COMTX_N_PDU_342_GLIWA_T1_TX_FD11_Init: value-spec=0
    COMTX_N_PDU_7B_GLIWA_MCPA_TX_FD11_Init: value-spec=0
    COMTX_N_PDU_7C_GLIWA_MCPB_TX_FD11_Init: value-spec=0
    COMTX_N_PDU_86_GLIWA_SGCP_TX_FD11_Init: value-spec=0
    COMTX_OBCM_OutVoltageSyncTgt_VDCM_OBCM_FD11_Init: value-spec=0
    COMTX_OperationalModeSts_BCM_FD_2_FD11_Init: value-spec=0
    COMTX_PerWakeUp_Diag_HYBRID_SYSTEM_EPT1_FD11_Init: value-spec=0
    COMTX_PowertrainPrplsnActv_ENGINE_FD_2_FD11_Init: value-spec=0
    COMTX_PowertrainPrplsnActv_PT_PT_SYSTEM_FD_1_FD11_Init: value-spec=0
    COMTX_PreviousCanNMState_FD03_EVCU2_PDC_INFO_FD_EVCU2_FD11_Init: value-spec=0
    COMTX_PreviousCanNMState_FD05_EVCU2_PDC_INFO_FD_EVCU2_FD11_Init: value-spec=0
    COMTX_PreviousCanNMState_FD11_EVCU2_PDC_INFO_FD_EVCU2_FD11_Init: value-spec=0
    COMTX_PreviousCanNMState_FD16_EVCU2_PDC_INFO_FD_EVCU2_FD11_Init: value-spec=0
    COMTX_PropulsionSystemActive_10B_HYBRID_SYSTEM_EPT1_FD11_Init: value-spec=0
    COMTX_QualifyDriveCycle_SYNCHRO_DC_GLOBAL_FD11_Init: value-spec=0
    COMTX_SGCP_DC_Current_P_SGCP_STATUS_FD11_Init: value-spec=16384
    COMTX_SGCP_Temp_SGCP_DATA2_FD11_Init: value-spec=0
    COMTX_StayActiveSource_FD03_EVCU2_PDC_INFO_FD_EVCU2_FD11_Init: value-spec=0
    COMTX_StayActiveSource_FD05_EVCU2_PDC_INFO_FD_EVCU2_FD11_Init: value-spec=0
    COMTX_StayActiveSource_FD11_EVCU2_PDC_INFO_FD_EVCU2_FD11_Init: value-spec=0
    COMTX_StayActiveSource_FD16_EVCU2_PDC_INFO_FD_EVCU2_FD11_Init: value-spec=0
    COMTX_StopReqBeforeCharge_EVCU_CHADEMO_STATUS1_FD11_Init: value-spec=0
    COMTX_TotalBatteryCapacity_EVCU_CHADEMO_STATUS1_FD11_Init: value-spec=0
    COMTX_TotalOdometer_IPC_FD_1_FD11_Init: value-spec=0
    COMTX_V2X_HVCMS_SlctdEnergyTransfType_VDCM_OBCM_FD11_Init: value-spec=0
    COMTX_VDCM_BattBulkSOC_VDCM_OBCM_FD11_Init: value-spec=0
    COMTX_VDCM_ContractAuthenticationID_VDCM_OBCM_FD11_Init: value-spec=0
    COMTX_VDCM_GenChallenge_VDCM_OBCM_FD11_Init: value-spec=0
    COMTX_VDCM_OBCDischCurrentLim_VDCM_OBCM_FD11_Init: value-spec=815
    COMTX_VDCM_TypeCNegotiationSts_VDCM_OBCM_FD11_Init: value-spec=0
    COMTX_VIN_DATA_VIN_FD11_Init: value-spec=0
    COMTX_VIN_MSG_VIN_FD11_Init: value-spec=3
    COMTX_VehicleDriveSts_EVCU_CHADEMO_STATUS1_FD11_Init: value-spec=0
    COMTX_VehicleSpeedVSOSig_BRAKE_FD_2_FD11_Init: value-spec=0
    COMTX_WU_Timer_Value_HYBRID_SYSTEM_EPT1_FD11_Init: value-spec=0
    COMTX_WakeupSource_FD03_EVCU2_PDC_INFO_FD_EVCU2_FD11_Init: value-spec=0
    COMTX_WakeupSource_FD05_EVCU2_PDC_INFO_FD_EVCU2_FD11_Init: value-spec=0
    COMTX_WakeupSource_FD11_EVCU2_PDC_INFO_FD_EVCU2_FD11_Init: value-spec=0
    COMTX_WakeupSource_FD16_EVCU2_PDC_INFO_FD_EVCU2_FD11_Init: value-spec=0
package /STLASWCs/ComSwCpts/ComDataDefinition/ComImpDataType
  223 x impl type, all with category=TYPE_REFERENCE:
    IDTSAPM2InterlockSts_APM2_VDCM_FD11: implementation-data-type=uint8
    IDTSAPM2_BoostSwitchSts_APM2_VDCM_FD11: implementation-data-type=boolean
    IDTSAPM2_ContactorFault_APM2_VDCM_FD11: implementation-data-type=uint8, invalid-value=Value:3
    IDTSAPM2_DcChEnaSts_Fdbk_APM2_VDCM_FD11: implementation-data-type=boolean
    IDTSAPM2_DeratRsnSts_APM2_VDCM_FD11: implementation-data-type=uint8
    IDTSAPM2_DisChargedSts_Fdbk_APM2_VDCM_FD11: implementation-data-type=boolean
    IDTSAPM2_ErrorWord_APM2_VDCM_FD11: implementation-data-type=uint32
    IDTSAPM2_FaultSts_APM2_VDCM_FD11: implementation-data-type=uint8, invalid-value=Value:3
    IDTSAPM2_HVChrgBusCurrent_APM2_VDCM_FD11: implementation-data-type=uint16
    IDTSAPM2_HVChrgBusVoltage_APM2_VDCM_FD11: implementation-data-type=uint16
    IDTSAPM2_IInpMaxCnvr_APM2_VDCM_FD11: implementation-data-type=uint16, invalid-value=Value:16383
    IDTSAPM2_K6_WldgDtnSts_APM2_VDCM_FD11: implementation-data-type=uint8
    IDTSAPM2_K7_WldgDtnSts_APM2_VDCM_FD11: implementation-data-type=uint8
    IDTSAPM2_ModeSts_Fbk_APM2_VDCM_FD11: implementation-data-type=uint8, invalid-value=Value:15
    IDTSAPM2_RecoveryAction_APM2_VDCM_FD11: implementation-data-type=uint8, invalid-value=Value:7
    IDTSAPM2_Service_Lamp_Request_APM2_VDCM_FD11: implementation-data-type=boolean
    IDTSAPM2_TempFET1_APM2_VDCM_FD11: implementation-data-type=uint8
    IDTSAPM2_TempFET2_APM2_VDCM_FD11: implementation-data-type=uint8
    IDTSAPM2_TempInlet_APM2_VDCM_FD11: implementation-data-type=uint16, invalid-value=Value:2047
    IDTSAPM2_TempInt_APM2_VDCM_FD11: implementation-data-type=uint8
    IDTSAPM2_TempL1_APM2_VDCM_FD11: implementation-data-type=uint8
    IDTSAPM2_TempL2_APM2_VDCM_FD11: implementation-data-type=uint8
    IDTSAPM2_TempMargin_APM2_VDCM_FD11: implementation-data-type=uint8
    IDTSBMS_HV_High_Temp_Thrsh_BATTERY_HV2_FD11: implementation-data-type=uint16
    IDTSBMS_HV_Low_Temp_Thrsh_BATTERY_HV2_FD11: implementation-data-type=uint16
    IDTSBMS_HV_SOC_AccuracySts_BATTERY_HV2_FD11: implementation-data-type=uint8, invalid-value=Value:3
    IDTSBMS_HV_SOC_Max_BATTERY_HV2_FD11: implementation-data-type=uint8
    IDTSBMS_HV_SOC_Min_BATTERY_HV2_FD11: implementation-data-type=uint8
    IDTSBattVoltDeviationErr_EVCU_CHADEMO_STATUS1_FD11: implementation-data-type=boolean
    IDTSBattery_Volt_1_BCM_FD_3_FD11: implementation-data-type=uint16, invalid-value=Value:511
    IDTSCHAdeMOProtocol_EVCU_CHADEMO_STATUS1_FD11: implementation-data-type=uint8, invalid-value=Value:7
    IDTSCRC_FOTA_MASTER_FOTA_MASTER_FD11: implementation-data-type=uint8
    IDTSCRC_HYBRID_DISPLAY2_HYBRID_DISPLAY2_FD11: implementation-data-type=uint8
    IDTSCRC_HYBRID_SYSTEM_EPT1_HYBRID_SYSTEM_EPT1_FD11: implementation-data-type=uint8
    IDTSCRC_IDCM_OBD_DTC_IDCM_OBD_DTC_FD11: implementation-data-type=uint8
    IDTSCRC_MCPA_STATUS_MCPA_STATUS_FD11: implementation-data-type=uint8
    IDTSCRC_MCPB_STATUS_MCPB_STATUS_FD11: implementation-data-type=uint8
    IDTSCdM_Avail_output_current_EXT_IDCM_CHADEMO_STATUS1_FD11: implementation-data-type=uint16
    IDTSCdM_Charger_connector_lock_IDCM_CHADEMO_STATUS1_FD11: implementation-data-type=boolean
    IDTSCdM_Chrg_current_req_ext_EVCU_CHADEMO_STATUS1_FD11: implementation-data-type=uint16
    IDTSCdM_ExtFun_Min_Batt_Volt_EVCU_CHADEMO_STATUS1_FD11: implementation-data-type=uint16, invalid-value=Value:2047
    IDTSCdM_ExtFun_Thres_Volt_IDCM_CHADEMO_STATUS1_FD11: implementation-data-type=uint16
    IDTSCdM_ExtFun_Veh_Dyn_Control_Comp_EVCU_CHADEMO_STATUS1_FD11: implementation-data-type=boolean
    IDTSCdM_ExtFun_Veh_HC_Control_Comp_EVCU_CHADEMO_STATUS1_FD11: implementation-data-type=boolean
    IDTSCdM_Remained_batt_capacity_EVCU_CHADEMO_STATUS1_FD11: implementation-data-type=uint8, invalid-value=Value:255
    IDTSChargedCurrentMin_EVCU_CHADEMO_STATUS1_FD11: implementation-data-type=uint8
    IDTSChargedReferenceConstant_EVCU_CHADEMO_STATUS1_FD11: implementation-data-type=uint8
    IDTSClrLgsDiagInfo_VDCM_PWT3_FD11: implementation-data-type=boolean
    IDTSCmdIgnSts_BCM_FD_10_FD11: implementation-data-type=uint8, invalid-value=Value:7
    IDTSCurrEVSE_APM2_VDCM_FD11: implementation-data-type=uint16, invalid-value=Value:16383
    IDTSCurrentCanNMState_FD03_EVCU2_PDC_INFO_FD_EVCU2_FD11: implementation-data-type=uint8
    IDTSCurrentCanNMState_FD05_EVCU2_PDC_INFO_FD_EVCU2_FD11: implementation-data-type=uint8
    IDTSCurrentCanNMState_FD11_EVCU2_PDC_INFO_FD_EVCU2_FD11: implementation-data-type=uint8
    IDTSCurrentCanNMState_FD16_EVCU2_PDC_INFO_FD_EVCU2_FD11: implementation-data-type=uint8
    IDTSCurrentFailSts_FD03_EVCU2_PDC_INFO_FD_EVCU2_FD11: implementation-data-type=boolean
    IDTSCurrentFailSts_FD05_EVCU2_PDC_INFO_FD_EVCU2_FD11: implementation-data-type=boolean
    IDTSCurrentFailSts_FD11_EVCU2_PDC_INFO_FD_EVCU2_FD11: implementation-data-type=boolean
    IDTSCurrentFailSts_FD16_EVCU2_PDC_INFO_FD_EVCU2_FD11: implementation-data-type=boolean
    IDTSDES_FD03_EVCU2_PDC_INFO_FD_EVCU2_FD11: implementation-data-type=uint8
    IDTSDES_FD05_EVCU2_PDC_INFO_FD_EVCU2_FD11: implementation-data-type=uint8
    IDTSDES_FD11_EVCU2_PDC_INFO_FD_EVCU2_FD11: implementation-data-type=uint8
    IDTSDES_FD16_EVCU2_PDC_INFO_FD_EVCU2_FD11: implementation-data-type=uint8
    IDTSDischargingSysStatus_HYBRID_DISPLAY2_FD11: implementation-data-type=uint8, invalid-value=Value:3
    IDTSDisplaySOC_EVCU_CHADEMO_STATUS1_FD11: implementation-data-type=uint8
    IDTSDriveReady_PT_PT_SYSTEM_FD_1_FD11: implementation-data-type=boolean
    IDTSEOL_FD03_EVCU2_PDC_INFO_FD_EVCU2_FD11: implementation-data-type=boolean
    IDTSEOL_FD05_EVCU2_PDC_INFO_FD_EVCU2_FD11: implementation-data-type=boolean
    IDTSEOL_FD11_EVCU2_PDC_INFO_FD_EVCU2_FD11: implementation-data-type=boolean
    IDTSEOL_FD16_EVCU2_PDC_INFO_FD_EVCU2_FD11: implementation-data-type=boolean
    IDTSEPBSts_BRAKE_FD_4_FD11: implementation-data-type=uint8, invalid-value=Value:15
    IDTSEVCU_CP3Cmd_EVCU_CHADEMO_STATUS1_FD11: implementation-data-type=boolean
    IDTSEVContactorSts_EVCU_CHADEMO_STATUS1_FD11: implementation-data-type=boolean
    IDTSEVSE_BatteryCompatibilty_IDCM_CHADEMO_STATUS1_FD11: implementation-data-type=boolean
    IDTSEVSE_CHAdeMOProtocol_IDCM_CHADEMO_STATUS1_FD11: implementation-data-type=uint8, invalid-value=Value:7
    IDTSEVSE_ChargingSystemError_IDCM_CHADEMO_STATUS1_FD11: implementation-data-type=boolean
    IDTSEVSE_EnergizingState_IDCM_CHADEMO_STATUS1_FD11: implementation-data-type=boolean
    IDTSEVSE_RemainingMin_IDCM_CHADEMO_STATUS1_FD11: implementation-data-type=uint8
    IDTSEVSE_RemainingSec_IDCM_CHADEMO_STATUS1_FD11: implementation-data-type=uint8
    IDTSEVSE_ThrshldVoltage_IDCM_CHADEMO_STATUS1_FD11: implementation-data-type=uint16
    IDTSEngineSpeed_W_ENGINE_FD_2_FD11: implementation-data-type=uint16, invalid-value=Value:16383
    IDTSExternalTemperatureC_BCM_FD_10_FD11: implementation-data-type=uint16, invalid-value=Value:511
    IDTSExternalTemperature_BCM_FD_9_FD11: implementation-data-type=uint16, invalid-value=Value:511
    IDTSFOTA_Status_FOTA_MASTER_FD11: implementation-data-type=uint8
    IDTSGPS_Date_Day_TELEMATIC_FD_1_FD11: implementation-data-type=uint8, invalid-value=Value:255
    IDTSGPS_Date_Month_TELEMATIC_FD_1_FD11: implementation-data-type=uint8, invalid-value=Value:255
    IDTSGPS_Date_Year_TELEMATIC_FD_1_FD11: implementation-data-type=uint16, invalid-value=Value:65535
    IDTSGPS_UTC_Hour_TELEMATIC_FD_1_FD11: implementation-data-type=uint8, invalid-value=Value:255
    IDTSGPS_UTC_Minute_TELEMATIC_FD_1_FD11: implementation-data-type=uint8, invalid-value=Value:255
    IDTSGPS_UTC_Second_TELEMATIC_FD_1_FD11: implementation-data-type=uint16, invalid-value=Value:65535
    IDTSGearEngagedForDisplay_PT_PT_SYSTEM_FD_1_FD11: implementation-data-type=uint8, invalid-value=Value:31
    IDTSGearEngagedForDisplay_TRANSM_FD_2_FD11: implementation-data-type=uint8, invalid-value=Value:31
    IDTSGearEngaged_PT_PT_SYSTEM_FD_1_FD11: implementation-data-type=uint8, invalid-value=Value:15
    IDTSGenericFailSts_FD03_EVCU2_PDC_INFO_FD_EVCU2_FD11: implementation-data-type=boolean
    IDTSGenericFailSts_FD05_EVCU2_PDC_INFO_FD_EVCU2_FD11: implementation-data-type=boolean
    IDTSGenericFailSts_FD11_EVCU2_PDC_INFO_FD_EVCU2_FD11: implementation-data-type=boolean
    IDTSGenericFailSts_FD16_EVCU2_PDC_INFO_FD_EVCU2_FD11: implementation-data-type=boolean
    IDTSHCP_ShutdownCommand_HYBRID_SYSTEM_EPT1_FD11: implementation-data-type=uint8, invalid-value=Value:7
    IDTSHEV_OnRq_BPCM_BATTERY_HV2_FD11: implementation-data-type=boolean
    IDTSHVBatCell_Voltage_High_Thrsh_BATTERY_HV2_FD11: implementation-data-type=uint16
    IDTSHVBatCell_Voltage_Low_Thrsh_BATTERY_HV2_FD11: implementation-data-type=uint16
    IDTSHVBatSleepTime_HVBATTERY_THERMAL_FD11: implementation-data-type=uint8, invalid-value=Value:255
    IDTSHVBatteryMILRequest_HVBATTERY2_FD11: implementation-data-type=boolean
    IDTSHVBattery_RealTimeClockV_HVBATTERY5_FD11: implementation-data-type=boolean
    IDTSHVBattery_RealTimeClock_HVBATTERY5_FD11: implementation-data-type=uint32, invalid-value=Value:4294967295
    IDTSHVCMS_BulkChargingComplete_VDCM_OBCM_FD11: implementation-data-type=boolean
    IDTSHVCMS_ChargingComplete_VDCM_OBCM_FD11: implementation-data-type=boolean
    IDTSHVCMS_EVEnergyCapacity_VDCM_OBCM_FD11: implementation-data-type=uint32, invalid-value=Value:131071
    IDTSHVCMS_EVEnergyRequest_VDCM_OBCM_FD11: implementation-data-type=uint32, invalid-value=Value:131071
    IDTSHVCMS_EVErrorCode_VDCM_OBCM_FD11: implementation-data-type=uint8, invalid-value=Value:15
    IDTSHVCMS_EVMax_I_Limit_VDCM_OBCM_FD11: implementation-data-type=uint16, invalid-value=Value:1023
    IDTSHVCMS_EVMax_P_Limit_VDCM_OBCM_FD11: implementation-data-type=uint32, invalid-value=Value:16777215
    IDTSHVCMS_EVMax_V_Limit_VDCM_OBCM_FD11: implementation-data-type=uint16, invalid-value=Value:16383
    IDTSHVCMS_EVRESSConditioning_VDCM_OBCM_FD11: implementation-data-type=boolean
    IDTSHVCMS_EVRESS_SOC_VDCM_OBCM_FD11: implementation-data-type=uint16, invalid-value=Value:4095
    IDTSHVCMS_EVReady_VDCM_OBCM_FD11: implementation-data-type=boolean
    IDTSHVCMS_EVTargetCurrent_VDCM_OBCM_FD11: implementation-data-type=uint16, invalid-value=Value:1023
    IDTSHVCMS_EVTargetVoltage_VDCM_OBCM_FD11: implementation-data-type=uint16, invalid-value=Value:16383
    IDTSHVCMS_Protocol_Entry{1..3}_VDCM_OBCM_FD11: implementation-data-type=uint16, invalid-value=Value:65535
    IDTSHVCMS_ReadyToChargeState_VDCM_OBCM_FD11: implementation-data-type=boolean
    IDTSHVCMS_RemaningTimeToBulkSOC_VDCM_OBCM_FD11: implementation-data-type=uint16, invalid-value=Value:65535
    IDTSHVCMS_RemaningTimeToFullSOC_VDCM_OBCM_FD11: implementation-data-type=uint16, invalid-value=Value:65535
    IDTSHVCMS_SelectedEnergyTransferType_VDCM_OBCM_FD11: implementation-data-type=uint8, invalid-value=Value:15
    IDTSHVCMS_SelectedPaymentOptn_VDCM_OBCM_FD11: implementation-data-type=uint8, invalid-value=Value:3
    IDTSHVCMS_SelectedServiceId_VDCM_OBCM_FD11: implementation-data-type=uint16
    IDTSHVCMS_ServiceCategory_VDCM_OBCM_FD11: implementation-data-type=uint8, invalid-value=Value:15
    IDTSHVCMS_ServiceScope_VDCM_OBCM_FD11: implementation-data-type=uint16, invalid-value=Value:65535
    IDTSHybridDriveModeSts_HYBRID_SYSTEM_EPT1_FD11: implementation-data-type=uint8, invalid-value=Value:15
    IDTSIDCM_CAL_ID_IDCM_OBD_DTC_FD11: implementation-data-type=uint8, invalid-value=Value:63
    IDTSIDCM_CAL_VN_IDCM_OBD_DTC_FD11: implementation-data-type=uint8, invalid-value=Value:255
    IDTSIDCM_DTC_Idx{1..8}_IDCM_OBD_DTC_FD11: implementation-data-type=uint8, invalid-value=Value:31
    IDTSIDCM_DTC_Stat{1..8}_IDCM_OBD_DTC_FD11: implementation-data-type=uint8
    IDTSIDCM_RBM_Idx_IDCM_OBD_DTC_FD11: implementation-data-type=uint8, invalid-value=Value:31
    IDTSIDCM_RBM_Stat_IDCM_OBD_DTC_FD11: implementation-data-type=uint8, invalid-value=Value:7
    IDTSIDCM_Wakeup_HCP_LV_CHARGER1_FD11: implementation-data-type=boolean
    IDTSIMPACTCommand_IMPACT_INFO_FD11: implementation-data-type=boolean
    IDTSIMPACTConfirm_IMPACT_INFO_FD11: implementation-data-type=boolean
    IDTSIgnitionOnCounter_BCM_FD_7_FD11: implementation-data-type=uint16
    IDTSImpactHardwireV_BATTERY_HV_FD11: implementation-data-type=boolean
    IDTSImpactHardwire_BATTERY_HV_FD11: implementation-data-type=boolean
    IDTSLID_Status_120V_Socket_A_HYBRID_DISPLAY2_FD11: implementation-data-type=boolean
    IDTSLID_Status_120V_Socket_B_HYBRID_DISPLAY2_FD11: implementation-data-type=boolean
    IDTSLID_Status_240V_Socket_HYBRID_DISPLAY2_FD11: implementation-data-type=boolean
    IDTSLOC_DiagEnable_ePT_HYBRID_SYSTEM_EPT1_FD11: implementation-data-type=uint8
    IDTSMCPA_DC_Current_P_MCPA_STATUS_FD11: implementation-data-type=uint16
    IDTSMCPA_Temp_MCPA_DATA2_FD11: implementation-data-type=uint8, invalid-value=Value:255
    IDTSMCPB_DC_Current_P_MCPB_STATUS_FD11: implementation-data-type=uint16
    IDTSMCPB_Temp_MCPB_DATA2_FD11: implementation-data-type=uint8, invalid-value=Value:255
    IDTSMC_HYBRID_DISPLAY2_HYBRID_DISPLAY2_FD11: implementation-data-type=uint8
    IDTSMC_MCPA_STATUS_MCPA_STATUS_FD11: implementation-data-type=uint8
    IDTSMC_MCPB_STATUS_MCPB_STATUS_FD11: implementation-data-type=uint8
    IDTSMax_Allwd_AC_Output_Current_L1_HYBRID_DISPLAY2_FD11: implementation-data-type=uint8
    IDTSMax_Allwd_AC_Output_Voltage_L1_HYBRID_DISPLAY2_FD11: implementation-data-type=uint16
    IDTSMessageCounter_FOTA_MASTER_FOTA_MASTER_FD11: implementation-data-type=uint8
    IDTSMessageCounter_HYBRID_SYSTEM_EPT1_HYBRID_SYSTEM_EPT1_FD11: implementation-data-type=uint8
    IDTSMessageCounter_IDCM_OBD_DTC_IDCM_OBD_DTC_FD11: implementation-data-type=uint8
    IDTSMinBatteryPackVoltage_EVCU_CHADEMO_STATUS1_FD11: implementation-data-type=uint16
    IDTSN_PDU_342_GLIWA_T1_TX_FD11: implementation-data-type=uint64
    IDTSN_PDU_343_GLIWA_T1_RX_FD11: implementation-data-type=uint64
    IDTSN_PDU_7B_GLIWA_MCPA_TX_FD11: implementation-data-type=uint64
    IDTSN_PDU_7C_GLIWA_MCPB_TX_FD11: implementation-data-type=uint64
    IDTSN_PDU_7E_GLIWA_MCPA_RX_FD11: implementation-data-type=uint64
    IDTSN_PDU_7F_GLIWA_MCPB_RX_FD11: implementation-data-type=uint64
    IDTSN_PDU_81_GLIWA_SGCP_RX_FD11: implementation-data-type=uint64
    IDTSN_PDU_86_GLIWA_SGCP_TX_FD11: implementation-data-type=uint64
    IDTSOBCM_OutVoltageSyncTgt_VDCM_OBCM_FD11: implementation-data-type=uint16, invalid-value=Value:1023
    IDTSOBC_Temp{1..4}_DUALCHARGER_THERMAL_FD11: implementation-data-type=uint8, invalid-value=Value:255
    IDTSOperationalModeSts_BCM_FD_2_FD11: implementation-data-type=uint8, invalid-value=Value:15
    IDTSPerWakeUp_Diag_HYBRID_SYSTEM_EPT1_FD11: implementation-data-type=uint16
    IDTSPowertrainPrplsnActv_ENGINE_FD_2_FD11: implementation-data-type=boolean
    IDTSPowertrainPrplsnActv_PT_PT_SYSTEM_FD_1_FD11: implementation-data-type=boolean
    IDTSPreviousCanNMState_FD03_EVCU2_PDC_INFO_FD_EVCU2_FD11: implementation-data-type=uint8
    IDTSPreviousCanNMState_FD05_EVCU2_PDC_INFO_FD_EVCU2_FD11: implementation-data-type=uint8
    IDTSPreviousCanNMState_FD11_EVCU2_PDC_INFO_FD_EVCU2_FD11: implementation-data-type=uint8
    IDTSPreviousCanNMState_FD16_EVCU2_PDC_INFO_FD_EVCU2_FD11: implementation-data-type=uint8
    IDTSPropulsionSystemActive_10B_HYBRID_SYSTEM_EPT1_FD11: implementation-data-type=boolean
    IDTSPwrEff_APM2_VDCM_FD11: implementation-data-type=uint16, invalid-value=Value:1023
    IDTSQualifyDriveCycle_SYNCHRO_DC_GLOBAL_FD11: implementation-data-type=boolean
    IDTSSGCP_DC_Current_P_SGCP_STATUS_FD11: implementation-data-type=uint16
    IDTSSGCP_Temp_SGCP_DATA2_FD11: implementation-data-type=uint8, invalid-value=Value:255
    IDTSStayActiveSource_FD03_EVCU2_PDC_INFO_FD_EVCU2_FD11: implementation-data-type=uint64
    IDTSStayActiveSource_FD05_EVCU2_PDC_INFO_FD_EVCU2_FD11: implementation-data-type=uint64
    IDTSStayActiveSource_FD11_EVCU2_PDC_INFO_FD_EVCU2_FD11: implementation-data-type=uint64
    IDTSStayActiveSource_FD16_EVCU2_PDC_INFO_FD_EVCU2_FD11: implementation-data-type=uint64
    IDTSStopReqBeforeCharge_EVCU_CHADEMO_STATUS1_FD11: implementation-data-type=boolean
    IDTSTotalBatteryCapacity_EVCU_CHADEMO_STATUS1_FD11: implementation-data-type=uint16
    IDTSTotalOdometer_IPC_FD_1_FD11: implementation-data-type=uint32
    IDTSV2X_HVCMS_SlctdEnergyTransfType_VDCM_OBCM_FD11: implementation-data-type=boolean
    IDTSVDCM_BattBulkSOC_VDCM_OBCM_FD11: implementation-data-type=uint16
    IDTSVDCM_ContractAuthenticationID_VDCM_OBCM_FD11: implementation-data-type=uint16
    IDTSVDCM_GenChallenge_VDCM_OBCM_FD11: implementation-data-type=uint16
    IDTSVDCM_OBCDischCurrentLim_VDCM_OBCM_FD11: implementation-data-type=uint16
    IDTSVDCM_TypeCNegotiationSts_VDCM_OBCM_FD11: implementation-data-type=uint8
    IDTSVIN_DATA_VIN_FD11: implementation-data-type=uint64
    IDTSVIN_MSG_VIN_FD11: implementation-data-type=uint8, invalid-value=Value:3
    IDTSVehicleDriveSts_EVCU_CHADEMO_STATUS1_FD11: implementation-data-type=boolean
    IDTSVehicleSpeedVSOSig_BRAKE_FD_2_FD11: implementation-data-type=uint16, invalid-value=Value:8191
    IDTSVltgChgEVSE_APM2_VDCM_FD11: implementation-data-type=uint16, invalid-value=Value:16383
    IDTSVltgChgInt_APM2_VDCM_FD11: implementation-data-type=uint16, invalid-value=Value:16383
    IDTSWU_Timer_Value_HYBRID_SYSTEM_EPT1_FD11: implementation-data-type=uint16
    IDTSWakeupSource_FD03_EVCU2_PDC_INFO_FD_EVCU2_FD11: implementation-data-type=uint8
    IDTSWakeupSource_FD05_EVCU2_PDC_INFO_FD_EVCU2_FD11: implementation-data-type=uint8
    IDTSWakeupSource_FD11_EVCU2_PDC_INFO_FD_EVCU2_FD11: implementation-data-type=uint8
    IDTSWakeupSource_FD16_EVCU2_PDC_INFO_FD_EVCU2_FD11: implementation-data-type=uint8
    IDTSWarning_PackTempHigh_HVBATTERY_RM_CHARGING1_FD11: implementation-data-type=boolean
package /STLASWCs/ComSwCpts/ComPrivateInterfaces
  sender receiver interface CanCom_FD11RxSignalsSR
    86 x data, all with category=TYPE_REFERENCE, sw-calibration-access=READ-ONLY:
      COMRX_APM2_BoostSwitchSts_APM2_VDCM_FD11: type=IDTSAPM2_BoostSwitchSts_APM2_VDCM_FD11
      COMRX_APM2_ContactorFault_APM2_VDCM_FD11: type=IDTSAPM2_ContactorFault_APM2_VDCM_FD11
      COMRX_APM2_DcChEnaSts_Fdbk_APM2_VDCM_FD11: type=IDTSAPM2_DcChEnaSts_Fdbk_APM2_VDCM_FD11
      COMRX_APM2_DeratRsnSts_APM2_VDCM_FD11: type=IDTSAPM2_DeratRsnSts_APM2_VDCM_FD11
      COMRX_APM2_DisChargedSts_Fdbk_APM2_VDCM_FD11: type=IDTSAPM2_DisChargedSts_Fdbk_APM2_VDCM_FD11
      COMRX_APM2_ErrorWord_APM2_VDCM_FD11: type=IDTSAPM2_ErrorWord_APM2_VDCM_FD11
      COMRX_APM2_FaultSts_APM2_VDCM_FD11: type=IDTSAPM2_FaultSts_APM2_VDCM_FD11
      COMRX_APM2_HVChrgBusCurrent_APM2_VDCM_FD11: type=IDTSAPM2_HVChrgBusCurrent_APM2_VDCM_FD11
      COMRX_APM2_HVChrgBusVoltage_APM2_VDCM_FD11: type=IDTSAPM2_HVChrgBusVoltage_APM2_VDCM_FD11
      COMRX_APM2_IInpMaxCnvr_APM2_VDCM_FD11: type=IDTSAPM2_IInpMaxCnvr_APM2_VDCM_FD11
      COMRX_APM2_K6_WldgDtnSts_APM2_VDCM_FD11: type=IDTSAPM2_K6_WldgDtnSts_APM2_VDCM_FD11
      COMRX_APM2_K7_WldgDtnSts_APM2_VDCM_FD11: type=IDTSAPM2_K7_WldgDtnSts_APM2_VDCM_FD11
      COMRX_APM2_ModeSts_Fbk_APM2_VDCM_FD11: type=IDTSAPM2_ModeSts_Fbk_APM2_VDCM_FD11
      COMRX_APM2_RecoveryAction_APM2_VDCM_FD11: type=IDTSAPM2_RecoveryAction_APM2_VDCM_FD11
      COMRX_APM2_Service_Lamp_Request_APM2_VDCM_FD11: type=IDTSAPM2_Service_Lamp_Request_APM2_VDCM_FD11
      COMRX_APM2_TempFET1_APM2_VDCM_FD11: type=IDTSAPM2_TempFET1_APM2_VDCM_FD11
      COMRX_APM2_TempFET2_APM2_VDCM_FD11: type=IDTSAPM2_TempFET2_APM2_VDCM_FD11
      COMRX_APM2_TempInlet_APM2_VDCM_FD11: type=IDTSAPM2_TempInlet_APM2_VDCM_FD11
      COMRX_APM2_TempInt_APM2_VDCM_FD11: type=IDTSAPM2_TempInt_APM2_VDCM_FD11
      COMRX_APM2_TempL1_APM2_VDCM_FD11: type=IDTSAPM2_TempL1_APM2_VDCM_FD11
      COMRX_APM2_TempL2_APM2_VDCM_FD11: type=IDTSAPM2_TempL2_APM2_VDCM_FD11
      COMRX_APM2_TempMargin_APM2_VDCM_FD11: type=IDTSAPM2_TempMargin_APM2_VDCM_FD11
      COMRX_APM2InterlockSts_APM2_VDCM_FD11: type=IDTSAPM2InterlockSts_APM2_VDCM_FD11
      COMRX_CurrEVSE_APM2_VDCM_FD11: type=IDTSCurrEVSE_APM2_VDCM_FD11
      COMRX_PwrEff_APM2_VDCM_FD11: type=IDTSPwrEff_APM2_VDCM_FD11
      COMRX_VltgChgEVSE_APM2_VDCM_FD11: type=IDTSVltgChgEVSE_APM2_VDCM_FD11
      COMRX_VltgChgInt_APM2_VDCM_FD11: type=IDTSVltgChgInt_APM2_VDCM_FD11
      COMRX_ImpactHardwire_BATTERY_HV_FD11: type=IDTSImpactHardwire_BATTERY_HV_FD11
      COMRX_ImpactHardwireV_BATTERY_HV_FD11: type=IDTSImpactHardwireV_BATTERY_HV_FD11
      COMRX_BMS_HV_High_Temp_Thrsh_BATTERY_HV2_FD11: type=IDTSBMS_HV_High_Temp_Thrsh_BATTERY_HV2_FD11
      COMRX_BMS_HV_Low_Temp_Thrsh_BATTERY_HV2_FD11: type=IDTSBMS_HV_Low_Temp_Thrsh_BATTERY_HV2_FD11
      COMRX_BMS_HV_SOC_AccuracySts_BATTERY_HV2_FD11: type=IDTSBMS_HV_SOC_AccuracySts_BATTERY_HV2_FD11
      COMRX_BMS_HV_SOC_Max_BATTERY_HV2_FD11: type=IDTSBMS_HV_SOC_Max_BATTERY_HV2_FD11
      COMRX_BMS_HV_SOC_Min_BATTERY_HV2_FD11: type=IDTSBMS_HV_SOC_Min_BATTERY_HV2_FD11
      COMRX_HEV_OnRq_BPCM_BATTERY_HV2_FD11: type=IDTSHEV_OnRq_BPCM_BATTERY_HV2_FD11
      COMRX_HVBatCell_Voltage_High_Thrsh_BATTERY_HV2_FD11: type=IDTSHVBatCell_Voltage_High_Thrsh_BATTERY_HV2_FD11
      COMRX_HVBatCell_Voltage_Low_Thrsh_BATTERY_HV2_FD11: type=IDTSHVBatCell_Voltage_Low_Thrsh_BATTERY_HV2_FD11
      COMRX_OBC_Temp{1..4}_DUALCHARGER_THERMAL_FD11: type=IDTSOBC_Temp{1..4}_DUALCHARGER_THERMAL_FD11
      COMRX_CRC_FOTA_MASTER_FOTA_MASTER_FD11: type=IDTSCRC_FOTA_MASTER_FOTA_MASTER_FD11
      COMRX_FOTA_Status_FOTA_MASTER_FD11: type=IDTSFOTA_Status_FOTA_MASTER_FD11
      COMRX_MessageCounter_FOTA_MASTER_FOTA_MASTER_FD11: type=IDTSMessageCounter_FOTA_MASTER_FOTA_MASTER_FD11
      COMRX_N_PDU_7E_GLIWA_MCPA_RX_FD11: type=IDTSN_PDU_7E_GLIWA_MCPA_RX_FD11
      COMRX_N_PDU_7F_GLIWA_MCPB_RX_FD11: type=IDTSN_PDU_7F_GLIWA_MCPB_RX_FD11
      COMRX_N_PDU_81_GLIWA_SGCP_RX_FD11: type=IDTSN_PDU_81_GLIWA_SGCP_RX_FD11
      COMRX_N_PDU_343_GLIWA_T1_RX_FD11: type=IDTSN_PDU_343_GLIWA_T1_RX_FD11
      COMRX_HVBatteryMILRequest_HVBATTERY2_FD11: type=IDTSHVBatteryMILRequest_HVBATTERY2_FD11
      COMRX_HVBattery_RealTimeClock_HVBATTERY5_FD11: type=IDTSHVBattery_RealTimeClock_HVBATTERY5_FD11
      COMRX_HVBattery_RealTimeClockV_HVBATTERY5_FD11: type=IDTSHVBattery_RealTimeClockV_HVBATTERY5_FD11
      COMRX_Warning_PackTempHigh_HVBATTERY_RM_CHARGING1_FD11: type=IDTSWarning_PackTempHigh_HVBATTERY_RM_CHARGING1_FD11
      COMRX_HVBatSleepTime_HVBATTERY_THERMAL_FD11: type=IDTSHVBatSleepTime_HVBATTERY_THERMAL_FD11
      COMRX_CdM_Avail_output_current_EXT_IDCM_CHADEMO_STATUS1_FD11: type=IDTSCdM_Avail_output_current_EXT_IDCM_CHADEMO_STATUS1_FD11
      COMRX_CdM_Charger_connector_lock_IDCM_CHADEMO_STATUS1_FD11: type=IDTSCdM_Charger_connector_lock_IDCM_CHADEMO_STATUS1_FD11
      COMRX_CdM_ExtFun_Thres_Volt_IDCM_CHADEMO_STATUS1_FD11: type=IDTSCdM_ExtFun_Thres_Volt_IDCM_CHADEMO_STATUS1_FD11
      COMRX_EVSE_BatteryCompatibilty_IDCM_CHADEMO_STATUS1_FD11: type=IDTSEVSE_BatteryCompatibilty_IDCM_CHADEMO_STATUS1_FD11
      COMRX_EVSE_CHAdeMOProtocol_IDCM_CHADEMO_STATUS1_FD11: type=IDTSEVSE_CHAdeMOProtocol_IDCM_CHADEMO_STATUS1_FD11
      COMRX_EVSE_ChargingSystemError_IDCM_CHADEMO_STATUS1_FD11: type=IDTSEVSE_ChargingSystemError_IDCM_CHADEMO_STATUS1_FD11
      COMRX_EVSE_EnergizingState_IDCM_CHADEMO_STATUS1_FD11: type=IDTSEVSE_EnergizingState_IDCM_CHADEMO_STATUS1_FD11
      COMRX_EVSE_RemainingMin_IDCM_CHADEMO_STATUS1_FD11: type=IDTSEVSE_RemainingMin_IDCM_CHADEMO_STATUS1_FD11
      COMRX_EVSE_RemainingSec_IDCM_CHADEMO_STATUS1_FD11: type=IDTSEVSE_RemainingSec_IDCM_CHADEMO_STATUS1_FD11
      COMRX_EVSE_ThrshldVoltage_IDCM_CHADEMO_STATUS1_FD11: type=IDTSEVSE_ThrshldVoltage_IDCM_CHADEMO_STATUS1_FD11
      COMRX_CRC_IDCM_OBD_DTC_IDCM_OBD_DTC_FD11: type=IDTSCRC_IDCM_OBD_DTC_IDCM_OBD_DTC_FD11
      COMRX_IDCM_CAL_ID_IDCM_OBD_DTC_FD11: type=IDTSIDCM_CAL_ID_IDCM_OBD_DTC_FD11
      COMRX_IDCM_CAL_VN_IDCM_OBD_DTC_FD11: type=IDTSIDCM_CAL_VN_IDCM_OBD_DTC_FD11
      COMRX_IDCM_DTC_Idx{1..8}_IDCM_OBD_DTC_FD11: type=IDTSIDCM_DTC_Idx{1..8}_IDCM_OBD_DTC_FD11
      COMRX_IDCM_DTC_Stat{1..8}_IDCM_OBD_DTC_FD11: type=IDTSIDCM_DTC_Stat{1..8}_IDCM_OBD_DTC_FD11
      COMRX_IDCM_RBM_Idx_IDCM_OBD_DTC_FD11: type=IDTSIDCM_RBM_Idx_IDCM_OBD_DTC_FD11
      COMRX_IDCM_RBM_Stat_IDCM_OBD_DTC_FD11: type=IDTSIDCM_RBM_Stat_IDCM_OBD_DTC_FD11
      COMRX_MessageCounter_IDCM_OBD_DTC_IDCM_OBD_DTC_FD11: type=IDTSMessageCounter_IDCM_OBD_DTC_IDCM_OBD_DTC_FD11
      COMRX_IDCM_Wakeup_HCP_LV_CHARGER1_FD11: type=IDTSIDCM_Wakeup_HCP_LV_CHARGER1_FD11
    invalidation-policys:
      data-element=COMRX_APM2_BoostSwitchSts_APM2_VDCM_FD11, handle-invalid=DONT-INVALIDATE
      data-element=COMRX_APM2_ContactorFault_APM2_VDCM_FD11, handle-invalid=KEEP
      data-element=COMRX_APM2_DcChEnaSts_Fdbk_APM2_VDCM_FD11, handle-invalid=DONT-INVALIDATE
      data-element=COMRX_APM2_DeratRsnSts_APM2_VDCM_FD11, handle-invalid=DONT-INVALIDATE
      data-element=COMRX_APM2_DisChargedSts_Fdbk_APM2_VDCM_FD11, handle-invalid=DONT-INVALIDATE
      data-element=COMRX_APM2_ErrorWord_APM2_VDCM_FD11, handle-invalid=DONT-INVALIDATE
      data-element=COMRX_APM2_FaultSts_APM2_VDCM_FD11, handle-invalid=KEEP
      data-element=COMRX_APM2_HVChrgBusCurrent_APM2_VDCM_FD11, handle-invalid=DONT-INVALIDATE
      data-element=COMRX_APM2_HVChrgBusVoltage_APM2_VDCM_FD11, handle-invalid=DONT-INVALIDATE
      data-element=COMRX_APM2_IInpMaxCnvr_APM2_VDCM_FD11, handle-invalid=KEEP
      data-element=COMRX_APM2_K6_WldgDtnSts_APM2_VDCM_FD11, handle-invalid=DONT-INVALIDATE
      data-element=COMRX_APM2_K7_WldgDtnSts_APM2_VDCM_FD11, handle-invalid=DONT-INVALIDATE
      data-element=COMRX_APM2_ModeSts_Fbk_APM2_VDCM_FD11, handle-invalid=KEEP
      data-element=COMRX_APM2_RecoveryAction_APM2_VDCM_FD11, handle-invalid=KEEP
      data-element=COMRX_APM2_Service_Lamp_Request_APM2_VDCM_FD11, handle-invalid=DONT-INVALIDATE
      data-element=COMRX_APM2_TempFET1_APM2_VDCM_FD11, handle-invalid=DONT-INVALIDATE
      data-element=COMRX_APM2_TempFET2_APM2_VDCM_FD11, handle-invalid=DONT-INVALIDATE
      data-element=COMRX_APM2_TempInlet_APM2_VDCM_FD11, handle-invalid=KEEP
      data-element=COMRX_APM2_TempInt_APM2_VDCM_FD11, handle-invalid=DONT-INVALIDATE
      data-element=COMRX_APM2_TempL1_APM2_VDCM_FD11, handle-invalid=DONT-INVALIDATE
      data-element=COMRX_APM2_TempL2_APM2_VDCM_FD11, handle-invalid=DONT-INVALIDATE
      data-element=COMRX_APM2_TempMargin_APM2_VDCM_FD11, handle-invalid=DONT-INVALIDATE
      data-element=COMRX_APM2InterlockSts_APM2_VDCM_FD11, handle-invalid=DONT-INVALIDATE
      data-element=COMRX_CurrEVSE_APM2_VDCM_FD11, handle-invalid=KEEP
      data-element=COMRX_PwrEff_APM2_VDCM_FD11, handle-invalid=KEEP
      data-element=COMRX_VltgChgEVSE_APM2_VDCM_FD11, handle-invalid=KEEP
      data-element=COMRX_VltgChgInt_APM2_VDCM_FD11, handle-invalid=KEEP
      data-element=COMRX_ImpactHardwire_BATTERY_HV_FD11, handle-invalid=DONT-INVALIDATE
      data-element=COMRX_ImpactHardwireV_BATTERY_HV_FD11, handle-invalid=DONT-INVALIDATE
      data-element=COMRX_BMS_HV_High_Temp_Thrsh_BATTERY_HV2_FD11, handle-invalid=DONT-INVALIDATE
      data-element=COMRX_BMS_HV_Low_Temp_Thrsh_BATTERY_HV2_FD11, handle-invalid=DONT-INVALIDATE
      data-element=COMRX_BMS_HV_SOC_AccuracySts_BATTERY_HV2_FD11, handle-invalid=KEEP
      data-element=COMRX_BMS_HV_SOC_Max_BATTERY_HV2_FD11, handle-invalid=DONT-INVALIDATE
      data-element=COMRX_BMS_HV_SOC_Min_BATTERY_HV2_FD11, handle-invalid=DONT-INVALIDATE
      data-element=COMRX_HEV_OnRq_BPCM_BATTERY_HV2_FD11, handle-invalid=DONT-INVALIDATE
      data-element=COMRX_HVBatCell_Voltage_High_Thrsh_BATTERY_HV2_FD11, handle-invalid=DONT-INVALIDATE
      data-element=COMRX_HVBatCell_Voltage_Low_Thrsh_BATTERY_HV2_FD11, handle-invalid=DONT-INVALIDATE
      data-element=COMRX_OBC_Temp{1..4}_DUALCHARGER_THERMAL_FD11, handle-invalid=KEEP
      data-element=COMRX_CRC_FOTA_MASTER_FOTA_MASTER_FD11, handle-invalid=DONT-INVALIDATE
      data-element=COMRX_FOTA_Status_FOTA_MASTER_FD11, handle-invalid=DONT-INVALIDATE
      data-element=COMRX_MessageCounter_FOTA_MASTER_FOTA_MASTER_FD11, handle-invalid=DONT-INVALIDATE
      data-element=COMRX_N_PDU_7E_GLIWA_MCPA_RX_FD11, handle-invalid=DONT-INVALIDATE
      data-element=COMRX_N_PDU_7F_GLIWA_MCPB_RX_FD11, handle-invalid=DONT-INVALIDATE
      data-element=COMRX_N_PDU_81_GLIWA_SGCP_RX_FD11, handle-invalid=DONT-INVALIDATE
      data-element=COMRX_N_PDU_343_GLIWA_T1_RX_FD11, handle-invalid=DONT-INVALIDATE
      data-element=COMRX_HVBatteryMILRequest_HVBATTERY2_FD11, handle-invalid=DONT-INVALIDATE
      data-element=COMRX_HVBattery_RealTimeClock_HVBATTERY5_FD11, handle-invalid=KEEP
      data-element=COMRX_HVBattery_RealTimeClockV_HVBATTERY5_FD11, handle-invalid=DONT-INVALIDATE
      data-element=COMRX_Warning_PackTempHigh_HVBATTERY_RM_CHARGING1_FD11, handle-invalid=DONT-INVALIDATE
      data-element=COMRX_HVBatSleepTime_HVBATTERY_THERMAL_FD11, handle-invalid=KEEP
      data-element=COMRX_CdM_Avail_output_current_EXT_IDCM_CHADEMO_STATUS1_FD11, handle-invalid=DONT-INVALIDATE
      data-element=COMRX_CdM_Charger_connector_lock_IDCM_CHADEMO_STATUS1_FD11, handle-invalid=DONT-INVALIDATE
      data-element=COMRX_CdM_ExtFun_Thres_Volt_IDCM_CHADEMO_STATUS1_FD11, handle-invalid=DONT-INVALIDATE
      data-element=COMRX_EVSE_BatteryCompatibilty_IDCM_CHADEMO_STATUS1_FD11, handle-invalid=DONT-INVALIDATE
      data-element=COMRX_EVSE_CHAdeMOProtocol_IDCM_CHADEMO_STATUS1_FD11, handle-invalid=KEEP
      data-element=COMRX_EVSE_ChargingSystemError_IDCM_CHADEMO_STATUS1_FD11, handle-invalid=DONT-INVALIDATE
      data-element=COMRX_EVSE_EnergizingState_IDCM_CHADEMO_STATUS1_FD11, handle-invalid=DONT-INVALIDATE
      data-element=COMRX_EVSE_RemainingMin_IDCM_CHADEMO_STATUS1_FD11, handle-invalid=DONT-INVALIDATE
      data-element=COMRX_EVSE_RemainingSec_IDCM_CHADEMO_STATUS1_FD11, handle-invalid=DONT-INVALIDATE
      data-element=COMRX_EVSE_ThrshldVoltage_IDCM_CHADEMO_STATUS1_FD11, handle-invalid=DONT-INVALIDATE
      data-element=COMRX_CRC_IDCM_OBD_DTC_IDCM_OBD_DTC_FD11, handle-invalid=DONT-INVALIDATE
      data-element=COMRX_IDCM_CAL_ID_IDCM_OBD_DTC_FD11, handle-invalid=KEEP
      data-element=COMRX_IDCM_CAL_VN_IDCM_OBD_DTC_FD11, handle-invalid=KEEP
      data-element=COMRX_IDCM_DTC_Idx{1..8}_IDCM_OBD_DTC_FD11, handle-invalid=KEEP
      data-element=COMRX_IDCM_DTC_Stat{1..8}_IDCM_OBD_DTC_FD11, handle-invalid=DONT-INVALIDATE
      data-element=COMRX_IDCM_RBM_Idx_IDCM_OBD_DTC_FD11, handle-invalid=KEEP
      data-element=COMRX_IDCM_RBM_Stat_IDCM_OBD_DTC_FD11, handle-invalid=KEEP
      data-element=COMRX_MessageCounter_IDCM_OBD_DTC_IDCM_OBD_DTC_FD11, handle-invalid=DONT-INVALIDATE
      data-element=COMRX_IDCM_Wakeup_HCP_LV_CHARGER1_FD11, handle-invalid=DONT-INVALIDATE
  sender receiver interface CanCom_FD11TxSignalsSR
    137 x data, all with category=TYPE_REFERENCE, sw-calibration-access=READ-ONLY:
      COMTX_CmdIgnSts_BCM_FD_10_FD11: type=IDTSCmdIgnSts_BCM_FD_10_FD11, init-value=COMTX_CmdIgnSts_BCM_FD_10_FD11Value:0  # Raw signal data to be transmitted over the CAN bus for the Signal CmdIgnSts
      COMTX_ExternalTemperatureC_BCM_FD_10_FD11: type=IDTSExternalTemperatureC_BCM_FD_10_FD11, init-value=COMTX_ExternalTemperatureC_BCM_FD_10_FD11Value:511  # Raw signal data to be transmitted over the CAN bus for the Signal ExternalTemperatureC
      COMTX_OperationalModeSts_BCM_FD_2_FD11: type=IDTSOperationalModeSts_BCM_FD_2_FD11, init-value=COMTX_OperationalModeSts_BCM_FD_2_FD11Value:0  # Raw signal data to be transmitted over the CAN bus for the Signal OperationalModeSts
      COMTX_Battery_Volt_1_BCM_FD_3_FD11: type=IDTSBattery_Volt_1_BCM_FD_3_FD11, init-value=COMTX_Battery_Volt_1_BCM_FD_3_FD11Value:0  # Raw signal data to be transmitted over the CAN bus for the Signal Battery_Volt_1
      COMTX_IgnitionOnCounter_BCM_FD_7_FD11: type=IDTSIgnitionOnCounter_BCM_FD_7_FD11, init-value=COMTX_IgnitionOnCounter_BCM_FD_7_FD11Value:0  # Raw signal data to be transmitted over the CAN bus for the Signal IgnitionOnCounter
      COMTX_ExternalTemperature_BCM_FD_9_FD11: type=IDTSExternalTemperature_BCM_FD_9_FD11, init-value=COMTX_ExternalTemperature_BCM_FD_9_FD11Value:0  # Raw signal data to be transmitted over the CAN bus for the Signal ExternalTemperature
      COMTX_VehicleSpeedVSOSig_BRAKE_FD_2_FD11: type=IDTSVehicleSpeedVSOSig_BRAKE_FD_2_FD11, init-value=COMTX_VehicleSpeedVSOSig_BRAKE_FD_2_FD11Value:0  # Raw signal data to be transmitted over the CAN bus for the Signal VehicleSpeedVSOSig
      COMTX_EPBSts_BRAKE_FD_4_FD11: type=IDTSEPBSts_BRAKE_FD_4_FD11, init-value=COMTX_EPBSts_BRAKE_FD_4_FD11Value:0  # Raw signal data to be transmitted over the CAN bus for the Signal EPBSts
      COMTX_EngineSpeed_W_ENGINE_FD_2_FD11: type=IDTSEngineSpeed_W_ENGINE_FD_2_FD11, init-value=COMTX_EngineSpeed_W_ENGINE_FD_2_FD11Value:0  # Raw signal data to be transmitted over the CAN bus for the Signal EngineSpeed_W
      COMTX_PowertrainPrplsnActv_ENGINE_FD_2_FD11: type=IDTSPowertrainPrplsnActv_ENGINE_FD_2_FD11, init-value=COMTX_PowertrainPrplsnActv_ENGINE_FD_2_FD11Value:0  # Raw signal data to be transmitted over the CAN bus for the Signal PowertrainPrplsnActv
      COMTX_BattVoltDeviationErr_EVCU_CHADEMO_STATUS1_FD11: type=IDTSBattVoltDeviationErr_EVCU_CHADEMO_STATUS1_FD11, init-value=COMTX_BattVoltDeviationErr_EVCU_CHADEMO_STATUS1_FD11Value:0  # Raw signal data to be transmitted over the CAN bus for the Signal BattVoltDeviationErr
      COMTX_CdM_Chrg_current_req_ext_EVCU_CHADEMO_STATUS1_FD11: type=IDTSCdM_Chrg_current_req_ext_EVCU_CHADEMO_STATUS1_FD11, init-value=COMTX_CdM_Chrg_current_req_ext_EVCU_CHADEMO_STATUS1_FD11Value:0  # Raw signal data to be transmitted over the CAN bus for the Signal CdM_Chrg_current_req_ext
      COMTX_CdM_ExtFun_Min_Batt_Volt_EVCU_CHADEMO_STATUS1_FD11: type=IDTSCdM_ExtFun_Min_Batt_Volt_EVCU_CHADEMO_STATUS1_FD11, init-value=COMTX_CdM_ExtFun_Min_Batt_Volt_EVCU_CHADEMO_STATUS1_FD11Value:0  # Raw signal data to be transmitted over the CAN bus for the Signal CdM_ExtFun_Min_Batt_Volt
      COMTX_CdM_ExtFun_Veh_Dyn_Control_Comp_EVCU_CHADEMO_STATUS1_FD11: type=IDTSCdM_ExtFun_Veh_Dyn_Control_Comp_EVCU_CHADEMO_STATUS1_FD11, init-value=COMTX_CdM_ExtFun_Veh_Dyn_Control_Comp_EVCU_CHADEMO_STATUS1_FD11Value:0  # Raw signal data to be transmitted over the CAN bus for the Signal CdM_ExtFun_Veh_Dyn_Control_Comp
      COMTX_CdM_ExtFun_Veh_HC_Control_Comp_EVCU_CHADEMO_STATUS1_FD11: type=IDTSCdM_ExtFun_Veh_HC_Control_Comp_EVCU_CHADEMO_STATUS1_FD11, init-value=COMTX_CdM_ExtFun_Veh_HC_Control_Comp_EVCU_CHADEMO_STATUS1_FD11Value:0  # Raw signal data to be transmitted over the CAN bus for the Signal CdM_ExtFun_Veh_HC_Control_Comp
      COMTX_CdM_Remained_batt_capacity_EVCU_CHADEMO_STATUS1_FD11: type=IDTSCdM_Remained_batt_capacity_EVCU_CHADEMO_STATUS1_FD11, init-value=COMTX_CdM_Remained_batt_capacity_EVCU_CHADEMO_STATUS1_FD11Value:0  # Raw signal data to be transmitted over the CAN bus for the Signal CdM_Remained_batt_capacity
      COMTX_CHAdeMOProtocol_EVCU_CHADEMO_STATUS1_FD11: type=IDTSCHAdeMOProtocol_EVCU_CHADEMO_STATUS1_FD11, init-value=COMTX_CHAdeMOProtocol_EVCU_CHADEMO_STATUS1_FD11Value:0  # Raw signal data to be transmitted over the CAN bus for the Signal CHAdeMOProtocol
      COMTX_ChargedCurrentMin_EVCU_CHADEMO_STATUS1_FD11: type=IDTSChargedCurrentMin_EVCU_CHADEMO_STATUS1_FD11, init-value=COMTX_ChargedCurrentMin_EVCU_CHADEMO_STATUS1_FD11Value:0  # Raw signal data to be transmitted over the CAN bus for the Signal ChargedCurrentMin
      COMTX_ChargedReferenceConstant_EVCU_CHADEMO_STATUS1_FD11: type=IDTSChargedReferenceConstant_EVCU_CHADEMO_STATUS1_FD11, init-value=COMTX_ChargedReferenceConstant_EVCU_CHADEMO_STATUS1_FD11Value:0  # Raw signal data to be transmitted over the CAN bus for the Signal ChargedReferenceConstant
      COMTX_DisplaySOC_EVCU_CHADEMO_STATUS1_FD11: type=IDTSDisplaySOC_EVCU_CHADEMO_STATUS1_FD11, init-value=COMTX_DisplaySOC_EVCU_CHADEMO_STATUS1_FD11Value:0  # Raw signal data to be transmitted over the CAN bus for the Signal DisplaySOC
      COMTX_EVContactorSts_EVCU_CHADEMO_STATUS1_FD11: type=IDTSEVContactorSts_EVCU_CHADEMO_STATUS1_FD11, init-value=COMTX_EVContactorSts_EVCU_CHADEMO_STATUS1_FD11Value:0  # Raw signal data to be transmitted over the CAN bus for the Signal EVContactorSts
      COMTX_EVCU_CP3Cmd_EVCU_CHADEMO_STATUS1_FD11: type=IDTSEVCU_CP3Cmd_EVCU_CHADEMO_STATUS1_FD11, init-value=COMTX_EVCU_CP3Cmd_EVCU_CHADEMO_STATUS1_FD11Value:0  # Raw signal data to be transmitted over the CAN bus for the Signal EVCU_CP3Cmd
      COMTX_MinBatteryPackVoltage_EVCU_CHADEMO_STATUS1_FD11: type=IDTSMinBatteryPackVoltage_EVCU_CHADEMO_STATUS1_FD11, init-value=COMTX_MinBatteryPackVoltage_EVCU_CHADEMO_STATUS1_FD11Value:0  # Raw signal data to be transmitted over the CAN bus for the Signal MinBatteryPackVoltage
      COMTX_StopReqBeforeCharge_EVCU_CHADEMO_STATUS1_FD11: type=IDTSStopReqBeforeCharge_EVCU_CHADEMO_STATUS1_FD11, init-value=COMTX_StopReqBeforeCharge_EVCU_CHADEMO_STATUS1_FD11Value:0  # Raw signal data to be transmitted over the CAN bus for the Signal StopReqBeforeCharge
      COMTX_TotalBatteryCapacity_EVCU_CHADEMO_STATUS1_FD11: type=IDTSTotalBatteryCapacity_EVCU_CHADEMO_STATUS1_FD11, init-value=COMTX_TotalBatteryCapacity_EVCU_CHADEMO_STATUS1_FD11Value:0  # Raw signal data to be transmitted over the CAN bus for the Signal TotalBatteryCapacity
      COMTX_VehicleDriveSts_EVCU_CHADEMO_STATUS1_FD11: type=IDTSVehicleDriveSts_EVCU_CHADEMO_STATUS1_FD11, init-value=COMTX_VehicleDriveSts_EVCU_CHADEMO_STATUS1_FD11Value:0  # Raw signal data to be transmitted over the CAN bus for the Signal VehicleDriveSts
      COMTX_N_PDU_7B_GLIWA_MCPA_TX_FD11: type=IDTSN_PDU_7B_GLIWA_MCPA_TX_FD11, init-value=COMTX_N_PDU_7B_GLIWA_MCPA_TX_FD11Value:0  # Raw signal data to be transmitted over the CAN bus for the Signal N_PDU_7B
      COMTX_N_PDU_7C_GLIWA_MCPB_TX_FD11: type=IDTSN_PDU_7C_GLIWA_MCPB_TX_FD11, init-value=COMTX_N_PDU_7C_GLIWA_MCPB_TX_FD11Value:0  # Raw signal data to be transmitted over the CAN bus for the Signal N_PDU_7C
      COMTX_N_PDU_86_GLIWA_SGCP_TX_FD11: type=IDTSN_PDU_86_GLIWA_SGCP_TX_FD11, init-value=COMTX_N_PDU_86_GLIWA_SGCP_TX_FD11Value:0  # Raw signal data to be transmitted over the CAN bus for the Signal N_PDU_86
      COMTX_N_PDU_342_GLIWA_T1_TX_FD11: type=IDTSN_PDU_342_GLIWA_T1_TX_FD11, init-value=COMTX_N_PDU_342_GLIWA_T1_TX_FD11Value:0  # Raw signal data to be transmitted over the CAN bus for the Signal N_PDU_342
      COMTX_CRC_HYBRID_DISPLAY2_HYBRID_DISPLAY2_FD11: type=IDTSCRC_HYBRID_DISPLAY2_HYBRID_DISPLAY2_FD11, init-value=COMTX_CRC_HYBRID_DISPLAY2_HYBRID_DISPLAY2_FD11Value:0  # Raw signal data to be transmitted over the CAN bus for the Signal CRC_HYBRID_DISPLAY2
      COMTX_DischargingSysStatus_HYBRID_DISPLAY2_FD11: type=IDTSDischargingSysStatus_HYBRID_DISPLAY2_FD11, init-value=COMTX_DischargingSysStatus_HYBRID_DISPLAY2_FD11Value:0  # Raw signal data to be transmitted over the CAN bus for the Signal DischargingSysStatus
      COMTX_LID_Status_120V_Socket_A_HYBRID_DISPLAY2_FD11: type=IDTSLID_Status_120V_Socket_A_HYBRID_DISPLAY2_FD11, init-value=COMTX_LID_Status_120V_Socket_A_HYBRID_DISPLAY2_FD11Value:0  # Raw signal data to be transmitted over the CAN bus for the Signal LID_Status_120V_Socket_A
      COMTX_LID_Status_120V_Socket_B_HYBRID_DISPLAY2_FD11: type=IDTSLID_Status_120V_Socket_B_HYBRID_DISPLAY2_FD11, init-value=COMTX_LID_Status_120V_Socket_B_HYBRID_DISPLAY2_FD11Value:0  # Raw signal data to be transmitted over the CAN bus for the Signal LID_Status_120V_Socket_B
      COMTX_LID_Status_240V_Socket_HYBRID_DISPLAY2_FD11: type=IDTSLID_Status_240V_Socket_HYBRID_DISPLAY2_FD11, init-value=COMTX_LID_Status_240V_Socket_HYBRID_DISPLAY2_FD11Value:0  # Raw signal data to be transmitted over the CAN bus for the Signal LID_Status_240V_Socket
      COMTX_Max_Allwd_AC_Output_Current_L1_HYBRID_DISPLAY2_FD11: type=IDTSMax_Allwd_AC_Output_Current_L1_HYBRID_DISPLAY2_FD11, init-value=COMTX_Max_Allwd_AC_Output_Current_L1_HYBRID_DISPLAY2_FD11Value:0  # Raw signal data to be transmitted over the CAN bus for the Signal Max_Allwd_AC_Output_Current_L1
      COMTX_Max_Allwd_AC_Output_Voltage_L1_HYBRID_DISPLAY2_FD11: type=IDTSMax_Allwd_AC_Output_Voltage_L1_HYBRID_DISPLAY2_FD11, init-value=COMTX_Max_Allwd_AC_Output_Voltage_L1_HYBRID_DISPLAY2_FD11Value:0  # Raw signal data to be transmitted over the CAN bus for the Signal Max_Allwd_AC_Output_Voltage_L1
      COMTX_MC_HYBRID_DISPLAY2_HYBRID_DISPLAY2_FD11: type=IDTSMC_HYBRID_DISPLAY2_HYBRID_DISPLAY2_FD11, init-value=COMTX_MC_HYBRID_DISPLAY2_HYBRID_DISPLAY2_FD11Value:0  # Raw signal data to be transmitted over the CAN bus for the Signal MC_HYBRID_DISPLAY2
      COMTX_CRC_HYBRID_SYSTEM_EPT1_HYBRID_SYSTEM_EPT1_FD11: type=IDTSCRC_HYBRID_SYSTEM_EPT1_HYBRID_SYSTEM_EPT1_FD11, init-value=COMTX_CRC_HYBRID_SYSTEM_EPT1_HYBRID_SYSTEM_EPT1_FD11Value:0  # Raw signal data to be transmitted over the CAN bus for the Signal CRC_HYBRID_SYSTEM_EPT1
      COMTX_HCP_ShutdownCommand_HYBRID_SYSTEM_EPT1_FD11: type=IDTSHCP_ShutdownCommand_HYBRID_SYSTEM_EPT1_FD11, init-value=COMTX_HCP_ShutdownCommand_HYBRID_SYSTEM_EPT1_FD11Value:0  # Raw signal data to be transmitted over the CAN bus for the Signal HCP_ShutdownCommand
      COMTX_HybridDriveModeSts_HYBRID_SYSTEM_EPT1_FD11: type=IDTSHybridDriveModeSts_HYBRID_SYSTEM_EPT1_FD11, init-value=COMTX_HybridDriveModeSts_HYBRID_SYSTEM_EPT1_FD11Value:0  # Raw signal data to be transmitted over the CAN bus for the Signal HybridDriveModeSts
      COMTX_LOC_DiagEnable_ePT_HYBRID_SYSTEM_EPT1_FD11: type=IDTSLOC_DiagEnable_ePT_HYBRID_SYSTEM_EPT1_FD11, init-value=COMTX_LOC_DiagEnable_ePT_HYBRID_SYSTEM_EPT1_FD11Value:0  # Raw signal data to be transmitted over the CAN bus for the Signal LOC_DiagEnable_ePT
      COMTX_MessageCounter_HYBRID_SYSTEM_EPT1_HYBRID_SYSTEM_EPT1_FD11: type=IDTSMessageCounter_HYBRID_SYSTEM_EPT1_HYBRID_SYSTEM_EPT1_FD11, init-value=COMTX_MessageCounter_HYBRID_SYSTEM_EPT1_HYBRID_SYSTEM_EPT1_FD11Value:0  # Raw signal data to be transmitted over the CAN bus for the Signal MessageCounter_HYBRID_SYSTEM_EPT1
      COMTX_PerWakeUp_Diag_HYBRID_SYSTEM_EPT1_FD11: type=IDTSPerWakeUp_Diag_HYBRID_SYSTEM_EPT1_FD11, init-value=COMTX_PerWakeUp_Diag_HYBRID_SYSTEM_EPT1_FD11Value:0  # Raw signal data to be transmitted over the CAN bus for the Signal PerWakeUp_Diag
      COMTX_PropulsionSystemActive_10B_HYBRID_SYSTEM_EPT1_FD11: type=IDTSPropulsionSystemActive_10B_HYBRID_SYSTEM_EPT1_FD11, init-value=COMTX_PropulsionSystemActive_10B_HYBRID_SYSTEM_EPT1_FD11Value:0  # Raw signal data to be transmitted over the CAN bus for the Signal PropulsionSystemActive_10B
      COMTX_WU_Timer_Value_HYBRID_SYSTEM_EPT1_FD11: type=IDTSWU_Timer_Value_HYBRID_SYSTEM_EPT1_FD11, init-value=COMTX_WU_Timer_Value_HYBRID_SYSTEM_EPT1_FD11Value:0  # Raw signal data to be transmitted over the CAN bus for the Signal WU_Timer_Value
      COMTX_IMPACTCommand_IMPACT_INFO_FD11: type=IDTSIMPACTCommand_IMPACT_INFO_FD11, init-value=COMTX_IMPACTCommand_IMPACT_INFO_FD11Value:0  # Raw signal data to be transmitted over the CAN bus for the Signal IMPACTCommand
      COMTX_IMPACTConfirm_IMPACT_INFO_FD11: type=IDTSIMPACTConfirm_IMPACT_INFO_FD11, init-value=COMTX_IMPACTConfirm_IMPACT_INFO_FD11Value:1  # Raw signal data to be transmitted over the CAN bus for the Signal IMPACTConfirm
      COMTX_TotalOdometer_IPC_FD_1_FD11: type=IDTSTotalOdometer_IPC_FD_1_FD11, init-value=COMTX_TotalOdometer_IPC_FD_1_FD11Value:0  # Raw signal data to be transmitted over the CAN bus for the Signal TotalOdometer
      COMTX_MCPA_Temp_MCPA_DATA2_FD11: type=IDTSMCPA_Temp_MCPA_DATA2_FD11, init-value=COMTX_MCPA_Temp_MCPA_DATA2_FD11Value:40  # Raw signal data to be transmitted over the CAN bus for the Signal MCPA_Temp
      COMTX_CRC_MCPA_STATUS_MCPA_STATUS_FD11: type=IDTSCRC_MCPA_STATUS_MCPA_STATUS_FD11, init-value=COMTX_CRC_MCPA_STATUS_MCPA_STATUS_FD11Value:0  # Raw signal data to be transmitted over the CAN bus for the Signal CRC_MCPA_STATUS
      COMTX_MC_MCPA_STATUS_MCPA_STATUS_FD11: type=IDTSMC_MCPA_STATUS_MCPA_STATUS_FD11, init-value=COMTX_MC_MCPA_STATUS_MCPA_STATUS_FD11Value:0  # Raw signal data to be transmitted over the CAN bus for the Signal MC_MCPA_STATUS
      COMTX_MCPA_DC_Current_P_MCPA_STATUS_FD11: type=IDTSMCPA_DC_Current_P_MCPA_STATUS_FD11, init-value=COMTX_MCPA_DC_Current_P_MCPA_STATUS_FD11Value:16384  # Raw signal data to be transmitted over the CAN bus for the Signal MCPA_DC_Current_P
      COMTX_MCPB_Temp_MCPB_DATA2_FD11: type=IDTSMCPB_Temp_MCPB_DATA2_FD11, init-value=COMTX_MCPB_Temp_MCPB_DATA2_FD11Value:40  # Raw signal data to be transmitted over the CAN bus for the Signal MCPB_Temp
      COMTX_CRC_MCPB_STATUS_MCPB_STATUS_FD11: type=IDTSCRC_MCPB_STATUS_MCPB_STATUS_FD11, init-value=COMTX_CRC_MCPB_STATUS_MCPB_STATUS_FD11Value:0  # Raw signal data to be transmitted over the CAN bus for the Signal CRC_MCPB_STATUS
      COMTX_MC_MCPB_STATUS_MCPB_STATUS_FD11: type=IDTSMC_MCPB_STATUS_MCPB_STATUS_FD11, init-value=COMTX_MC_MCPB_STATUS_MCPB_STATUS_FD11Value:0  # Raw signal data to be transmitted over the CAN bus for the Signal MC_MCPB_STATUS
      COMTX_MCPB_DC_Current_P_MCPB_STATUS_FD11: type=IDTSMCPB_DC_Current_P_MCPB_STATUS_FD11, init-value=COMTX_MCPB_DC_Current_P_MCPB_STATUS_FD11Value:16384  # Raw signal data to be transmitted over the CAN bus for the Signal MCPB_DC_Current_P
      COMTX_CurrentCanNMState_FD03_EVCU2_PDC_INFO_FD_EVCU2_FD11: type=IDTSCurrentCanNMState_FD03_EVCU2_PDC_INFO_FD_EVCU2_FD11, init-value=COMTX_CurrentCanNMState_FD03_EVCU2_PDC_INFO_FD_EVCU2_FD11Value:0  # Raw signal data to be transmitted over the CAN bus for the Signal CurrentCanNMState_FD03_EVCU2
      COMTX_CurrentCanNMState_FD05_EVCU2_PDC_INFO_FD_EVCU2_FD11: type=IDTSCurrentCanNMState_FD05_EVCU2_PDC_INFO_FD_EVCU2_FD11, init-value=COMTX_CurrentCanNMState_FD05_EVCU2_PDC_INFO_FD_EVCU2_FD11Value:0  # Raw signal data to be transmitted over the CAN bus for the Signal CurrentCanNMState_FD05_EVCU2
      COMTX_CurrentCanNMState_FD11_EVCU2_PDC_INFO_FD_EVCU2_FD11: type=IDTSCurrentCanNMState_FD11_EVCU2_PDC_INFO_FD_EVCU2_FD11, init-value=COMTX_CurrentCanNMState_FD11_EVCU2_PDC_INFO_FD_EVCU2_FD11Value:0  # Raw signal data to be transmitted over the CAN bus for the Signal CurrentCanNMState_FD11_EVCU2
      COMTX_CurrentCanNMState_FD16_EVCU2_PDC_INFO_FD_EVCU2_FD11: type=IDTSCurrentCanNMState_FD16_EVCU2_PDC_INFO_FD_EVCU2_FD11, init-value=COMTX_CurrentCanNMState_FD16_EVCU2_PDC_INFO_FD_EVCU2_FD11Value:0  # Raw signal data to be transmitted over the CAN bus for the Signal CurrentCanNMState_FD16_EVCU2
      COMTX_CurrentFailSts_FD03_EVCU2_PDC_INFO_FD_EVCU2_FD11: type=IDTSCurrentFailSts_FD03_EVCU2_PDC_INFO_FD_EVCU2_FD11, init-value=COMTX_CurrentFailSts_FD03_EVCU2_PDC_INFO_FD_EVCU2_FD11Value:0  # Raw signal data to be transmitted over the CAN bus for the Signal CurrentFailSts_FD03_EVCU2
      COMTX_CurrentFailSts_FD05_EVCU2_PDC_INFO_FD_EVCU2_FD11: type=IDTSCurrentFailSts_FD05_EVCU2_PDC_INFO_FD_EVCU2_FD11, init-value=COMTX_CurrentFailSts_FD05_EVCU2_PDC_INFO_FD_EVCU2_FD11Value:0  # Raw signal data to be transmitted over the CAN bus for the Signal CurrentFailSts_FD05_EVCU2
      COMTX_CurrentFailSts_FD11_EVCU2_PDC_INFO_FD_EVCU2_FD11: type=IDTSCurrentFailSts_FD11_EVCU2_PDC_INFO_FD_EVCU2_FD11, init-value=COMTX_CurrentFailSts_FD11_EVCU2_PDC_INFO_FD_EVCU2_FD11Value:0  # Raw signal data to be transmitted over the CAN bus for the Signal CurrentFailSts_FD11_EVCU2
      COMTX_CurrentFailSts_FD16_EVCU2_PDC_INFO_FD_EVCU2_FD11: type=IDTSCurrentFailSts_FD16_EVCU2_PDC_INFO_FD_EVCU2_FD11, init-value=COMTX_CurrentFailSts_FD16_EVCU2_PDC_INFO_FD_EVCU2_FD11Value:0  # Raw signal data to be transmitted over the CAN bus for the Signal CurrentFailSts_FD16_EVCU2
      COMTX_DES_FD03_EVCU2_PDC_INFO_FD_EVCU2_FD11: type=IDTSDES_FD03_EVCU2_PDC_INFO_FD_EVCU2_FD11, init-value=COMTX_DES_FD03_EVCU2_PDC_INFO_FD_EVCU2_FD11Value:0  # Raw signal data to be transmitted over the CAN bus for the Signal DES_FD03_EVCU2
      COMTX_DES_FD05_EVCU2_PDC_INFO_FD_EVCU2_FD11: type=IDTSDES_FD05_EVCU2_PDC_INFO_FD_EVCU2_FD11, init-value=COMTX_DES_FD05_EVCU2_PDC_INFO_FD_EVCU2_FD11Value:0  # Raw signal data to be transmitted over the CAN bus for the Signal DES_FD05_EVCU2
      COMTX_DES_FD11_EVCU2_PDC_INFO_FD_EVCU2_FD11: type=IDTSDES_FD11_EVCU2_PDC_INFO_FD_EVCU2_FD11, init-value=COMTX_DES_FD11_EVCU2_PDC_INFO_FD_EVCU2_FD11Value:0  # Raw signal data to be transmitted over the CAN bus for the Signal DES_FD11_EVCU2
      COMTX_DES_FD16_EVCU2_PDC_INFO_FD_EVCU2_FD11: type=IDTSDES_FD16_EVCU2_PDC_INFO_FD_EVCU2_FD11, init-value=COMTX_DES_FD16_EVCU2_PDC_INFO_FD_EVCU2_FD11Value:0  # Raw signal data to be transmitted over the CAN bus for the Signal DES_FD16_EVCU2
      COMTX_EOL_FD03_EVCU2_PDC_INFO_FD_EVCU2_FD11: type=IDTSEOL_FD03_EVCU2_PDC_INFO_FD_EVCU2_FD11, init-value=COMTX_EOL_FD03_EVCU2_PDC_INFO_FD_EVCU2_FD11Value:0  # Raw signal data to be transmitted over the CAN bus for the Signal EOL_FD03_EVCU2
      COMTX_EOL_FD05_EVCU2_PDC_INFO_FD_EVCU2_FD11: type=IDTSEOL_FD05_EVCU2_PDC_INFO_FD_EVCU2_FD11, init-value=COMTX_EOL_FD05_EVCU2_PDC_INFO_FD_EVCU2_FD11Value:0  # Raw signal data to be transmitted over the CAN bus for the Signal EOL_FD05_EVCU2
      COMTX_EOL_FD11_EVCU2_PDC_INFO_FD_EVCU2_FD11: type=IDTSEOL_FD11_EVCU2_PDC_INFO_FD_EVCU2_FD11, init-value=COMTX_EOL_FD11_EVCU2_PDC_INFO_FD_EVCU2_FD11Value:0  # Raw signal data to be transmitted over the CAN bus for the Signal EOL_FD11_EVCU2
      COMTX_EOL_FD16_EVCU2_PDC_INFO_FD_EVCU2_FD11: type=IDTSEOL_FD16_EVCU2_PDC_INFO_FD_EVCU2_FD11, init-value=COMTX_EOL_FD16_EVCU2_PDC_INFO_FD_EVCU2_FD11Value:0  # Raw signal data to be transmitted over the CAN bus for the Signal EOL_FD16_EVCU2
      COMTX_GenericFailSts_FD03_EVCU2_PDC_INFO_FD_EVCU2_FD11: type=IDTSGenericFailSts_FD03_EVCU2_PDC_INFO_FD_EVCU2_FD11, init-value=COMTX_GenericFailSts_FD03_EVCU2_PDC_INFO_FD_EVCU2_FD11Value:0  # Raw signal data to be transmitted over the CAN bus for the Signal GenericFailSts_FD03_EVCU2
      COMTX_GenericFailSts_FD05_EVCU2_PDC_INFO_FD_EVCU2_FD11: type=IDTSGenericFailSts_FD05_EVCU2_PDC_INFO_FD_EVCU2_FD11, init-value=COMTX_GenericFailSts_FD05_EVCU2_PDC_INFO_FD_EVCU2_FD11Value:0  # Raw signal data to be transmitted over the CAN bus for the Signal GenericFailSts_FD05_EVCU2
      COMTX_GenericFailSts_FD11_EVCU2_PDC_INFO_FD_EVCU2_FD11: type=IDTSGenericFailSts_FD11_EVCU2_PDC_INFO_FD_EVCU2_FD11, init-value=COMTX_GenericFailSts_FD11_EVCU2_PDC_INFO_FD_EVCU2_FD11Value:0  # Raw signal data to be transmitted over the CAN bus for the Signal GenericFailSts_FD11_EVCU2
      COMTX_GenericFailSts_FD16_EVCU2_PDC_INFO_FD_EVCU2_FD11: type=IDTSGenericFailSts_FD16_EVCU2_PDC_INFO_FD_EVCU2_FD11, init-value=COMTX_GenericFailSts_FD16_EVCU2_PDC_INFO_FD_EVCU2_FD11Value:0  # Raw signal data to be transmitted over the CAN bus for the Signal GenericFailSts_FD16_EVCU2
      COMTX_PreviousCanNMState_FD03_EVCU2_PDC_INFO_FD_EVCU2_FD11: type=IDTSPreviousCanNMState_FD03_EVCU2_PDC_INFO_FD_EVCU2_FD11, init-value=COMTX_PreviousCanNMState_FD03_EVCU2_PDC_INFO_FD_EVCU2_FD11Value:0  # Raw signal data to be transmitted over the CAN bus for the Signal PreviousCanNMState_FD03_EVCU2
      COMTX_PreviousCanNMState_FD05_EVCU2_PDC_INFO_FD_EVCU2_FD11: type=IDTSPreviousCanNMState_FD05_EVCU2_PDC_INFO_FD_EVCU2_FD11, init-value=COMTX_PreviousCanNMState_FD05_EVCU2_PDC_INFO_FD_EVCU2_FD11Value:0  # Raw signal data to be transmitted over the CAN bus for the Signal PreviousCanNMState_FD05_EVCU2
      COMTX_PreviousCanNMState_FD11_EVCU2_PDC_INFO_FD_EVCU2_FD11: type=IDTSPreviousCanNMState_FD11_EVCU2_PDC_INFO_FD_EVCU2_FD11, init-value=COMTX_PreviousCanNMState_FD11_EVCU2_PDC_INFO_FD_EVCU2_FD11Value:0  # Raw signal data to be transmitted over the CAN bus for the Signal PreviousCanNMState_FD11_EVCU2
      COMTX_PreviousCanNMState_FD16_EVCU2_PDC_INFO_FD_EVCU2_FD11: type=IDTSPreviousCanNMState_FD16_EVCU2_PDC_INFO_FD_EVCU2_FD11, init-value=COMTX_PreviousCanNMState_FD16_EVCU2_PDC_INFO_FD_EVCU2_FD11Value:0  # Raw signal data to be transmitted over the CAN bus for the Signal PreviousCanNMState_FD16_EVCU2
      COMTX_StayActiveSource_FD03_EVCU2_PDC_INFO_FD_EVCU2_FD11: type=IDTSStayActiveSource_FD03_EVCU2_PDC_INFO_FD_EVCU2_FD11, init-value=COMTX_StayActiveSource_FD03_EVCU2_PDC_INFO_FD_EVCU2_FD11Value:0  # Raw signal data to be transmitted over the CAN bus for the Signal StayActiveSource_FD03_EVCU2
      COMTX_StayActiveSource_FD05_EVCU2_PDC_INFO_FD_EVCU2_FD11: type=IDTSStayActiveSource_FD05_EVCU2_PDC_INFO_FD_EVCU2_FD11, init-value=COMTX_StayActiveSource_FD05_EVCU2_PDC_INFO_FD_EVCU2_FD11Value:0  # Raw signal data to be transmitted over the CAN bus for the Signal StayActiveSource_FD05_EVCU2
      COMTX_StayActiveSource_FD11_EVCU2_PDC_INFO_FD_EVCU2_FD11: type=IDTSStayActiveSource_FD11_EVCU2_PDC_INFO_FD_EVCU2_FD11, init-value=COMTX_StayActiveSource_FD11_EVCU2_PDC_INFO_FD_EVCU2_FD11Value:0  # Raw signal data to be transmitted over the CAN bus for the Signal StayActiveSource_FD11_EVCU2
      COMTX_StayActiveSource_FD16_EVCU2_PDC_INFO_FD_EVCU2_FD11: type=IDTSStayActiveSource_FD16_EVCU2_PDC_INFO_FD_EVCU2_FD11, init-value=COMTX_StayActiveSource_FD16_EVCU2_PDC_INFO_FD_EVCU2_FD11Value:0  # Raw signal data to be transmitted over the CAN bus for the Signal StayActiveSource_FD16_EVCU2
      COMTX_WakeupSource_FD03_EVCU2_PDC_INFO_FD_EVCU2_FD11: type=IDTSWakeupSource_FD03_EVCU2_PDC_INFO_FD_EVCU2_FD11, init-value=COMTX_WakeupSource_FD03_EVCU2_PDC_INFO_FD_EVCU2_FD11Value:0  # Raw signal data to be transmitted over the CAN bus for the Signal WakeupSource_FD03_EVCU2
      COMTX_WakeupSource_FD05_EVCU2_PDC_INFO_FD_EVCU2_FD11: type=IDTSWakeupSource_FD05_EVCU2_PDC_INFO_FD_EVCU2_FD11, init-value=COMTX_WakeupSource_FD05_EVCU2_PDC_INFO_FD_EVCU2_FD11Value:0  # Raw signal data to be transmitted over the CAN bus for the Signal WakeupSource_FD05_EVCU2
      COMTX_WakeupSource_FD11_EVCU2_PDC_INFO_FD_EVCU2_FD11: type=IDTSWakeupSource_FD11_EVCU2_PDC_INFO_FD_EVCU2_FD11, init-value=COMTX_WakeupSource_FD11_EVCU2_PDC_INFO_FD_EVCU2_FD11Value:0  # Raw signal data to be transmitted over the CAN bus for the Signal WakeupSource_FD11_EVCU2
      COMTX_WakeupSource_FD16_EVCU2_PDC_INFO_FD_EVCU2_FD11: type=IDTSWakeupSource_FD16_EVCU2_PDC_INFO_FD_EVCU2_FD11, init-value=COMTX_WakeupSource_FD16_EVCU2_PDC_INFO_FD_EVCU2_FD11Value:0  # Raw signal data to be transmitted over the CAN bus for the Signal WakeupSource_FD16_EVCU2
      COMTX_DriveReady_PT_PT_SYSTEM_FD_1_FD11: type=IDTSDriveReady_PT_PT_SYSTEM_FD_1_FD11, init-value=COMTX_DriveReady_PT_PT_SYSTEM_FD_1_FD11Value:0  # Raw signal data to be transmitted over the CAN bus for the Signal DriveReady_PT
      COMTX_GearEngaged_PT_PT_SYSTEM_FD_1_FD11: type=IDTSGearEngaged_PT_PT_SYSTEM_FD_1_FD11, init-value=COMTX_GearEngaged_PT_PT_SYSTEM_FD_1_FD11Value:0  # Raw signal data to be transmitted over the CAN bus for the Signal GearEngaged_PT
      COMTX_GearEngagedForDisplay_PT_PT_SYSTEM_FD_1_FD11: type=IDTSGearEngagedForDisplay_PT_PT_SYSTEM_FD_1_FD11, init-value=COMTX_GearEngagedForDisplay_PT_PT_SYSTEM_FD_1_FD11Value:0  # Raw signal data to be transmitted over the CAN bus for the Signal GearEngagedForDisplay_PT
      COMTX_PowertrainPrplsnActv_PT_PT_SYSTEM_FD_1_FD11: type=IDTSPowertrainPrplsnActv_PT_PT_SYSTEM_FD_1_FD11, init-value=COMTX_PowertrainPrplsnActv_PT_PT_SYSTEM_FD_1_FD11Value:0  # Raw signal data to be transmitted over the CAN bus for the Signal PowertrainPrplsnActv_PT
      COMTX_SGCP_Temp_SGCP_DATA2_FD11: type=IDTSSGCP_Temp_SGCP_DATA2_FD11, init-value=COMTX_SGCP_Temp_SGCP_DATA2_FD11Value:0  # Raw signal data to be transmitted over the CAN bus for the Signal SGCP_Temp
      COMTX_SGCP_DC_Current_P_SGCP_STATUS_FD11: type=IDTSSGCP_DC_Current_P_SGCP_STATUS_FD11, init-value=COMTX_SGCP_DC_Current_P_SGCP_STATUS_FD11Value:16384  # Raw signal data to be transmitted over the CAN bus for the Signal SGCP_DC_Current_P
      COMTX_QualifyDriveCycle_SYNCHRO_DC_GLOBAL_FD11: type=IDTSQualifyDriveCycle_SYNCHRO_DC_GLOBAL_FD11, init-value=COMTX_QualifyDriveCycle_SYNCHRO_DC_GLOBAL_FD11Value:0  # Raw signal data to be transmitted over the CAN bus for the Signal QualifyDriveCycle
      COMTX_GPS_Date_Day_TELEMATIC_FD_1_FD11: type=IDTSGPS_Date_Day_TELEMATIC_FD_1_FD11, init-value=COMTX_GPS_Date_Day_TELEMATIC_FD_1_FD11Value:255  # Raw signal data to be transmitted over the CAN bus for the Signal GPS_Date_Day
      COMTX_GPS_Date_Month_TELEMATIC_FD_1_FD11: type=IDTSGPS_Date_Month_TELEMATIC_FD_1_FD11, init-value=COMTX_GPS_Date_Month_TELEMATIC_FD_1_FD11Value:255  # Raw signal data to be transmitted over the CAN bus for the Signal GPS_Date_Month
      COMTX_GPS_Date_Year_TELEMATIC_FD_1_FD11: type=IDTSGPS_Date_Year_TELEMATIC_FD_1_FD11, init-value=COMTX_GPS_Date_Year_TELEMATIC_FD_1_FD11Value:65535  # Raw signal data to be transmitted over the CAN bus for the Signal GPS_Date_Year
      COMTX_GPS_UTC_Hour_TELEMATIC_FD_1_FD11: type=IDTSGPS_UTC_Hour_TELEMATIC_FD_1_FD11, init-value=COMTX_GPS_UTC_Hour_TELEMATIC_FD_1_FD11Value:255  # Raw signal data to be transmitted over the CAN bus for the Signal GPS_UTC_Hour
      COMTX_GPS_UTC_Minute_TELEMATIC_FD_1_FD11: type=IDTSGPS_UTC_Minute_TELEMATIC_FD_1_FD11, init-value=COMTX_GPS_UTC_Minute_TELEMATIC_FD_1_FD11Value:255  # Raw signal data to be transmitted over the CAN bus for the Signal GPS_UTC_Minute
      COMTX_GPS_UTC_Second_TELEMATIC_FD_1_FD11: type=IDTSGPS_UTC_Second_TELEMATIC_FD_1_FD11, init-value=COMTX_GPS_UTC_Second_TELEMATIC_FD_1_FD11Value:65535  # Raw signal data to be transmitted over the CAN bus for the Signal GPS_UTC_Second
      COMTX_GearEngagedForDisplay_TRANSM_FD_2_FD11: type=IDTSGearEngagedForDisplay_TRANSM_FD_2_FD11, init-value=COMTX_GearEngagedForDisplay_TRANSM_FD_2_FD11Value:31  # Raw signal data to be transmitted over the CAN bus for the Signal GearEngagedForDisplay
      COMTX_HVCMS_BulkChargingComplete_VDCM_OBCM_FD11: type=IDTSHVCMS_BulkChargingComplete_VDCM_OBCM_FD11, init-value=COMTX_HVCMS_BulkChargingComplete_VDCM_OBCM_FD11Value:0  # Raw signal data to be transmitted over the CAN bus for the Signal HVCMS_BulkChargingComplete
      COMTX_HVCMS_ChargingComplete_VDCM_OBCM_FD11: type=IDTSHVCMS_ChargingComplete_VDCM_OBCM_FD11, init-value=COMTX_HVCMS_ChargingComplete_VDCM_OBCM_FD11Value:0  # Raw signal data to be transmitted over the CAN bus for the Signal HVCMS_ChargingComplete
      COMTX_HVCMS_EVEnergyCapacity_VDCM_OBCM_FD11: type=IDTSHVCMS_EVEnergyCapacity_VDCM_OBCM_FD11, init-value=COMTX_HVCMS_EVEnergyCapacity_VDCM_OBCM_FD11Value:0  # Raw signal data to be transmitted over the CAN bus for the Signal HVCMS_EVEnergyCapacity
      COMTX_HVCMS_EVEnergyRequest_VDCM_OBCM_FD11: type=IDTSHVCMS_EVEnergyRequest_VDCM_OBCM_FD11, init-value=COMTX_HVCMS_EVEnergyRequest_VDCM_OBCM_FD11Value:131071  # Raw signal data to be transmitted over the CAN bus for the Signal HVCMS_EVEnergyRequest
      COMTX_HVCMS_EVErrorCode_VDCM_OBCM_FD11: type=IDTSHVCMS_EVErrorCode_VDCM_OBCM_FD11, init-value=COMTX_HVCMS_EVErrorCode_VDCM_OBCM_FD11Value:0  # Raw signal data to be transmitted over the CAN bus for the Signal HVCMS_EVErrorCode
      COMTX_HVCMS_EVMax_I_Limit_VDCM_OBCM_FD11: type=IDTSHVCMS_EVMax_I_Limit_VDCM_OBCM_FD11, init-value=COMTX_HVCMS_EVMax_I_Limit_VDCM_OBCM_FD11Value:0  # Raw signal data to be transmitted over the CAN bus for the Signal HVCMS_EVMax_I_Limit
      COMTX_HVCMS_EVMax_P_Limit_VDCM_OBCM_FD11: type=IDTSHVCMS_EVMax_P_Limit_VDCM_OBCM_FD11, init-value=COMTX_HVCMS_EVMax_P_Limit_VDCM_OBCM_FD11Value:0  # Raw signal data to be transmitted over the CAN bus for the Signal HVCMS_EVMax_P_Limit
      COMTX_HVCMS_EVMax_V_Limit_VDCM_OBCM_FD11: type=IDTSHVCMS_EVMax_V_Limit_VDCM_OBCM_FD11, init-value=COMTX_HVCMS_EVMax_V_Limit_VDCM_OBCM_FD11Value:0  # Raw signal data to be transmitted over the CAN bus for the Signal HVCMS_EVMax_V_Limit
      COMTX_HVCMS_EVReady_VDCM_OBCM_FD11: type=IDTSHVCMS_EVReady_VDCM_OBCM_FD11, init-value=COMTX_HVCMS_EVReady_VDCM_OBCM_FD11Value:0  # Raw signal data to be transmitted over the CAN bus for the Signal HVCMS_EVReady
      COMTX_HVCMS_EVRESS_SOC_VDCM_OBCM_FD11: type=IDTSHVCMS_EVRESS_SOC_VDCM_OBCM_FD11, init-value=COMTX_HVCMS_EVRESS_SOC_VDCM_OBCM_FD11Value:0  # Raw signal data to be transmitted over the CAN bus for the Signal HVCMS_EVRESS_SOC
      COMTX_HVCMS_EVRESSConditioning_VDCM_OBCM_FD11: type=IDTSHVCMS_EVRESSConditioning_VDCM_OBCM_FD11, init-value=COMTX_HVCMS_EVRESSConditioning_VDCM_OBCM_FD11Value:0  # Raw signal data to be transmitted over the CAN bus for the Signal HVCMS_EVRESSConditioning
      COMTX_HVCMS_EVTargetCurrent_VDCM_OBCM_FD11: type=IDTSHVCMS_EVTargetCurrent_VDCM_OBCM_FD11, init-value=COMTX_HVCMS_EVTargetCurrent_VDCM_OBCM_FD11Value:0  # Raw signal data to be transmitted over the CAN bus for the Signal HVCMS_EVTargetCurrent
      COMTX_HVCMS_EVTargetVoltage_VDCM_OBCM_FD11: type=IDTSHVCMS_EVTargetVoltage_VDCM_OBCM_FD11, init-value=COMTX_HVCMS_EVTargetVoltage_VDCM_OBCM_FD11Value:0  # Raw signal data to be transmitted over the CAN bus for the Signal HVCMS_EVTargetVoltage
      COMTX_HVCMS_Protocol_Entry{1..3}_VDCM_OBCM_FD11: type=IDTSHVCMS_Protocol_Entry{1..3}_VDCM_OBCM_FD11, init-value=COMTX_HVCMS_Protocol_Entry{1..3}_VDCM_OBCM_FD11Value:0  # Raw signal data to be transmitted over the CAN bus for the Signal HVCMS_Protocol_Entry{1..3}
      COMTX_HVCMS_ReadyToChargeState_VDCM_OBCM_FD11: type=IDTSHVCMS_ReadyToChargeState_VDCM_OBCM_FD11, init-value=COMTX_HVCMS_ReadyToChargeState_VDCM_OBCM_FD11Value:0  # Raw signal data to be transmitted over the CAN bus for the Signal HVCMS_ReadyToChargeState
      COMTX_HVCMS_RemaningTimeToBulkSOC_VDCM_OBCM_FD11: type=IDTSHVCMS_RemaningTimeToBulkSOC_VDCM_OBCM_FD11, init-value=COMTX_HVCMS_RemaningTimeToBulkSOC_VDCM_OBCM_FD11Value:0  # Raw signal data to be transmitted over the CAN bus for the Signal HVCMS_RemaningTimeToBulkSOC
      COMTX_HVCMS_RemaningTimeToFullSOC_VDCM_OBCM_FD11: type=IDTSHVCMS_RemaningTimeToFullSOC_VDCM_OBCM_FD11, init-value=COMTX_HVCMS_RemaningTimeToFullSOC_VDCM_OBCM_FD11Value:0  # Raw signal data to be transmitted over the CAN bus for the Signal HVCMS_RemaningTimeToFullSOC
      COMTX_HVCMS_SelectedEnergyTransferType_VDCM_OBCM_FD11: type=IDTSHVCMS_SelectedEnergyTransferType_VDCM_OBCM_FD11, init-value=COMTX_HVCMS_SelectedEnergyTransferType_VDCM_OBCM_FD11Value:0  # Raw signal data to be transmitted over the CAN bus for the Signal HVCMS_SelectedEnergyTransferType
      COMTX_HVCMS_SelectedPaymentOptn_VDCM_OBCM_FD11: type=IDTSHVCMS_SelectedPaymentOptn_VDCM_OBCM_FD11, init-value=COMTX_HVCMS_SelectedPaymentOptn_VDCM_OBCM_FD11Value:0  # Raw signal data to be transmitted over the CAN bus for the Signal HVCMS_SelectedPaymentOptn
      COMTX_HVCMS_SelectedServiceId_VDCM_OBCM_FD11: type=IDTSHVCMS_SelectedServiceId_VDCM_OBCM_FD11, init-value=COMTX_HVCMS_SelectedServiceId_VDCM_OBCM_FD11Value:0  # Raw signal data to be transmitted over the CAN bus for the Signal HVCMS_SelectedServiceId
      COMTX_HVCMS_ServiceCategory_VDCM_OBCM_FD11: type=IDTSHVCMS_ServiceCategory_VDCM_OBCM_FD11, init-value=COMTX_HVCMS_ServiceCategory_VDCM_OBCM_FD11Value:0  # Raw signal data to be transmitted over the CAN bus for the Signal HVCMS_ServiceCategory
      COMTX_HVCMS_ServiceScope_VDCM_OBCM_FD11: type=IDTSHVCMS_ServiceScope_VDCM_OBCM_FD11, init-value=COMTX_HVCMS_ServiceScope_VDCM_OBCM_FD11Value:0  # Raw signal data to be transmitted over the CAN bus for the Signal HVCMS_ServiceScope
      COMTX_OBCM_OutVoltageSyncTgt_VDCM_OBCM_FD11: type=IDTSOBCM_OutVoltageSyncTgt_VDCM_OBCM_FD11, init-value=COMTX_OBCM_OutVoltageSyncTgt_VDCM_OBCM_FD11Value:0  # Raw signal data to be transmitted over the CAN bus for the Signal OBCM_OutVoltageSyncTgt
      COMTX_V2X_HVCMS_SlctdEnergyTransfType_VDCM_OBCM_FD11: type=IDTSV2X_HVCMS_SlctdEnergyTransfType_VDCM_OBCM_FD11, init-value=COMTX_V2X_HVCMS_SlctdEnergyTransfType_VDCM_OBCM_FD11Value:0  # Raw signal data to be transmitted over the CAN bus for the Signal V2X_HVCMS_SlctdEnergyTransfType
      COMTX_VDCM_BattBulkSOC_VDCM_OBCM_FD11: type=IDTSVDCM_BattBulkSOC_VDCM_OBCM_FD11, init-value=COMTX_VDCM_BattBulkSOC_VDCM_OBCM_FD11Value:0  # Raw signal data to be transmitted over the CAN bus for the Signal VDCM_BattBulkSOC
      COMTX_VDCM_ContractAuthenticationID_VDCM_OBCM_FD11: type=IDTSVDCM_ContractAuthenticationID_VDCM_OBCM_FD11, init-value=COMTX_VDCM_ContractAuthenticationID_VDCM_OBCM_FD11Value:0  # Raw signal data to be transmitted over the CAN bus for the Signal VDCM_ContractAuthenticationID
      COMTX_VDCM_GenChallenge_VDCM_OBCM_FD11: type=IDTSVDCM_GenChallenge_VDCM_OBCM_FD11, init-value=COMTX_VDCM_GenChallenge_VDCM_OBCM_FD11Value:0  # Raw signal data to be transmitted over the CAN bus for the Signal VDCM_GenChallenge
      COMTX_VDCM_OBCDischCurrentLim_VDCM_OBCM_FD11: type=IDTSVDCM_OBCDischCurrentLim_VDCM_OBCM_FD11, init-value=COMTX_VDCM_OBCDischCurrentLim_VDCM_OBCM_FD11Value:815  # Raw signal data to be transmitted over the CAN bus for the Signal VDCM_OBCDischCurrentLim
      COMTX_VDCM_TypeCNegotiationSts_VDCM_OBCM_FD11: type=IDTSVDCM_TypeCNegotiationSts_VDCM_OBCM_FD11, init-value=COMTX_VDCM_TypeCNegotiationSts_VDCM_OBCM_FD11Value:0  # Raw signal data to be transmitted over the CAN bus for the Signal VDCM_TypeCNegotiationSts
      COMTX_ClrLgsDiagInfo_VDCM_PWT3_FD11: type=IDTSClrLgsDiagInfo_VDCM_PWT3_FD11, init-value=COMTX_ClrLgsDiagInfo_VDCM_PWT3_FD11Value:0  # Raw signal data to be transmitted over the CAN bus for the Signal ClrLgsDiagInfo
      COMTX_VIN_DATA_VIN_FD11: type=IDTSVIN_DATA_VIN_FD11, init-value=COMTX_VIN_DATA_VIN_FD11Value:0  # Raw signal data to be transmitted over the CAN bus for the Signal VIN_DATA
      COMTX_VIN_MSG_VIN_FD11: type=IDTSVIN_MSG_VIN_FD11, init-value=COMTX_VIN_MSG_VIN_FD11Value:3  # Raw signal data to be transmitted over the CAN bus for the Signal VIN_MSG
    invalidation-policys:
      data-element=COMTX_CmdIgnSts_BCM_FD_10_FD11, handle-invalid=KEEP
      data-element=COMTX_ExternalTemperatureC_BCM_FD_10_FD11, handle-invalid=KEEP
      data-element=COMTX_OperationalModeSts_BCM_FD_2_FD11, handle-invalid=KEEP
      data-element=COMTX_Battery_Volt_1_BCM_FD_3_FD11, handle-invalid=KEEP
      data-element=COMTX_IgnitionOnCounter_BCM_FD_7_FD11, handle-invalid=DONT-INVALIDATE
      data-element=COMTX_ExternalTemperature_BCM_FD_9_FD11, handle-invalid=KEEP
      data-element=COMTX_VehicleSpeedVSOSig_BRAKE_FD_2_FD11, handle-invalid=KEEP
      data-element=COMTX_EPBSts_BRAKE_FD_4_FD11, handle-invalid=KEEP
      data-element=COMTX_EngineSpeed_W_ENGINE_FD_2_FD11, handle-invalid=KEEP
      data-element=COMTX_PowertrainPrplsnActv_ENGINE_FD_2_FD11, handle-invalid=DONT-INVALIDATE
      data-element=COMTX_BattVoltDeviationErr_EVCU_CHADEMO_STATUS1_FD11, handle-invalid=DONT-INVALIDATE
      data-element=COMTX_CdM_Chrg_current_req_ext_EVCU_CHADEMO_STATUS1_FD11, handle-invalid=DONT-INVALIDATE
      data-element=COMTX_CdM_ExtFun_Min_Batt_Volt_EVCU_CHADEMO_STATUS1_FD11, handle-invalid=KEEP
      data-element=COMTX_CdM_ExtFun_Veh_Dyn_Control_Comp_EVCU_CHADEMO_STATUS1_FD11, handle-invalid=DONT-INVALIDATE
      data-element=COMTX_CdM_ExtFun_Veh_HC_Control_Comp_EVCU_CHADEMO_STATUS1_FD11, handle-invalid=DONT-INVALIDATE
      data-element=COMTX_CdM_Remained_batt_capacity_EVCU_CHADEMO_STATUS1_FD11, handle-invalid=KEEP
      data-element=COMTX_CHAdeMOProtocol_EVCU_CHADEMO_STATUS1_FD11, handle-invalid=KEEP
      data-element=COMTX_ChargedCurrentMin_EVCU_CHADEMO_STATUS1_FD11, handle-invalid=DONT-INVALIDATE
      data-element=COMTX_ChargedReferenceConstant_EVCU_CHADEMO_STATUS1_FD11, handle-invalid=DONT-INVALIDATE
      data-element=COMTX_DisplaySOC_EVCU_CHADEMO_STATUS1_FD11, handle-invalid=DONT-INVALIDATE
      data-element=COMTX_EVContactorSts_EVCU_CHADEMO_STATUS1_FD11, handle-invalid=DONT-INVALIDATE
      data-element=COMTX_EVCU_CP3Cmd_EVCU_CHADEMO_STATUS1_FD11, handle-invalid=DONT-INVALIDATE
      data-element=COMTX_MinBatteryPackVoltage_EVCU_CHADEMO_STATUS1_FD11, handle-invalid=DONT-INVALIDATE
      data-element=COMTX_StopReqBeforeCharge_EVCU_CHADEMO_STATUS1_FD11, handle-invalid=DONT-INVALIDATE
      data-element=COMTX_TotalBatteryCapacity_EVCU_CHADEMO_STATUS1_FD11, handle-invalid=DONT-INVALIDATE
      data-element=COMTX_VehicleDriveSts_EVCU_CHADEMO_STATUS1_FD11, handle-invalid=DONT-INVALIDATE
      data-element=COMTX_N_PDU_7B_GLIWA_MCPA_TX_FD11, handle-invalid=DONT-INVALIDATE
      data-element=COMTX_N_PDU_7C_GLIWA_MCPB_TX_FD11, handle-invalid=DONT-INVALIDATE
      data-element=COMTX_N_PDU_86_GLIWA_SGCP_TX_FD11, handle-invalid=DONT-INVALIDATE
      data-element=COMTX_N_PDU_342_GLIWA_T1_TX_FD11, handle-invalid=DONT-INVALIDATE
      data-element=COMTX_CRC_HYBRID_DISPLAY2_HYBRID_DISPLAY2_FD11, handle-invalid=DONT-INVALIDATE
      data-element=COMTX_DischargingSysStatus_HYBRID_DISPLAY2_FD11, handle-invalid=KEEP
      data-element=COMTX_LID_Status_120V_Socket_A_HYBRID_DISPLAY2_FD11, handle-invalid=DONT-INVALIDATE
      data-element=COMTX_LID_Status_120V_Socket_B_HYBRID_DISPLAY2_FD11, handle-invalid=DONT-INVALIDATE
      data-element=COMTX_LID_Status_240V_Socket_HYBRID_DISPLAY2_FD11, handle-invalid=DONT-INVALIDATE
      data-element=COMTX_Max_Allwd_AC_Output_Current_L1_HYBRID_DISPLAY2_FD11, handle-invalid=DONT-INVALIDATE
      data-element=COMTX_Max_Allwd_AC_Output_Voltage_L1_HYBRID_DISPLAY2_FD11, handle-invalid=DONT-INVALIDATE
      data-element=COMTX_MC_HYBRID_DISPLAY2_HYBRID_DISPLAY2_FD11, handle-invalid=DONT-INVALIDATE
      data-element=COMTX_CRC_HYBRID_SYSTEM_EPT1_HYBRID_SYSTEM_EPT1_FD11, handle-invalid=DONT-INVALIDATE
      data-element=COMTX_HCP_ShutdownCommand_HYBRID_SYSTEM_EPT1_FD11, handle-invalid=KEEP
      data-element=COMTX_HybridDriveModeSts_HYBRID_SYSTEM_EPT1_FD11, handle-invalid=KEEP
      data-element=COMTX_LOC_DiagEnable_ePT_HYBRID_SYSTEM_EPT1_FD11, handle-invalid=DONT-INVALIDATE
      data-element=COMTX_MessageCounter_HYBRID_SYSTEM_EPT1_HYBRID_SYSTEM_EPT1_FD11, handle-invalid=DONT-INVALIDATE
      data-element=COMTX_PerWakeUp_Diag_HYBRID_SYSTEM_EPT1_FD11, handle-invalid=DONT-INVALIDATE
      data-element=COMTX_PropulsionSystemActive_10B_HYBRID_SYSTEM_EPT1_FD11, handle-invalid=DONT-INVALIDATE
      data-element=COMTX_WU_Timer_Value_HYBRID_SYSTEM_EPT1_FD11, handle-invalid=DONT-INVALIDATE
      data-element=COMTX_IMPACTCommand_IMPACT_INFO_FD11, handle-invalid=DONT-INVALIDATE
      data-element=COMTX_IMPACTConfirm_IMPACT_INFO_FD11, handle-invalid=DONT-INVALIDATE
      data-element=COMTX_TotalOdometer_IPC_FD_1_FD11, handle-invalid=DONT-INVALIDATE
      data-element=COMTX_MCPA_Temp_MCPA_DATA2_FD11, handle-invalid=KEEP
      data-element=COMTX_CRC_MCPA_STATUS_MCPA_STATUS_FD11, handle-invalid=DONT-INVALIDATE
      data-element=COMTX_MC_MCPA_STATUS_MCPA_STATUS_FD11, handle-invalid=DONT-INVALIDATE
      data-element=COMTX_MCPA_DC_Current_P_MCPA_STATUS_FD11, handle-invalid=DONT-INVALIDATE
      data-element=COMTX_MCPB_Temp_MCPB_DATA2_FD11, handle-invalid=KEEP
      data-element=COMTX_CRC_MCPB_STATUS_MCPB_STATUS_FD11, handle-invalid=DONT-INVALIDATE
      data-element=COMTX_MC_MCPB_STATUS_MCPB_STATUS_FD11, handle-invalid=DONT-INVALIDATE
      data-element=COMTX_MCPB_DC_Current_P_MCPB_STATUS_FD11, handle-invalid=DONT-INVALIDATE
      data-element=COMTX_CurrentCanNMState_FD03_EVCU2_PDC_INFO_FD_EVCU2_FD11, handle-invalid=DONT-INVALIDATE
      data-element=COMTX_CurrentCanNMState_FD05_EVCU2_PDC_INFO_FD_EVCU2_FD11, handle-invalid=DONT-INVALIDATE
      data-element=COMTX_CurrentCanNMState_FD11_EVCU2_PDC_INFO_FD_EVCU2_FD11, handle-invalid=DONT-INVALIDATE
      data-element=COMTX_CurrentCanNMState_FD16_EVCU2_PDC_INFO_FD_EVCU2_FD11, handle-invalid=DONT-INVALIDATE
      data-element=COMTX_CurrentFailSts_FD03_EVCU2_PDC_INFO_FD_EVCU2_FD11, handle-invalid=DONT-INVALIDATE
      data-element=COMTX_CurrentFailSts_FD05_EVCU2_PDC_INFO_FD_EVCU2_FD11, handle-invalid=DONT-INVALIDATE
      data-element=COMTX_CurrentFailSts_FD11_EVCU2_PDC_INFO_FD_EVCU2_FD11, handle-invalid=DONT-INVALIDATE
      data-element=COMTX_CurrentFailSts_FD16_EVCU2_PDC_INFO_FD_EVCU2_FD11, handle-invalid=DONT-INVALIDATE
      data-element=COMTX_DES_FD03_EVCU2_PDC_INFO_FD_EVCU2_FD11, handle-invalid=DONT-INVALIDATE
      data-element=COMTX_DES_FD05_EVCU2_PDC_INFO_FD_EVCU2_FD11, handle-invalid=DONT-INVALIDATE
      data-element=COMTX_DES_FD11_EVCU2_PDC_INFO_FD_EVCU2_FD11, handle-invalid=DONT-INVALIDATE
      data-element=COMTX_DES_FD16_EVCU2_PDC_INFO_FD_EVCU2_FD11, handle-invalid=DONT-INVALIDATE
      data-element=COMTX_EOL_FD03_EVCU2_PDC_INFO_FD_EVCU2_FD11, handle-invalid=DONT-INVALIDATE
      data-element=COMTX_EOL_FD05_EVCU2_PDC_INFO_FD_EVCU2_FD11, handle-invalid=DONT-INVALIDATE
      data-element=COMTX_EOL_FD11_EVCU2_PDC_INFO_FD_EVCU2_FD11, handle-invalid=DONT-INVALIDATE
      data-element=COMTX_EOL_FD16_EVCU2_PDC_INFO_FD_EVCU2_FD11, handle-invalid=DONT-INVALIDATE
      data-element=COMTX_GenericFailSts_FD03_EVCU2_PDC_INFO_FD_EVCU2_FD11, handle-invalid=DONT-INVALIDATE
      data-element=COMTX_GenericFailSts_FD05_EVCU2_PDC_INFO_FD_EVCU2_FD11, handle-invalid=DONT-INVALIDATE
      data-element=COMTX_GenericFailSts_FD11_EVCU2_PDC_INFO_FD_EVCU2_FD11, handle-invalid=DONT-INVALIDATE
      data-element=COMTX_GenericFailSts_FD16_EVCU2_PDC_INFO_FD_EVCU2_FD11, handle-invalid=DONT-INVALIDATE
      data-element=COMTX_PreviousCanNMState_FD03_EVCU2_PDC_INFO_FD_EVCU2_FD11, handle-invalid=DONT-INVALIDATE
      data-element=COMTX_PreviousCanNMState_FD05_EVCU2_PDC_INFO_FD_EVCU2_FD11, handle-invalid=DONT-INVALIDATE
      data-element=COMTX_PreviousCanNMState_FD11_EVCU2_PDC_INFO_FD_EVCU2_FD11, handle-invalid=DONT-INVALIDATE
      data-element=COMTX_PreviousCanNMState_FD16_EVCU2_PDC_INFO_FD_EVCU2_FD11, handle-invalid=DONT-INVALIDATE
      data-element=COMTX_StayActiveSource_FD03_EVCU2_PDC_INFO_FD_EVCU2_FD11, handle-invalid=DONT-INVALIDATE
      data-element=COMTX_StayActiveSource_FD05_EVCU2_PDC_INFO_FD_EVCU2_FD11, handle-invalid=DONT-INVALIDATE
      data-element=COMTX_StayActiveSource_FD11_EVCU2_PDC_INFO_FD_EVCU2_FD11, handle-invalid=DONT-INVALIDATE
      data-element=COMTX_StayActiveSource_FD16_EVCU2_PDC_INFO_FD_EVCU2_FD11, handle-invalid=DONT-INVALIDATE
      data-element=COMTX_WakeupSource_FD03_EVCU2_PDC_INFO_FD_EVCU2_FD11, handle-invalid=DONT-INVALIDATE
      data-element=COMTX_WakeupSource_FD05_EVCU2_PDC_INFO_FD_EVCU2_FD11, handle-invalid=DONT-INVALIDATE
      data-element=COMTX_WakeupSource_FD11_EVCU2_PDC_INFO_FD_EVCU2_FD11, handle-invalid=DONT-INVALIDATE
      data-element=COMTX_WakeupSource_FD16_EVCU2_PDC_INFO_FD_EVCU2_FD11, handle-invalid=DONT-INVALIDATE
      data-element=COMTX_DriveReady_PT_PT_SYSTEM_FD_1_FD11, handle-invalid=DONT-INVALIDATE
      data-element=COMTX_GearEngaged_PT_PT_SYSTEM_FD_1_FD11, handle-invalid=KEEP
      data-element=COMTX_GearEngagedForDisplay_PT_PT_SYSTEM_FD_1_FD11, handle-invalid=KEEP
      data-element=COMTX_PowertrainPrplsnActv_PT_PT_SYSTEM_FD_1_FD11, handle-invalid=DONT-INVALIDATE
      data-element=COMTX_SGCP_Temp_SGCP_DATA2_FD11, handle-invalid=KEEP
      data-element=COMTX_SGCP_DC_Current_P_SGCP_STATUS_FD11, handle-invalid=DONT-INVALIDATE
      data-element=COMTX_QualifyDriveCycle_SYNCHRO_DC_GLOBAL_FD11, handle-invalid=DONT-INVALIDATE
      data-element=COMTX_GPS_Date_Day_TELEMATIC_FD_1_FD11, handle-invalid=KEEP
      data-element=COMTX_GPS_Date_Month_TELEMATIC_FD_1_FD11, handle-invalid=KEEP
      data-element=COMTX_GPS_Date_Year_TELEMATIC_FD_1_FD11, handle-invalid=KEEP
      data-element=COMTX_GPS_UTC_Hour_TELEMATIC_FD_1_FD11, handle-invalid=KEEP
      data-element=COMTX_GPS_UTC_Minute_TELEMATIC_FD_1_FD11, handle-invalid=KEEP
      data-element=COMTX_GPS_UTC_Second_TELEMATIC_FD_1_FD11, handle-invalid=KEEP
      data-element=COMTX_GearEngagedForDisplay_TRANSM_FD_2_FD11, handle-invalid=KEEP
      data-element=COMTX_HVCMS_BulkChargingComplete_VDCM_OBCM_FD11, handle-invalid=DONT-INVALIDATE
      data-element=COMTX_HVCMS_ChargingComplete_VDCM_OBCM_FD11, handle-invalid=DONT-INVALIDATE
      data-element=COMTX_HVCMS_EVEnergyCapacity_VDCM_OBCM_FD11, handle-invalid=KEEP
      data-element=COMTX_HVCMS_EVEnergyRequest_VDCM_OBCM_FD11, handle-invalid=KEEP
      data-element=COMTX_HVCMS_EVErrorCode_VDCM_OBCM_FD11, handle-invalid=KEEP
      data-element=COMTX_HVCMS_EVMax_I_Limit_VDCM_OBCM_FD11, handle-invalid=KEEP
      data-element=COMTX_HVCMS_EVMax_P_Limit_VDCM_OBCM_FD11, handle-invalid=KEEP
      data-element=COMTX_HVCMS_EVMax_V_Limit_VDCM_OBCM_FD11, handle-invalid=KEEP
      data-element=COMTX_HVCMS_EVReady_VDCM_OBCM_FD11, handle-invalid=DONT-INVALIDATE
      data-element=COMTX_HVCMS_EVRESS_SOC_VDCM_OBCM_FD11, handle-invalid=KEEP
      data-element=COMTX_HVCMS_EVRESSConditioning_VDCM_OBCM_FD11, handle-invalid=DONT-INVALIDATE
      data-element=COMTX_HVCMS_EVTargetCurrent_VDCM_OBCM_FD11, handle-invalid=KEEP
      data-element=COMTX_HVCMS_EVTargetVoltage_VDCM_OBCM_FD11, handle-invalid=KEEP
      data-element=COMTX_HVCMS_Protocol_Entry{1..3}_VDCM_OBCM_FD11, handle-invalid=KEEP
      data-element=COMTX_HVCMS_ReadyToChargeState_VDCM_OBCM_FD11, handle-invalid=DONT-INVALIDATE
      data-element=COMTX_HVCMS_RemaningTimeToBulkSOC_VDCM_OBCM_FD11, handle-invalid=KEEP
      data-element=COMTX_HVCMS_RemaningTimeToFullSOC_VDCM_OBCM_FD11, handle-invalid=KEEP
      data-element=COMTX_HVCMS_SelectedEnergyTransferType_VDCM_OBCM_FD11, handle-invalid=KEEP
      data-element=COMTX_HVCMS_SelectedPaymentOptn_VDCM_OBCM_FD11, handle-invalid=KEEP
      data-element=COMTX_HVCMS_SelectedServiceId_VDCM_OBCM_FD11, handle-invalid=DONT-INVALIDATE
      data-element=COMTX_HVCMS_ServiceCategory_VDCM_OBCM_FD11, handle-invalid=KEEP
      data-element=COMTX_HVCMS_ServiceScope_VDCM_OBCM_FD11, handle-invalid=KEEP
      data-element=COMTX_OBCM_OutVoltageSyncTgt_VDCM_OBCM_FD11, handle-invalid=KEEP
      data-element=COMTX_V2X_HVCMS_SlctdEnergyTransfType_VDCM_OBCM_FD11, handle-invalid=DONT-INVALIDATE
      data-element=COMTX_VDCM_BattBulkSOC_VDCM_OBCM_FD11, handle-invalid=DONT-INVALIDATE
      data-element=COMTX_VDCM_ContractAuthenticationID_VDCM_OBCM_FD11, handle-invalid=DONT-INVALIDATE
      data-element=COMTX_VDCM_GenChallenge_VDCM_OBCM_FD11, handle-invalid=DONT-INVALIDATE
      data-element=COMTX_VDCM_OBCDischCurrentLim_VDCM_OBCM_FD11, handle-invalid=DONT-INVALIDATE
      data-element=COMTX_VDCM_TypeCNegotiationSts_VDCM_OBCM_FD11, handle-invalid=DONT-INVALIDATE
      data-element=COMTX_ClrLgsDiagInfo_VDCM_PWT3_FD11, handle-invalid=DONT-INVALIDATE
      data-element=COMTX_VIN_DATA_VIN_FD11, handle-invalid=DONT-INVALIDATE
      data-element=COMTX_VIN_MSG_VIN_FD11, handle-invalid=KEEP
