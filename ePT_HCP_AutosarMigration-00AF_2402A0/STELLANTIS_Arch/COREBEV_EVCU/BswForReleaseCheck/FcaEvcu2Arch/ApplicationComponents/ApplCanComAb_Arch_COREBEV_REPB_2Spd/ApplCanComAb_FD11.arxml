[part 2 of 3: package /STLASWCs]
AUTOSAR XML (schema 4-3-0)
package /STLASWCs  (continued)
  complex device driver sw component type ApplCanComAb_FD11  (continued)
    behavior IBApplCanComAb_FD11: data-type-mapping=ADTtoIDTMapping, handle-termination-and-restart=NO-SUPPORT  (continued)
      137 x data received event:
        DRESendCANR_CmdIgnSts_FD11: start-on-event=SendCANR_CmdIgnSts_FD11, data=SendCANR_CmdIgnSts_FD11.SendCANR_CmdIgnSts_FD11
        DRESendCANR_ExternTemperatureCFD11: start-on-event=SendCANR_ExternTemperatureCFD11, data=SendCANR_ExternTemperatureCFD11.SendCANR_ExternTemperatureCFD11
        DRESendCANR_OperationalModeStsFD11: start-on-event=SendCANR_OperationalModeStsFD11, data=SendCANR_OperationalModeStsFD11.SendCANR_OperationalModeStsFD11
        DRESendCANR_Battery_Volt_1_FD11: start-on-event=SendCANR_Battery_Volt_1_FD11, data=SendCANR_Battery_Volt_1_FD11.SendCANR_Battery_Volt_1_FD11
        DRESendCANR_IgnitionOnCounter_FD11: start-on-event=SendCANR_IgnitionOnCounter_FD11, data=SendCANR_IgnitionOnCounter_FD11.SendCANR_IgnitionOnCounter_FD11
        DRESendCANR_ExtTemp_FD11: start-on-event=SendCANR_ExtTemp_FD11, data=SendCANR_ExtTemp_FD11.SendCANR_ExtTemp_FD11
        DRESendCANR_VehicleSpeedVSOSigFD11: start-on-event=SendCANR_VehicleSpeedVSOSigFD11, data=SendCANR_VehicleSpeedVSOSigFD11.SendCANR_VehicleSpeedVSOSigFD11
        DRESendCANR_EPBSts_FD11: start-on-event=SendCANR_EPBSts_FD11, data=SendCANR_EPBSts_FD11.SendCANR_EPBSts_FD11
        DRESendCANR_EngineSpeed_W_FD11: start-on-event=SendCANR_EngineSpeed_W_FD11, data=SendCANR_EngineSpeed_W_FD11.SendCANR_EngineSpeed_W_FD11
        DRESendCANR_PtPrplsnActv_FD11: start-on-event=SendCANR_PtPrplsnActv_FD11, data=SendCANR_PtPrplsnActv_FD11.SendCANR_PtPrplsnActv_FD11
        DRESendCANR_BattVoltDeviationErr: start-on-event=SendCANR_BattVoltDeviationErr, data=SendCANR_BattVoltDeviationErr.SendCANR_BattVoltDeviationErr
        DRESendCANR_CdM_Chrgcurrentreqext: start-on-event=SendCANR_CdM_Chrgcurrentreqext, data=SendCANR_CdM_Chrgcurrentreqext.SendCANR_CdM_Chrgcurrentreqext
        DRESendCANR_CdMExtFunMinBattVolt: start-on-event=SendCANR_CdMExtFunMinBattVolt, data=SendCANR_CdMExtFunMinBattVolt.SendCANR_CdMExtFunMinBattVolt
        DRESendCANR_CdMExtFunVehDynCtrlCmp: start-on-event=SendCANR_CdMExtFunVehDynCtrlCmp, data=SendCANR_CdMExtFunVehDynCtrlCmp.SendCANR_CdMExtFunVehDynCtrlCmp
        DRESendCANR_CdM_ExtFunVehHCCntrCmp: start-on-event=SendCANR_CdM_ExtFunVehHCCntrCmp, data=SendCANR_CdM_ExtFunVehHCCntrCmp.SendCANR_CdM_ExtFunVehHCCntrCmp
        DRESendCANR_CdM_Reminedbattcpcity: start-on-event=SendCANR_CdM_Reminedbattcpcity, data=SendCANR_CdM_Reminedbattcpcity.SendCANR_CdM_Reminedbattcpcity
        DRESendCANR_CHAdeMOProtocol: start-on-event=SendCANR_CHAdeMOProtocol, data=SendCANR_CHAdeMOProtocol.SendCANR_CHAdeMOProtocol
        DRESendCANR_ChargedCurrentMin: start-on-event=SendCANR_ChargedCurrentMin, data=SendCANR_ChargedCurrentMin.SendCANR_ChargedCurrentMin
        DRESendCANR_ChrgdRefrncCnstnt: start-on-event=SendCANR_ChrgdRefrncCnstnt, data=SendCANR_ChrgdRefrncCnstnt.SendCANR_ChrgdRefrncCnstnt
        DRESendCANR_DisplaySOC: start-on-event=SendCANR_DisplaySOC, data=SendCANR_DisplaySOC.SendCANR_DisplaySOC
        DRESendCANR_EVContactorSts: start-on-event=SendCANR_EVContactorSts, data=SendCANR_EVContactorSts.SendCANR_EVContactorSts
        DRESendCANR_EVCU_CP3Cmd: start-on-event=SendCANR_EVCU_CP3Cmd, data=SendCANR_EVCU_CP3Cmd.SendCANR_EVCU_CP3Cmd
        DRESendCANR_MinBatteryPackVoltage: start-on-event=SendCANR_MinBatteryPackVoltage, data=SendCANR_MinBatteryPackVoltage.SendCANR_MinBatteryPackVoltage
        DRESendCANR_StopReqBeforeCharge: start-on-event=SendCANR_StopReqBeforeCharge, data=SendCANR_StopReqBeforeCharge.SendCANR_StopReqBeforeCharge
        DRESendCANR_TotalBatteryCapacity: start-on-event=SendCANR_TotalBatteryCapacity, data=SendCANR_TotalBatteryCapacity.SendCANR_TotalBatteryCapacity
        DRESendCANR_VehicleDriveSts: start-on-event=SendCANR_VehicleDriveSts, data=SendCANR_VehicleDriveSts.SendCANR_VehicleDriveSts
        DRESendCANR_N_PDU_7B_FD11: start-on-event=SendCANR_N_PDU_7B_FD11, data=SendCANR_N_PDU_7B_FD11.SendCANR_N_PDU_7B_FD11
        DRESendCANR_N_PDU_7C_FD11: start-on-event=SendCANR_N_PDU_7C_FD11, data=SendCANR_N_PDU_7C_FD11.SendCANR_N_PDU_7C_FD11
        DRESendCANR_N_PDU_86: start-on-event=SendCANR_N_PDU_86, data=SendCANR_N_PDU_86.SendCANR_N_PDU_86
        DRESendCANR_N_PDU_342_FD11: start-on-event=SendCANR_N_PDU_342_FD11, data=SendCANR_N_PDU_342_FD11.SendCANR_N_PDU_342_FD11
        DRESendCANR_CRC_HYBRID_DISPLAY2: start-on-event=SendCANR_CRC_HYBRID_DISPLAY2, data=SendCANR_CRC_HYBRID_DISPLAY2.SendCANR_CRC_HYBRID_DISPLAY2
        DRESendCANR_DischrgngSysStatusFD11: start-on-event=SendCANR_DischrgngSysStatusFD11, data=SendCANR_DischrgngSysStatusFD11.SendCANR_DischrgngSysStatusFD11
        DRESendCANR_LID_Status_120VSocketA: start-on-event=SendCANR_LID_Status_120VSocketA, data=SendCANR_LID_Status_120VSocketA.SendCANR_LID_Status_120VSocketA
        DRESendCANR_LID_Status_120VSocketB: start-on-event=SendCANR_LID_Status_120VSocketB, data=SendCANR_LID_Status_120VSocketB.SendCANR_LID_Status_120VSocketB
        DRESendCANR_LID_Status_240V_Socket: start-on-event=SendCANR_LID_Status_240V_Socket, data=SendCANR_LID_Status_240V_Socket.SendCANR_LID_Status_240V_Socket
        DRESendCANR_Max_AllwdACOutputCurL1: start-on-event=SendCANR_Max_AllwdACOutputCurL1, data=SendCANR_Max_AllwdACOutputCurL1.SendCANR_Max_AllwdACOutputCurL1
        DRESendCANR_Max_AllwdACOutputVltL1: start-on-event=SendCANR_Max_AllwdACOutputVltL1, data=SendCANR_Max_AllwdACOutputVltL1.SendCANR_Max_AllwdACOutputVltL1
        DRESendCANR_MC_HYBRID_DISPLAY2: start-on-event=SendCANR_MC_HYBRID_DISPLAY2, data=SendCANR_MC_HYBRID_DISPLAY2.SendCANR_MC_HYBRID_DISPLAY2
        DRESendCANR_CRC_HYBRID_SYSTEM_EPT1: start-on-event=SendCANR_CRC_HYBRID_SYSTEM_EPT1, data=SendCANR_CRC_HYBRID_SYSTEM_EPT1.SendCANR_CRC_HYBRID_SYSTEM_EPT1
        DRESendCANR_HCP_ShutdownCommand: start-on-event=SendCANR_HCP_ShutdownCommand, data=SendCANR_HCP_ShutdownCommand.SendCANR_HCP_ShutdownCommand
        DRESendCANR_HybridDriveModeSts: start-on-event=SendCANR_HybridDriveModeSts, data=SendCANR_HybridDriveModeSts.SendCANR_HybridDriveModeSts
        DRESendCANR_LOC_DiagEnable_ePT: start-on-event=SendCANR_LOC_DiagEnable_ePT, data=SendCANR_LOC_DiagEnable_ePT.SendCANR_LOC_DiagEnable_ePT
        DRESendCANR_MsgCtrHYB_SYSTEM_EPT1: start-on-event=SendCANR_MsgCtrHYB_SYSTEM_EPT1, data=SendCANR_MsgCtrHYB_SYSTEM_EPT1.SendCANR_MsgCtrHYB_SYSTEM_EPT1
        DRESendCANR_PerWakeUp_Diag_FD11: start-on-event=SendCANR_PerWakeUp_Diag_FD11, data=SendCANR_PerWakeUp_Diag_FD11.SendCANR_PerWakeUp_Diag_FD11
        DRESendCANR_PrplsnSysActive_10B: start-on-event=SendCANR_PrplsnSysActive_10B, data=SendCANR_PrplsnSysActive_10B.SendCANR_PrplsnSysActive_10B
        DRESendCANR_WU_Timer_Value_FD11: start-on-event=SendCANR_WU_Timer_Value_FD11, data=SendCANR_WU_Timer_Value_FD11.SendCANR_WU_Timer_Value_FD11
        DRESendCANR_IMPACTCommand_FD11: start-on-event=SendCANR_IMPACTCommand_FD11, data=SendCANR_IMPACTCommand_FD11.SendCANR_IMPACTCommand_FD11
        DRESendCANR_IMPACTConfirm_FD11: start-on-event=SendCANR_IMPACTConfirm_FD11, data=SendCANR_IMPACTConfirm_FD11.SendCANR_IMPACTConfirm_FD11
        DRESendCANR_TotalOdometer_FD11: start-on-event=SendCANR_TotalOdometer_FD11, data=SendCANR_TotalOdometer_FD11.SendCANR_TotalOdometer_FD11
        DRESendCANR_MCPA_Temp_FD11: start-on-event=SendCANR_MCPA_Temp_FD11, data=SendCANR_MCPA_Temp_FD11.SendCANR_MCPA_Temp_FD11
        DRESendCANR_CRC_MCPA_STATUS_FD11: start-on-event=SendCANR_CRC_MCPA_STATUS_FD11, data=SendCANR_CRC_MCPA_STATUS_FD11.SendCANR_CRC_MCPA_STATUS_FD11
        DRESendCANR_MC_MCPA_STATUS_FD11: start-on-event=SendCANR_MC_MCPA_STATUS_FD11, data=SendCANR_MC_MCPA_STATUS_FD11.SendCANR_MC_MCPA_STATUS_FD11
        DRESendCANR_MCPA_DC_Current_P_FD11: start-on-event=SendCANR_MCPA_DC_Current_P_FD11, data=SendCANR_MCPA_DC_Current_P_FD11.SendCANR_MCPA_DC_Current_P_FD11
        DRESendCANR_MCPB_Temp_FD11: start-on-event=SendCANR_MCPB_Temp_FD11, data=SendCANR_MCPB_Temp_FD11.SendCANR_MCPB_Temp_FD11
        DRESendCANR_CRC_MCPB_STATUS_FD11: start-on-event=SendCANR_CRC_MCPB_STATUS_FD11, data=SendCANR_CRC_MCPB_STATUS_FD11.SendCANR_CRC_MCPB_STATUS_FD11
        DRESendCANR_MC_MCPB_STATUS_FD11: start-on-event=SendCANR_MC_MCPB_STATUS_FD11, data=SendCANR_MC_MCPB_STATUS_FD11.SendCANR_MC_MCPB_STATUS_FD11
        DRESendCANR_MCPB_DC_Current_P_FD11: start-on-event=SendCANR_MCPB_DC_Current_P_FD11, data=SendCANR_MCPB_DC_Current_P_FD11.SendCANR_MCPB_DC_Current_P_FD11
        DRESendCANR_CrCanNMStFD03EVCU2FD11: start-on-event=SendCANR_CrCanNMStFD03EVCU2FD11, data=SendCANR_CrCanNMStFD03EVCU2FD11.SendCANR_CrCanNMStFD03EVCU2FD11
        DRESendCANR_CrCanNMStFD05EVCU2FD11: start-on-event=SendCANR_CrCanNMStFD05EVCU2FD11, data=SendCANR_CrCanNMStFD05EVCU2FD11.SendCANR_CrCanNMStFD05EVCU2FD11
        DRESendCANR_CrCanNMStFD11EVCU2FD11: start-on-event=SendCANR_CrCanNMStFD11EVCU2FD11, data=SendCANR_CrCanNMStFD11EVCU2FD11.SendCANR_CrCanNMStFD11EVCU2FD11
        DRESendCANR_CrCanNMStFD16EVCU2FD11: start-on-event=SendCANR_CrCanNMStFD16EVCU2FD11, data=SendCANR_CrCanNMStFD16EVCU2FD11.SendCANR_CrCanNMStFD16EVCU2FD11
        DRESendCANR_CurFailStFD03EVCU2FD11: start-on-event=SendCANR_CurFailStFD03EVCU2FD11, data=SendCANR_CurFailStFD03EVCU2FD11.SendCANR_CurFailStFD03EVCU2FD11
        DRESendCANR_CurFailStFD05EVCU2FD11: start-on-event=SendCANR_CurFailStFD05EVCU2FD11, data=SendCANR_CurFailStFD05EVCU2FD11.SendCANR_CurFailStFD05EVCU2FD11
        DRESendCANR_CurFailStFD11EVCU2FD11: start-on-event=SendCANR_CurFailStFD11EVCU2FD11, data=SendCANR_CurFailStFD11EVCU2FD11.SendCANR_CurFailStFD11EVCU2FD11
        DRESendCANR_CurFailStFD16EVCU2FD11: start-on-event=SendCANR_CurFailStFD16EVCU2FD11, data=SendCANR_CurFailStFD16EVCU2FD11.SendCANR_CurFailStFD16EVCU2FD11
        DRESendCANR_DES_FD03_EVCU2_FD11: start-on-event=SendCANR_DES_FD03_EVCU2_FD11, data=SendCANR_DES_FD03_EVCU2_FD11.SendCANR_DES_FD03_EVCU2_FD11
        DRESendCANR_DES_FD05_EVCU2_FD11: start-on-event=SendCANR_DES_FD05_EVCU2_FD11, data=SendCANR_DES_FD05_EVCU2_FD11.SendCANR_DES_FD05_EVCU2_FD11
        DRESendCANR_DES_FD11_EVCU2_FD11: start-on-event=SendCANR_DES_FD11_EVCU2_FD11, data=SendCANR_DES_FD11_EVCU2_FD11.SendCANR_DES_FD11_EVCU2_FD11
        DRESendCANR_DES_FD16_EVCU2_FD11: start-on-event=SendCANR_DES_FD16_EVCU2_FD11, data=SendCANR_DES_FD16_EVCU2_FD11.SendCANR_DES_FD16_EVCU2_FD11
        DRESendCANR_EOL_FD03_EVCU2_FD11: start-on-event=SendCANR_EOL_FD03_EVCU2_FD11, data=SendCANR_EOL_FD03_EVCU2_FD11.SendCANR_EOL_FD03_EVCU2_FD11
        DRESendCANR_EOL_FD05_EVCU2_FD11: start-on-event=SendCANR_EOL_FD05_EVCU2_FD11, data=SendCANR_EOL_FD05_EVCU2_FD11.SendCANR_EOL_FD05_EVCU2_FD11
        DRESendCANR_EOL_FD11_EVCU2_FD11: start-on-event=SendCANR_EOL_FD11_EVCU2_FD11, data=SendCANR_EOL_FD11_EVCU2_FD11.SendCANR_EOL_FD11_EVCU2_FD11
        DRESendCANR_EOL_FD16_EVCU2_FD11: start-on-event=SendCANR_EOL_FD16_EVCU2_FD11, data=SendCANR_EOL_FD16_EVCU2_FD11.SendCANR_EOL_FD16_EVCU2_FD11
        DRESendCANR_GenFailStFD03EVCU2FD11: start-on-event=SendCANR_GenFailStFD03EVCU2FD11, data=SendCANR_GenFailStFD03EVCU2FD11.SendCANR_GenFailStFD03EVCU2FD11
        DRESendCANR_GenFailStFD05EVCU2FD11: start-on-event=SendCANR_GenFailStFD05EVCU2FD11, data=SendCANR_GenFailStFD05EVCU2FD11.SendCANR_GenFailStFD05EVCU2FD11
        DRESendCANR_GenFailStFD11EVCU2FD11: start-on-event=SendCANR_GenFailStFD11EVCU2FD11, data=SendCANR_GenFailStFD11EVCU2FD11.SendCANR_GenFailStFD11EVCU2FD11
        DRESendCANR_GenFailStFD16EVCU2FD11: start-on-event=SendCANR_GenFailStFD16EVCU2FD11, data=SendCANR_GenFailStFD16EVCU2FD11.SendCANR_GenFailStFD16EVCU2FD11
        DRESendCANR_PvCanNMStFD03EVCU2FD11: start-on-event=SendCANR_PvCanNMStFD03EVCU2FD11, data=SendCANR_PvCanNMStFD03EVCU2FD11.SendCANR_PvCanNMStFD03EVCU2FD11
        DRESendCANR_PvCanNMStFD05EVCU2FD11: start-on-event=SendCANR_PvCanNMStFD05EVCU2FD11, data=SendCANR_PvCanNMStFD05EVCU2FD11.SendCANR_PvCanNMStFD05EVCU2FD11
        DRESendCANR_PvCanNMStFD11EVCU2FD11: start-on-event=SendCANR_PvCanNMStFD11EVCU2FD11, data=SendCANR_PvCanNMStFD11EVCU2FD11.SendCANR_PvCanNMStFD11EVCU2FD11
        DRESendCANR_PvCanNMStFD16EVCU2FD11: start-on-event=SendCANR_PvCanNMStFD16EVCU2FD11, data=SendCANR_PvCanNMStFD16EVCU2FD11.SendCANR_PvCanNMStFD16EVCU2FD11
        DRESendCANR_StyActSrcFD03EVCU2FD11: start-on-event=SendCANR_StyActSrcFD03EVCU2FD11, data=SendCANR_StyActSrcFD03EVCU2FD11.SendCANR_StyActSrcFD03EVCU2FD11
        DRESendCANR_StyActSrcFD05EVCU2FD11: start-on-event=SendCANR_StyActSrcFD05EVCU2FD11, data=SendCANR_StyActSrcFD05EVCU2FD11.SendCANR_StyActSrcFD05EVCU2FD11
        DRESendCANR_StyActSrcFD11EVCU2FD11: start-on-event=SendCANR_StyActSrcFD11EVCU2FD11, data=SendCANR_StyActSrcFD11EVCU2FD11.SendCANR_StyActSrcFD11EVCU2FD11
        DRESendCANR_StyActSrcFD16EVCU2FD11: start-on-event=SendCANR_StyActSrcFD16EVCU2FD11, data=SendCANR_StyActSrcFD16EVCU2FD11.SendCANR_StyActSrcFD16EVCU2FD11
        DRESendCANR_WkeupSrcFD03_EVCU2FD11: start-on-event=SendCANR_WkeupSrcFD03_EVCU2FD11, data=SendCANR_WkeupSrcFD03_EVCU2FD11.SendCANR_WkeupSrcFD03_EVCU2FD11
        DRESendCANR_WkeupSrcFD05_EVCU2FD11: start-on-event=SendCANR_WkeupSrcFD05_EVCU2FD11, data=SendCANR_WkeupSrcFD05_EVCU2FD11.SendCANR_WkeupSrcFD05_EVCU2FD11
        DRESendCANR_WkeupSrcFD11_EVCU2FD11: start-on-event=SendCANR_WkeupSrcFD11_EVCU2FD11, data=SendCANR_WkeupSrcFD11_EVCU2FD11.SendCANR_WkeupSrcFD11_EVCU2FD11
        DRESendCANR_WkeupSrcFD16_EVCU2FD11: start-on-event=SendCANR_WkeupSrcFD16_EVCU2FD11, data=SendCANR_WkeupSrcFD16_EVCU2FD11.SendCANR_WkeupSrcFD16_EVCU2FD11
        DRESendCANR_DriveReady_PT_FD11: start-on-event=SendCANR_DriveReady_PT_FD11, data=SendCANR_DriveReady_PT_FD11.SendCANR_DriveReady_PT_FD11
        DRESendCANR_GearEngaged_PT_FD11: start-on-event=SendCANR_GearEngaged_PT_FD11, data=SendCANR_GearEngaged_PT_FD11.SendCANR_GearEngaged_PT_FD11
        DRESendCANR_GearEngdForDispPTFD11: start-on-event=SendCANR_GearEngdForDispPTFD11, data=SendCANR_GearEngdForDispPTFD11.SendCANR_GearEngdForDispPTFD11
        DRESendCANR_PtrainPrplsnActvPTFD11: start-on-event=SendCANR_PtrainPrplsnActvPTFD11, data=SendCANR_PtrainPrplsnActvPTFD11.SendCANR_PtrainPrplsnActvPTFD11
        DRESendCANR_SGCP_Temp_FD11: start-on-event=SendCANR_SGCP_Temp_FD11, data=SendCANR_SGCP_Temp_FD11.SendCANR_SGCP_Temp_FD11
        DRESendCANR_SGCP_DC_Current_P_FD11: start-on-event=SendCANR_SGCP_DC_Current_P_FD11, data=SendCANR_SGCP_DC_Current_P_FD11.SendCANR_SGCP_DC_Current_P_FD11
        DRESendCANR_QualifyDriveCycle_FD11: start-on-event=SendCANR_QualifyDriveCycle_FD11, data=SendCANR_QualifyDriveCycle_FD11.SendCANR_QualifyDriveCycle_FD11
        DRESendCANR_GPS_Date_Day_FD11: start-on-event=SendCANR_GPS_Date_Day_FD11, data=SendCANR_GPS_Date_Day_FD11.SendCANR_GPS_Date_Day_FD11
        DRESendCANR_GPS_Date_Month_FD11: start-on-event=SendCANR_GPS_Date_Month_FD11, data=SendCANR_GPS_Date_Month_FD11.SendCANR_GPS_Date_Month_FD11
        DRESendCANR_GPS_Date_Year_FD11: start-on-event=SendCANR_GPS_Date_Year_FD11, data=SendCANR_GPS_Date_Year_FD11.SendCANR_GPS_Date_Year_FD11
        DRESendCANR_GPS_UTC_Hour_FD11: start-on-event=SendCANR_GPS_UTC_Hour_FD11, data=SendCANR_GPS_UTC_Hour_FD11.SendCANR_GPS_UTC_Hour_FD11
        DRESendCANR_GPS_UTC_Minute_FD11: start-on-event=SendCANR_GPS_UTC_Minute_FD11, data=SendCANR_GPS_UTC_Minute_FD11.SendCANR_GPS_UTC_Minute_FD11
        DRESendCANR_GPS_UTC_Second_FD11: start-on-event=SendCANR_GPS_UTC_Second_FD11, data=SendCANR_GPS_UTC_Second_FD11.SendCANR_GPS_UTC_Second_FD11
        DRESendCANR_GearEngagedForDisplay: start-on-event=SendCANR_GearEngagedForDisplay, data=SendCANR_GearEngagedForDisplay.SendCANR_GearEngagedForDisplay
        DRESendCANR_HVCMS_BulChrgnCmplFD11: start-on-event=SendCANR_HVCMS_BulChrgnCmplFD11, data=SendCANR_HVCMS_BulChrgnCmplFD11.SendCANR_HVCMS_BulChrgnCmplFD11
        DRESendCANR_HVCMS_ChrgnCmpl_FD11: start-on-event=SendCANR_HVCMS_ChrgnCmpl_FD11, data=SendCANR_HVCMS_ChrgnCmpl_FD11.SendCANR_HVCMS_ChrgnCmpl_FD11
        DRESendCANR_HVCMS_EVEgyCap_FD11: start-on-event=SendCANR_HVCMS_EVEgyCap_FD11, data=SendCANR_HVCMS_EVEgyCap_FD11.SendCANR_HVCMS_EVEgyCap_FD11
        DRESendCANR_HVCMS_EVEgyReq_FD11: start-on-event=SendCANR_HVCMS_EVEgyReq_FD11, data=SendCANR_HVCMS_EVEgyReq_FD11.SendCANR_HVCMS_EVEgyReq_FD11
        DRESendCANR_HVCMS_EVErrorCode_FD11: start-on-event=SendCANR_HVCMS_EVErrorCode_FD11, data=SendCANR_HVCMS_EVErrorCode_FD11.SendCANR_HVCMS_EVErrorCode_FD11
        DRESendCANR_HVCMS_EVMaxILimit_FD11: start-on-event=SendCANR_HVCMS_EVMaxILimit_FD11, data=SendCANR_HVCMS_EVMaxILimit_FD11.SendCANR_HVCMS_EVMaxILimit_FD11
        DRESendCANR_HVCMS_EVMaxPLimit_FD11: start-on-event=SendCANR_HVCMS_EVMaxPLimit_FD11, data=SendCANR_HVCMS_EVMaxPLimit_FD11.SendCANR_HVCMS_EVMaxPLimit_FD11
        DRESendCANR_HVCMSEVMaxVLimit_FD11: start-on-event=SendCANR_HVCMSEVMaxVLimit_FD11, data=SendCANR_HVCMSEVMaxVLimit_FD11.SendCANR_HVCMSEVMaxVLimit_FD11
        DRESendCANR_HVCMS_EVReady_FD11: start-on-event=SendCANR_HVCMS_EVReady_FD11, data=SendCANR_HVCMS_EVReady_FD11.SendCANR_HVCMS_EVReady_FD11
        DRESendCANR_HVCMS_EVRESS_SOC_FD11: start-on-event=SendCANR_HVCMS_EVRESS_SOC_FD11, data=SendCANR_HVCMS_EVRESS_SOC_FD11.SendCANR_HVCMS_EVRESS_SOC_FD11
        DRESendCANR_HVCMS_EVRESSCdng_FD11: start-on-event=SendCANR_HVCMS_EVRESSCdng_FD11, data=SendCANR_HVCMS_EVRESSCdng_FD11.SendCANR_HVCMS_EVRESSCdng_FD11
        DRESendCANR_HVCMS_EVTarCurr_FD11: start-on-event=SendCANR_HVCMS_EVTarCurr_FD11, data=SendCANR_HVCMS_EVTarCurr_FD11.SendCANR_HVCMS_EVTarCurr_FD11
        DRESendCANR_HVCMS_EVTarVolt_FD11: start-on-event=SendCANR_HVCMS_EVTarVolt_FD11, data=SendCANR_HVCMS_EVTarVolt_FD11.SendCANR_HVCMS_EVTarVolt_FD11
        DRESendCANR_HVCMS_PrtclEntry{1..3}_FD11: start-on-event=SendCANR_HVCMS_PrtclEntry{1..3}_FD11, data=SendCANR_HVCMS_PrtclEntry{1..3}_FD11.SendCANR_HVCMS_PrtclEntry{1..3}_FD11
        DRESendCANR_HVCMS_RdyToChrgSt_FD11: start-on-event=SendCANR_HVCMS_RdyToChrgSt_FD11, data=SendCANR_HVCMS_RdyToChrgSt_FD11.SendCANR_HVCMS_RdyToChrgSt_FD11
        DRESendCANR_HVCMS_RmnTiToBuSOCFD11: start-on-event=SendCANR_HVCMS_RmnTiToBuSOCFD11, data=SendCANR_HVCMS_RmnTiToBuSOCFD11.SendCANR_HVCMS_RmnTiToBuSOCFD11
        DRESendCANR_HVCMS_RmnTiToFuSOCFD11: start-on-event=SendCANR_HVCMS_RmnTiToFuSOCFD11, data=SendCANR_HVCMS_RmnTiToFuSOCFD11.SendCANR_HVCMS_RmnTiToFuSOCFD11
        DRESendCANR_HVCMS_SelEgyTrfTypFD11: start-on-event=SendCANR_HVCMS_SelEgyTrfTypFD11, data=SendCANR_HVCMS_SelEgyTrfTypFD11.SendCANR_HVCMS_SelEgyTrfTypFD11
        DRESendCANR_HVCMS_SelPmtOptn_FD11: start-on-event=SendCANR_HVCMS_SelPmtOptn_FD11, data=SendCANR_HVCMS_SelPmtOptn_FD11.SendCANR_HVCMS_SelPmtOptn_FD11
        DRESendCANR_HVCMS_SelServId_FD11: start-on-event=SendCANR_HVCMS_SelServId_FD11, data=SendCANR_HVCMS_SelServId_FD11.SendCANR_HVCMS_SelServId_FD11
        DRESendCANR_HVCMS_ServCtgy_FD11: start-on-event=SendCANR_HVCMS_ServCtgy_FD11, data=SendCANR_HVCMS_ServCtgy_FD11.SendCANR_HVCMS_ServCtgy_FD11
        DRESendCANR_HVCMS_ServScope_FD11: start-on-event=SendCANR_HVCMS_ServScope_FD11, data=SendCANR_HVCMS_ServScope_FD11.SendCANR_HVCMS_ServScope_FD11
        DRESendCANR_OBCMOutVoltSyncTgtFD11: start-on-event=SendCANR_OBCMOutVoltSyncTgtFD11, data=SendCANR_OBCMOutVoltSyncTgtFD11.SendCANR_OBCMOutVoltSyncTgtFD11
        DRESendCANR_V2X_HVCMSSltdEngTrfTyp: start-on-event=SendCANR_V2X_HVCMSSltdEngTrfTyp, data=SendCANR_V2X_HVCMSSltdEngTrfTyp.SendCANR_V2X_HVCMSSltdEngTrfTyp
        DRESendCANR_VDCM_BattBulkSOC_FD11: start-on-event=SendCANR_VDCM_BattBulkSOC_FD11, data=SendCANR_VDCM_BattBulkSOC_FD11.SendCANR_VDCM_BattBulkSOC_FD11
        DRESendCANR_VDCMCntrtAuthentIDFD11: start-on-event=SendCANR_VDCMCntrtAuthentIDFD11, data=SendCANR_VDCMCntrtAuthentIDFD11.SendCANR_VDCMCntrtAuthentIDFD11
        DRESendCANR_VDCM_GenChallenge_FD11: start-on-event=SendCANR_VDCM_GenChallenge_FD11, data=SendCANR_VDCM_GenChallenge_FD11.SendCANR_VDCM_GenChallenge_FD11
        DRESendCANR_VDCMOBCDchaCurrLimFD11: start-on-event=SendCANR_VDCMOBCDchaCurrLimFD11, data=SendCANR_VDCMOBCDchaCurrLimFD11.SendCANR_VDCMOBCDchaCurrLimFD11
        DRESendCANR_VDCMTypeCNegotnStsFD11: start-on-event=SendCANR_VDCMTypeCNegotnStsFD11, data=SendCANR_VDCMTypeCNegotnStsFD11.SendCANR_VDCMTypeCNegotnStsFD11
        DRESendCANR_ClrLgsDiagInfo_FD11: start-on-event=SendCANR_ClrLgsDiagInfo_FD11, data=SendCANR_ClrLgsDiagInfo_FD11.SendCANR_ClrLgsDiagInfo_FD11
        DRESendCANR_VIN_DATA_FD11: start-on-event=SendCANR_VIN_DATA_FD11, data=SendCANR_VIN_DATA_FD11.SendCANR_VIN_DATA_FD11
        DRESendCANR_VIN_MSG_FD11: start-on-event=SendCANR_VIN_MSG_FD11, data=SendCANR_VIN_MSG_FD11.SendCANR_VIN_MSG_FD11
      310 x runnable:
        ApplCanComAb_FD11Inin: symbol=ApplCanComAb_FD11_ApplCanComAb_FD11Inin  # CAN SWC initialization runnable
          data-send-points:
            22 x access:
              DSP_VeRxPDU_RPF_FD_2_FD11_E2E_Sts_E2ECheckSts: accessed-variable=VeRxPDU_RPF_FD_2_FD11_E2E_Sts.E2ECheckSts
              DSP_VeRxPDU_RPF_FD_2_FD11_E2E_Sts_OpRetVal: accessed-variable=VeRxPDU_RPF_FD_2_FD11_E2E_Sts.OpRetVal
              DSP_VeRxPDU_RPF_FD_1_FD11_E2E_Sts_E2ECheckSts: accessed-variable=VeRxPDU_RPF_FD_1_FD11_E2E_Sts.E2ECheckSts
              DSP_VeRxPDU_RPF_FD_1_FD11_E2E_Sts_OpRetVal: accessed-variable=VeRxPDU_RPF_FD_1_FD11_E2E_Sts.OpRetVal
              DSP_VeRxPDU_OBCM_VDCM2_FD11_E2E_Sts_E2ECheckSts: accessed-variable=VeRxPDU_OBCM_VDCM2_FD11_E2E_Sts.E2ECheckSts
              DSP_VeRxPDU_OBCM_VDCM2_FD11_E2E_Sts_OpRetVal: accessed-variable=VeRxPDU_OBCM_VDCM2_FD11_E2E_Sts.OpRetVal
              DSP_VeRxPDU_OBCM_VDCM_FD11_E2E_Sts_E2ECheckSts: accessed-variable=VeRxPDU_OBCM_VDCM_FD11_E2E_Sts.E2ECheckSts
              DSP_VeRxPDU_OBCM_VDCM_FD11_E2E_Sts_OpRetVal: accessed-variable=VeRxPDU_OBCM_VDCM_FD11_E2E_Sts.OpRetVal
              DSP_VeRxPDU_IDCM_ISO15118_STATUS1_FD11_E2E_Sts_E2ECheckSts: accessed-variable=VeRxPDU_IDCM_ISO15118_STATUS1_FD11_E2E_Sts.E2ECheckSts
              DSP_VeRxPDU_IDCM_ISO15118_STATUS1_FD11_E2E_Sts_OpRetVal: accessed-variable=VeRxPDU_IDCM_ISO15118_STATUS1_FD11_E2E_Sts.OpRetVal
              DSP_VeRxPDU_HV_CHARGER2_FD11_E2E_Sts_E2ECheckSts: accessed-variable=VeRxPDU_HV_CHARGER2_FD11_E2E_Sts.E2ECheckSts
              DSP_VeRxPDU_HV_CHARGER2_FD11_E2E_Sts_OpRetVal: accessed-variable=VeRxPDU_HV_CHARGER2_FD11_E2E_Sts.OpRetVal
              DSP_VeRxPDU_HV_CHARGER1_FD11_E2E_Sts_E2ECheckSts: accessed-variable=VeRxPDU_HV_CHARGER1_FD11_E2E_Sts.E2ECheckSts
              DSP_VeRxPDU_HV_CHARGER1_FD11_E2E_Sts_OpRetVal: accessed-variable=VeRxPDU_HV_CHARGER1_FD11_E2E_Sts.OpRetVal
              DSP_VeRxPDU_BATTERY_HV_VLIMITS_FD11_E2E_Sts_E2ECheckSts: accessed-variable=VeRxPDU_BATTERY_HV_VLIMITS_FD11_E2E_Sts.E2ECheckSts
              DSP_VeRxPDU_BATTERY_HV_VLIMITS_FD11_E2E_Sts_OpRetVal: accessed-variable=VeRxPDU_BATTERY_HV_VLIMITS_FD11_E2E_Sts.OpRetVal
              DSP_VeRxPDU_BATTERY_HV_STATUS1_FD11_E2E_Sts_E2ECheckSts: accessed-variable=VeRxPDU_BATTERY_HV_STATUS1_FD11_E2E_Sts.E2ECheckSts
              DSP_VeRxPDU_BATTERY_HV_STATUS1_FD11_E2E_Sts_OpRetVal: accessed-variable=VeRxPDU_BATTERY_HV_STATUS1_FD11_E2E_Sts.OpRetVal
              DSP_VeRxPDU_BATTERY_HV_POWERLIMITS_FD11_E2E_Sts_E2ECheckSts: accessed-variable=VeRxPDU_BATTERY_HV_POWERLIMITS_FD11_E2E_Sts.E2ECheckSts
              DSP_VeRxPDU_BATTERY_HV_POWERLIMITS_FD11_E2E_Sts_OpRetVal: accessed-variable=VeRxPDU_BATTERY_HV_POWERLIMITS_FD11_E2E_Sts.OpRetVal
              DSP_VeRxPDU_APM_VDCM_FD11_E2E_Sts_E2ECheckSts: accessed-variable=VeRxPDU_APM_VDCM_FD11_E2E_Sts.E2ECheckSts
              DSP_VeRxPDU_APM_VDCM_FD11_E2E_Sts_OpRetVal: accessed-variable=VeRxPDU_APM_VDCM_FD11_E2E_Sts.OpRetVal
          39 x parameter access:
            SCPVA_KeCANR_b_ComTxMsg_BCM_FD_10_FD11_Enbld: accessed-parameter=KeCANR_b_ComTxMsg_BCM_FD_10_FD11_Enbld
            SCPVA_KeCANR_b_ComTxMsg_BCM_FD_2_FD11_Enbld: accessed-parameter=KeCANR_b_ComTxMsg_BCM_FD_2_FD11_Enbld
            SCPVA_KeCANR_b_ComTxMsg_BCM_FD_3_FD11_Enbld: accessed-parameter=KeCANR_b_ComTxMsg_BCM_FD_3_FD11_Enbld
            SCPVA_KeCANR_b_ComTxMsg_BCM_FD_7_FD11_Enbld: accessed-parameter=KeCANR_b_ComTxMsg_BCM_FD_7_FD11_Enbld
            SCPVA_KeCANR_b_ComTxMsg_BCM_FD_9_FD11_Enbld: accessed-parameter=KeCANR_b_ComTxMsg_BCM_FD_9_FD11_Enbld
            SCPVA_KeCANR_b_ComTxMsg_BRAKE_FD_2_FD11_Enbld: accessed-parameter=KeCANR_b_ComTxMsg_BRAKE_FD_2_FD11_Enbld
            SCPVA_KeCANR_b_ComTxMsg_BRAKE_FD_4_FD11_Enbld: accessed-parameter=KeCANR_b_ComTxMsg_BRAKE_FD_4_FD11_Enbld
            SCPVA_KeCANR_b_ComTxMsg_ENGINE_FD_2_FD11_Enbld: accessed-parameter=KeCANR_b_ComTxMsg_ENGINE_FD_2_FD11_Enbld
            SCPVA_KeCANR_b_ComTxMsg_EVCU_CHADEMO_STATUS1_FD11_Enbld: accessed-parameter=KeCANR_b_ComTxMsg_EVCU_CHADEMO_STATUS1_FD11_Enbld
            SCPVA_KeCANR_b_ComTxMsg_EVCU_ISO15118_STATUS1_FD11_Enbld: accessed-parameter=KeCANR_b_ComTxMsg_EVCU_ISO15118_STATUS1_FD11_Enbld
            SCPVA_KeCANR_b_ComTxMsg_GLIWA_MCPA_TX_FD11_Enbld: accessed-parameter=KeCANR_b_ComTxMsg_GLIWA_MCPA_TX_FD11_Enbld
            SCPVA_KeCANR_b_ComTxMsg_GLIWA_MCPB_TX_FD11_Enbld: accessed-parameter=KeCANR_b_ComTxMsg_GLIWA_MCPB_TX_FD11_Enbld
            SCPVA_KeCANR_b_ComTxMsg_GLIWA_SGCP_TX_FD11_Enbld: accessed-parameter=KeCANR_b_ComTxMsg_GLIWA_SGCP_TX_FD11_Enbld
            SCPVA_KeCANR_b_ComTxMsg_GLIWA_T1_TX_FD11_Enbld: accessed-parameter=KeCANR_b_ComTxMsg_GLIWA_T1_TX_FD11_Enbld
            SCPVA_KeCANR_b_ComTxMsg_HYBRID_CHARGING_COMMAND_FD11_Enbld: accessed-parameter=KeCANR_b_ComTxMsg_HYBRID_CHARGING_COMMAND_FD11_Enbld
            SCPVA_KeCANR_b_ComTxMsg_HYBRID_CHARGING_STATUS_FD11_Enbld: accessed-parameter=KeCANR_b_ComTxMsg_HYBRID_CHARGING_STATUS_FD11_Enbld
            SCPVA_KeCANR_b_ComTxMsg_HYBRID_DISPLAY2_FD11_Enbld: accessed-parameter=KeCANR_b_ComTxMsg_HYBRID_DISPLAY2_FD11_Enbld
            SCPVA_KeCANR_b_ComTxMsg_HYBRID_POWERTRAIN1_FD11_Enbld: accessed-parameter=KeCANR_b_ComTxMsg_HYBRID_POWERTRAIN1_FD11_Enbld
            SCPVA_KeCANR_b_ComTxMsg_HYBRID_SYSTEM_EPT1_FD11_Enbld: accessed-parameter=KeCANR_b_ComTxMsg_HYBRID_SYSTEM_EPT1_FD11_Enbld
            SCPVA_KeCANR_b_ComTxMsg_IMPACT_INFO_FD11_Enbld: accessed-parameter=KeCANR_b_ComTxMsg_IMPACT_INFO_FD11_Enbld
            SCPVA_KeCANR_b_ComTxMsg_IPC_FD_1_FD11_Enbld: accessed-parameter=KeCANR_b_ComTxMsg_IPC_FD_1_FD11_Enbld
            SCPVA_KeCANR_b_ComTxMsg_MCPA_DATA2_FD11_Enbld: accessed-parameter=KeCANR_b_ComTxMsg_MCPA_DATA2_FD11_Enbld
            SCPVA_KeCANR_b_ComTxMsg_MCPA_STATUS_FD11_Enbld: accessed-parameter=KeCANR_b_ComTxMsg_MCPA_STATUS_FD11_Enbld
            SCPVA_KeCANR_b_ComTxMsg_MCPB_DATA2_FD11_Enbld: accessed-parameter=KeCANR_b_ComTxMsg_MCPB_DATA2_FD11_Enbld
            SCPVA_KeCANR_b_ComTxMsg_MCPB_STATUS_FD11_Enbld: accessed-parameter=KeCANR_b_ComTxMsg_MCPB_STATUS_FD11_Enbld
            SCPVA_KeCANR_b_ComTxMsg_PDC_INFO_FD_EVCU2_FD11_Enbld: accessed-parameter=KeCANR_b_ComTxMsg_PDC_INFO_FD_EVCU2_FD11_Enbld
            SCPVA_KeCANR_b_ComTxMsg_PT_ENERGY_FD_1_FD11_Enbld: accessed-parameter=KeCANR_b_ComTxMsg_PT_ENERGY_FD_1_FD11_Enbld
            SCPVA_KeCANR_b_ComTxMsg_PT_SYSTEM_FD_1_FD11_Enbld: accessed-parameter=KeCANR_b_ComTxMsg_PT_SYSTEM_FD_1_FD11_Enbld
            SCPVA_KeCANR_b_ComTxMsg_RPF_FD_3_FD11_Enbld: accessed-parameter=KeCANR_b_ComTxMsg_RPF_FD_3_FD11_Enbld
            SCPVA_KeCANR_b_ComTxMsg_SGCP_DATA2_FD11_Enbld: accessed-parameter=KeCANR_b_ComTxMsg_SGCP_DATA2_FD11_Enbld
            SCPVA_KeCANR_b_ComTxMsg_SGCP_STATUS_FD11_Enbld: accessed-parameter=KeCANR_b_ComTxMsg_SGCP_STATUS_FD11_Enbld
            SCPVA_KeCANR_b_ComTxMsg_SYNCHRO_DC_GLOBAL_FD11_Enbld: accessed-parameter=KeCANR_b_ComTxMsg_SYNCHRO_DC_GLOBAL_FD11_Enbld
            SCPVA_KeCANR_b_ComTxMsg_TELEMATIC_FD_1_FD11_Enbld: accessed-parameter=KeCANR_b_ComTxMsg_TELEMATIC_FD_1_FD11_Enbld
            SCPVA_KeCANR_b_ComTxMsg_TRANSM_FD_2_FD11_Enbld: accessed-parameter=KeCANR_b_ComTxMsg_TRANSM_FD_2_FD11_Enbld
            SCPVA_KeCANR_b_ComTxMsg_VDCM_OBCM_FD11_Enbld: accessed-parameter=KeCANR_b_ComTxMsg_VDCM_OBCM_FD11_Enbld
            SCPVA_KeCANR_b_ComTxMsg_VDCM_OBCM2_FD11_Enbld: accessed-parameter=KeCANR_b_ComTxMsg_VDCM_OBCM2_FD11_Enbld
            SCPVA_KeCANR_b_ComTxMsg_VDCM_PWT3_FD11_Enbld: accessed-parameter=KeCANR_b_ComTxMsg_VDCM_PWT3_FD11_Enbld
            SCPVA_KeCANR_b_ComTxMsg_VIN_FD11_Enbld: accessed-parameter=KeCANR_b_ComTxMsg_VIN_FD11_Enbld
            SCPVA_KeCANR_b_ComTxMsg_CFG_DATA_CODE_REQUEST_FD11_Enbld: accessed-parameter=KeCANR_b_ComTxMsg_CFG_DATA_CODE_REQUEST_FD11_Enbld
        COMRX_APM2_BoostSwitchSts_APM2_VDCM_FD11_Received: symbol=ApplCanComAb_FD11_COMRX_APM2_BoostSwitchSts_APM2_VDCM_FD11_Received  # Received
          data-receive-point-by-arguments:
            access DRP_CanCom_FD11RxSignalsSR_COMRX_APM2_BoostSwitchSts_APM2_VDCM_FD11: accessed-variable=CanCom_FD11RxSignalsSR.COMRX_APM2_BoostSwitchSts_APM2_VDCM_FD11
          data-send-points:
            access DSP_VeCANR_b_APM2_BoostSwitchSts_VeCANR_b_APM2_BoostSwitchSts: accessed-variable=VeCANR_b_APM2_BoostSwitchSts.VeCANR_b_APM2_BoostSwitchSts
            access DSP_VeCANR_b_APM2_BoostSwitchStsTO_VeCANR_b_APM2_BoostSwitchStsTO: accessed-variable=VeCANR_b_APM2_BoostSwitchStsTO.VeCANR_b_APM2_BoostSwitchStsTO
        COMRX_APM2_BoostSwitchSts_APM2_VDCM_FD11_Error: symbol=ApplCanComAb_FD11_COMRX_APM2_BoostSwitchSts_APM2_VDCM_FD11_Error  # Error
          data-receive-point-by-arguments:
            access DRP_CanCom_FD11RxSignalsSR_COMRX_APM2_BoostSwitchSts_APM2_VDCM_FD11: accessed-variable=CanCom_FD11RxSignalsSR.COMRX_APM2_BoostSwitchSts_APM2_VDCM_FD11
          data-send-points:
            access DSP_VeCANR_b_APM2_BoostSwitchSts_VeCANR_b_APM2_BoostSwitchSts: accessed-variable=VeCANR_b_APM2_BoostSwitchSts.VeCANR_b_APM2_BoostSwitchSts
            access DSP_VeCANR_b_APM2_BoostSwitchStsTO_VeCANR_b_APM2_BoostSwitchStsTO: accessed-variable=VeCANR_b_APM2_BoostSwitchStsTO.VeCANR_b_APM2_BoostSwitchStsTO
        COMRX_APM2_ContactorFault_APM2_VDCM_FD11_Received: symbol=ApplCanComAb_FD11_COMRX_APM2_ContactorFault_APM2_VDCM_FD11_Received  # Received
          data-receive-point-by-arguments:
            access DRP_CanCom_FD11RxSignalsSR_COMRX_APM2_ContactorFault_APM2_VDCM_FD11: accessed-variable=CanCom_FD11RxSignalsSR.COMRX_APM2_ContactorFault_APM2_VDCM_FD11
          data-send-points:
            access DSP_VeCANR_e_APM2_ContactorFault_VeCANR_e_APM2_ContactorFault: accessed-variable=VeCANR_e_APM2_ContactorFault.VeCANR_e_APM2_ContactorFault
            access DSP_VeCANR_b_APM2_ContactorFaultTO_VeCANR_b_APM2_ContactorFaultTO: accessed-variable=VeCANR_b_APM2_ContactorFaultTO.VeCANR_b_APM2_ContactorFaultTO
        COMRX_APM2_ContactorFault_APM2_VDCM_FD11_Error: symbol=ApplCanComAb_FD11_COMRX_APM2_ContactorFault_APM2_VDCM_FD11_Error  # Error
          data-receive-point-by-arguments:
            access DRP_CanCom_FD11RxSignalsSR_COMRX_APM2_ContactorFault_APM2_VDCM_FD11: accessed-variable=CanCom_FD11RxSignalsSR.COMRX_APM2_ContactorFault_APM2_VDCM_FD11
          data-send-points:
            access DSP_VeCANR_e_APM2_ContactorFault_VeCANR_e_APM2_ContactorFault: accessed-variable=VeCANR_e_APM2_ContactorFault.VeCANR_e_APM2_ContactorFault
            access DSP_VeCANR_b_APM2_ContactorFaultTO_VeCANR_b_APM2_ContactorFaultTO: accessed-variable=VeCANR_b_APM2_ContactorFaultTO.VeCANR_b_APM2_ContactorFaultTO
        COMRX_APM2_DcChEnaSts_Fdbk_APM2_VDCM_FD11_Received: symbol=ApplCanComAb_FD11_COMRX_APM2_DcChEnaSts_Fdbk_APM2_VDCM_FD11_Received  # Received
          data-receive-point-by-arguments:
            access DRP_CanCom_FD11RxSignalsSR_COMRX_APM2_DcChEnaSts_Fdbk_APM2_VDCM_FD11: accessed-variable=CanCom_FD11RxSignalsSR.COMRX_APM2_DcChEnaSts_Fdbk_APM2_VDCM_FD11
          data-send-points:
            access DSP_VeCANR_b_APM2_DcChEnaSts_Fdbk_VeCANR_b_APM2_DcChEnaSts_Fdbk: accessed-variable=VeCANR_b_APM2_DcChEnaSts_Fdbk.VeCANR_b_APM2_DcChEnaSts_Fdbk
            access DSP_VeCANR_b_APM2_DcChEnaSts_FdbkTO_VeCANR_b_APM2_DcChEnaSts_FdbkTO: accessed-variable=VeCANR_b_APM2_DcChEnaSts_FdbkTO.VeCANR_b_APM2_DcChEnaSts_FdbkTO
        COMRX_APM2_DcChEnaSts_Fdbk_APM2_VDCM_FD11_Error: symbol=ApplCanComAb_FD11_COMRX_APM2_DcChEnaSts_Fdbk_APM2_VDCM_FD11_Error  # Error
          data-receive-point-by-arguments:
            access DRP_CanCom_FD11RxSignalsSR_COMRX_APM2_DcChEnaSts_Fdbk_APM2_VDCM_FD11: accessed-variable=CanCom_FD11RxSignalsSR.COMRX_APM2_DcChEnaSts_Fdbk_APM2_VDCM_FD11
          data-send-points:
            access DSP_VeCANR_b_APM2_DcChEnaSts_Fdbk_VeCANR_b_APM2_DcChEnaSts_Fdbk: accessed-variable=VeCANR_b_APM2_DcChEnaSts_Fdbk.VeCANR_b_APM2_DcChEnaSts_Fdbk
            access DSP_VeCANR_b_APM2_DcChEnaSts_FdbkTO_VeCANR_b_APM2_DcChEnaSts_FdbkTO: accessed-variable=VeCANR_b_APM2_DcChEnaSts_FdbkTO.VeCANR_b_APM2_DcChEnaSts_FdbkTO
        COMRX_APM2_DeratRsnSts_APM2_VDCM_FD11_Received: symbol=ApplCanComAb_FD11_COMRX_APM2_DeratRsnSts_APM2_VDCM_FD11_Received  # Received
          data-receive-point-by-arguments:
            access DRP_CanCom_FD11RxSignalsSR_COMRX_APM2_DeratRsnSts_APM2_VDCM_FD11: accessed-variable=CanCom_FD11RxSignalsSR.COMRX_APM2_DeratRsnSts_APM2_VDCM_FD11
          data-send-points:
            access DSP_VeCANR_e_APM2_DeratRsnSts_VeCANR_e_APM2_DeratRsnSts: accessed-variable=VeCANR_e_APM2_DeratRsnSts.VeCANR_e_APM2_DeratRsnSts
            access DSP_VeCANR_b_APM2_DeratRsnStsTO_VeCANR_b_APM2_DeratRsnStsTO: accessed-variable=VeCANR_b_APM2_DeratRsnStsTO.VeCANR_b_APM2_DeratRsnStsTO
        COMRX_APM2_DeratRsnSts_APM2_VDCM_FD11_Error: symbol=ApplCanComAb_FD11_COMRX_APM2_DeratRsnSts_APM2_VDCM_FD11_Error  # Error
          data-receive-point-by-arguments:
            access DRP_CanCom_FD11RxSignalsSR_COMRX_APM2_DeratRsnSts_APM2_VDCM_FD11: accessed-variable=CanCom_FD11RxSignalsSR.COMRX_APM2_DeratRsnSts_APM2_VDCM_FD11
          data-send-points:
            access DSP_VeCANR_e_APM2_DeratRsnSts_VeCANR_e_APM2_DeratRsnSts: accessed-variable=VeCANR_e_APM2_DeratRsnSts.VeCANR_e_APM2_DeratRsnSts
            access DSP_VeCANR_b_APM2_DeratRsnStsTO_VeCANR_b_APM2_DeratRsnStsTO: accessed-variable=VeCANR_b_APM2_DeratRsnStsTO.VeCANR_b_APM2_DeratRsnStsTO
        COMRX_APM2_DisChargedSts_Fdbk_APM2_VDCM_FD11_Received: symbol=ApplCanComAb_FD11_COMRX_APM2_DisChargedSts_Fdbk_APM2_VDCM_FD11_Received  # Received
          data-receive-point-by-arguments:
            access DRP_CanCom_FD11RxSignalsSR_COMRX_APM2_DisChargedSts_Fdbk_APM2_VDCM_FD11: accessed-variable=CanCom_FD11RxSignalsSR.COMRX_APM2_DisChargedSts_Fdbk_APM2_VDCM_FD11
          data-send-points:
            access DSP_VeCANR_b_APM2_DisChargedStsFdbk_VeCANR_b_APM2_DisChargedStsFdbk: accessed-variable=VeCANR_b_APM2_DisChargedStsFdbk.VeCANR_b_APM2_DisChargedStsFdbk
            access DSP_VeCANR_b_APM2_DisChargedStsFdbkTO_VeCANR_b_APM2_DisChargedStsFdbkTO: accessed-variable=VeCANR_b_APM2_DisChargedStsFdbkTO.VeCANR_b_APM2_DisChargedStsFdbkTO
        COMRX_APM2_DisChargedSts_Fdbk_APM2_VDCM_FD11_Error: symbol=ApplCanComAb_FD11_COMRX_APM2_DisChargedSts_Fdbk_APM2_VDCM_FD11_Error  # Error
          data-receive-point-by-arguments:
            access DRP_CanCom_FD11RxSignalsSR_COMRX_APM2_DisChargedSts_Fdbk_APM2_VDCM_FD11: accessed-variable=CanCom_FD11RxSignalsSR.COMRX_APM2_DisChargedSts_Fdbk_APM2_VDCM_FD11
          data-send-points:
            access DSP_VeCANR_b_APM2_DisChargedStsFdbk_VeCANR_b_APM2_DisChargedStsFdbk: accessed-variable=VeCANR_b_APM2_DisChargedStsFdbk.VeCANR_b_APM2_DisChargedStsFdbk
            access DSP_VeCANR_b_APM2_DisChargedStsFdbkTO_VeCANR_b_APM2_DisChargedStsFdbkTO: accessed-variable=VeCANR_b_APM2_DisChargedStsFdbkTO.VeCANR_b_APM2_DisChargedStsFdbkTO
        COMRX_APM2_ErrorWord_APM2_VDCM_FD11_Received: symbol=ApplCanComAb_FD11_COMRX_APM2_ErrorWord_APM2_VDCM_FD11_Received  # Received
          data-receive-point-by-arguments:
            access DRP_CanCom_FD11RxSignalsSR_COMRX_APM2_ErrorWord_APM2_VDCM_FD11: accessed-variable=CanCom_FD11RxSignalsSR.COMRX_APM2_ErrorWord_APM2_VDCM_FD11
          data-send-points:
            access DSP_VeCANR_g_APM2_ErrorWord_VeCANR_g_APM2_ErrorWord: accessed-variable=VeCANR_g_APM2_ErrorWord.VeCANR_g_APM2_ErrorWord
            access DSP_VeCANR_b_APM2_ErrorWordTO_VeCANR_b_APM2_ErrorWordTO: accessed-variable=VeCANR_b_APM2_ErrorWordTO.VeCANR_b_APM2_ErrorWordTO
        COMRX_APM2_ErrorWord_APM2_VDCM_FD11_Error: symbol=ApplCanComAb_FD11_COMRX_APM2_ErrorWord_APM2_VDCM_FD11_Error  # Error
          data-receive-point-by-arguments:
            access DRP_CanCom_FD11RxSignalsSR_COMRX_APM2_ErrorWord_APM2_VDCM_FD11: accessed-variable=CanCom_FD11RxSignalsSR.COMRX_APM2_ErrorWord_APM2_VDCM_FD11
          data-send-points:
            access DSP_VeCANR_g_APM2_ErrorWord_VeCANR_g_APM2_ErrorWord: accessed-variable=VeCANR_g_APM2_ErrorWord.VeCANR_g_APM2_ErrorWord
            access DSP_VeCANR_b_APM2_ErrorWordTO_VeCANR_b_APM2_ErrorWordTO: accessed-variable=VeCANR_b_APM2_ErrorWordTO.VeCANR_b_APM2_ErrorWordTO
        COMRX_APM2_FaultSts_APM2_VDCM_FD11_Received: symbol=ApplCanComAb_FD11_COMRX_APM2_FaultSts_APM2_VDCM_FD11_Received  # Received
          data-receive-point-by-arguments:
            access DRP_CanCom_FD11RxSignalsSR_COMRX_APM2_FaultSts_APM2_VDCM_FD11: accessed-variable=CanCom_FD11RxSignalsSR.COMRX_APM2_FaultSts_APM2_VDCM_FD11
          data-send-points:
            access DSP_VeCANR_e_APM2_FaultSts_VeCANR_e_APM2_FaultSts: accessed-variable=VeCANR_e_APM2_FaultSts.VeCANR_e_APM2_FaultSts
            access DSP_VeCANR_b_APM2_FaultStsTO_VeCANR_b_APM2_FaultStsTO: accessed-variable=VeCANR_b_APM2_FaultStsTO.VeCANR_b_APM2_FaultStsTO
        COMRX_APM2_FaultSts_APM2_VDCM_FD11_Error: symbol=ApplCanComAb_FD11_COMRX_APM2_FaultSts_APM2_VDCM_FD11_Error  # Error
          data-receive-point-by-arguments:
            access DRP_CanCom_FD11RxSignalsSR_COMRX_APM2_FaultSts_APM2_VDCM_FD11: accessed-variable=CanCom_FD11RxSignalsSR.COMRX_APM2_FaultSts_APM2_VDCM_FD11
          data-send-points:
            access DSP_VeCANR_e_APM2_FaultSts_VeCANR_e_APM2_FaultSts: accessed-variable=VeCANR_e_APM2_FaultSts.VeCANR_e_APM2_FaultSts
            access DSP_VeCANR_b_APM2_FaultStsTO_VeCANR_b_APM2_FaultStsTO: accessed-variable=VeCANR_b_APM2_FaultStsTO.VeCANR_b_APM2_FaultStsTO
        COMRX_APM2_HVChrgBusCurrent_APM2_VDCM_FD11_Received: symbol=ApplCanComAb_FD11_COMRX_APM2_HVChrgBusCurrent_APM2_VDCM_FD11_Received  # Received
          data-receive-point-by-arguments:
            access DRP_CanCom_FD11RxSignalsSR_COMRX_APM2_HVChrgBusCurrent_APM2_VDCM_FD11: accessed-variable=CanCom_FD11RxSignalsSR.COMRX_APM2_HVChrgBusCurrent_APM2_VDCM_FD11
          data-send-points:
            access DSP_VeCANR_I_APM2_HVChrgBusCurrent_VeCANR_I_APM2_HVChrgBusCurrent: accessed-variable=VeCANR_I_APM2_HVChrgBusCurrent.VeCANR_I_APM2_HVChrgBusCurrent
            access DSP_VeCANR_b_APM2_HVChrgBusCurrentTO_VeCANR_b_APM2_HVChrgBusCurrentTO: accessed-variable=VeCANR_b_APM2_HVChrgBusCurrentTO.VeCANR_b_APM2_HVChrgBusCurrentTO
        COMRX_APM2_HVChrgBusCurrent_APM2_VDCM_FD11_Error: symbol=ApplCanComAb_FD11_COMRX_APM2_HVChrgBusCurrent_APM2_VDCM_FD11_Error  # Error
          data-receive-point-by-arguments:
            access DRP_CanCom_FD11RxSignalsSR_COMRX_APM2_HVChrgBusCurrent_APM2_VDCM_FD11: accessed-variable=CanCom_FD11RxSignalsSR.COMRX_APM2_HVChrgBusCurrent_APM2_VDCM_FD11
          data-send-points:
            access DSP_VeCANR_I_APM2_HVChrgBusCurrent_VeCANR_I_APM2_HVChrgBusCurrent: accessed-variable=VeCANR_I_APM2_HVChrgBusCurrent.VeCANR_I_APM2_HVChrgBusCurrent
            access DSP_VeCANR_b_APM2_HVChrgBusCurrentTO_VeCANR_b_APM2_HVChrgBusCurrentTO: accessed-variable=VeCANR_b_APM2_HVChrgBusCurrentTO.VeCANR_b_APM2_HVChrgBusCurrentTO
        COMRX_APM2_HVChrgBusVoltage_APM2_VDCM_FD11_Received: symbol=ApplCanComAb_FD11_COMRX_APM2_HVChrgBusVoltage_APM2_VDCM_FD11_Received  # Received
          data-receive-point-by-arguments:
            access DRP_CanCom_FD11RxSignalsSR_COMRX_APM2_HVChrgBusVoltage_APM2_VDCM_FD11: accessed-variable=CanCom_FD11RxSignalsSR.COMRX_APM2_HVChrgBusVoltage_APM2_VDCM_FD11
          data-send-points:
            access DSP_VeCANR_U_APM2_HVChrgBusVoltage_VeCANR_U_APM2_HVChrgBusVoltage: accessed-variable=VeCANR_U_APM2_HVChrgBusVoltage.VeCANR_U_APM2_HVChrgBusVoltage
            access DSP_VeCANR_b_APM2_HVChrgBusVoltageTO_VeCANR_b_APM2_HVChrgBusVoltageTO: accessed-variable=VeCANR_b_APM2_HVChrgBusVoltageTO.VeCANR_b_APM2_HVChrgBusVoltageTO
        COMRX_APM2_HVChrgBusVoltage_APM2_VDCM_FD11_Error: symbol=ApplCanComAb_FD11_COMRX_APM2_HVChrgBusVoltage_APM2_VDCM_FD11_Error  # Error
          data-receive-point-by-arguments:
            access DRP_CanCom_FD11RxSignalsSR_COMRX_APM2_HVChrgBusVoltage_APM2_VDCM_FD11: accessed-variable=CanCom_FD11RxSignalsSR.COMRX_APM2_HVChrgBusVoltage_APM2_VDCM_FD11
          data-send-points:
            access DSP_VeCANR_U_APM2_HVChrgBusVoltage_VeCANR_U_APM2_HVChrgBusVoltage: accessed-variable=VeCANR_U_APM2_HVChrgBusVoltage.VeCANR_U_APM2_HVChrgBusVoltage
            access DSP_VeCANR_b_APM2_HVChrgBusVoltageTO_VeCANR_b_APM2_HVChrgBusVoltageTO: accessed-variable=VeCANR_b_APM2_HVChrgBusVoltageTO.VeCANR_b_APM2_HVChrgBusVoltageTO
        COMRX_APM2_IInpMaxCnvr_APM2_VDCM_FD11_Received: symbol=ApplCanComAb_FD11_COMRX_APM2_IInpMaxCnvr_APM2_VDCM_FD11_Received  # Received
          data-receive-point-by-arguments:
            access DRP_CanCom_FD11RxSignalsSR_COMRX_APM2_IInpMaxCnvr_APM2_VDCM_FD11: accessed-variable=CanCom_FD11RxSignalsSR.COMRX_APM2_IInpMaxCnvr_APM2_VDCM_FD11
          data-send-points:
            access DSP_VeCANR_I_APM2_IInpMaxCnvr_VeCANR_I_APM2_IInpMaxCnvr: accessed-variable=VeCANR_I_APM2_IInpMaxCnvr.VeCANR_I_APM2_IInpMaxCnvr
            access DSP_VeCANR_b_APM2_IInpMaxCnvrTO_VeCANR_b_APM2_IInpMaxCnvrTO: accessed-variable=VeCANR_b_APM2_IInpMaxCnvrTO.VeCANR_b_APM2_IInpMaxCnvrTO
        COMRX_APM2_IInpMaxCnvr_APM2_VDCM_FD11_Error: symbol=ApplCanComAb_FD11_COMRX_APM2_IInpMaxCnvr_APM2_VDCM_FD11_Error  # Error
          data-receive-point-by-arguments:
            access DRP_CanCom_FD11RxSignalsSR_COMRX_APM2_IInpMaxCnvr_APM2_VDCM_FD11: accessed-variable=CanCom_FD11RxSignalsSR.COMRX_APM2_IInpMaxCnvr_APM2_VDCM_FD11
          data-send-points:
            access DSP_VeCANR_I_APM2_IInpMaxCnvr_VeCANR_I_APM2_IInpMaxCnvr: accessed-variable=VeCANR_I_APM2_IInpMaxCnvr.VeCANR_I_APM2_IInpMaxCnvr
            access DSP_VeCANR_b_APM2_IInpMaxCnvrTO_VeCANR_b_APM2_IInpMaxCnvrTO: accessed-variable=VeCANR_b_APM2_IInpMaxCnvrTO.VeCANR_b_APM2_IInpMaxCnvrTO
        COMRX_APM2_K6_WldgDtnSts_APM2_VDCM_FD11_Received: symbol=ApplCanComAb_FD11_COMRX_APM2_K6_WldgDtnSts_APM2_VDCM_FD11_Received  # Received
          data-receive-point-by-arguments:
            access DRP_CanCom_FD11RxSignalsSR_COMRX_APM2_K6_WldgDtnSts_APM2_VDCM_FD11: accessed-variable=CanCom_FD11RxSignalsSR.COMRX_APM2_K6_WldgDtnSts_APM2_VDCM_FD11
          data-send-points:
            access DSP_VeCANR_e_APM2_K6_WldgDtnSts_VeCANR_e_APM2_K6_WldgDtnSts: accessed-variable=VeCANR_e_APM2_K6_WldgDtnSts.VeCANR_e_APM2_K6_WldgDtnSts
            access DSP_VeCANR_b_APM2_K6_WldgDtnStsTO_VeCANR_b_APM2_K6_WldgDtnStsTO: accessed-variable=VeCANR_b_APM2_K6_WldgDtnStsTO.VeCANR_b_APM2_K6_WldgDtnStsTO
        COMRX_APM2_K6_WldgDtnSts_APM2_VDCM_FD11_Error: symbol=ApplCanComAb_FD11_COMRX_APM2_K6_WldgDtnSts_APM2_VDCM_FD11_Error  # Error
          data-receive-point-by-arguments:
            access DRP_CanCom_FD11RxSignalsSR_COMRX_APM2_K6_WldgDtnSts_APM2_VDCM_FD11: accessed-variable=CanCom_FD11RxSignalsSR.COMRX_APM2_K6_WldgDtnSts_APM2_VDCM_FD11
          data-send-points:
            access DSP_VeCANR_e_APM2_K6_WldgDtnSts_VeCANR_e_APM2_K6_WldgDtnSts: accessed-variable=VeCANR_e_APM2_K6_WldgDtnSts.VeCANR_e_APM2_K6_WldgDtnSts
            access DSP_VeCANR_b_APM2_K6_WldgDtnStsTO_VeCANR_b_APM2_K6_WldgDtnStsTO: accessed-variable=VeCANR_b_APM2_K6_WldgDtnStsTO.VeCANR_b_APM2_K6_WldgDtnStsTO
        COMRX_APM2_K7_WldgDtnSts_APM2_VDCM_FD11_Received: symbol=ApplCanComAb_FD11_COMRX_APM2_K7_WldgDtnSts_APM2_VDCM_FD11_Received  # Received
          data-receive-point-by-arguments:
            access DRP_CanCom_FD11RxSignalsSR_COMRX_APM2_K7_WldgDtnSts_APM2_VDCM_FD11: accessed-variable=CanCom_FD11RxSignalsSR.COMRX_APM2_K7_WldgDtnSts_APM2_VDCM_FD11
          data-send-points:
            access DSP_VeCANR_e_APM2_K7_WldgDtnSts_VeCANR_e_APM2_K7_WldgDtnSts: accessed-variable=VeCANR_e_APM2_K7_WldgDtnSts.VeCANR_e_APM2_K7_WldgDtnSts
            access DSP_VeCANR_b_APM2_K7_WldgDtnStsTO_VeCANR_b_APM2_K7_WldgDtnStsTO: accessed-variable=VeCANR_b_APM2_K7_WldgDtnStsTO.VeCANR_b_APM2_K7_WldgDtnStsTO
        COMRX_APM2_K7_WldgDtnSts_APM2_VDCM_FD11_Error: symbol=ApplCanComAb_FD11_COMRX_APM2_K7_WldgDtnSts_APM2_VDCM_FD11_Error  # Error
          data-receive-point-by-arguments:
            access DRP_CanCom_FD11RxSignalsSR_COMRX_APM2_K7_WldgDtnSts_APM2_VDCM_FD11: accessed-variable=CanCom_FD11RxSignalsSR.COMRX_APM2_K7_WldgDtnSts_APM2_VDCM_FD11
          data-send-points:
            access DSP_VeCANR_e_APM2_K7_WldgDtnSts_VeCANR_e_APM2_K7_WldgDtnSts: accessed-variable=VeCANR_e_APM2_K7_WldgDtnSts.VeCANR_e_APM2_K7_WldgDtnSts
            access DSP_VeCANR_b_APM2_K7_WldgDtnStsTO_VeCANR_b_APM2_K7_WldgDtnStsTO: accessed-variable=VeCANR_b_APM2_K7_WldgDtnStsTO.VeCANR_b_APM2_K7_WldgDtnStsTO
        COMRX_APM2_ModeSts_Fbk_APM2_VDCM_FD11_Received: symbol=ApplCanComAb_FD11_COMRX_APM2_ModeSts_Fbk_APM2_VDCM_FD11_Received  # Received
          data-receive-point-by-arguments:
            access DRP_CanCom_FD11RxSignalsSR_COMRX_APM2_ModeSts_Fbk_APM2_VDCM_FD11: accessed-variable=CanCom_FD11RxSignalsSR.COMRX_APM2_ModeSts_Fbk_APM2_VDCM_FD11
          data-send-points:
            access DSP_VeCANR_e_APM2_ModeSts_Fbk_VeCANR_e_APM2_ModeSts_Fbk: accessed-variable=VeCANR_e_APM2_ModeSts_Fbk.VeCANR_e_APM2_ModeSts_Fbk
            access DSP_VeCANR_b_APM2_ModeSts_FbkTO_VeCANR_b_APM2_ModeSts_FbkTO: accessed-variable=VeCANR_b_APM2_ModeSts_FbkTO.VeCANR_b_APM2_ModeSts_FbkTO
        COMRX_APM2_ModeSts_Fbk_APM2_VDCM_FD11_Error: symbol=ApplCanComAb_FD11_COMRX_APM2_ModeSts_Fbk_APM2_VDCM_FD11_Error  # Error
          data-receive-point-by-arguments:
            access DRP_CanCom_FD11RxSignalsSR_COMRX_APM2_ModeSts_Fbk_APM2_VDCM_FD11: accessed-variable=CanCom_FD11RxSignalsSR.COMRX_APM2_ModeSts_Fbk_APM2_VDCM_FD11
          data-send-points:
            access DSP_VeCANR_e_APM2_ModeSts_Fbk_VeCANR_e_APM2_ModeSts_Fbk: accessed-variable=VeCANR_e_APM2_ModeSts_Fbk.VeCANR_e_APM2_ModeSts_Fbk
            access DSP_VeCANR_b_APM2_ModeSts_FbkTO_VeCANR_b_APM2_ModeSts_FbkTO: accessed-variable=VeCANR_b_APM2_ModeSts_FbkTO.VeCANR_b_APM2_ModeSts_FbkTO
        COMRX_APM2_RecoveryAction_APM2_VDCM_FD11_Received: symbol=ApplCanComAb_FD11_COMRX_APM2_RecoveryAction_APM2_VDCM_FD11_Received  # Received
          data-receive-point-by-arguments:
            access DRP_CanCom_FD11RxSignalsSR_COMRX_APM2_RecoveryAction_APM2_VDCM_FD11: accessed-variable=CanCom_FD11RxSignalsSR.COMRX_APM2_RecoveryAction_APM2_VDCM_FD11
          data-send-points:
            access DSP_VeCANR_e_APM2_RecoveryAction_VeCANR_e_APM2_RecoveryAction: accessed-variable=VeCANR_e_APM2_RecoveryAction.VeCANR_e_APM2_RecoveryAction
            access DSP_VeCANR_b_APM2_RecoveryActionTO_VeCANR_b_APM2_RecoveryActionTO: accessed-variable=VeCANR_b_APM2_RecoveryActionTO.VeCANR_b_APM2_RecoveryActionTO
        COMRX_APM2_RecoveryAction_APM2_VDCM_FD11_Error: symbol=ApplCanComAb_FD11_COMRX_APM2_RecoveryAction_APM2_VDCM_FD11_Error  # Error
          data-receive-point-by-arguments:
            access DRP_CanCom_FD11RxSignalsSR_COMRX_APM2_RecoveryAction_APM2_VDCM_FD11: accessed-variable=CanCom_FD11RxSignalsSR.COMRX_APM2_RecoveryAction_APM2_VDCM_FD11
          data-send-points:
            access DSP_VeCANR_e_APM2_RecoveryAction_VeCANR_e_APM2_RecoveryAction: accessed-variable=VeCANR_e_APM2_RecoveryAction.VeCANR_e_APM2_RecoveryAction
            access DSP_VeCANR_b_APM2_RecoveryActionTO_VeCANR_b_APM2_RecoveryActionTO: accessed-variable=VeCANR_b_APM2_RecoveryActionTO.VeCANR_b_APM2_RecoveryActionTO
        COMRX_APM2_Service_Lamp_Request_APM2_VDCM_FD11_Received: symbol=ApplCanComAb_FD11_COMRX_APM2_Service_Lamp_Request_APM2_VDCM_FD11_Received  # Received
          data-receive-point-by-arguments:
            access DRP_CanCom_FD11RxSignalsSR_COMRX_APM2_Service_Lamp_Request_APM2_VDCM_FD11: accessed-variable=CanCom_FD11RxSignalsSR.COMRX_APM2_Service_Lamp_Request_APM2_VDCM_FD11
          data-send-points:
            access DSP_VeCANR_b_APM2_Service_Lamp_Req_VeCANR_b_APM2_Service_Lamp_Req: accessed-variable=VeCANR_b_APM2_Service_Lamp_Req.VeCANR_b_APM2_Service_Lamp_Req
            access DSP_VeCANR_b_APM2_Service_Lamp_ReqTO_VeCANR_b_APM2_Service_Lamp_ReqTO: accessed-variable=VeCANR_b_APM2_Service_Lamp_ReqTO.VeCANR_b_APM2_Service_Lamp_ReqTO
        COMRX_APM2_Service_Lamp_Request_APM2_VDCM_FD11_Error: symbol=ApplCanComAb_FD11_COMRX_APM2_Service_Lamp_Request_APM2_VDCM_FD11_Error  # Error
          data-receive-point-by-arguments:
            access DRP_CanCom_FD11RxSignalsSR_COMRX_APM2_Service_Lamp_Request_APM2_VDCM_FD11: accessed-variable=CanCom_FD11RxSignalsSR.COMRX_APM2_Service_Lamp_Request_APM2_VDCM_FD11
          data-send-points:
            access DSP_VeCANR_b_APM2_Service_Lamp_Req_VeCANR_b_APM2_Service_Lamp_Req: accessed-variable=VeCANR_b_APM2_Service_Lamp_Req.VeCANR_b_APM2_Service_Lamp_Req
            access DSP_VeCANR_b_APM2_Service_Lamp_ReqTO_VeCANR_b_APM2_Service_Lamp_ReqTO: accessed-variable=VeCANR_b_APM2_Service_Lamp_ReqTO.VeCANR_b_APM2_Service_Lamp_ReqTO
        COMRX_APM2_TempFET1_APM2_VDCM_FD11_Received: symbol=ApplCanComAb_FD11_COMRX_APM2_TempFET1_APM2_VDCM_FD11_Received  # Received
          data-receive-point-by-arguments:
            access DRP_CanCom_FD11RxSignalsSR_COMRX_APM2_TempFET1_APM2_VDCM_FD11: accessed-variable=CanCom_FD11RxSignalsSR.COMRX_APM2_TempFET1_APM2_VDCM_FD11
          data-send-points:
            access DSP_VeCANR_T_APM2_TempFET1_VeCANR_T_APM2_TempFET1: accessed-variable=VeCANR_T_APM2_TempFET1.VeCANR_T_APM2_TempFET1
            access DSP_VeCANR_b_APM2_TempFET1TO_VeCANR_b_APM2_TempFET1TO: accessed-variable=VeCANR_b_APM2_TempFET1TO.VeCANR_b_APM2_TempFET1TO
        COMRX_APM2_TempFET1_APM2_VDCM_FD11_Error: symbol=ApplCanComAb_FD11_COMRX_APM2_TempFET1_APM2_VDCM_FD11_Error  # Error
          data-receive-point-by-arguments:
            access DRP_CanCom_FD11RxSignalsSR_COMRX_APM2_TempFET1_APM2_VDCM_FD11: accessed-variable=CanCom_FD11RxSignalsSR.COMRX_APM2_TempFET1_APM2_VDCM_FD11
          data-send-points:
            access DSP_VeCANR_T_APM2_TempFET1_VeCANR_T_APM2_TempFET1: accessed-variable=VeCANR_T_APM2_TempFET1.VeCANR_T_APM2_TempFET1
            access DSP_VeCANR_b_APM2_TempFET1TO_VeCANR_b_APM2_TempFET1TO: accessed-variable=VeCANR_b_APM2_TempFET1TO.VeCANR_b_APM2_TempFET1TO
        COMRX_APM2_TempFET2_APM2_VDCM_FD11_Received: symbol=ApplCanComAb_FD11_COMRX_APM2_TempFET2_APM2_VDCM_FD11_Received  # Received
          data-receive-point-by-arguments:
            access DRP_CanCom_FD11RxSignalsSR_COMRX_APM2_TempFET2_APM2_VDCM_FD11: accessed-variable=CanCom_FD11RxSignalsSR.COMRX_APM2_TempFET2_APM2_VDCM_FD11
          data-send-points:
            access DSP_VeCANR_T_APM2_TempFET2_VeCANR_T_APM2_TempFET2: accessed-variable=VeCANR_T_APM2_TempFET2.VeCANR_T_APM2_TempFET2
            access DSP_VeCANR_b_APM2_TempFET2TO_VeCANR_b_APM2_TempFET2TO: accessed-variable=VeCANR_b_APM2_TempFET2TO.VeCANR_b_APM2_TempFET2TO
        COMRX_APM2_TempFET2_APM2_VDCM_FD11_Error: symbol=ApplCanComAb_FD11_COMRX_APM2_TempFET2_APM2_VDCM_FD11_Error  # Error
          data-receive-point-by-arguments:
            access DRP_CanCom_FD11RxSignalsSR_COMRX_APM2_TempFET2_APM2_VDCM_FD11: accessed-variable=CanCom_FD11RxSignalsSR.COMRX_APM2_TempFET2_APM2_VDCM_FD11
          data-send-points:
            access DSP_VeCANR_T_APM2_TempFET2_VeCANR_T_APM2_TempFET2: accessed-variable=VeCANR_T_APM2_TempFET2.VeCANR_T_APM2_TempFET2
            access DSP_VeCANR_b_APM2_TempFET2TO_VeCANR_b_APM2_TempFET2TO: accessed-variable=VeCANR_b_APM2_TempFET2TO.VeCANR_b_APM2_TempFET2TO
        COMRX_APM2_TempInlet_APM2_VDCM_FD11_Received: symbol=ApplCanComAb_FD11_COMRX_APM2_TempInlet_APM2_VDCM_FD11_Received  # Received
          data-receive-point-by-arguments:
            access DRP_CanCom_FD11RxSignalsSR_COMRX_APM2_TempInlet_APM2_VDCM_FD11: accessed-variable=CanCom_FD11RxSignalsSR.COMRX_APM2_TempInlet_APM2_VDCM_FD11
          data-send-points:
            access DSP_VeCANR_T_APM2_TempInlet_VeCANR_T_APM2_TempInlet: accessed-variable=VeCANR_T_APM2_TempInlet.VeCANR_T_APM2_TempInlet
            access DSP_VeCANR_b_APM2_TempInletTO_VeCANR_b_APM2_TempInletTO: accessed-variable=VeCANR_b_APM2_TempInletTO.VeCANR_b_APM2_TempInletTO
        COMRX_APM2_TempInlet_APM2_VDCM_FD11_Error: symbol=ApplCanComAb_FD11_COMRX_APM2_TempInlet_APM2_VDCM_FD11_Error  # Error
          data-receive-point-by-arguments:
            access DRP_CanCom_FD11RxSignalsSR_COMRX_APM2_TempInlet_APM2_VDCM_FD11: accessed-variable=CanCom_FD11RxSignalsSR.COMRX_APM2_TempInlet_APM2_VDCM_FD11
          data-send-points:
            access DSP_VeCANR_T_APM2_TempInlet_VeCANR_T_APM2_TempInlet: accessed-variable=VeCANR_T_APM2_TempInlet.VeCANR_T_APM2_TempInlet
            access DSP_VeCANR_b_APM2_TempInletTO_VeCANR_b_APM2_TempInletTO: accessed-variable=VeCANR_b_APM2_TempInletTO.VeCANR_b_APM2_TempInletTO
        COMRX_APM2_TempInt_APM2_VDCM_FD11_Received: symbol=ApplCanComAb_FD11_COMRX_APM2_TempInt_APM2_VDCM_FD11_Received  # Received
          data-receive-point-by-arguments:
            access DRP_CanCom_FD11RxSignalsSR_COMRX_APM2_TempInt_APM2_VDCM_FD11: accessed-variable=CanCom_FD11RxSignalsSR.COMRX_APM2_TempInt_APM2_VDCM_FD11
          data-send-points:
            access DSP_VeCANR_T_APM2_TempInt_VeCANR_T_APM2_TempInt: accessed-variable=VeCANR_T_APM2_TempInt.VeCANR_T_APM2_TempInt
            access DSP_VeCANR_b_APM2_TempIntTO_VeCANR_b_APM2_TempIntTO: accessed-variable=VeCANR_b_APM2_TempIntTO.VeCANR_b_APM2_TempIntTO
        COMRX_APM2_TempInt_APM2_VDCM_FD11_Error: symbol=ApplCanComAb_FD11_COMRX_APM2_TempInt_APM2_VDCM_FD11_Error  # Error
          data-receive-point-by-arguments:
            access DRP_CanCom_FD11RxSignalsSR_COMRX_APM2_TempInt_APM2_VDCM_FD11: accessed-variable=CanCom_FD11RxSignalsSR.COMRX_APM2_TempInt_APM2_VDCM_FD11
          data-send-points:
            access DSP_VeCANR_T_APM2_TempInt_VeCANR_T_APM2_TempInt: accessed-variable=VeCANR_T_APM2_TempInt.VeCANR_T_APM2_TempInt
            access DSP_VeCANR_b_APM2_TempIntTO_VeCANR_b_APM2_TempIntTO: accessed-variable=VeCANR_b_APM2_TempIntTO.VeCANR_b_APM2_TempIntTO
        COMRX_APM2_TempL1_APM2_VDCM_FD11_Received: symbol=ApplCanComAb_FD11_COMRX_APM2_TempL1_APM2_VDCM_FD11_Received  # Received
          data-receive-point-by-arguments:
            access DRP_CanCom_FD11RxSignalsSR_COMRX_APM2_TempL1_APM2_VDCM_FD11: accessed-variable=CanCom_FD11RxSignalsSR.COMRX_APM2_TempL1_APM2_VDCM_FD11
          data-send-points:
            access DSP_VeCANR_T_APM2_TempL1_VeCANR_T_APM2_TempL1: accessed-variable=VeCANR_T_APM2_TempL1.VeCANR_T_APM2_TempL1
            access DSP_VeCANR_b_APM2_TempL1TO_VeCANR_b_APM2_TempL1TO: accessed-variable=VeCANR_b_APM2_TempL1TO.VeCANR_b_APM2_TempL1TO
        COMRX_APM2_TempL1_APM2_VDCM_FD11_Error: symbol=ApplCanComAb_FD11_COMRX_APM2_TempL1_APM2_VDCM_FD11_Error  # Error
          data-receive-point-by-arguments:
            access DRP_CanCom_FD11RxSignalsSR_COMRX_APM2_TempL1_APM2_VDCM_FD11: accessed-variable=CanCom_FD11RxSignalsSR.COMRX_APM2_TempL1_APM2_VDCM_FD11
          data-send-points:
            access DSP_VeCANR_T_APM2_TempL1_VeCANR_T_APM2_TempL1: accessed-variable=VeCANR_T_APM2_TempL1.VeCANR_T_APM2_TempL1
            access DSP_VeCANR_b_APM2_TempL1TO_VeCANR_b_APM2_TempL1TO: accessed-variable=VeCANR_b_APM2_TempL1TO.VeCANR_b_APM2_TempL1TO
        COMRX_APM2_TempL2_APM2_VDCM_FD11_Received: symbol=ApplCanComAb_FD11_COMRX_APM2_TempL2_APM2_VDCM_FD11_Received  # Received
          data-receive-point-by-arguments:
            access DRP_CanCom_FD11RxSignalsSR_COMRX_APM2_TempL2_APM2_VDCM_FD11: accessed-variable=CanCom_FD11RxSignalsSR.COMRX_APM2_TempL2_APM2_VDCM_FD11
          data-send-points:
            access DSP_VeCANR_T_APM2_TempL2_VeCANR_T_APM2_TempL2: accessed-variable=VeCANR_T_APM2_TempL2.VeCANR_T_APM2_TempL2
            access DSP_VeCANR_b_APM2_TempL2TO_VeCANR_b_APM2_TempL2TO: accessed-variable=VeCANR_b_APM2_TempL2TO.VeCANR_b_APM2_TempL2TO
        COMRX_APM2_TempL2_APM2_VDCM_FD11_Error: symbol=ApplCanComAb_FD11_COMRX_APM2_TempL2_APM2_VDCM_FD11_Error  # Error
          data-receive-point-by-arguments:
            access DRP_CanCom_FD11RxSignalsSR_COMRX_APM2_TempL2_APM2_VDCM_FD11: accessed-variable=CanCom_FD11RxSignalsSR.COMRX_APM2_TempL2_APM2_VDCM_FD11
          data-send-points:
            access DSP_VeCANR_T_APM2_TempL2_VeCANR_T_APM2_TempL2: accessed-variable=VeCANR_T_APM2_TempL2.VeCANR_T_APM2_TempL2
            access DSP_VeCANR_b_APM2_TempL2TO_VeCANR_b_APM2_TempL2TO: accessed-variable=VeCANR_b_APM2_TempL2TO.VeCANR_b_APM2_TempL2TO
        COMRX_APM2_TempMargin_APM2_VDCM_FD11_Received: symbol=ApplCanComAb_FD11_COMRX_APM2_TempMargin_APM2_VDCM_FD11_Received  # Received
          data-receive-point-by-arguments:
            access DRP_CanCom_FD11RxSignalsSR_COMRX_APM2_TempMargin_APM2_VDCM_FD11: accessed-variable=CanCom_FD11RxSignalsSR.COMRX_APM2_TempMargin_APM2_VDCM_FD11
          data-send-points:
            access DSP_VeCANR_T_APM2_TempMargin_VeCANR_T_APM2_TempMargin: accessed-variable=VeCANR_T_APM2_TempMargin.VeCANR_T_APM2_TempMargin
            access DSP_VeCANR_b_APM2_TempMarginTO_VeCANR_b_APM2_TempMarginTO: accessed-variable=VeCANR_b_APM2_TempMarginTO.VeCANR_b_APM2_TempMarginTO
        COMRX_APM2_TempMargin_APM2_VDCM_FD11_Error: symbol=ApplCanComAb_FD11_COMRX_APM2_TempMargin_APM2_VDCM_FD11_Error  # Error
          data-receive-point-by-arguments:
            access DRP_CanCom_FD11RxSignalsSR_COMRX_APM2_TempMargin_APM2_VDCM_FD11: accessed-variable=CanCom_FD11RxSignalsSR.COMRX_APM2_TempMargin_APM2_VDCM_FD11
          data-send-points:
            access DSP_VeCANR_T_APM2_TempMargin_VeCANR_T_APM2_TempMargin: accessed-variable=VeCANR_T_APM2_TempMargin.VeCANR_T_APM2_TempMargin
            access DSP_VeCANR_b_APM2_TempMarginTO_VeCANR_b_APM2_TempMarginTO: accessed-variable=VeCANR_b_APM2_TempMarginTO.VeCANR_b_APM2_TempMarginTO
        COMRX_APM2InterlockSts_APM2_VDCM_FD11_Received: symbol=ApplCanComAb_FD11_COMRX_APM2InterlockSts_APM2_VDCM_FD11_Received  # Received
          data-receive-point-by-arguments:
            access DRP_CanCom_FD11RxSignalsSR_COMRX_APM2InterlockSts_APM2_VDCM_FD11: accessed-variable=CanCom_FD11RxSignalsSR.COMRX_APM2InterlockSts_APM2_VDCM_FD11
          data-send-points:
            access DSP_VeCANR_e_APM2InterlockSts_VeCANR_e_APM2InterlockSts: accessed-variable=VeCANR_e_APM2InterlockSts.VeCANR_e_APM2InterlockSts
            access DSP_VeCANR_b_APM2InterlockStsTO_VeCANR_b_APM2InterlockStsTO: accessed-variable=VeCANR_b_APM2InterlockStsTO.VeCANR_b_APM2InterlockStsTO
        COMRX_APM2InterlockSts_APM2_VDCM_FD11_Error: symbol=ApplCanComAb_FD11_COMRX_APM2InterlockSts_APM2_VDCM_FD11_Error  # Error
          data-receive-point-by-arguments:
            access DRP_CanCom_FD11RxSignalsSR_COMRX_APM2InterlockSts_APM2_VDCM_FD11: accessed-variable=CanCom_FD11RxSignalsSR.COMRX_APM2InterlockSts_APM2_VDCM_FD11
          data-send-points:
            access DSP_VeCANR_e_APM2InterlockSts_VeCANR_e_APM2InterlockSts: accessed-variable=VeCANR_e_APM2InterlockSts.VeCANR_e_APM2InterlockSts
            access DSP_VeCANR_b_APM2InterlockStsTO_VeCANR_b_APM2InterlockStsTO: accessed-variable=VeCANR_b_APM2InterlockStsTO.VeCANR_b_APM2InterlockStsTO
        COMRX_CurrEVSE_APM2_VDCM_FD11_Received: symbol=ApplCanComAb_FD11_COMRX_CurrEVSE_APM2_VDCM_FD11_Received  # Received
          data-receive-point-by-arguments:
            access DRP_CanCom_FD11RxSignalsSR_COMRX_CurrEVSE_APM2_VDCM_FD11: accessed-variable=CanCom_FD11RxSignalsSR.COMRX_CurrEVSE_APM2_VDCM_FD11
          data-send-points:
            access DSP_VeCANR_I_CurrEVSE_VeCANR_I_CurrEVSE: accessed-variable=VeCANR_I_CurrEVSE.VeCANR_I_CurrEVSE
            access DSP_VeCANR_b_CurrEVSE_TO_VeCANR_b_CurrEVSE_TO: accessed-variable=VeCANR_b_CurrEVSE_TO.VeCANR_b_CurrEVSE_TO
        COMRX_CurrEVSE_APM2_VDCM_FD11_Error: symbol=ApplCanComAb_FD11_COMRX_CurrEVSE_APM2_VDCM_FD11_Error  # Error
          data-receive-point-by-arguments:
            access DRP_CanCom_FD11RxSignalsSR_COMRX_CurrEVSE_APM2_VDCM_FD11: accessed-variable=CanCom_FD11RxSignalsSR.COMRX_CurrEVSE_APM2_VDCM_FD11
          data-send-points:
            access DSP_VeCANR_I_CurrEVSE_VeCANR_I_CurrEVSE: accessed-variable=VeCANR_I_CurrEVSE.VeCANR_I_CurrEVSE
            access DSP_VeCANR_b_CurrEVSE_TO_VeCANR_b_CurrEVSE_TO: accessed-variable=VeCANR_b_CurrEVSE_TO.VeCANR_b_CurrEVSE_TO
        COMRX_PwrEff_APM2_VDCM_FD11_Received: symbol=ApplCanComAb_FD11_COMRX_PwrEff_APM2_VDCM_FD11_Received  # Received
          data-receive-point-by-arguments:
            access DRP_CanCom_FD11RxSignalsSR_COMRX_PwrEff_APM2_VDCM_FD11: accessed-variable=CanCom_FD11RxSignalsSR.COMRX_PwrEff_APM2_VDCM_FD11
          data-send-points:
            access DSP_VeCANR_Pct_PwrEff_VeCANR_Pct_PwrEff: accessed-variable=VeCANR_Pct_PwrEff.VeCANR_Pct_PwrEff
            access DSP_VeCANR_b_PwrEffTO_VeCANR_b_PwrEffTO: accessed-variable=VeCANR_b_PwrEffTO.VeCANR_b_PwrEffTO
        COMRX_PwrEff_APM2_VDCM_FD11_Error: symbol=ApplCanComAb_FD11_COMRX_PwrEff_APM2_VDCM_FD11_Error  # Error
          data-receive-point-by-arguments:
            access DRP_CanCom_FD11RxSignalsSR_COMRX_PwrEff_APM2_VDCM_FD11: accessed-variable=CanCom_FD11RxSignalsSR.COMRX_PwrEff_APM2_VDCM_FD11
          data-send-points:
            access DSP_VeCANR_Pct_PwrEff_VeCANR_Pct_PwrEff: accessed-variable=VeCANR_Pct_PwrEff.VeCANR_Pct_PwrEff
            access DSP_VeCANR_b_PwrEffTO_VeCANR_b_PwrEffTO: accessed-variable=VeCANR_b_PwrEffTO.VeCANR_b_PwrEffTO
        COMRX_VltgChgEVSE_APM2_VDCM_FD11_Received: symbol=ApplCanComAb_FD11_COMRX_VltgChgEVSE_APM2_VDCM_FD11_Received  # Received
          data-receive-point-by-arguments:
            access DRP_CanCom_FD11RxSignalsSR_COMRX_VltgChgEVSE_APM2_VDCM_FD11: accessed-variable=CanCom_FD11RxSignalsSR.COMRX_VltgChgEVSE_APM2_VDCM_FD11
          data-send-points:
            access DSP_VeCANR_U_VltgChgEVSE_VeCANR_U_VltgChgEVSE: accessed-variable=VeCANR_U_VltgChgEVSE.VeCANR_U_VltgChgEVSE
            access DSP_VeCANR_b_VltgChgEVSE_TO_VeCANR_b_VltgChgEVSE_TO: accessed-variable=VeCANR_b_VltgChgEVSE_TO.VeCANR_b_VltgChgEVSE_TO
        COMRX_VltgChgEVSE_APM2_VDCM_FD11_Error: symbol=ApplCanComAb_FD11_COMRX_VltgChgEVSE_APM2_VDCM_FD11_Error  # Error
          data-receive-point-by-arguments:
            access DRP_CanCom_FD11RxSignalsSR_COMRX_VltgChgEVSE_APM2_VDCM_FD11: accessed-variable=CanCom_FD11RxSignalsSR.COMRX_VltgChgEVSE_APM2_VDCM_FD11
          data-send-points:
            access DSP_VeCANR_U_VltgChgEVSE_VeCANR_U_VltgChgEVSE: accessed-variable=VeCANR_U_VltgChgEVSE.VeCANR_U_VltgChgEVSE
            access DSP_VeCANR_b_VltgChgEVSE_TO_VeCANR_b_VltgChgEVSE_TO: accessed-variable=VeCANR_b_VltgChgEVSE_TO.VeCANR_b_VltgChgEVSE_TO
        COMRX_VltgChgInt_APM2_VDCM_FD11_Received: symbol=ApplCanComAb_FD11_COMRX_VltgChgInt_APM2_VDCM_FD11_Received  # Received
          data-receive-point-by-arguments:
            access DRP_CanCom_FD11RxSignalsSR_COMRX_VltgChgInt_APM2_VDCM_FD11: accessed-variable=CanCom_FD11RxSignalsSR.COMRX_VltgChgInt_APM2_VDCM_FD11
          data-send-points:
            access DSP_VeCANR_U_VltgChgInt_VeCANR_U_VltgChgInt: accessed-variable=VeCANR_U_VltgChgInt.VeCANR_U_VltgChgInt
            access DSP_VeCANR_b_VltgChgIntTO_VeCANR_b_VltgChgIntTO: accessed-variable=VeCANR_b_VltgChgIntTO.VeCANR_b_VltgChgIntTO
        COMRX_VltgChgInt_APM2_VDCM_FD11_Error: symbol=ApplCanComAb_FD11_COMRX_VltgChgInt_APM2_VDCM_FD11_Error  # Error
          data-receive-point-by-arguments:
            access DRP_CanCom_FD11RxSignalsSR_COMRX_VltgChgInt_APM2_VDCM_FD11: accessed-variable=CanCom_FD11RxSignalsSR.COMRX_VltgChgInt_APM2_VDCM_FD11
          data-send-points:
            access DSP_VeCANR_U_VltgChgInt_VeCANR_U_VltgChgInt: accessed-variable=VeCANR_U_VltgChgInt.VeCANR_U_VltgChgInt
            access DSP_VeCANR_b_VltgChgIntTO_VeCANR_b_VltgChgIntTO: accessed-variable=VeCANR_b_VltgChgIntTO.VeCANR_b_VltgChgIntTO
        COMRX_ImpactHardwire_BATTERY_HV_FD11_Received: symbol=ApplCanComAb_FD11_COMRX_ImpactHardwire_BATTERY_HV_FD11_Received  # Received
          data-receive-point-by-arguments:
            access DRP_CanCom_FD11RxSignalsSR_COMRX_ImpactHardwire_BATTERY_HV_FD11: accessed-variable=CanCom_FD11RxSignalsSR.COMRX_ImpactHardwire_BATTERY_HV_FD11
          data-send-points:
            access DSP_VeCANR_b_ImpactHardwire_FD11_VeCANR_b_ImpactHardwire_FD11: accessed-variable=VeCANR_b_ImpactHardwire_FD11.VeCANR_b_ImpactHardwire_FD11
            access DSP_VeCANR_b_ImpactHardwire_FD11TO_VeCANR_b_ImpactHardwire_FD11TO: accessed-variable=VeCANR_b_ImpactHardwire_FD11TO.VeCANR_b_ImpactHardwire_FD11TO
        COMRX_ImpactHardwire_BATTERY_HV_FD11_Error: symbol=ApplCanComAb_FD11_COMRX_ImpactHardwire_BATTERY_HV_FD11_Error  # Error
          data-receive-point-by-arguments:
            access DRP_CanCom_FD11RxSignalsSR_COMRX_ImpactHardwire_BATTERY_HV_FD11: accessed-variable=CanCom_FD11RxSignalsSR.COMRX_ImpactHardwire_BATTERY_HV_FD11
          data-send-points:
            access DSP_VeCANR_b_ImpactHardwire_FD11_VeCANR_b_ImpactHardwire_FD11: accessed-variable=VeCANR_b_ImpactHardwire_FD11.VeCANR_b_ImpactHardwire_FD11
            access DSP_VeCANR_b_ImpactHardwire_FD11TO_VeCANR_b_ImpactHardwire_FD11TO: accessed-variable=VeCANR_b_ImpactHardwire_FD11TO.VeCANR_b_ImpactHardwire_FD11TO
        COMRX_ImpactHardwireV_BATTERY_HV_FD11_Received: symbol=ApplCanComAb_FD11_COMRX_ImpactHardwireV_BATTERY_HV_FD11_Received  # Received
          data-receive-point-by-arguments:
            access DRP_CanCom_FD11RxSignalsSR_COMRX_ImpactHardwireV_BATTERY_HV_FD11: accessed-variable=CanCom_FD11RxSignalsSR.COMRX_ImpactHardwireV_BATTERY_HV_FD11
          data-send-points:
            access DSP_VeCANR_b_ImpactHardwireV_FD11_VeCANR_b_ImpactHardwireV_FD11: accessed-variable=VeCANR_b_ImpactHardwireV_FD11.VeCANR_b_ImpactHardwireV_FD11
            access DSP_VeCANR_b_ImpactHardwireV_FD11TO_VeCANR_b_ImpactHardwireV_FD11TO: accessed-variable=VeCANR_b_ImpactHardwireV_FD11TO.VeCANR_b_ImpactHardwireV_FD11TO
        COMRX_ImpactHardwireV_BATTERY_HV_FD11_Error: symbol=ApplCanComAb_FD11_COMRX_ImpactHardwireV_BATTERY_HV_FD11_Error  # Error
          data-receive-point-by-arguments:
            access DRP_CanCom_FD11RxSignalsSR_COMRX_ImpactHardwireV_BATTERY_HV_FD11: accessed-variable=CanCom_FD11RxSignalsSR.COMRX_ImpactHardwireV_BATTERY_HV_FD11
          data-send-points:
            access DSP_VeCANR_b_ImpactHardwireV_FD11_VeCANR_b_ImpactHardwireV_FD11: accessed-variable=VeCANR_b_ImpactHardwireV_FD11.VeCANR_b_ImpactHardwireV_FD11
            access DSP_VeCANR_b_ImpactHardwireV_FD11TO_VeCANR_b_ImpactHardwireV_FD11TO: accessed-variable=VeCANR_b_ImpactHardwireV_FD11TO.VeCANR_b_ImpactHardwireV_FD11TO
        COMRX_BMS_HV_High_Temp_Thrsh_BATTERY_HV2_FD11_Received: symbol=ApplCanComAb_FD11_COMRX_BMS_HV_High_Temp_Thrsh_BATTERY_HV2_FD11_Received  # Received
          data-receive-point-by-arguments:
            access DRP_CanCom_FD11RxSignalsSR_COMRX_BMS_HV_High_Temp_Thrsh_BATTERY_HV2_FD11: accessed-variable=CanCom_FD11RxSignalsSR.COMRX_BMS_HV_High_Temp_Thrsh_BATTERY_HV2_FD11
          data-send-points:
            access DSP_VeCANR_T_BMS_HV_HiTempThd_FD11_VeCANR_T_BMS_HV_HiTempThd_FD11: accessed-variable=VeCANR_T_BMS_HV_HiTempThd_FD11.VeCANR_T_BMS_HV_HiTempThd_FD11
            access DSP_VeCANR_b_BMS_HV_HiTempThd_FD11TO_VeCANR_b_BMS_HV_HiTempThd_FD11TO: accessed-variable=VeCANR_b_BMS_HV_HiTempThd_FD11TO.VeCANR_b_BMS_HV_HiTempThd_FD11TO
        COMRX_BMS_HV_High_Temp_Thrsh_BATTERY_HV2_FD11_Error: symbol=ApplCanComAb_FD11_COMRX_BMS_HV_High_Temp_Thrsh_BATTERY_HV2_FD11_Error  # Error
          data-receive-point-by-arguments:
            access DRP_CanCom_FD11RxSignalsSR_COMRX_BMS_HV_High_Temp_Thrsh_BATTERY_HV2_FD11: accessed-variable=CanCom_FD11RxSignalsSR.COMRX_BMS_HV_High_Temp_Thrsh_BATTERY_HV2_FD11
          data-send-points:
            access DSP_VeCANR_T_BMS_HV_HiTempThd_FD11_VeCANR_T_BMS_HV_HiTempThd_FD11: accessed-variable=VeCANR_T_BMS_HV_HiTempThd_FD11.VeCANR_T_BMS_HV_HiTempThd_FD11
            access DSP_VeCANR_b_BMS_HV_HiTempThd_FD11TO_VeCANR_b_BMS_HV_HiTempThd_FD11TO: accessed-variable=VeCANR_b_BMS_HV_HiTempThd_FD11TO.VeCANR_b_BMS_HV_HiTempThd_FD11TO
        COMRX_BMS_HV_Low_Temp_Thrsh_BATTERY_HV2_FD11_Received: symbol=ApplCanComAb_FD11_COMRX_BMS_HV_Low_Temp_Thrsh_BATTERY_HV2_FD11_Received  # Received
          data-receive-point-by-arguments:
            access DRP_CanCom_FD11RxSignalsSR_COMRX_BMS_HV_Low_Temp_Thrsh_BATTERY_HV2_FD11: accessed-variable=CanCom_FD11RxSignalsSR.COMRX_BMS_HV_Low_Temp_Thrsh_BATTERY_HV2_FD11
          data-send-points:
            access DSP_VeCANR_T_BMS_HVLoTempThd_FD11_VeCANR_T_BMS_HVLoTempThd_FD11: accessed-variable=VeCANR_T_BMS_HVLoTempThd_FD11.VeCANR_T_BMS_HVLoTempThd_FD11
            access DSP_VeCANR_b_BMS_HVLoTempThd_FD11TO_VeCANR_b_BMS_HVLoTempThd_FD11TO: accessed-variable=VeCANR_b_BMS_HVLoTempThd_FD11TO.VeCANR_b_BMS_HVLoTempThd_FD11TO
        COMRX_BMS_HV_Low_Temp_Thrsh_BATTERY_HV2_FD11_Error: symbol=ApplCanComAb_FD11_COMRX_BMS_HV_Low_Temp_Thrsh_BATTERY_HV2_FD11_Error  # Error
          data-receive-point-by-arguments:
            access DRP_CanCom_FD11RxSignalsSR_COMRX_BMS_HV_Low_Temp_Thrsh_BATTERY_HV2_FD11: accessed-variable=CanCom_FD11RxSignalsSR.COMRX_BMS_HV_Low_Temp_Thrsh_BATTERY_HV2_FD11
          data-send-points:
            access DSP_VeCANR_T_BMS_HVLoTempThd_FD11_VeCANR_T_BMS_HVLoTempThd_FD11: accessed-variable=VeCANR_T_BMS_HVLoTempThd_FD11.VeCANR_T_BMS_HVLoTempThd_FD11
            access DSP_VeCANR_b_BMS_HVLoTempThd_FD11TO_VeCANR_b_BMS_HVLoTempThd_FD11TO: accessed-variable=VeCANR_b_BMS_HVLoTempThd_FD11TO.VeCANR_b_BMS_HVLoTempThd_FD11TO
        COMRX_BMS_HV_SOC_AccuracySts_BATTERY_HV2_FD11_Received: symbol=ApplCanComAb_FD11_COMRX_BMS_HV_SOC_AccuracySts_BATTERY_HV2_FD11_Received  # Received
          data-receive-point-by-arguments:
            access DRP_CanCom_FD11RxSignalsSR_COMRX_BMS_HV_SOC_AccuracySts_BATTERY_HV2_FD11: accessed-variable=CanCom_FD11RxSignalsSR.COMRX_BMS_HV_SOC_AccuracySts_BATTERY_HV2_FD11
          data-send-points:
            access DSP_VeCANR_e_BMS_HV_SOCAcrcyStsFD11_VeCANR_e_BMS_HV_SOCAcrcyStsFD11: accessed-variable=VeCANR_e_BMS_HV_SOCAcrcyStsFD11.VeCANR_e_BMS_HV_SOCAcrcyStsFD11
            access DSP_VeCANR_b_BMS_HV_SOCAcrcyStsFD11TO_VeCANR_b_BMS_HV_SOCAcrcyStsFD11TO: accessed-variable=VeCANR_b_BMS_HV_SOCAcrcyStsFD11TO.VeCANR_b_BMS_HV_SOCAcrcyStsFD11TO
        COMRX_BMS_HV_SOC_AccuracySts_BATTERY_HV2_FD11_Error: symbol=ApplCanComAb_FD11_COMRX_BMS_HV_SOC_AccuracySts_BATTERY_HV2_FD11_Error  # Error
          data-receive-point-by-arguments:
            access DRP_CanCom_FD11RxSignalsSR_COMRX_BMS_HV_SOC_AccuracySts_BATTERY_HV2_FD11: accessed-variable=CanCom_FD11RxSignalsSR.COMRX_BMS_HV_SOC_AccuracySts_BATTERY_HV2_FD11
          data-send-points:
            access DSP_VeCANR_e_BMS_HV_SOCAcrcyStsFD11_VeCANR_e_BMS_HV_SOCAcrcyStsFD11: accessed-variable=VeCANR_e_BMS_HV_SOCAcrcyStsFD11.VeCANR_e_BMS_HV_SOCAcrcyStsFD11
            access DSP_VeCANR_b_BMS_HV_SOCAcrcyStsFD11TO_VeCANR_b_BMS_HV_SOCAcrcyStsFD11TO: accessed-variable=VeCANR_b_BMS_HV_SOCAcrcyStsFD11TO.VeCANR_b_BMS_HV_SOCAcrcyStsFD11TO
        COMRX_BMS_HV_SOC_Max_BATTERY_HV2_FD11_Received: symbol=ApplCanComAb_FD11_COMRX_BMS_HV_SOC_Max_BATTERY_HV2_FD11_Received  # Received
          data-receive-point-by-arguments:
            access DRP_CanCom_FD11RxSignalsSR_COMRX_BMS_HV_SOC_Max_BATTERY_HV2_FD11: accessed-variable=CanCom_FD11RxSignalsSR.COMRX_BMS_HV_SOC_Max_BATTERY_HV2_FD11
          data-send-points:
            access DSP_VeCANR_Pct_BMS_HV_SOC_Max_FD11_VeCANR_Pct_BMS_HV_SOC_Max_FD11: accessed-variable=VeCANR_Pct_BMS_HV_SOC_Max_FD11.VeCANR_Pct_BMS_HV_SOC_Max_FD11
            access DSP_VeCANR_b_BMS_HV_SOC_Max_FD11TO_VeCANR_b_BMS_HV_SOC_Max_FD11TO: accessed-variable=VeCANR_b_BMS_HV_SOC_Max_FD11TO.VeCANR_b_BMS_HV_SOC_Max_FD11TO
        COMRX_BMS_HV_SOC_Max_BATTERY_HV2_FD11_Error: symbol=ApplCanComAb_FD11_COMRX_BMS_HV_SOC_Max_BATTERY_HV2_FD11_Error  # Error
          data-receive-point-by-arguments:
            access DRP_CanCom_FD11RxSignalsSR_COMRX_BMS_HV_SOC_Max_BATTERY_HV2_FD11: accessed-variable=CanCom_FD11RxSignalsSR.COMRX_BMS_HV_SOC_Max_BATTERY_HV2_FD11
          data-send-points:
            access DSP_VeCANR_Pct_BMS_HV_SOC_Max_FD11_VeCANR_Pct_BMS_HV_SOC_Max_FD11: accessed-variable=VeCANR_Pct_BMS_HV_SOC_Max_FD11.VeCANR_Pct_BMS_HV_SOC_Max_FD11
            access DSP_VeCANR_b_BMS_HV_SOC_Max_FD11TO_VeCANR_b_BMS_HV_SOC_Max_FD11TO: accessed-variable=VeCANR_b_BMS_HV_SOC_Max_FD11TO.VeCANR_b_BMS_HV_SOC_Max_FD11TO
        COMRX_BMS_HV_SOC_Min_BATTERY_HV2_FD11_Received: symbol=ApplCanComAb_FD11_COMRX_BMS_HV_SOC_Min_BATTERY_HV2_FD11_Received  # Received
          data-receive-point-by-arguments:
            access DRP_CanCom_FD11RxSignalsSR_COMRX_BMS_HV_SOC_Min_BATTERY_HV2_FD11: accessed-variable=CanCom_FD11RxSignalsSR.COMRX_BMS_HV_SOC_Min_BATTERY_HV2_FD11
          data-send-points:
            access DSP_VeCANR_Pct_BMS_HV_SOC_Min_FD11_VeCANR_Pct_BMS_HV_SOC_Min_FD11: accessed-variable=VeCANR_Pct_BMS_HV_SOC_Min_FD11.VeCANR_Pct_BMS_HV_SOC_Min_FD11
            access DSP_VeCANR_b_BMS_HV_SOC_Min_FD11TO_VeCANR_b_BMS_HV_SOC_Min_FD11TO: accessed-variable=VeCANR_b_BMS_HV_SOC_Min_FD11TO.VeCANR_b_BMS_HV_SOC_Min_FD11TO
        COMRX_BMS_HV_SOC_Min_BATTERY_HV2_FD11_Error: symbol=ApplCanComAb_FD11_COMRX_BMS_HV_SOC_Min_BATTERY_HV2_FD11_Error  # Error
          data-receive-point-by-arguments:
            access DRP_CanCom_FD11RxSignalsSR_COMRX_BMS_HV_SOC_Min_BATTERY_HV2_FD11: accessed-variable=CanCom_FD11RxSignalsSR.COMRX_BMS_HV_SOC_Min_BATTERY_HV2_FD11
          data-send-points:
            access DSP_VeCANR_Pct_BMS_HV_SOC_Min_FD11_VeCANR_Pct_BMS_HV_SOC_Min_FD11: accessed-variable=VeCANR_Pct_BMS_HV_SOC_Min_FD11.VeCANR_Pct_BMS_HV_SOC_Min_FD11
            access DSP_VeCANR_b_BMS_HV_SOC_Min_FD11TO_VeCANR_b_BMS_HV_SOC_Min_FD11TO: accessed-variable=VeCANR_b_BMS_HV_SOC_Min_FD11TO.VeCANR_b_BMS_HV_SOC_Min_FD11TO
        COMRX_HEV_OnRq_BPCM_BATTERY_HV2_FD11_Received: symbol=ApplCanComAb_FD11_COMRX_HEV_OnRq_BPCM_BATTERY_HV2_FD11_Received  # Received
          data-receive-point-by-arguments:
            access DRP_CanCom_FD11RxSignalsSR_COMRX_HEV_OnRq_BPCM_BATTERY_HV2_FD11: accessed-variable=CanCom_FD11RxSignalsSR.COMRX_HEV_OnRq_BPCM_BATTERY_HV2_FD11
          data-send-points:
            access DSP_VeCANR_b_HEV_OnRq_BPCM_FD11_VeCANR_b_HEV_OnRq_BPCM_FD11: accessed-variable=VeCANR_b_HEV_OnRq_BPCM_FD11.VeCANR_b_HEV_OnRq_BPCM_FD11
            access DSP_VeCANR_b_HEV_OnRq_BPCM_FD11TO_VeCANR_b_HEV_OnRq_BPCM_FD11TO: accessed-variable=VeCANR_b_HEV_OnRq_BPCM_FD11TO.VeCANR_b_HEV_OnRq_BPCM_FD11TO
        COMRX_HEV_OnRq_BPCM_BATTERY_HV2_FD11_Error: symbol=ApplCanComAb_FD11_COMRX_HEV_OnRq_BPCM_BATTERY_HV2_FD11_Error  # Error
          data-receive-point-by-arguments:
            access DRP_CanCom_FD11RxSignalsSR_COMRX_HEV_OnRq_BPCM_BATTERY_HV2_FD11: accessed-variable=CanCom_FD11RxSignalsSR.COMRX_HEV_OnRq_BPCM_BATTERY_HV2_FD11
          data-send-points:
            access DSP_VeCANR_b_HEV_OnRq_BPCM_FD11_VeCANR_b_HEV_OnRq_BPCM_FD11: accessed-variable=VeCANR_b_HEV_OnRq_BPCM_FD11.VeCANR_b_HEV_OnRq_BPCM_FD11
            access DSP_VeCANR_b_HEV_OnRq_BPCM_FD11TO_VeCANR_b_HEV_OnRq_BPCM_FD11TO: accessed-variable=VeCANR_b_HEV_OnRq_BPCM_FD11TO.VeCANR_b_HEV_OnRq_BPCM_FD11TO
        COMRX_HVBatCell_Voltage_High_Thrsh_BATTERY_HV2_FD11_Received: symbol=ApplCanComAb_FD11_COMRX_HVBatCell_Voltage_High_Thrsh_BATTERY_HV2_FD11_Received  # Received
          data-receive-point-by-arguments:
            access DRP_CanCom_FD11RxSignalsSR_COMRX_HVBatCell_Voltage_High_Thrsh_BATTERY_HV2_FD11: accessed-variable=CanCom_FD11RxSignalsSR.COMRX_HVBatCell_Voltage_High_Thrsh_BATTERY_HV2_FD11
          data-send-points:
            access DSP_VeCANR_d_HVBatCelVoltHiThrsFD11_VeCANR_d_HVBatCelVoltHiThrsFD11: accessed-variable=VeCANR_d_HVBatCelVoltHiThrsFD11.VeCANR_d_HVBatCelVoltHiThrsFD11
            access DSP_VeCANR_b_HVBatCelVoltHiThrsFD11TO_VeCANR_b_HVBatCelVoltHiThrsFD11TO: accessed-variable=VeCANR_b_HVBatCelVoltHiThrsFD11TO.VeCANR_b_HVBatCelVoltHiThrsFD11TO
        COMRX_HVBatCell_Voltage_High_Thrsh_BATTERY_HV2_FD11_Error: symbol=ApplCanComAb_FD11_COMRX_HVBatCell_Voltage_High_Thrsh_BATTERY_HV2_FD11_Error  # Error
          data-receive-point-by-arguments:
            access DRP_CanCom_FD11RxSignalsSR_COMRX_HVBatCell_Voltage_High_Thrsh_BATTERY_HV2_FD11: accessed-variable=CanCom_FD11RxSignalsSR.COMRX_HVBatCell_Voltage_High_Thrsh_BATTERY_HV2_FD11
          data-send-points:
            access DSP_VeCANR_d_HVBatCelVoltHiThrsFD11_VeCANR_d_HVBatCelVoltHiThrsFD11: accessed-variable=VeCANR_d_HVBatCelVoltHiThrsFD11.VeCANR_d_HVBatCelVoltHiThrsFD11
            access DSP_VeCANR_b_HVBatCelVoltHiThrsFD11TO_VeCANR_b_HVBatCelVoltHiThrsFD11TO: accessed-variable=VeCANR_b_HVBatCelVoltHiThrsFD11TO.VeCANR_b_HVBatCelVoltHiThrsFD11TO
        COMRX_HVBatCell_Voltage_Low_Thrsh_BATTERY_HV2_FD11_Received: symbol=ApplCanComAb_FD11_COMRX_HVBatCell_Voltage_Low_Thrsh_BATTERY_HV2_FD11_Received  # Received
          data-receive-point-by-arguments:
            access DRP_CanCom_FD11RxSignalsSR_COMRX_HVBatCell_Voltage_Low_Thrsh_BATTERY_HV2_FD11: accessed-variable=CanCom_FD11RxSignalsSR.COMRX_HVBatCell_Voltage_Low_Thrsh_BATTERY_HV2_FD11
          data-send-points:
            access DSP_VeCANR_h_HVBatCelVoltLoThrsFD11_VeCANR_h_HVBatCelVoltLoThrsFD11: accessed-variable=VeCANR_h_HVBatCelVoltLoThrsFD11.VeCANR_h_HVBatCelVoltLoThrsFD11
            access DSP_VeCANR_b_HVBatCelVoltLoThrsFD11TO_VeCANR_b_HVBatCelVoltLoThrsFD11TO: accessed-variable=VeCANR_b_HVBatCelVoltLoThrsFD11TO.VeCANR_b_HVBatCelVoltLoThrsFD11TO
        COMRX_HVBatCell_Voltage_Low_Thrsh_BATTERY_HV2_FD11_Error: symbol=ApplCanComAb_FD11_COMRX_HVBatCell_Voltage_Low_Thrsh_BATTERY_HV2_FD11_Error  # Error
          data-receive-point-by-arguments:
            access DRP_CanCom_FD11RxSignalsSR_COMRX_HVBatCell_Voltage_Low_Thrsh_BATTERY_HV2_FD11: accessed-variable=CanCom_FD11RxSignalsSR.COMRX_HVBatCell_Voltage_Low_Thrsh_BATTERY_HV2_FD11
          data-send-points:
            access DSP_VeCANR_h_HVBatCelVoltLoThrsFD11_VeCANR_h_HVBatCelVoltLoThrsFD11: accessed-variable=VeCANR_h_HVBatCelVoltLoThrsFD11.VeCANR_h_HVBatCelVoltLoThrsFD11
            access DSP_VeCANR_b_HVBatCelVoltLoThrsFD11TO_VeCANR_b_HVBatCelVoltLoThrsFD11TO: accessed-variable=VeCANR_b_HVBatCelVoltLoThrsFD11TO.VeCANR_b_HVBatCelVoltLoThrsFD11TO
        COMRX_OBC_Temp1_DUALCHARGER_THERMAL_FD11_Received: symbol=ApplCanComAb_FD11_COMRX_OBC_Temp1_DUALCHARGER_THERMAL_FD11_Received  # Received
          data-receive-point-by-arguments:
            access DRP_CanCom_FD11RxSignalsSR_COMRX_OBC_Temp1_DUALCHARGER_THERMAL_FD11: accessed-variable=CanCom_FD11RxSignalsSR.COMRX_OBC_Temp1_DUALCHARGER_THERMAL_FD11
          data-send-points:
            access DSP_VeCANR_T_OBC_Temp1_FD11_VeCANR_T_OBC_Temp1_FD11: accessed-variable=VeCANR_T_OBC_Temp1_FD11.VeCANR_T_OBC_Temp1_FD11
            access DSP_VeCANR_b_OBC_Temp1_FD11TO_VeCANR_b_OBC_Temp1_FD11TO: accessed-variable=VeCANR_b_OBC_Temp1_FD11TO.VeCANR_b_OBC_Temp1_FD11TO
        COMRX_OBC_Temp1_DUALCHARGER_THERMAL_FD11_Error: symbol=ApplCanComAb_FD11_COMRX_OBC_Temp1_DUALCHARGER_THERMAL_FD11_Error  # Error
          data-receive-point-by-arguments:
            access DRP_CanCom_FD11RxSignalsSR_COMRX_OBC_Temp1_DUALCHARGER_THERMAL_FD11: accessed-variable=CanCom_FD11RxSignalsSR.COMRX_OBC_Temp1_DUALCHARGER_THERMAL_FD11
          data-send-points:
            access DSP_VeCANR_T_OBC_Temp1_FD11_VeCANR_T_OBC_Temp1_FD11: accessed-variable=VeCANR_T_OBC_Temp1_FD11.VeCANR_T_OBC_Temp1_FD11
            access DSP_VeCANR_b_OBC_Temp1_FD11TO_VeCANR_b_OBC_Temp1_FD11TO: accessed-variable=VeCANR_b_OBC_Temp1_FD11TO.VeCANR_b_OBC_Temp1_FD11TO
        COMRX_OBC_Temp2_DUALCHARGER_THERMAL_FD11_Received: symbol=ApplCanComAb_FD11_COMRX_OBC_Temp2_DUALCHARGER_THERMAL_FD11_Received  # Received
          data-receive-point-by-arguments:
            access DRP_CanCom_FD11RxSignalsSR_COMRX_OBC_Temp2_DUALCHARGER_THERMAL_FD11: accessed-variable=CanCom_FD11RxSignalsSR.COMRX_OBC_Temp2_DUALCHARGER_THERMAL_FD11
          data-send-points:
            access DSP_VeCANR_T_OBC_Temp2_FD11_VeCANR_T_OBC_Temp2_FD11: accessed-variable=VeCANR_T_OBC_Temp2_FD11.VeCANR_T_OBC_Temp2_FD11
            access DSP_VeCANR_b_OBC_Temp2_FD11TO_VeCANR_b_OBC_Temp2_FD11TO: accessed-variable=VeCANR_b_OBC_Temp2_FD11TO.VeCANR_b_OBC_Temp2_FD11TO
        COMRX_OBC_Temp2_DUALCHARGER_THERMAL_FD11_Error: symbol=ApplCanComAb_FD11_COMRX_OBC_Temp2_DUALCHARGER_THERMAL_FD11_Error  # Error
          data-receive-point-by-arguments:
            access DRP_CanCom_FD11RxSignalsSR_COMRX_OBC_Temp2_DUALCHARGER_THERMAL_FD11: accessed-variable=CanCom_FD11RxSignalsSR.COMRX_OBC_Temp2_DUALCHARGER_THERMAL_FD11
          data-send-points:
            access DSP_VeCANR_T_OBC_Temp2_FD11_VeCANR_T_OBC_Temp2_FD11: accessed-variable=VeCANR_T_OBC_Temp2_FD11.VeCANR_T_OBC_Temp2_FD11
            access DSP_VeCANR_b_OBC_Temp2_FD11TO_VeCANR_b_OBC_Temp2_FD11TO: accessed-variable=VeCANR_b_OBC_Temp2_FD11TO.VeCANR_b_OBC_Temp2_FD11TO
        COMRX_OBC_Temp3_DUALCHARGER_THERMAL_FD11_Received: symbol=ApplCanComAb_FD11_COMRX_OBC_Temp3_DUALCHARGER_THERMAL_FD11_Received  # Received
          data-receive-point-by-arguments:
            access DRP_CanCom_FD11RxSignalsSR_COMRX_OBC_Temp3_DUALCHARGER_THERMAL_FD11: accessed-variable=CanCom_FD11RxSignalsSR.COMRX_OBC_Temp3_DUALCHARGER_THERMAL_FD11
          data-send-points:
            access DSP_VeCANR_T_OBC_Temp3_FD11_VeCANR_T_OBC_Temp3_FD11: accessed-variable=VeCANR_T_OBC_Temp3_FD11.VeCANR_T_OBC_Temp3_FD11
            access DSP_VeCANR_b_OBC_Temp3_FD11TO_VeCANR_b_OBC_Temp3_FD11TO: accessed-variable=VeCANR_b_OBC_Temp3_FD11TO.VeCANR_b_OBC_Temp3_FD11TO
        COMRX_OBC_Temp3_DUALCHARGER_THERMAL_FD11_Error: symbol=ApplCanComAb_FD11_COMRX_OBC_Temp3_DUALCHARGER_THERMAL_FD11_Error  # Error
          data-receive-point-by-arguments:
            access DRP_CanCom_FD11RxSignalsSR_COMRX_OBC_Temp3_DUALCHARGER_THERMAL_FD11: accessed-variable=CanCom_FD11RxSignalsSR.COMRX_OBC_Temp3_DUALCHARGER_THERMAL_FD11
          data-send-points:
            access DSP_VeCANR_T_OBC_Temp3_FD11_VeCANR_T_OBC_Temp3_FD11: accessed-variable=VeCANR_T_OBC_Temp3_FD11.VeCANR_T_OBC_Temp3_FD11
            access DSP_VeCANR_b_OBC_Temp3_FD11TO_VeCANR_b_OBC_Temp3_FD11TO: accessed-variable=VeCANR_b_OBC_Temp3_FD11TO.VeCANR_b_OBC_Temp3_FD11TO
        COMRX_OBC_Temp4_DUALCHARGER_THERMAL_FD11_Received: symbol=ApplCanComAb_FD11_COMRX_OBC_Temp4_DUALCHARGER_THERMAL_FD11_Received  # Received
          data-receive-point-by-arguments:
            access DRP_CanCom_FD11RxSignalsSR_COMRX_OBC_Temp4_DUALCHARGER_THERMAL_FD11: accessed-variable=CanCom_FD11RxSignalsSR.COMRX_OBC_Temp4_DUALCHARGER_THERMAL_FD11
          data-send-points:
            access DSP_VeCANR_T_OBC_Temp4_FD11_VeCANR_T_OBC_Temp4_FD11: accessed-variable=VeCANR_T_OBC_Temp4_FD11.VeCANR_T_OBC_Temp4_FD11
            access DSP_VeCANR_b_OBC_Temp4_FD11TO_VeCANR_b_OBC_Temp4_FD11TO: accessed-variable=VeCANR_b_OBC_Temp4_FD11TO.VeCANR_b_OBC_Temp4_FD11TO
        COMRX_OBC_Temp4_DUALCHARGER_THERMAL_FD11_Error: symbol=ApplCanComAb_FD11_COMRX_OBC_Temp4_DUALCHARGER_THERMAL_FD11_Error  # Error
          data-receive-point-by-arguments:
            access DRP_CanCom_FD11RxSignalsSR_COMRX_OBC_Temp4_DUALCHARGER_THERMAL_FD11: accessed-variable=CanCom_FD11RxSignalsSR.COMRX_OBC_Temp4_DUALCHARGER_THERMAL_FD11
          data-send-points:
            access DSP_VeCANR_T_OBC_Temp4_FD11_VeCANR_T_OBC_Temp4_FD11: accessed-variable=VeCANR_T_OBC_Temp4_FD11.VeCANR_T_OBC_Temp4_FD11
            access DSP_VeCANR_b_OBC_Temp4_FD11TO_VeCANR_b_OBC_Temp4_FD11TO: accessed-variable=VeCANR_b_OBC_Temp4_FD11TO.VeCANR_b_OBC_Temp4_FD11TO
        COMRX_CRC_FOTA_MASTER_FOTA_MASTER_FD11_Received: symbol=ApplCanComAb_FD11_COMRX_CRC_FOTA_MASTER_FOTA_MASTER_FD11_Received  # Received
          data-receive-point-by-arguments:
            access DRP_CanCom_FD11RxSignalsSR_COMRX_CRC_FOTA_MASTER_FOTA_MASTER_FD11: accessed-variable=CanCom_FD11RxSignalsSR.COMRX_CRC_FOTA_MASTER_FOTA_MASTER_FD11
          data-send-points:
            access DSP_VeCANR_y_CRC_FOTA_MASTER_VeCANR_y_CRC_FOTA_MASTER: accessed-variable=VeCANR_y_CRC_FOTA_MASTER.VeCANR_y_CRC_FOTA_MASTER
            access DSP_VeCANR_b_CRC_FOTA_MASTER_TO_VeCANR_b_CRC_FOTA_MASTER_TO: accessed-variable=VeCANR_b_CRC_FOTA_MASTER_TO.VeCANR_b_CRC_FOTA_MASTER_TO
        COMRX_CRC_FOTA_MASTER_FOTA_MASTER_FD11_Error: symbol=ApplCanComAb_FD11_COMRX_CRC_FOTA_MASTER_FOTA_MASTER_FD11_Error  # Error
          data-receive-point-by-arguments:
            access DRP_CanCom_FD11RxSignalsSR_COMRX_CRC_FOTA_MASTER_FOTA_MASTER_FD11: accessed-variable=CanCom_FD11RxSignalsSR.COMRX_CRC_FOTA_MASTER_FOTA_MASTER_FD11
          data-send-points:
            access DSP_VeCANR_y_CRC_FOTA_MASTER_VeCANR_y_CRC_FOTA_MASTER: accessed-variable=VeCANR_y_CRC_FOTA_MASTER.VeCANR_y_CRC_FOTA_MASTER
            access DSP_VeCANR_b_CRC_FOTA_MASTER_TO_VeCANR_b_CRC_FOTA_MASTER_TO: accessed-variable=VeCANR_b_CRC_FOTA_MASTER_TO.VeCANR_b_CRC_FOTA_MASTER_TO
        COMRX_FOTA_Status_FOTA_MASTER_FD11_Received: symbol=ApplCanComAb_FD11_COMRX_FOTA_Status_FOTA_MASTER_FD11_Received  # Received
          data-receive-point-by-arguments:
            access DRP_CanCom_FD11RxSignalsSR_COMRX_FOTA_Status_FOTA_MASTER_FD11: accessed-variable=CanCom_FD11RxSignalsSR.COMRX_FOTA_Status_FOTA_MASTER_FD11
          data-send-points:
            access DSP_VeCANR_e_FOTA_Status_VeCANR_e_FOTA_Status: accessed-variable=VeCANR_e_FOTA_Status.VeCANR_e_FOTA_Status
            access DSP_VeCANR_b_FOTA_StatusTO_VeCANR_b_FOTA_StatusTO: accessed-variable=VeCANR_b_FOTA_StatusTO.VeCANR_b_FOTA_StatusTO
        COMRX_FOTA_Status_FOTA_MASTER_FD11_Error: symbol=ApplCanComAb_FD11_COMRX_FOTA_Status_FOTA_MASTER_FD11_Error  # Error
          data-receive-point-by-arguments:
            access DRP_CanCom_FD11RxSignalsSR_COMRX_FOTA_Status_FOTA_MASTER_FD11: accessed-variable=CanCom_FD11RxSignalsSR.COMRX_FOTA_Status_FOTA_MASTER_FD11
          data-send-points:
            access DSP_VeCANR_e_FOTA_Status_VeCANR_e_FOTA_Status: accessed-variable=VeCANR_e_FOTA_Status.VeCANR_e_FOTA_Status
            access DSP_VeCANR_b_FOTA_StatusTO_VeCANR_b_FOTA_StatusTO: accessed-variable=VeCANR_b_FOTA_StatusTO.VeCANR_b_FOTA_StatusTO
        COMRX_MessageCounter_FOTA_MASTER_FOTA_MASTER_FD11_Received: symbol=ApplCanComAb_FD11_COMRX_MessageCounter_FOTA_MASTER_FOTA_MASTER_FD11_Received  # Received
          data-receive-point-by-arguments:
            access DRP_CanCom_FD11RxSignalsSR_COMRX_MessageCounter_FOTA_MASTER_FOTA_MASTER_FD11: accessed-variable=CanCom_FD11RxSignalsSR.COMRX_MessageCounter_FOTA_MASTER_FOTA_MASTER_FD11
          data-send-points:
            access DSP_VeCANR_y_MC_FOTA_MASTER_VeCANR_y_MC_FOTA_MASTER: accessed-variable=VeCANR_y_MC_FOTA_MASTER.VeCANR_y_MC_FOTA_MASTER
            access DSP_VeCANR_b_MC_FOTA_MASTER_TO_VeCANR_b_MC_FOTA_MASTER_TO: accessed-variable=VeCANR_b_MC_FOTA_MASTER_TO.VeCANR_b_MC_FOTA_MASTER_TO
        COMRX_MessageCounter_FOTA_MASTER_FOTA_MASTER_FD11_Error: symbol=ApplCanComAb_FD11_COMRX_MessageCounter_FOTA_MASTER_FOTA_MASTER_FD11_Error  # Error
          data-receive-point-by-arguments:
            access DRP_CanCom_FD11RxSignalsSR_COMRX_MessageCounter_FOTA_MASTER_FOTA_MASTER_FD11: accessed-variable=CanCom_FD11RxSignalsSR.COMRX_MessageCounter_FOTA_MASTER_FOTA_MASTER_FD11
          data-send-points:
            access DSP_VeCANR_y_MC_FOTA_MASTER_VeCANR_y_MC_FOTA_MASTER: accessed-variable=VeCANR_y_MC_FOTA_MASTER.VeCANR_y_MC_FOTA_MASTER
            access DSP_VeCANR_b_MC_FOTA_MASTER_TO_VeCANR_b_MC_FOTA_MASTER_TO: accessed-variable=VeCANR_b_MC_FOTA_MASTER_TO.VeCANR_b_MC_FOTA_MASTER_TO
        COMRX_N_PDU_7E_GLIWA_MCPA_RX_FD11_Received: symbol=ApplCanComAb_FD11_COMRX_N_PDU_7E_GLIWA_MCPA_RX_FD11_Received  # Received
          data-receive-point-by-arguments:
            access DRP_CanCom_FD11RxSignalsSR_COMRX_N_PDU_7E_GLIWA_MCPA_RX_FD11: accessed-variable=CanCom_FD11RxSignalsSR.COMRX_N_PDU_7E_GLIWA_MCPA_RX_FD11
          data-send-points:
            access DSP_VeCANR_cmp_N_PDU_7E_FD11_VeCANR_cmp_N_PDU_7E_FD11: accessed-variable=VeCANR_cmp_N_PDU_7E_FD11.VeCANR_cmp_N_PDU_7E_FD11
            access DSP_VeCANR_b_N_PDU_7E_FD11TO_VeCANR_b_N_PDU_7E_FD11TO: accessed-variable=VeCANR_b_N_PDU_7E_FD11TO.VeCANR_b_N_PDU_7E_FD11TO
        COMRX_N_PDU_7E_GLIWA_MCPA_RX_FD11_Error: symbol=ApplCanComAb_FD11_COMRX_N_PDU_7E_GLIWA_MCPA_RX_FD11_Error  # Error
          data-receive-point-by-arguments:
            access DRP_CanCom_FD11RxSignalsSR_COMRX_N_PDU_7E_GLIWA_MCPA_RX_FD11: accessed-variable=CanCom_FD11RxSignalsSR.COMRX_N_PDU_7E_GLIWA_MCPA_RX_FD11
          data-send-points:
            access DSP_VeCANR_cmp_N_PDU_7E_FD11_VeCANR_cmp_N_PDU_7E_FD11: accessed-variable=VeCANR_cmp_N_PDU_7E_FD11.VeCANR_cmp_N_PDU_7E_FD11
            access DSP_VeCANR_b_N_PDU_7E_FD11TO_VeCANR_b_N_PDU_7E_FD11TO: accessed-variable=VeCANR_b_N_PDU_7E_FD11TO.VeCANR_b_N_PDU_7E_FD11TO
        COMRX_N_PDU_7F_GLIWA_MCPB_RX_FD11_Received: symbol=ApplCanComAb_FD11_COMRX_N_PDU_7F_GLIWA_MCPB_RX_FD11_Received  # Received
          data-receive-point-by-arguments:
            access DRP_CanCom_FD11RxSignalsSR_COMRX_N_PDU_7F_GLIWA_MCPB_RX_FD11: accessed-variable=CanCom_FD11RxSignalsSR.COMRX_N_PDU_7F_GLIWA_MCPB_RX_FD11
          data-send-points:
            access DSP_VeCANR_cmp_N_PDU_7F_FD11_VeCANR_cmp_N_PDU_7F_FD11: accessed-variable=VeCANR_cmp_N_PDU_7F_FD11.VeCANR_cmp_N_PDU_7F_FD11
            access DSP_VeCANR_b_N_PDU_7F_FD11TO_VeCANR_b_N_PDU_7F_FD11TO: accessed-variable=VeCANR_b_N_PDU_7F_FD11TO.VeCANR_b_N_PDU_7F_FD11TO
        COMRX_N_PDU_7F_GLIWA_MCPB_RX_FD11_Error: symbol=ApplCanComAb_FD11_COMRX_N_PDU_7F_GLIWA_MCPB_RX_FD11_Error  # Error
          data-receive-point-by-arguments:
            access DRP_CanCom_FD11RxSignalsSR_COMRX_N_PDU_7F_GLIWA_MCPB_RX_FD11: accessed-variable=CanCom_FD11RxSignalsSR.COMRX_N_PDU_7F_GLIWA_MCPB_RX_FD11
          data-send-points:
            access DSP_VeCANR_cmp_N_PDU_7F_FD11_VeCANR_cmp_N_PDU_7F_FD11: accessed-variable=VeCANR_cmp_N_PDU_7F_FD11.VeCANR_cmp_N_PDU_7F_FD11
            access DSP_VeCANR_b_N_PDU_7F_FD11TO_VeCANR_b_N_PDU_7F_FD11TO: accessed-variable=VeCANR_b_N_PDU_7F_FD11TO.VeCANR_b_N_PDU_7F_FD11TO
        COMRX_N_PDU_81_GLIWA_SGCP_RX_FD11_Received: symbol=ApplCanComAb_FD11_COMRX_N_PDU_81_GLIWA_SGCP_RX_FD11_Received  # Received
          data-receive-point-by-arguments:
            access DRP_CanCom_FD11RxSignalsSR_COMRX_N_PDU_81_GLIWA_SGCP_RX_FD11: accessed-variable=CanCom_FD11RxSignalsSR.COMRX_N_PDU_81_GLIWA_SGCP_RX_FD11
          data-send-points:
            access DSP_VeCANR_cmp_N_PDU_81_FD11_VeCANR_cmp_N_PDU_81_FD11: accessed-variable=VeCANR_cmp_N_PDU_81_FD11.VeCANR_cmp_N_PDU_81_FD11
            access DSP_VeCANR_b_N_PDU_81_FD11TO_VeCANR_b_N_PDU_81_FD11TO: accessed-variable=VeCANR_b_N_PDU_81_FD11TO.VeCANR_b_N_PDU_81_FD11TO
        COMRX_N_PDU_81_GLIWA_SGCP_RX_FD11_Error: symbol=ApplCanComAb_FD11_COMRX_N_PDU_81_GLIWA_SGCP_RX_FD11_Error  # Error
          data-receive-point-by-arguments:
            access DRP_CanCom_FD11RxSignalsSR_COMRX_N_PDU_81_GLIWA_SGCP_RX_FD11: accessed-variable=CanCom_FD11RxSignalsSR.COMRX_N_PDU_81_GLIWA_SGCP_RX_FD11
          data-send-points:
            access DSP_VeCANR_cmp_N_PDU_81_FD11_VeCANR_cmp_N_PDU_81_FD11: accessed-variable=VeCANR_cmp_N_PDU_81_FD11.VeCANR_cmp_N_PDU_81_FD11
            access DSP_VeCANR_b_N_PDU_81_FD11TO_VeCANR_b_N_PDU_81_FD11TO: accessed-variable=VeCANR_b_N_PDU_81_FD11TO.VeCANR_b_N_PDU_81_FD11TO
        COMRX_N_PDU_343_GLIWA_T1_RX_FD11_Received: symbol=ApplCanComAb_FD11_COMRX_N_PDU_343_GLIWA_T1_RX_FD11_Received  # Received
          data-receive-point-by-arguments:
            access DRP_CanCom_FD11RxSignalsSR_COMRX_N_PDU_343_GLIWA_T1_RX_FD11: accessed-variable=CanCom_FD11RxSignalsSR.COMRX_N_PDU_343_GLIWA_T1_RX_FD11
          data-send-points:
            access DSP_VeCANR_cmp_N_PDU_343_FD11_VeCANR_cmp_N_PDU_343_FD11: accessed-variable=VeCANR_cmp_N_PDU_343_FD11.VeCANR_cmp_N_PDU_343_FD11
            access DSP_VeCANR_b_N_PDU_343_FD11TO_VeCANR_b_N_PDU_343_FD11TO: accessed-variable=VeCANR_b_N_PDU_343_FD11TO.VeCANR_b_N_PDU_343_FD11TO
        COMRX_N_PDU_343_GLIWA_T1_RX_FD11_Error: symbol=ApplCanComAb_FD11_COMRX_N_PDU_343_GLIWA_T1_RX_FD11_Error  # Error
          data-receive-point-by-arguments:
            access DRP_CanCom_FD11RxSignalsSR_COMRX_N_PDU_343_GLIWA_T1_RX_FD11: accessed-variable=CanCom_FD11RxSignalsSR.COMRX_N_PDU_343_GLIWA_T1_RX_FD11
          data-send-points:
            access DSP_VeCANR_cmp_N_PDU_343_FD11_VeCANR_cmp_N_PDU_343_FD11: accessed-variable=VeCANR_cmp_N_PDU_343_FD11.VeCANR_cmp_N_PDU_343_FD11
            access DSP_VeCANR_b_N_PDU_343_FD11TO_VeCANR_b_N_PDU_343_FD11TO: accessed-variable=VeCANR_b_N_PDU_343_FD11TO.VeCANR_b_N_PDU_343_FD11TO
        COMRX_HVBatteryMILRequest_HVBATTERY2_FD11_Received: symbol=ApplCanComAb_FD11_COMRX_HVBatteryMILRequest_HVBATTERY2_FD11_Received  # Received
          data-receive-point-by-arguments:
            access DRP_CanCom_FD11RxSignalsSR_COMRX_HVBatteryMILRequest_HVBATTERY2_FD11: accessed-variable=CanCom_FD11RxSignalsSR.COMRX_HVBatteryMILRequest_HVBATTERY2_FD11
          data-send-points:
            access DSP_VeCANR_b_HVBatteryMILReq_FD11_VeCANR_b_HVBatteryMILReq_FD11: accessed-variable=VeCANR_b_HVBatteryMILReq_FD11.VeCANR_b_HVBatteryMILReq_FD11
            access DSP_VeCANR_b_HVBatteryMILReq_FD11TO_VeCANR_b_HVBatteryMILReq_FD11TO: accessed-variable=VeCANR_b_HVBatteryMILReq_FD11TO.VeCANR_b_HVBatteryMILReq_FD11TO
        COMRX_HVBatteryMILRequest_HVBATTERY2_FD11_Error: symbol=ApplCanComAb_FD11_COMRX_HVBatteryMILRequest_HVBATTERY2_FD11_Error  # Error
          data-receive-point-by-arguments:
            access DRP_CanCom_FD11RxSignalsSR_COMRX_HVBatteryMILRequest_HVBATTERY2_FD11: accessed-variable=CanCom_FD11RxSignalsSR.COMRX_HVBatteryMILRequest_HVBATTERY2_FD11
          data-send-points:
            access DSP_VeCANR_b_HVBatteryMILReq_FD11_VeCANR_b_HVBatteryMILReq_FD11: accessed-variable=VeCANR_b_HVBatteryMILReq_FD11.VeCANR_b_HVBatteryMILReq_FD11
            access DSP_VeCANR_b_HVBatteryMILReq_FD11TO_VeCANR_b_HVBatteryMILReq_FD11TO: accessed-variable=VeCANR_b_HVBatteryMILReq_FD11TO.VeCANR_b_HVBatteryMILReq_FD11TO
        COMRX_HVBattery_RealTimeClock_HVBATTERY5_FD11_Received: symbol=ApplCanComAb_FD11_COMRX_HVBattery_RealTimeClock_HVBATTERY5_FD11_Received  # Received
          data-receive-point-by-arguments:
            access DRP_CanCom_FD11RxSignalsSR_COMRX_HVBattery_RealTimeClock_HVBATTERY5_FD11: accessed-variable=CanCom_FD11RxSignalsSR.COMRX_HVBattery_RealTimeClock_HVBATTERY5_FD11
          data-send-points:
            access DSP_VeCANR_t_HVBattRealTimeClkFD11_VeCANR_t_HVBattRealTimeClkFD11: accessed-variable=VeCANR_t_HVBattRealTimeClkFD11.VeCANR_t_HVBattRealTimeClkFD11
            access DSP_VeCANR_b_HVBattRealTimeClkFD11TO_VeCANR_b_HVBattRealTimeClkFD11TO: accessed-variable=VeCANR_b_HVBattRealTimeClkFD11TO.VeCANR_b_HVBattRealTimeClkFD11TO
        COMRX_HVBattery_RealTimeClock_HVBATTERY5_FD11_Error: symbol=ApplCanComAb_FD11_COMRX_HVBattery_RealTimeClock_HVBATTERY5_FD11_Error  # Error
          data-receive-point-by-arguments:
            access DRP_CanCom_FD11RxSignalsSR_COMRX_HVBattery_RealTimeClock_HVBATTERY5_FD11: accessed-variable=CanCom_FD11RxSignalsSR.COMRX_HVBattery_RealTimeClock_HVBATTERY5_FD11
          data-send-points:
            access DSP_VeCANR_t_HVBattRealTimeClkFD11_VeCANR_t_HVBattRealTimeClkFD11: accessed-variable=VeCANR_t_HVBattRealTimeClkFD11.VeCANR_t_HVBattRealTimeClkFD11
            access DSP_VeCANR_b_HVBattRealTimeClkFD11TO_VeCANR_b_HVBattRealTimeClkFD11TO: accessed-variable=VeCANR_b_HVBattRealTimeClkFD11TO.VeCANR_b_HVBattRealTimeClkFD11TO
        COMRX_HVBattery_RealTimeClockV_HVBATTERY5_FD11_Received: symbol=ApplCanComAb_FD11_COMRX_HVBattery_RealTimeClockV_HVBATTERY5_FD11_Received  # Received
          data-receive-point-by-arguments:
            access DRP_CanCom_FD11RxSignalsSR_COMRX_HVBattery_RealTimeClockV_HVBATTERY5_FD11: accessed-variable=CanCom_FD11RxSignalsSR.COMRX_HVBattery_RealTimeClockV_HVBATTERY5_FD11
          data-send-points:
            access DSP_VeCANR_b_HVBattRealTimeClkVFD11_VeCANR_b_HVBattRealTimeClkVFD11: accessed-variable=VeCANR_b_HVBattRealTimeClkVFD11.VeCANR_b_HVBattRealTimeClkVFD11
            access DSP_VeCANR_b_HVBattRealTimeClkVFD11TO_VeCANR_b_HVBattRealTimeClkVFD11TO: accessed-variable=VeCANR_b_HVBattRealTimeClkVFD11TO.VeCANR_b_HVBattRealTimeClkVFD11TO
        COMRX_HVBattery_RealTimeClockV_HVBATTERY5_FD11_Error: symbol=ApplCanComAb_FD11_COMRX_HVBattery_RealTimeClockV_HVBATTERY5_FD11_Error  # Error
          data-receive-point-by-arguments:
            access DRP_CanCom_FD11RxSignalsSR_COMRX_HVBattery_RealTimeClockV_HVBATTERY5_FD11: accessed-variable=CanCom_FD11RxSignalsSR.COMRX_HVBattery_RealTimeClockV_HVBATTERY5_FD11
          data-send-points:
            access DSP_VeCANR_b_HVBattRealTimeClkVFD11_VeCANR_b_HVBattRealTimeClkVFD11: accessed-variable=VeCANR_b_HVBattRealTimeClkVFD11.VeCANR_b_HVBattRealTimeClkVFD11
            access DSP_VeCANR_b_HVBattRealTimeClkVFD11TO_VeCANR_b_HVBattRealTimeClkVFD11TO: accessed-variable=VeCANR_b_HVBattRealTimeClkVFD11TO.VeCANR_b_HVBattRealTimeClkVFD11TO
        COMRX_Warning_PackTempHigh_HVBATTERY_RM_CHARGING1_FD11_Received: symbol=ApplCanComAb_FD11_COMRX_Warning_PackTempHigh_HVBATTERY_RM_CHARGING1_FD11_Received  # Received
          data-receive-point-by-arguments:
            access DRP_CanCom_FD11RxSignalsSR_COMRX_Warning_PackTempHigh_HVBATTERY_RM_CHARGING1_FD11: accessed-variable=CanCom_FD11RxSignalsSR.COMRX_Warning_PackTempHigh_HVBATTERY_RM_CHARGING1_FD11
          data-send-points:
            access DSP_VeCANR_b_Wrng_PackTempHigh_FD11_VeCANR_b_Wrng_PackTempHigh_FD11: accessed-variable=VeCANR_b_Wrng_PackTempHigh_FD11.VeCANR_b_Wrng_PackTempHigh_FD11
            access DSP_VeCANR_b_Wrng_PackTempHigh_FD11TO_VeCANR_b_Wrng_PackTempHigh_FD11TO: accessed-variable=VeCANR_b_Wrng_PackTempHigh_FD11TO.VeCANR_b_Wrng_PackTempHigh_FD11TO
        COMRX_Warning_PackTempHigh_HVBATTERY_RM_CHARGING1_FD11_Error: symbol=ApplCanComAb_FD11_COMRX_Warning_PackTempHigh_HVBATTERY_RM_CHARGING1_FD11_Error  # Error
          data-receive-point-by-arguments:
            access DRP_CanCom_FD11RxSignalsSR_COMRX_Warning_PackTempHigh_HVBATTERY_RM_CHARGING1_FD11: accessed-variable=CanCom_FD11RxSignalsSR.COMRX_Warning_PackTempHigh_HVBATTERY_RM_CHARGING1_FD11
          data-send-points:
            access DSP_VeCANR_b_Wrng_PackTempHigh_FD11_VeCANR_b_Wrng_PackTempHigh_FD11: accessed-variable=VeCANR_b_Wrng_PackTempHigh_FD11.VeCANR_b_Wrng_PackTempHigh_FD11
            access DSP_VeCANR_b_Wrng_PackTempHigh_FD11TO_VeCANR_b_Wrng_PackTempHigh_FD11TO: accessed-variable=VeCANR_b_Wrng_PackTempHigh_FD11TO.VeCANR_b_Wrng_PackTempHigh_FD11TO
        COMRX_HVBatSleepTime_HVBATTERY_THERMAL_FD11_Received: symbol=ApplCanComAb_FD11_COMRX_HVBatSleepTime_HVBATTERY_THERMAL_FD11_Received  # Received
          data-receive-point-by-arguments:
            access DRP_CanCom_FD11RxSignalsSR_COMRX_HVBatSleepTime_HVBATTERY_THERMAL_FD11: accessed-variable=CanCom_FD11RxSignalsSR.COMRX_HVBatSleepTime_HVBATTERY_THERMAL_FD11
          data-send-points:
            access DSP_VeCANR_t_HVBatSleepTime_FD11_VeCANR_t_HVBatSleepTime_FD11: accessed-variable=VeCANR_t_HVBatSleepTime_FD11.VeCANR_t_HVBatSleepTime_FD11
            access DSP_VeCANR_b_HVBatSleepTime_FD11TO_VeCANR_b_HVBatSleepTime_FD11TO: accessed-variable=VeCANR_b_HVBatSleepTime_FD11TO.VeCANR_b_HVBatSleepTime_FD11TO
        COMRX_HVBatSleepTime_HVBATTERY_THERMAL_FD11_Error: symbol=ApplCanComAb_FD11_COMRX_HVBatSleepTime_HVBATTERY_THERMAL_FD11_Error  # Error
          data-receive-point-by-arguments:
            access DRP_CanCom_FD11RxSignalsSR_COMRX_HVBatSleepTime_HVBATTERY_THERMAL_FD11: accessed-variable=CanCom_FD11RxSignalsSR.COMRX_HVBatSleepTime_HVBATTERY_THERMAL_FD11
          data-send-points:
            access DSP_VeCANR_t_HVBatSleepTime_FD11_VeCANR_t_HVBatSleepTime_FD11: accessed-variable=VeCANR_t_HVBatSleepTime_FD11.VeCANR_t_HVBatSleepTime_FD11
            access DSP_VeCANR_b_HVBatSleepTime_FD11TO_VeCANR_b_HVBatSleepTime_FD11TO: accessed-variable=VeCANR_b_HVBatSleepTime_FD11TO.VeCANR_b_HVBatSleepTime_FD11TO
        COMRX_CdM_Avail_output_current_EXT_IDCM_CHADEMO_STATUS1_FD11_Received: symbol=ApplCanComAb_FD11_COMRX_CdM_Avail_output_current_EXT_IDCM_CHADEMO_STATUS1_FD11_Received  # Received
          data-receive-point-by-arguments:
            access DRP_CanCom_FD11RxSignalsSR_COMRX_CdM_Avail_output_current_EXT_IDCM_CHADEMO_STATUS1_FD11: accessed-variable=CanCom_FD11RxSignalsSR.COMRX_CdM_Avail_output_current_EXT_IDCM_CHADEMO_STATUS1_FD11
          data-send-points:
            access DSP_VeCANR_I_CdMAvailopcurentEXT_VeCANR_I_CdMAvailopcurentEXT: accessed-variable=VeCANR_I_CdMAvailopcurentEXT.VeCANR_I_CdMAvailopcurentEXT
            access DSP_VeCANR_b_CdMAvailopcurentEXT_TO_VeCANR_b_CdMAvailopcurentEXT_TO: accessed-variable=VeCANR_b_CdMAvailopcurentEXT_TO.VeCANR_b_CdMAvailopcurentEXT_TO
        COMRX_CdM_Avail_output_current_EXT_IDCM_CHADEMO_STATUS1_FD11_Error: symbol=ApplCanComAb_FD11_COMRX_CdM_Avail_output_current_EXT_IDCM_CHADEMO_STATUS1_FD11_Error  # Error
          data-receive-point-by-arguments:
            access DRP_CanCom_FD11RxSignalsSR_COMRX_CdM_Avail_output_current_EXT_IDCM_CHADEMO_STATUS1_FD11: accessed-variable=CanCom_FD11RxSignalsSR.COMRX_CdM_Avail_output_current_EXT_IDCM_CHADEMO_STATUS1_FD11
          data-send-points:
            access DSP_VeCANR_I_CdMAvailopcurentEXT_VeCANR_I_CdMAvailopcurentEXT: accessed-variable=VeCANR_I_CdMAvailopcurentEXT.VeCANR_I_CdMAvailopcurentEXT
            access DSP_VeCANR_b_CdMAvailopcurentEXT_TO_VeCANR_b_CdMAvailopcurentEXT_TO: accessed-variable=VeCANR_b_CdMAvailopcurentEXT_TO.VeCANR_b_CdMAvailopcurentEXT_TO
        COMRX_CdM_Charger_connector_lock_IDCM_CHADEMO_STATUS1_FD11_Received: symbol=ApplCanComAb_FD11_COMRX_CdM_Charger_connector_lock_IDCM_CHADEMO_STATUS1_FD11_Received  # Received
          data-receive-point-by-arguments:
            access DRP_CanCom_FD11RxSignalsSR_COMRX_CdM_Charger_connector_lock_IDCM_CHADEMO_STATUS1_FD11: accessed-variable=CanCom_FD11RxSignalsSR.COMRX_CdM_Charger_connector_lock_IDCM_CHADEMO_STATUS1_FD11
          data-send-points:
            access DSP_VeCANR_b_CdMChargerconnectlock_VeCANR_b_CdMChargerconnectlock: accessed-variable=VeCANR_b_CdMChargerconnectlock.VeCANR_b_CdMChargerconnectlock
            access DSP_VeCANR_b_CdMChargerconnectlockTO_VeCANR_b_CdMChargerconnectlockTO: accessed-variable=VeCANR_b_CdMChargerconnectlockTO.VeCANR_b_CdMChargerconnectlockTO
        COMRX_CdM_Charger_connector_lock_IDCM_CHADEMO_STATUS1_FD11_Error: symbol=ApplCanComAb_FD11_COMRX_CdM_Charger_connector_lock_IDCM_CHADEMO_STATUS1_FD11_Error  # Error
          data-receive-point-by-arguments:
            access DRP_CanCom_FD11RxSignalsSR_COMRX_CdM_Charger_connector_lock_IDCM_CHADEMO_STATUS1_FD11: accessed-variable=CanCom_FD11RxSignalsSR.COMRX_CdM_Charger_connector_lock_IDCM_CHADEMO_STATUS1_FD11
          data-send-points:
            access DSP_VeCANR_b_CdMChargerconnectlock_VeCANR_b_CdMChargerconnectlock: accessed-variable=VeCANR_b_CdMChargerconnectlock.VeCANR_b_CdMChargerconnectlock
            access DSP_VeCANR_b_CdMChargerconnectlockTO_VeCANR_b_CdMChargerconnectlockTO: accessed-variable=VeCANR_b_CdMChargerconnectlockTO.VeCANR_b_CdMChargerconnectlockTO
        COMRX_CdM_ExtFun_Thres_Volt_IDCM_CHADEMO_STATUS1_FD11_Received: symbol=ApplCanComAb_FD11_COMRX_CdM_ExtFun_Thres_Volt_IDCM_CHADEMO_STATUS1_FD11_Received  # Received
          data-receive-point-by-arguments:
            access DRP_CanCom_FD11RxSignalsSR_COMRX_CdM_ExtFun_Thres_Volt_IDCM_CHADEMO_STATUS1_FD11: accessed-variable=CanCom_FD11RxSignalsSR.COMRX_CdM_ExtFun_Thres_Volt_IDCM_CHADEMO_STATUS1_FD11
          data-send-points:
            access DSP_VeCANR_U_CdM_ExtFun_Thres_Volt_VeCANR_U_CdM_ExtFun_Thres_Volt: accessed-variable=VeCANR_U_CdM_ExtFun_Thres_Volt.VeCANR_U_CdM_ExtFun_Thres_Volt
            access DSP_VeCANR_b_CdM_ExtFun_Thres_VoltTO_VeCANR_b_CdM_ExtFun_Thres_VoltTO: accessed-variable=VeCANR_b_CdM_ExtFun_Thres_VoltTO.VeCANR_b_CdM_ExtFun_Thres_VoltTO
        COMRX_CdM_ExtFun_Thres_Volt_IDCM_CHADEMO_STATUS1_FD11_Error: symbol=ApplCanComAb_FD11_COMRX_CdM_ExtFun_Thres_Volt_IDCM_CHADEMO_STATUS1_FD11_Error  # Error
          data-receive-point-by-arguments:
            access DRP_CanCom_FD11RxSignalsSR_COMRX_CdM_ExtFun_Thres_Volt_IDCM_CHADEMO_STATUS1_FD11: accessed-variable=CanCom_FD11RxSignalsSR.COMRX_CdM_ExtFun_Thres_Volt_IDCM_CHADEMO_STATUS1_FD11
          data-send-points:
            access DSP_VeCANR_U_CdM_ExtFun_Thres_Volt_VeCANR_U_CdM_ExtFun_Thres_Volt: accessed-variable=VeCANR_U_CdM_ExtFun_Thres_Volt.VeCANR_U_CdM_ExtFun_Thres_Volt
            access DSP_VeCANR_b_CdM_ExtFun_Thres_VoltTO_VeCANR_b_CdM_ExtFun_Thres_VoltTO: accessed-variable=VeCANR_b_CdM_ExtFun_Thres_VoltTO.VeCANR_b_CdM_ExtFun_Thres_VoltTO
        COMRX_EVSE_BatteryCompatibilty_IDCM_CHADEMO_STATUS1_FD11_Received: symbol=ApplCanComAb_FD11_COMRX_EVSE_BatteryCompatibilty_IDCM_CHADEMO_STATUS1_FD11_Received  # Received
          data-receive-point-by-arguments:
            access DRP_CanCom_FD11RxSignalsSR_COMRX_EVSE_BatteryCompatibilty_IDCM_CHADEMO_STATUS1_FD11: accessed-variable=CanCom_FD11RxSignalsSR.COMRX_EVSE_BatteryCompatibilty_IDCM_CHADEMO_STATUS1_FD11
          data-send-points:
            access DSP_VeCANR_b_EVSEBTRyCompatibilty_VeCANR_b_EVSEBTRyCompatibilty: accessed-variable=VeCANR_b_EVSEBTRyCompatibilty.VeCANR_b_EVSEBTRyCompatibilty
            access DSP_VeCANR_b_EVSEBTRyCompatibiltyTO_VeCANR_b_EVSEBTRyCompatibiltyTO: accessed-variable=VeCANR_b_EVSEBTRyCompatibiltyTO.VeCANR_b_EVSEBTRyCompatibiltyTO
        COMRX_EVSE_BatteryCompatibilty_IDCM_CHADEMO_STATUS1_FD11_Error: symbol=ApplCanComAb_FD11_COMRX_EVSE_BatteryCompatibilty_IDCM_CHADEMO_STATUS1_FD11_Error  # Error
          data-receive-point-by-arguments:
            access DRP_CanCom_FD11RxSignalsSR_COMRX_EVSE_BatteryCompatibilty_IDCM_CHADEMO_STATUS1_FD11: accessed-variable=CanCom_FD11RxSignalsSR.COMRX_EVSE_BatteryCompatibilty_IDCM_CHADEMO_STATUS1_FD11
          data-send-points:
            access DSP_VeCANR_b_EVSEBTRyCompatibilty_VeCANR_b_EVSEBTRyCompatibilty: accessed-variable=VeCANR_b_EVSEBTRyCompatibilty.VeCANR_b_EVSEBTRyCompatibilty
            access DSP_VeCANR_b_EVSEBTRyCompatibiltyTO_VeCANR_b_EVSEBTRyCompatibiltyTO: accessed-variable=VeCANR_b_EVSEBTRyCompatibiltyTO.VeCANR_b_EVSEBTRyCompatibiltyTO
        COMRX_EVSE_CHAdeMOProtocol_IDCM_CHADEMO_STATUS1_FD11_Received: symbol=ApplCanComAb_FD11_COMRX_EVSE_CHAdeMOProtocol_IDCM_CHADEMO_STATUS1_FD11_Received  # Received
          data-receive-point-by-arguments:
            access DRP_CanCom_FD11RxSignalsSR_COMRX_EVSE_CHAdeMOProtocol_IDCM_CHADEMO_STATUS1_FD11: accessed-variable=CanCom_FD11RxSignalsSR.COMRX_EVSE_CHAdeMOProtocol_IDCM_CHADEMO_STATUS1_FD11
          data-send-points:
            access DSP_VeCANR_e_EVSE_CHAdeMOProtocol_VeCANR_e_EVSE_CHAdeMOProtocol: accessed-variable=VeCANR_e_EVSE_CHAdeMOProtocol.VeCANR_e_EVSE_CHAdeMOProtocol
            access DSP_VeCANR_b_EVSE_CHAdeMOProtocolTO_VeCANR_b_EVSE_CHAdeMOProtocolTO: accessed-variable=VeCANR_b_EVSE_CHAdeMOProtocolTO.VeCANR_b_EVSE_CHAdeMOProtocolTO
        COMRX_EVSE_CHAdeMOProtocol_IDCM_CHADEMO_STATUS1_FD11_Error: symbol=ApplCanComAb_FD11_COMRX_EVSE_CHAdeMOProtocol_IDCM_CHADEMO_STATUS1_FD11_Error  # Error
          data-receive-point-by-arguments:
            access DRP_CanCom_FD11RxSignalsSR_COMRX_EVSE_CHAdeMOProtocol_IDCM_CHADEMO_STATUS1_FD11: accessed-variable=CanCom_FD11RxSignalsSR.COMRX_EVSE_CHAdeMOProtocol_IDCM_CHADEMO_STATUS1_FD11
          data-send-points:
            access DSP_VeCANR_e_EVSE_CHAdeMOProtocol_VeCANR_e_EVSE_CHAdeMOProtocol: accessed-variable=VeCANR_e_EVSE_CHAdeMOProtocol.VeCANR_e_EVSE_CHAdeMOProtocol
            access DSP_VeCANR_b_EVSE_CHAdeMOProtocolTO_VeCANR_b_EVSE_CHAdeMOProtocolTO: accessed-variable=VeCANR_b_EVSE_CHAdeMOProtocolTO.VeCANR_b_EVSE_CHAdeMOProtocolTO
        COMRX_EVSE_ChargingSystemError_IDCM_CHADEMO_STATUS1_FD11_Received: symbol=ApplCanComAb_FD11_COMRX_EVSE_ChargingSystemError_IDCM_CHADEMO_STATUS1_FD11_Received  # Received
          data-receive-point-by-arguments:
            access DRP_CanCom_FD11RxSignalsSR_COMRX_EVSE_ChargingSystemError_IDCM_CHADEMO_STATUS1_FD11: accessed-variable=CanCom_FD11RxSignalsSR.COMRX_EVSE_ChargingSystemError_IDCM_CHADEMO_STATUS1_FD11
          data-send-points:
            access DSP_VeCANR_b_EVSEChargingStmError_VeCANR_b_EVSEChargingStmError: accessed-variable=VeCANR_b_EVSEChargingStmError.VeCANR_b_EVSEChargingStmError
            access DSP_VeCANR_b_EVSEChargingStmErrorTO_VeCANR_b_EVSEChargingStmErrorTO: accessed-variable=VeCANR_b_EVSEChargingStmErrorTO.VeCANR_b_EVSEChargingStmErrorTO
        COMRX_EVSE_ChargingSystemError_IDCM_CHADEMO_STATUS1_FD11_Error: symbol=ApplCanComAb_FD11_COMRX_EVSE_ChargingSystemError_IDCM_CHADEMO_STATUS1_FD11_Error  # Error
          data-receive-point-by-arguments:
            access DRP_CanCom_FD11RxSignalsSR_COMRX_EVSE_ChargingSystemError_IDCM_CHADEMO_STATUS1_FD11: accessed-variable=CanCom_FD11RxSignalsSR.COMRX_EVSE_ChargingSystemError_IDCM_CHADEMO_STATUS1_FD11
          data-send-points:
            access DSP_VeCANR_b_EVSEChargingStmError_VeCANR_b_EVSEChargingStmError: accessed-variable=VeCANR_b_EVSEChargingStmError.VeCANR_b_EVSEChargingStmError
            access DSP_VeCANR_b_EVSEChargingStmErrorTO_VeCANR_b_EVSEChargingStmErrorTO: accessed-variable=VeCANR_b_EVSEChargingStmErrorTO.VeCANR_b_EVSEChargingStmErrorTO
        COMRX_EVSE_EnergizingState_IDCM_CHADEMO_STATUS1_FD11_Received: symbol=ApplCanComAb_FD11_COMRX_EVSE_EnergizingState_IDCM_CHADEMO_STATUS1_FD11_Received  # Received
          data-receive-point-by-arguments:
            access DRP_CanCom_FD11RxSignalsSR_COMRX_EVSE_EnergizingState_IDCM_CHADEMO_STATUS1_FD11: accessed-variable=CanCom_FD11RxSignalsSR.COMRX_EVSE_EnergizingState_IDCM_CHADEMO_STATUS1_FD11
          data-send-points:
            access DSP_VeCANR_b_EVSE_EnergizingState_VeCANR_b_EVSE_EnergizingState: accessed-variable=VeCANR_b_EVSE_EnergizingState.VeCANR_b_EVSE_EnergizingState
            access DSP_VeCANR_b_EVSE_EnergizingStateTO_VeCANR_b_EVSE_EnergizingStateTO: accessed-variable=VeCANR_b_EVSE_EnergizingStateTO.VeCANR_b_EVSE_EnergizingStateTO
        COMRX_EVSE_EnergizingState_IDCM_CHADEMO_STATUS1_FD11_Error: symbol=ApplCanComAb_FD11_COMRX_EVSE_EnergizingState_IDCM_CHADEMO_STATUS1_FD11_Error  # Error
          data-receive-point-by-arguments:
            access DRP_CanCom_FD11RxSignalsSR_COMRX_EVSE_EnergizingState_IDCM_CHADEMO_STATUS1_FD11: accessed-variable=CanCom_FD11RxSignalsSR.COMRX_EVSE_EnergizingState_IDCM_CHADEMO_STATUS1_FD11
          data-send-points:
            access DSP_VeCANR_b_EVSE_EnergizingState_VeCANR_b_EVSE_EnergizingState: accessed-variable=VeCANR_b_EVSE_EnergizingState.VeCANR_b_EVSE_EnergizingState
            access DSP_VeCANR_b_EVSE_EnergizingStateTO_VeCANR_b_EVSE_EnergizingStateTO: accessed-variable=VeCANR_b_EVSE_EnergizingStateTO.VeCANR_b_EVSE_EnergizingStateTO
        COMRX_EVSE_RemainingMin_IDCM_CHADEMO_STATUS1_FD11_Received: symbol=ApplCanComAb_FD11_COMRX_EVSE_RemainingMin_IDCM_CHADEMO_STATUS1_FD11_Received  # Received
          data-receive-point-by-arguments:
            access DRP_CanCom_FD11RxSignalsSR_COMRX_EVSE_RemainingMin_IDCM_CHADEMO_STATUS1_FD11: accessed-variable=CanCom_FD11RxSignalsSR.COMRX_EVSE_RemainingMin_IDCM_CHADEMO_STATUS1_FD11
          data-send-points:
            access DSP_VeCANR_t_EVSE_RemainingMin_VeCANR_t_EVSE_RemainingMin: accessed-variable=VeCANR_t_EVSE_RemainingMin.VeCANR_t_EVSE_RemainingMin
            access DSP_VeCANR_b_EVSE_RemainingMinTO_VeCANR_b_EVSE_RemainingMinTO: accessed-variable=VeCANR_b_EVSE_RemainingMinTO.VeCANR_b_EVSE_RemainingMinTO
        COMRX_EVSE_RemainingMin_IDCM_CHADEMO_STATUS1_FD11_Error: symbol=ApplCanComAb_FD11_COMRX_EVSE_RemainingMin_IDCM_CHADEMO_STATUS1_FD11_Error  # Error
          data-receive-point-by-arguments:
            access DRP_CanCom_FD11RxSignalsSR_COMRX_EVSE_RemainingMin_IDCM_CHADEMO_STATUS1_FD11: accessed-variable=CanCom_FD11RxSignalsSR.COMRX_EVSE_RemainingMin_IDCM_CHADEMO_STATUS1_FD11
          data-send-points:
            access DSP_VeCANR_t_EVSE_RemainingMin_VeCANR_t_EVSE_RemainingMin: accessed-variable=VeCANR_t_EVSE_RemainingMin.VeCANR_t_EVSE_RemainingMin
            access DSP_VeCANR_b_EVSE_RemainingMinTO_VeCANR_b_EVSE_RemainingMinTO: accessed-variable=VeCANR_b_EVSE_RemainingMinTO.VeCANR_b_EVSE_RemainingMinTO
        COMRX_EVSE_RemainingSec_IDCM_CHADEMO_STATUS1_FD11_Received: symbol=ApplCanComAb_FD11_COMRX_EVSE_RemainingSec_IDCM_CHADEMO_STATUS1_FD11_Received  # Received
          data-receive-point-by-arguments:
            access DRP_CanCom_FD11RxSignalsSR_COMRX_EVSE_RemainingSec_IDCM_CHADEMO_STATUS1_FD11: accessed-variable=CanCom_FD11RxSignalsSR.COMRX_EVSE_RemainingSec_IDCM_CHADEMO_STATUS1_FD11
          data-send-points:
            access DSP_VeCANR_t_EVSE_RemainingSec_VeCANR_t_EVSE_RemainingSec: accessed-variable=VeCANR_t_EVSE_RemainingSec.VeCANR_t_EVSE_RemainingSec
            access DSP_VeCANR_b_EVSE_RemainingSecTO_VeCANR_b_EVSE_RemainingSecTO: accessed-variable=VeCANR_b_EVSE_RemainingSecTO.VeCANR_b_EVSE_RemainingSecTO
        COMRX_EVSE_RemainingSec_IDCM_CHADEMO_STATUS1_FD11_Error: symbol=ApplCanComAb_FD11_COMRX_EVSE_RemainingSec_IDCM_CHADEMO_STATUS1_FD11_Error  # Error
          data-receive-point-by-arguments:
            access DRP_CanCom_FD11RxSignalsSR_COMRX_EVSE_RemainingSec_IDCM_CHADEMO_STATUS1_FD11: accessed-variable=CanCom_FD11RxSignalsSR.COMRX_EVSE_RemainingSec_IDCM_CHADEMO_STATUS1_FD11
          data-send-points:
            access DSP_VeCANR_t_EVSE_RemainingSec_VeCANR_t_EVSE_RemainingSec: accessed-variable=VeCANR_t_EVSE_RemainingSec.VeCANR_t_EVSE_RemainingSec
            access DSP_VeCANR_b_EVSE_RemainingSecTO_VeCANR_b_EVSE_RemainingSecTO: accessed-variable=VeCANR_b_EVSE_RemainingSecTO.VeCANR_b_EVSE_RemainingSecTO
        COMRX_EVSE_ThrshldVoltage_IDCM_CHADEMO_STATUS1_FD11_Received: symbol=ApplCanComAb_FD11_COMRX_EVSE_ThrshldVoltage_IDCM_CHADEMO_STATUS1_FD11_Received  # Received
          data-receive-point-by-arguments:
            access DRP_CanCom_FD11RxSignalsSR_COMRX_EVSE_ThrshldVoltage_IDCM_CHADEMO_STATUS1_FD11: accessed-variable=CanCom_FD11RxSignalsSR.COMRX_EVSE_ThrshldVoltage_IDCM_CHADEMO_STATUS1_FD11
          data-send-points:
            access DSP_VeCANR_U_EVSE_ThrshldVoltage_VeCANR_U_EVSE_ThrshldVoltage: accessed-variable=VeCANR_U_EVSE_ThrshldVoltage.VeCANR_U_EVSE_ThrshldVoltage
            access DSP_VeCANR_b_EVSE_ThrshldVoltageTO_VeCANR_b_EVSE_ThrshldVoltageTO: accessed-variable=VeCANR_b_EVSE_ThrshldVoltageTO.VeCANR_b_EVSE_ThrshldVoltageTO
        COMRX_EVSE_ThrshldVoltage_IDCM_CHADEMO_STATUS1_FD11_Error: symbol=ApplCanComAb_FD11_COMRX_EVSE_ThrshldVoltage_IDCM_CHADEMO_STATUS1_FD11_Error  # Error
          data-receive-point-by-arguments:
            access DRP_CanCom_FD11RxSignalsSR_COMRX_EVSE_ThrshldVoltage_IDCM_CHADEMO_STATUS1_FD11: accessed-variable=CanCom_FD11RxSignalsSR.COMRX_EVSE_ThrshldVoltage_IDCM_CHADEMO_STATUS1_FD11
          data-send-points:
            access DSP_VeCANR_U_EVSE_ThrshldVoltage_VeCANR_U_EVSE_ThrshldVoltage: accessed-variable=VeCANR_U_EVSE_ThrshldVoltage.VeCANR_U_EVSE_ThrshldVoltage
            access DSP_VeCANR_b_EVSE_ThrshldVoltageTO_VeCANR_b_EVSE_ThrshldVoltageTO: accessed-variable=VeCANR_b_EVSE_ThrshldVoltageTO.VeCANR_b_EVSE_ThrshldVoltageTO
        COMRX_CRC_IDCM_OBD_DTC_IDCM_OBD_DTC_FD11_Received: symbol=ApplCanComAb_FD11_COMRX_CRC_IDCM_OBD_DTC_IDCM_OBD_DTC_FD11_Received  # Received
          data-receive-point-by-arguments:
            access DRP_CanCom_FD11RxSignalsSR_COMRX_CRC_IDCM_OBD_DTC_IDCM_OBD_DTC_FD11: accessed-variable=CanCom_FD11RxSignalsSR.COMRX_CRC_IDCM_OBD_DTC_IDCM_OBD_DTC_FD11
          data-send-points:
            access DSP_VeCANR_y_CRC_IDCM_OBD_DTC_VeCANR_y_CRC_IDCM_OBD_DTC: accessed-variable=VeCANR_y_CRC_IDCM_OBD_DTC.VeCANR_y_CRC_IDCM_OBD_DTC
            access DSP_VeCANR_b_CRC_IDCM_OBD_DTC_TO_VeCANR_b_CRC_IDCM_OBD_DTC_TO: accessed-variable=VeCANR_b_CRC_IDCM_OBD_DTC_TO.VeCANR_b_CRC_IDCM_OBD_DTC_TO
        COMRX_CRC_IDCM_OBD_DTC_IDCM_OBD_DTC_FD11_Error: symbol=ApplCanComAb_FD11_COMRX_CRC_IDCM_OBD_DTC_IDCM_OBD_DTC_FD11_Error  # Error
          data-receive-point-by-arguments:
            access DRP_CanCom_FD11RxSignalsSR_COMRX_CRC_IDCM_OBD_DTC_IDCM_OBD_DTC_FD11: accessed-variable=CanCom_FD11RxSignalsSR.COMRX_CRC_IDCM_OBD_DTC_IDCM_OBD_DTC_FD11
          data-send-points:
            access DSP_VeCANR_y_CRC_IDCM_OBD_DTC_VeCANR_y_CRC_IDCM_OBD_DTC: accessed-variable=VeCANR_y_CRC_IDCM_OBD_DTC.VeCANR_y_CRC_IDCM_OBD_DTC
            access DSP_VeCANR_b_CRC_IDCM_OBD_DTC_TO_VeCANR_b_CRC_IDCM_OBD_DTC_TO: accessed-variable=VeCANR_b_CRC_IDCM_OBD_DTC_TO.VeCANR_b_CRC_IDCM_OBD_DTC_TO
        COMRX_IDCM_CAL_ID_IDCM_OBD_DTC_FD11_Received: symbol=ApplCanComAb_FD11_COMRX_IDCM_CAL_ID_IDCM_OBD_DTC_FD11_Received  # Received
          data-receive-point-by-arguments:
            access DRP_CanCom_FD11RxSignalsSR_COMRX_IDCM_CAL_ID_IDCM_OBD_DTC_FD11: accessed-variable=CanCom_FD11RxSignalsSR.COMRX_IDCM_CAL_ID_IDCM_OBD_DTC_FD11
          data-send-points:
            access DSP_VeCANR_y_IDCM_CAL_ID_VeCANR_y_IDCM_CAL_ID: accessed-variable=VeCANR_y_IDCM_CAL_ID.VeCANR_y_IDCM_CAL_ID
            access DSP_VeCANR_b_IDCM_CAL_ID_TO_VeCANR_b_IDCM_CAL_ID_TO: accessed-variable=VeCANR_b_IDCM_CAL_ID_TO.VeCANR_b_IDCM_CAL_ID_TO
        COMRX_IDCM_CAL_ID_IDCM_OBD_DTC_FD11_Error: symbol=ApplCanComAb_FD11_COMRX_IDCM_CAL_ID_IDCM_OBD_DTC_FD11_Error  # Error
          data-receive-point-by-arguments:
            access DRP_CanCom_FD11RxSignalsSR_COMRX_IDCM_CAL_ID_IDCM_OBD_DTC_FD11: accessed-variable=CanCom_FD11RxSignalsSR.COMRX_IDCM_CAL_ID_IDCM_OBD_DTC_FD11
          data-send-points:
            access DSP_VeCANR_y_IDCM_CAL_ID_VeCANR_y_IDCM_CAL_ID: accessed-variable=VeCANR_y_IDCM_CAL_ID.VeCANR_y_IDCM_CAL_ID
            access DSP_VeCANR_b_IDCM_CAL_ID_TO_VeCANR_b_IDCM_CAL_ID_TO: accessed-variable=VeCANR_b_IDCM_CAL_ID_TO.VeCANR_b_IDCM_CAL_ID_TO
        COMRX_IDCM_CAL_VN_IDCM_OBD_DTC_FD11_Received: symbol=ApplCanComAb_FD11_COMRX_IDCM_CAL_VN_IDCM_OBD_DTC_FD11_Received  # Received
          data-receive-point-by-arguments:
            access DRP_CanCom_FD11RxSignalsSR_COMRX_IDCM_CAL_VN_IDCM_OBD_DTC_FD11: accessed-variable=CanCom_FD11RxSignalsSR.COMRX_IDCM_CAL_VN_IDCM_OBD_DTC_FD11
          data-send-points:
            access DSP_VeCANR_y_IDCM_CAL_VN_VeCANR_y_IDCM_CAL_VN: accessed-variable=VeCANR_y_IDCM_CAL_VN.VeCANR_y_IDCM_CAL_VN
            access DSP_VeCANR_b_IDCM_CAL_VN_TO_VeCANR_b_IDCM_CAL_VN_TO: accessed-variable=VeCANR_b_IDCM_CAL_VN_TO.VeCANR_b_IDCM_CAL_VN_TO
        COMRX_IDCM_CAL_VN_IDCM_OBD_DTC_FD11_Error: symbol=ApplCanComAb_FD11_COMRX_IDCM_CAL_VN_IDCM_OBD_DTC_FD11_Error  # Error
          data-receive-point-by-arguments:
            access DRP_CanCom_FD11RxSignalsSR_COMRX_IDCM_CAL_VN_IDCM_OBD_DTC_FD11: accessed-variable=CanCom_FD11RxSignalsSR.COMRX_IDCM_CAL_VN_IDCM_OBD_DTC_FD11
          data-send-points:
            access DSP_VeCANR_y_IDCM_CAL_VN_VeCANR_y_IDCM_CAL_VN: accessed-variable=VeCANR_y_IDCM_CAL_VN.VeCANR_y_IDCM_CAL_VN
            access DSP_VeCANR_b_IDCM_CAL_VN_TO_VeCANR_b_IDCM_CAL_VN_TO: accessed-variable=VeCANR_b_IDCM_CAL_VN_TO.VeCANR_b_IDCM_CAL_VN_TO
        COMRX_IDCM_DTC_Idx1_IDCM_OBD_DTC_FD11_Received: symbol=ApplCanComAb_FD11_COMRX_IDCM_DTC_Idx1_IDCM_OBD_DTC_FD11_Received  # Received
          data-receive-point-by-arguments:
            access DRP_CanCom_FD11RxSignalsSR_COMRX_IDCM_DTC_Idx1_IDCM_OBD_DTC_FD11: accessed-variable=CanCom_FD11RxSignalsSR.COMRX_IDCM_DTC_Idx1_IDCM_OBD_DTC_FD11
          data-send-points:
            access DSP_VeCANR_y_IDCM_DTC_Idx1_VeCANR_y_IDCM_DTC_Idx1: accessed-variable=VeCANR_y_IDCM_DTC_Idx1.VeCANR_y_IDCM_DTC_Idx1
            access DSP_VeCANR_b_IDCM_DTC_Idx1TO_VeCANR_b_IDCM_DTC_Idx1TO: accessed-variable=VeCANR_b_IDCM_DTC_Idx1TO.VeCANR_b_IDCM_DTC_Idx1TO
        COMRX_IDCM_DTC_Idx1_IDCM_OBD_DTC_FD11_Error: symbol=ApplCanComAb_FD11_COMRX_IDCM_DTC_Idx1_IDCM_OBD_DTC_FD11_Error  # Error
          data-receive-point-by-arguments:
            access DRP_CanCom_FD11RxSignalsSR_COMRX_IDCM_DTC_Idx1_IDCM_OBD_DTC_FD11: accessed-variable=CanCom_FD11RxSignalsSR.COMRX_IDCM_DTC_Idx1_IDCM_OBD_DTC_FD11
          data-send-points:
            access DSP_VeCANR_y_IDCM_DTC_Idx1_VeCANR_y_IDCM_DTC_Idx1: accessed-variable=VeCANR_y_IDCM_DTC_Idx1.VeCANR_y_IDCM_DTC_Idx1
            access DSP_VeCANR_b_IDCM_DTC_Idx1TO_VeCANR_b_IDCM_DTC_Idx1TO: accessed-variable=VeCANR_b_IDCM_DTC_Idx1TO.VeCANR_b_IDCM_DTC_Idx1TO
        COMRX_IDCM_DTC_Idx2_IDCM_OBD_DTC_FD11_Received: symbol=ApplCanComAb_FD11_COMRX_IDCM_DTC_Idx2_IDCM_OBD_DTC_FD11_Received  # Received
          data-receive-point-by-arguments:
            access DRP_CanCom_FD11RxSignalsSR_COMRX_IDCM_DTC_Idx2_IDCM_OBD_DTC_FD11: accessed-variable=CanCom_FD11RxSignalsSR.COMRX_IDCM_DTC_Idx2_IDCM_OBD_DTC_FD11
          data-send-points:
            access DSP_VeCANR_y_IDCM_DTC_Idx2_VeCANR_y_IDCM_DTC_Idx2: accessed-variable=VeCANR_y_IDCM_DTC_Idx2.VeCANR_y_IDCM_DTC_Idx2
            access DSP_VeCANR_b_IDCM_DTC_Idx2TO_VeCANR_b_IDCM_DTC_Idx2TO: accessed-variable=VeCANR_b_IDCM_DTC_Idx2TO.VeCANR_b_IDCM_DTC_Idx2TO
        COMRX_IDCM_DTC_Idx2_IDCM_OBD_DTC_FD11_Error: symbol=ApplCanComAb_FD11_COMRX_IDCM_DTC_Idx2_IDCM_OBD_DTC_FD11_Error  # Error
          data-receive-point-by-arguments:
            access DRP_CanCom_FD11RxSignalsSR_COMRX_IDCM_DTC_Idx2_IDCM_OBD_DTC_FD11: accessed-variable=CanCom_FD11RxSignalsSR.COMRX_IDCM_DTC_Idx2_IDCM_OBD_DTC_FD11
          data-send-points:
            access DSP_VeCANR_y_IDCM_DTC_Idx2_VeCANR_y_IDCM_DTC_Idx2: accessed-variable=VeCANR_y_IDCM_DTC_Idx2.VeCANR_y_IDCM_DTC_Idx2
            access DSP_VeCANR_b_IDCM_DTC_Idx2TO_VeCANR_b_IDCM_DTC_Idx2TO: accessed-variable=VeCANR_b_IDCM_DTC_Idx2TO.VeCANR_b_IDCM_DTC_Idx2TO
        COMRX_IDCM_DTC_Idx3_IDCM_OBD_DTC_FD11_Received: symbol=ApplCanComAb_FD11_COMRX_IDCM_DTC_Idx3_IDCM_OBD_DTC_FD11_Received  # Received
          data-receive-point-by-arguments:
            access DRP_CanCom_FD11RxSignalsSR_COMRX_IDCM_DTC_Idx3_IDCM_OBD_DTC_FD11: accessed-variable=CanCom_FD11RxSignalsSR.COMRX_IDCM_DTC_Idx3_IDCM_OBD_DTC_FD11
          data-send-points:
            access DSP_VeCANR_y_IDCM_DTC_Idx3_VeCANR_y_IDCM_DTC_Idx3: accessed-variable=VeCANR_y_IDCM_DTC_Idx3.VeCANR_y_IDCM_DTC_Idx3
            access DSP_VeCANR_b_IDCM_DTC_Idx3TO_VeCANR_b_IDCM_DTC_Idx3TO: accessed-variable=VeCANR_b_IDCM_DTC_Idx3TO.VeCANR_b_IDCM_DTC_Idx3TO
        COMRX_IDCM_DTC_Idx3_IDCM_OBD_DTC_FD11_Error: symbol=ApplCanComAb_FD11_COMRX_IDCM_DTC_Idx3_IDCM_OBD_DTC_FD11_Error  # Error
          data-receive-point-by-arguments:
            access DRP_CanCom_FD11RxSignalsSR_COMRX_IDCM_DTC_Idx3_IDCM_OBD_DTC_FD11: accessed-variable=CanCom_FD11RxSignalsSR.COMRX_IDCM_DTC_Idx3_IDCM_OBD_DTC_FD11
          data-send-points:
            access DSP_VeCANR_y_IDCM_DTC_Idx3_VeCANR_y_IDCM_DTC_Idx3: accessed-variable=VeCANR_y_IDCM_DTC_Idx3.VeCANR_y_IDCM_DTC_Idx3
            access DSP_VeCANR_b_IDCM_DTC_Idx3TO_VeCANR_b_IDCM_DTC_Idx3TO: accessed-variable=VeCANR_b_IDCM_DTC_Idx3TO.VeCANR_b_IDCM_DTC_Idx3TO
        COMRX_IDCM_DTC_Idx4_IDCM_OBD_DTC_FD11_Received: symbol=ApplCanComAb_FD11_COMRX_IDCM_DTC_Idx4_IDCM_OBD_DTC_FD11_Received  # Received
          data-receive-point-by-arguments:
            access DRP_CanCom_FD11RxSignalsSR_COMRX_IDCM_DTC_Idx4_IDCM_OBD_DTC_FD11: accessed-variable=CanCom_FD11RxSignalsSR.COMRX_IDCM_DTC_Idx4_IDCM_OBD_DTC_FD11
          data-send-points:
            access DSP_VeCANR_y_IDCM_DTC_Idx4_VeCANR_y_IDCM_DTC_Idx4: accessed-variable=VeCANR_y_IDCM_DTC_Idx4.VeCANR_y_IDCM_DTC_Idx4
            access DSP_VeCANR_b_IDCM_DTC_Idx4TO_VeCANR_b_IDCM_DTC_Idx4TO: accessed-variable=VeCANR_b_IDCM_DTC_Idx4TO.VeCANR_b_IDCM_DTC_Idx4TO
        COMRX_IDCM_DTC_Idx4_IDCM_OBD_DTC_FD11_Error: symbol=ApplCanComAb_FD11_COMRX_IDCM_DTC_Idx4_IDCM_OBD_DTC_FD11_Error  # Error
          data-receive-point-by-arguments:
            access DRP_CanCom_FD11RxSignalsSR_COMRX_IDCM_DTC_Idx4_IDCM_OBD_DTC_FD11: accessed-variable=CanCom_FD11RxSignalsSR.COMRX_IDCM_DTC_Idx4_IDCM_OBD_DTC_FD11
          data-send-points:
            access DSP_VeCANR_y_IDCM_DTC_Idx4_VeCANR_y_IDCM_DTC_Idx4: accessed-variable=VeCANR_y_IDCM_DTC_Idx4.VeCANR_y_IDCM_DTC_Idx4
            access DSP_VeCANR_b_IDCM_DTC_Idx4TO_VeCANR_b_IDCM_DTC_Idx4TO: accessed-variable=VeCANR_b_IDCM_DTC_Idx4TO.VeCANR_b_IDCM_DTC_Idx4TO
        COMRX_IDCM_DTC_Idx5_IDCM_OBD_DTC_FD11_Received: symbol=ApplCanComAb_FD11_COMRX_IDCM_DTC_Idx5_IDCM_OBD_DTC_FD11_Received  # Received
          data-receive-point-by-arguments:
            access DRP_CanCom_FD11RxSignalsSR_COMRX_IDCM_DTC_Idx5_IDCM_OBD_DTC_FD11: accessed-variable=CanCom_FD11RxSignalsSR.COMRX_IDCM_DTC_Idx5_IDCM_OBD_DTC_FD11
          data-send-points:
            access DSP_VeCANR_y_IDCM_DTC_Idx5_VeCANR_y_IDCM_DTC_Idx5: accessed-variable=VeCANR_y_IDCM_DTC_Idx5.VeCANR_y_IDCM_DTC_Idx5
            access DSP_VeCANR_b_IDCM_DTC_Idx5TO_VeCANR_b_IDCM_DTC_Idx5TO: accessed-variable=VeCANR_b_IDCM_DTC_Idx5TO.VeCANR_b_IDCM_DTC_Idx5TO
        COMRX_IDCM_DTC_Idx5_IDCM_OBD_DTC_FD11_Error: symbol=ApplCanComAb_FD11_COMRX_IDCM_DTC_Idx5_IDCM_OBD_DTC_FD11_Error  # Error
          data-receive-point-by-arguments:
            access DRP_CanCom_FD11RxSignalsSR_COMRX_IDCM_DTC_Idx5_IDCM_OBD_DTC_FD11: accessed-variable=CanCom_FD11RxSignalsSR.COMRX_IDCM_DTC_Idx5_IDCM_OBD_DTC_FD11
          data-send-points:
            access DSP_VeCANR_y_IDCM_DTC_Idx5_VeCANR_y_IDCM_DTC_Idx5: accessed-variable=VeCANR_y_IDCM_DTC_Idx5.VeCANR_y_IDCM_DTC_Idx5
            access DSP_VeCANR_b_IDCM_DTC_Idx5TO_VeCANR_b_IDCM_DTC_Idx5TO: accessed-variable=VeCANR_b_IDCM_DTC_Idx5TO.VeCANR_b_IDCM_DTC_Idx5TO
        COMRX_IDCM_DTC_Idx6_IDCM_OBD_DTC_FD11_Received: symbol=ApplCanComAb_FD11_COMRX_IDCM_DTC_Idx6_IDCM_OBD_DTC_FD11_Received  # Received
          data-receive-point-by-arguments:
            access DRP_CanCom_FD11RxSignalsSR_COMRX_IDCM_DTC_Idx6_IDCM_OBD_DTC_FD11: accessed-variable=CanCom_FD11RxSignalsSR.COMRX_IDCM_DTC_Idx6_IDCM_OBD_DTC_FD11
          data-send-points:
            access DSP_VeCANR_y_IDCM_DTC_Idx6_VeCANR_y_IDCM_DTC_Idx6: accessed-variable=VeCANR_y_IDCM_DTC_Idx6.VeCANR_y_IDCM_DTC_Idx6
            access DSP_VeCANR_b_IDCM_DTC_Idx6TO_VeCANR_b_IDCM_DTC_Idx6TO: accessed-variable=VeCANR_b_IDCM_DTC_Idx6TO.VeCANR_b_IDCM_DTC_Idx6TO
        COMRX_IDCM_DTC_Idx6_IDCM_OBD_DTC_FD11_Error: symbol=ApplCanComAb_FD11_COMRX_IDCM_DTC_Idx6_IDCM_OBD_DTC_FD11_Error  # Error
          data-receive-point-by-arguments:
            access DRP_CanCom_FD11RxSignalsSR_COMRX_IDCM_DTC_Idx6_IDCM_OBD_DTC_FD11: accessed-variable=CanCom_FD11RxSignalsSR.COMRX_IDCM_DTC_Idx6_IDCM_OBD_DTC_FD11
          data-send-points:
            access DSP_VeCANR_y_IDCM_DTC_Idx6_VeCANR_y_IDCM_DTC_Idx6: accessed-variable=VeCANR_y_IDCM_DTC_Idx6.VeCANR_y_IDCM_DTC_Idx6
            access DSP_VeCANR_b_IDCM_DTC_Idx6TO_VeCANR_b_IDCM_DTC_Idx6TO: accessed-variable=VeCANR_b_IDCM_DTC_Idx6TO.VeCANR_b_IDCM_DTC_Idx6TO
        COMRX_IDCM_DTC_Idx7_IDCM_OBD_DTC_FD11_Received: symbol=ApplCanComAb_FD11_COMRX_IDCM_DTC_Idx7_IDCM_OBD_DTC_FD11_Received  # Received
          data-receive-point-by-arguments:
            access DRP_CanCom_FD11RxSignalsSR_COMRX_IDCM_DTC_Idx7_IDCM_OBD_DTC_FD11: accessed-variable=CanCom_FD11RxSignalsSR.COMRX_IDCM_DTC_Idx7_IDCM_OBD_DTC_FD11
          data-send-points:
            access DSP_VeCANR_y_IDCM_DTC_Idx7_VeCANR_y_IDCM_DTC_Idx7: accessed-variable=VeCANR_y_IDCM_DTC_Idx7.VeCANR_y_IDCM_DTC_Idx7
            access DSP_VeCANR_b_IDCM_DTC_Idx7TO_VeCANR_b_IDCM_DTC_Idx7TO: accessed-variable=VeCANR_b_IDCM_DTC_Idx7TO.VeCANR_b_IDCM_DTC_Idx7TO
        COMRX_IDCM_DTC_Idx7_IDCM_OBD_DTC_FD11_Error: symbol=ApplCanComAb_FD11_COMRX_IDCM_DTC_Idx7_IDCM_OBD_DTC_FD11_Error  # Error
          data-receive-point-by-arguments:
            access DRP_CanCom_FD11RxSignalsSR_COMRX_IDCM_DTC_Idx7_IDCM_OBD_DTC_FD11: accessed-variable=CanCom_FD11RxSignalsSR.COMRX_IDCM_DTC_Idx7_IDCM_OBD_DTC_FD11
          data-send-points:
            access DSP_VeCANR_y_IDCM_DTC_Idx7_VeCANR_y_IDCM_DTC_Idx7: accessed-variable=VeCANR_y_IDCM_DTC_Idx7.VeCANR_y_IDCM_DTC_Idx7
            access DSP_VeCANR_b_IDCM_DTC_Idx7TO_VeCANR_b_IDCM_DTC_Idx7TO: accessed-variable=VeCANR_b_IDCM_DTC_Idx7TO.VeCANR_b_IDCM_DTC_Idx7TO
        COMRX_IDCM_DTC_Idx8_IDCM_OBD_DTC_FD11_Received: symbol=ApplCanComAb_FD11_COMRX_IDCM_DTC_Idx8_IDCM_OBD_DTC_FD11_Received  # Received
          data-receive-point-by-arguments:
            access DRP_CanCom_FD11RxSignalsSR_COMRX_IDCM_DTC_Idx8_IDCM_OBD_DTC_FD11: accessed-variable=CanCom_FD11RxSignalsSR.COMRX_IDCM_DTC_Idx8_IDCM_OBD_DTC_FD11
          data-send-points:
            access DSP_VeCANR_y_IDCM_DTC_Idx8_VeCANR_y_IDCM_DTC_Idx8: accessed-variable=VeCANR_y_IDCM_DTC_Idx8.VeCANR_y_IDCM_DTC_Idx8
            access DSP_VeCANR_b_IDCM_DTC_Idx8TO_VeCANR_b_IDCM_DTC_Idx8TO: accessed-variable=VeCANR_b_IDCM_DTC_Idx8TO.VeCANR_b_IDCM_DTC_Idx8TO
        COMRX_IDCM_DTC_Idx8_IDCM_OBD_DTC_FD11_Error: symbol=ApplCanComAb_FD11_COMRX_IDCM_DTC_Idx8_IDCM_OBD_DTC_FD11_Error  # Error
          data-receive-point-by-arguments:
            access DRP_CanCom_FD11RxSignalsSR_COMRX_IDCM_DTC_Idx8_IDCM_OBD_DTC_FD11: accessed-variable=CanCom_FD11RxSignalsSR.COMRX_IDCM_DTC_Idx8_IDCM_OBD_DTC_FD11
          data-send-points:
            access DSP_VeCANR_y_IDCM_DTC_Idx8_VeCANR_y_IDCM_DTC_Idx8: accessed-variable=VeCANR_y_IDCM_DTC_Idx8.VeCANR_y_IDCM_DTC_Idx8
            access DSP_VeCANR_b_IDCM_DTC_Idx8TO_VeCANR_b_IDCM_DTC_Idx8TO: accessed-variable=VeCANR_b_IDCM_DTC_Idx8TO.VeCANR_b_IDCM_DTC_Idx8TO
        COMRX_IDCM_DTC_Stat1_IDCM_OBD_DTC_FD11_Received: symbol=ApplCanComAb_FD11_COMRX_IDCM_DTC_Stat1_IDCM_OBD_DTC_FD11_Received  # Received
          data-receive-point-by-arguments:
            access DRP_CanCom_FD11RxSignalsSR_COMRX_IDCM_DTC_Stat1_IDCM_OBD_DTC_FD11: accessed-variable=CanCom_FD11RxSignalsSR.COMRX_IDCM_DTC_Stat1_IDCM_OBD_DTC_FD11
          data-send-points:
            access DSP_VeCANR_e_IDCM_DTC_Stat1_VeCANR_e_IDCM_DTC_Stat1: accessed-variable=VeCANR_e_IDCM_DTC_Stat1.VeCANR_e_IDCM_DTC_Stat1
            access DSP_VeCANR_b_IDCM_DTC_Stat1TO_VeCANR_b_IDCM_DTC_Stat1TO: accessed-variable=VeCANR_b_IDCM_DTC_Stat1TO.VeCANR_b_IDCM_DTC_Stat1TO
        COMRX_IDCM_DTC_Stat1_IDCM_OBD_DTC_FD11_Error: symbol=ApplCanComAb_FD11_COMRX_IDCM_DTC_Stat1_IDCM_OBD_DTC_FD11_Error  # Error
          data-receive-point-by-arguments:
            access DRP_CanCom_FD11RxSignalsSR_COMRX_IDCM_DTC_Stat1_IDCM_OBD_DTC_FD11: accessed-variable=CanCom_FD11RxSignalsSR.COMRX_IDCM_DTC_Stat1_IDCM_OBD_DTC_FD11
          data-send-points:
            access DSP_VeCANR_e_IDCM_DTC_Stat1_VeCANR_e_IDCM_DTC_Stat1: accessed-variable=VeCANR_e_IDCM_DTC_Stat1.VeCANR_e_IDCM_DTC_Stat1
            access DSP_VeCANR_b_IDCM_DTC_Stat1TO_VeCANR_b_IDCM_DTC_Stat1TO: accessed-variable=VeCANR_b_IDCM_DTC_Stat1TO.VeCANR_b_IDCM_DTC_Stat1TO
        COMRX_IDCM_DTC_Stat2_IDCM_OBD_DTC_FD11_Received: symbol=ApplCanComAb_FD11_COMRX_IDCM_DTC_Stat2_IDCM_OBD_DTC_FD11_Received  # Received
          data-receive-point-by-arguments:
            access DRP_CanCom_FD11RxSignalsSR_COMRX_IDCM_DTC_Stat2_IDCM_OBD_DTC_FD11: accessed-variable=CanCom_FD11RxSignalsSR.COMRX_IDCM_DTC_Stat2_IDCM_OBD_DTC_FD11
          data-send-points:
            access DSP_VeCANR_e_IDCM_DTC_Stat2_VeCANR_e_IDCM_DTC_Stat2: accessed-variable=VeCANR_e_IDCM_DTC_Stat2.VeCANR_e_IDCM_DTC_Stat2
            access DSP_VeCANR_b_IDCM_DTC_Stat2TO_VeCANR_b_IDCM_DTC_Stat2TO: accessed-variable=VeCANR_b_IDCM_DTC_Stat2TO.VeCANR_b_IDCM_DTC_Stat2TO
        COMRX_IDCM_DTC_Stat2_IDCM_OBD_DTC_FD11_Error: symbol=ApplCanComAb_FD11_COMRX_IDCM_DTC_Stat2_IDCM_OBD_DTC_FD11_Error  # Error
          data-receive-point-by-arguments:
            access DRP_CanCom_FD11RxSignalsSR_COMRX_IDCM_DTC_Stat2_IDCM_OBD_DTC_FD11: accessed-variable=CanCom_FD11RxSignalsSR.COMRX_IDCM_DTC_Stat2_IDCM_OBD_DTC_FD11
          data-send-points:
            access DSP_VeCANR_e_IDCM_DTC_Stat2_VeCANR_e_IDCM_DTC_Stat2: accessed-variable=VeCANR_e_IDCM_DTC_Stat2.VeCANR_e_IDCM_DTC_Stat2
            access DSP_VeCANR_b_IDCM_DTC_Stat2TO_VeCANR_b_IDCM_DTC_Stat2TO: accessed-variable=VeCANR_b_IDCM_DTC_Stat2TO.VeCANR_b_IDCM_DTC_Stat2TO
        COMRX_IDCM_DTC_Stat3_IDCM_OBD_DTC_FD11_Received: symbol=ApplCanComAb_FD11_COMRX_IDCM_DTC_Stat3_IDCM_OBD_DTC_FD11_Received  # Received
          data-receive-point-by-arguments:
            access DRP_CanCom_FD11RxSignalsSR_COMRX_IDCM_DTC_Stat3_IDCM_OBD_DTC_FD11: accessed-variable=CanCom_FD11RxSignalsSR.COMRX_IDCM_DTC_Stat3_IDCM_OBD_DTC_FD11
          data-send-points:
            access DSP_VeCANR_e_IDCM_DTC_Stat3_VeCANR_e_IDCM_DTC_Stat3: accessed-variable=VeCANR_e_IDCM_DTC_Stat3.VeCANR_e_IDCM_DTC_Stat3
            access DSP_VeCANR_b_IDCM_DTC_Stat3TO_VeCANR_b_IDCM_DTC_Stat3TO: accessed-variable=VeCANR_b_IDCM_DTC_Stat3TO.VeCANR_b_IDCM_DTC_Stat3TO
        COMRX_IDCM_DTC_Stat3_IDCM_OBD_DTC_FD11_Error: symbol=ApplCanComAb_FD11_COMRX_IDCM_DTC_Stat3_IDCM_OBD_DTC_FD11_Error  # Error
          data-receive-point-by-arguments:
            access DRP_CanCom_FD11RxSignalsSR_COMRX_IDCM_DTC_Stat3_IDCM_OBD_DTC_FD11: accessed-variable=CanCom_FD11RxSignalsSR.COMRX_IDCM_DTC_Stat3_IDCM_OBD_DTC_FD11
          data-send-points:
            access DSP_VeCANR_e_IDCM_DTC_Stat3_VeCANR_e_IDCM_DTC_Stat3: accessed-variable=VeCANR_e_IDCM_DTC_Stat3.VeCANR_e_IDCM_DTC_Stat3
            access DSP_VeCANR_b_IDCM_DTC_Stat3TO_VeCANR_b_IDCM_DTC_Stat3TO: accessed-variable=VeCANR_b_IDCM_DTC_Stat3TO.VeCANR_b_IDCM_DTC_Stat3TO
        COMRX_IDCM_DTC_Stat4_IDCM_OBD_DTC_FD11_Received: symbol=ApplCanComAb_FD11_COMRX_IDCM_DTC_Stat4_IDCM_OBD_DTC_FD11_Received  # Received
          data-receive-point-by-arguments:
            access DRP_CanCom_FD11RxSignalsSR_COMRX_IDCM_DTC_Stat4_IDCM_OBD_DTC_FD11: accessed-variable=CanCom_FD11RxSignalsSR.COMRX_IDCM_DTC_Stat4_IDCM_OBD_DTC_FD11
          data-send-points:
            access DSP_VeCANR_e_IDCM_DTC_Stat4_VeCANR_e_IDCM_DTC_Stat4: accessed-variable=VeCANR_e_IDCM_DTC_Stat4.VeCANR_e_IDCM_DTC_Stat4
            access DSP_VeCANR_b_IDCM_DTC_Stat4TO_VeCANR_b_IDCM_DTC_Stat4TO: accessed-variable=VeCANR_b_IDCM_DTC_Stat4TO.VeCANR_b_IDCM_DTC_Stat4TO
        COMRX_IDCM_DTC_Stat4_IDCM_OBD_DTC_FD11_Error: symbol=ApplCanComAb_FD11_COMRX_IDCM_DTC_Stat4_IDCM_OBD_DTC_FD11_Error  # Error
          data-receive-point-by-arguments:
            access DRP_CanCom_FD11RxSignalsSR_COMRX_IDCM_DTC_Stat4_IDCM_OBD_DTC_FD11: accessed-variable=CanCom_FD11RxSignalsSR.COMRX_IDCM_DTC_Stat4_IDCM_OBD_DTC_FD11
          data-send-points:
            access DSP_VeCANR_e_IDCM_DTC_Stat4_VeCANR_e_IDCM_DTC_Stat4: accessed-variable=VeCANR_e_IDCM_DTC_Stat4.VeCANR_e_IDCM_DTC_Stat4
            access DSP_VeCANR_b_IDCM_DTC_Stat4TO_VeCANR_b_IDCM_DTC_Stat4TO: accessed-variable=VeCANR_b_IDCM_DTC_Stat4TO.VeCANR_b_IDCM_DTC_Stat4TO
        COMRX_IDCM_DTC_Stat5_IDCM_OBD_DTC_FD11_Received: symbol=ApplCanComAb_FD11_COMRX_IDCM_DTC_Stat5_IDCM_OBD_DTC_FD11_Received  # Received
          data-receive-point-by-arguments:
            access DRP_CanCom_FD11RxSignalsSR_COMRX_IDCM_DTC_Stat5_IDCM_OBD_DTC_FD11: accessed-variable=CanCom_FD11RxSignalsSR.COMRX_IDCM_DTC_Stat5_IDCM_OBD_DTC_FD11
          data-send-points:
            access DSP_VeCANR_e_IDCM_DTC_Stat5_VeCANR_e_IDCM_DTC_Stat5: accessed-variable=VeCANR_e_IDCM_DTC_Stat5.VeCANR_e_IDCM_DTC_Stat5
            access DSP_VeCANR_b_IDCM_DTC_Stat5TO_VeCANR_b_IDCM_DTC_Stat5TO: accessed-variable=VeCANR_b_IDCM_DTC_Stat5TO.VeCANR_b_IDCM_DTC_Stat5TO
        COMRX_IDCM_DTC_Stat5_IDCM_OBD_DTC_FD11_Error: symbol=ApplCanComAb_FD11_COMRX_IDCM_DTC_Stat5_IDCM_OBD_DTC_FD11_Error  # Error
          data-receive-point-by-arguments:
            access DRP_CanCom_FD11RxSignalsSR_COMRX_IDCM_DTC_Stat5_IDCM_OBD_DTC_FD11: accessed-variable=CanCom_FD11RxSignalsSR.COMRX_IDCM_DTC_Stat5_IDCM_OBD_DTC_FD11
          data-send-points:
            access DSP_VeCANR_e_IDCM_DTC_Stat5_VeCANR_e_IDCM_DTC_Stat5: accessed-variable=VeCANR_e_IDCM_DTC_Stat5.VeCANR_e_IDCM_DTC_Stat5
            access DSP_VeCANR_b_IDCM_DTC_Stat5TO_VeCANR_b_IDCM_DTC_Stat5TO: accessed-variable=VeCANR_b_IDCM_DTC_Stat5TO.VeCANR_b_IDCM_DTC_Stat5TO
        COMRX_IDCM_DTC_Stat6_IDCM_OBD_DTC_FD11_Received: symbol=ApplCanComAb_FD11_COMRX_IDCM_DTC_Stat6_IDCM_OBD_DTC_FD11_Received  # Received
          data-receive-point-by-arguments:
            access DRP_CanCom_FD11RxSignalsSR_COMRX_IDCM_DTC_Stat6_IDCM_OBD_DTC_FD11: accessed-variable=CanCom_FD11RxSignalsSR.COMRX_IDCM_DTC_Stat6_IDCM_OBD_DTC_FD11
          data-send-points:
            access DSP_VeCANR_e_IDCM_DTC_Stat6_VeCANR_e_IDCM_DTC_Stat6: accessed-variable=VeCANR_e_IDCM_DTC_Stat6.VeCANR_e_IDCM_DTC_Stat6
            access DSP_VeCANR_b_IDCM_DTC_Stat6TO_VeCANR_b_IDCM_DTC_Stat6TO: accessed-variable=VeCANR_b_IDCM_DTC_Stat6TO.VeCANR_b_IDCM_DTC_Stat6TO
        COMRX_IDCM_DTC_Stat6_IDCM_OBD_DTC_FD11_Error: symbol=ApplCanComAb_FD11_COMRX_IDCM_DTC_Stat6_IDCM_OBD_DTC_FD11_Error  # Error
          data-receive-point-by-arguments:
            access DRP_CanCom_FD11RxSignalsSR_COMRX_IDCM_DTC_Stat6_IDCM_OBD_DTC_FD11: accessed-variable=CanCom_FD11RxSignalsSR.COMRX_IDCM_DTC_Stat6_IDCM_OBD_DTC_FD11
          data-send-points:
            access DSP_VeCANR_e_IDCM_DTC_Stat6_VeCANR_e_IDCM_DTC_Stat6: accessed-variable=VeCANR_e_IDCM_DTC_Stat6.VeCANR_e_IDCM_DTC_Stat6
            access DSP_VeCANR_b_IDCM_DTC_Stat6TO_VeCANR_b_IDCM_DTC_Stat6TO: accessed-variable=VeCANR_b_IDCM_DTC_Stat6TO.VeCANR_b_IDCM_DTC_Stat6TO
        COMRX_IDCM_DTC_Stat7_IDCM_OBD_DTC_FD11_Received: symbol=ApplCanComAb_FD11_COMRX_IDCM_DTC_Stat7_IDCM_OBD_DTC_FD11_Received  # Received
          data-receive-point-by-arguments:
            access DRP_CanCom_FD11RxSignalsSR_COMRX_IDCM_DTC_Stat7_IDCM_OBD_DTC_FD11: accessed-variable=CanCom_FD11RxSignalsSR.COMRX_IDCM_DTC_Stat7_IDCM_OBD_DTC_FD11
          data-send-points:
            access DSP_VeCANR_e_IDCM_DTC_Stat7_VeCANR_e_IDCM_DTC_Stat7: accessed-variable=VeCANR_e_IDCM_DTC_Stat7.VeCANR_e_IDCM_DTC_Stat7
            access DSP_VeCANR_b_IDCM_DTC_Stat7TO_VeCANR_b_IDCM_DTC_Stat7TO: accessed-variable=VeCANR_b_IDCM_DTC_Stat7TO.VeCANR_b_IDCM_DTC_Stat7TO
        COMRX_IDCM_DTC_Stat7_IDCM_OBD_DTC_FD11_Error: symbol=ApplCanComAb_FD11_COMRX_IDCM_DTC_Stat7_IDCM_OBD_DTC_FD11_Error  # Error
          data-receive-point-by-arguments:
            access DRP_CanCom_FD11RxSignalsSR_COMRX_IDCM_DTC_Stat7_IDCM_OBD_DTC_FD11: accessed-variable=CanCom_FD11RxSignalsSR.COMRX_IDCM_DTC_Stat7_IDCM_OBD_DTC_FD11
          data-send-points:
            access DSP_VeCANR_e_IDCM_DTC_Stat7_VeCANR_e_IDCM_DTC_Stat7: accessed-variable=VeCANR_e_IDCM_DTC_Stat7.VeCANR_e_IDCM_DTC_Stat7
            access DSP_VeCANR_b_IDCM_DTC_Stat7TO_VeCANR_b_IDCM_DTC_Stat7TO: accessed-variable=VeCANR_b_IDCM_DTC_Stat7TO.VeCANR_b_IDCM_DTC_Stat7TO
        COMRX_IDCM_DTC_Stat8_IDCM_OBD_DTC_FD11_Received: symbol=ApplCanComAb_FD11_COMRX_IDCM_DTC_Stat8_IDCM_OBD_DTC_FD11_Received  # Received
          data-receive-point-by-arguments:
            access DRP_CanCom_FD11RxSignalsSR_COMRX_IDCM_DTC_Stat8_IDCM_OBD_DTC_FD11: accessed-variable=CanCom_FD11RxSignalsSR.COMRX_IDCM_DTC_Stat8_IDCM_OBD_DTC_FD11
          data-send-points:
            access DSP_VeCANR_e_IDCM_DTC_Stat8_VeCANR_e_IDCM_DTC_Stat8: accessed-variable=VeCANR_e_IDCM_DTC_Stat8.VeCANR_e_IDCM_DTC_Stat8
            access DSP_VeCANR_b_IDCM_DTC_Stat8TO_VeCANR_b_IDCM_DTC_Stat8TO: accessed-variable=VeCANR_b_IDCM_DTC_Stat8TO.VeCANR_b_IDCM_DTC_Stat8TO
        COMRX_IDCM_DTC_Stat8_IDCM_OBD_DTC_FD11_Error: symbol=ApplCanComAb_FD11_COMRX_IDCM_DTC_Stat8_IDCM_OBD_DTC_FD11_Error  # Error
          data-receive-point-by-arguments:
            access DRP_CanCom_FD11RxSignalsSR_COMRX_IDCM_DTC_Stat8_IDCM_OBD_DTC_FD11: accessed-variable=CanCom_FD11RxSignalsSR.COMRX_IDCM_DTC_Stat8_IDCM_OBD_DTC_FD11
          data-send-points:
            access DSP_VeCANR_e_IDCM_DTC_Stat8_VeCANR_e_IDCM_DTC_Stat8: accessed-variable=VeCANR_e_IDCM_DTC_Stat8.VeCANR_e_IDCM_DTC_Stat8
            access DSP_VeCANR_b_IDCM_DTC_Stat8TO_VeCANR_b_IDCM_DTC_Stat8TO: accessed-variable=VeCANR_b_IDCM_DTC_Stat8TO.VeCANR_b_IDCM_DTC_Stat8TO
        COMRX_IDCM_RBM_Idx_IDCM_OBD_DTC_FD11_Received: symbol=ApplCanComAb_FD11_COMRX_IDCM_RBM_Idx_IDCM_OBD_DTC_FD11_Received  # Received
          data-receive-point-by-arguments:
            access DRP_CanCom_FD11RxSignalsSR_COMRX_IDCM_RBM_Idx_IDCM_OBD_DTC_FD11: accessed-variable=CanCom_FD11RxSignalsSR.COMRX_IDCM_RBM_Idx_IDCM_OBD_DTC_FD11
          data-send-points:
            access DSP_VeCANR_y_IDCM_RBM_Idx_VeCANR_y_IDCM_RBM_Idx: accessed-variable=VeCANR_y_IDCM_RBM_Idx.VeCANR_y_IDCM_RBM_Idx
            access DSP_VeCANR_b_IDCM_RBM_IdxTO_VeCANR_b_IDCM_RBM_IdxTO: accessed-variable=VeCANR_b_IDCM_RBM_IdxTO.VeCANR_b_IDCM_RBM_IdxTO
        COMRX_IDCM_RBM_Idx_IDCM_OBD_DTC_FD11_Error: symbol=ApplCanComAb_FD11_COMRX_IDCM_RBM_Idx_IDCM_OBD_DTC_FD11_Error  # Error
          data-receive-point-by-arguments:
            access DRP_CanCom_FD11RxSignalsSR_COMRX_IDCM_RBM_Idx_IDCM_OBD_DTC_FD11: accessed-variable=CanCom_FD11RxSignalsSR.COMRX_IDCM_RBM_Idx_IDCM_OBD_DTC_FD11
          data-send-points:
            access DSP_VeCANR_y_IDCM_RBM_Idx_VeCANR_y_IDCM_RBM_Idx: accessed-variable=VeCANR_y_IDCM_RBM_Idx.VeCANR_y_IDCM_RBM_Idx
            access DSP_VeCANR_b_IDCM_RBM_IdxTO_VeCANR_b_IDCM_RBM_IdxTO: accessed-variable=VeCANR_b_IDCM_RBM_IdxTO.VeCANR_b_IDCM_RBM_IdxTO
        COMRX_IDCM_RBM_Stat_IDCM_OBD_DTC_FD11_Received: symbol=ApplCanComAb_FD11_COMRX_IDCM_RBM_Stat_IDCM_OBD_DTC_FD11_Received  # Received
          data-receive-point-by-arguments:
            access DRP_CanCom_FD11RxSignalsSR_COMRX_IDCM_RBM_Stat_IDCM_OBD_DTC_FD11: accessed-variable=CanCom_FD11RxSignalsSR.COMRX_IDCM_RBM_Stat_IDCM_OBD_DTC_FD11
          data-send-points:
            access DSP_VeCANR_y_IDCM_RBM_Stat_VeCANR_y_IDCM_RBM_Stat: accessed-variable=VeCANR_y_IDCM_RBM_Stat.VeCANR_y_IDCM_RBM_Stat
            access DSP_VeCANR_b_IDCM_RBM_StatTO_VeCANR_b_IDCM_RBM_StatTO: accessed-variable=VeCANR_b_IDCM_RBM_StatTO.VeCANR_b_IDCM_RBM_StatTO
        COMRX_IDCM_RBM_Stat_IDCM_OBD_DTC_FD11_Error: symbol=ApplCanComAb_FD11_COMRX_IDCM_RBM_Stat_IDCM_OBD_DTC_FD11_Error  # Error
          data-receive-point-by-arguments:
            access DRP_CanCom_FD11RxSignalsSR_COMRX_IDCM_RBM_Stat_IDCM_OBD_DTC_FD11: accessed-variable=CanCom_FD11RxSignalsSR.COMRX_IDCM_RBM_Stat_IDCM_OBD_DTC_FD11
          data-send-points:
            access DSP_VeCANR_y_IDCM_RBM_Stat_VeCANR_y_IDCM_RBM_Stat: accessed-variable=VeCANR_y_IDCM_RBM_Stat.VeCANR_y_IDCM_RBM_Stat
            access DSP_VeCANR_b_IDCM_RBM_StatTO_VeCANR_b_IDCM_RBM_StatTO: accessed-variable=VeCANR_b_IDCM_RBM_StatTO.VeCANR_b_IDCM_RBM_StatTO
        COMRX_MessageCounter_IDCM_OBD_DTC_IDCM_OBD_DTC_FD11_Received: symbol=ApplCanComAb_FD11_COMRX_MessageCounter_IDCM_OBD_DTC_IDCM_OBD_DTC_FD11_Received  # Received
          data-receive-point-by-arguments:
            access DRP_CanCom_FD11RxSignalsSR_COMRX_MessageCounter_IDCM_OBD_DTC_IDCM_OBD_DTC_FD11: accessed-variable=CanCom_FD11RxSignalsSR.COMRX_MessageCounter_IDCM_OBD_DTC_IDCM_OBD_DTC_FD11
          data-send-points:
            access DSP_VeCANR_y_MCIDCMOBDDTC_VeCANR_y_MCIDCMOBDDTC: accessed-variable=VeCANR_y_MCIDCMOBDDTC.VeCANR_y_MCIDCMOBDDTC
            access DSP_VeCANR_b_MCIDCMOBDDTC_TO_VeCANR_b_MCIDCMOBDDTC_TO: accessed-variable=VeCANR_b_MCIDCMOBDDTC_TO.VeCANR_b_MCIDCMOBDDTC_TO
        COMRX_MessageCounter_IDCM_OBD_DTC_IDCM_OBD_DTC_FD11_Error: symbol=ApplCanComAb_FD11_COMRX_MessageCounter_IDCM_OBD_DTC_IDCM_OBD_DTC_FD11_Error  # Error
          data-receive-point-by-arguments:
            access DRP_CanCom_FD11RxSignalsSR_COMRX_MessageCounter_IDCM_OBD_DTC_IDCM_OBD_DTC_FD11: accessed-variable=CanCom_FD11RxSignalsSR.COMRX_MessageCounter_IDCM_OBD_DTC_IDCM_OBD_DTC_FD11
          data-send-points:
            access DSP_VeCANR_y_MCIDCMOBDDTC_VeCANR_y_MCIDCMOBDDTC: accessed-variable=VeCANR_y_MCIDCMOBDDTC.VeCANR_y_MCIDCMOBDDTC
            access DSP_VeCANR_b_MCIDCMOBDDTC_TO_VeCANR_b_MCIDCMOBDDTC_TO: accessed-variable=VeCANR_b_MCIDCMOBDDTC_TO.VeCANR_b_MCIDCMOBDDTC_TO
        COMRX_IDCM_Wakeup_HCP_LV_CHARGER1_FD11_Received: symbol=ApplCanComAb_FD11_COMRX_IDCM_Wakeup_HCP_LV_CHARGER1_FD11_Received  # Received
          data-receive-point-by-arguments:
            access DRP_CanCom_FD11RxSignalsSR_COMRX_IDCM_Wakeup_HCP_LV_CHARGER1_FD11: accessed-variable=CanCom_FD11RxSignalsSR.COMRX_IDCM_Wakeup_HCP_LV_CHARGER1_FD11
          data-send-points:
            access DSP_VeCANR_b_IDCM_Wakeup_HCP_FD11_VeCANR_b_IDCM_Wakeup_HCP_FD11: accessed-variable=VeCANR_b_IDCM_Wakeup_HCP_FD11.VeCANR_b_IDCM_Wakeup_HCP_FD11
            access DSP_VeCANR_b_IDCM_Wakeup_HCP_FD11TO_VeCANR_b_IDCM_Wakeup_HCP_FD11TO: accessed-variable=VeCANR_b_IDCM_Wakeup_HCP_FD11TO.VeCANR_b_IDCM_Wakeup_HCP_FD11TO
        COMRX_IDCM_Wakeup_HCP_LV_CHARGER1_FD11_Error: symbol=ApplCanComAb_FD11_COMRX_IDCM_Wakeup_HCP_LV_CHARGER1_FD11_Error  # Error
          data-receive-point-by-arguments:
            access DRP_CanCom_FD11RxSignalsSR_COMRX_IDCM_Wakeup_HCP_LV_CHARGER1_FD11: accessed-variable=CanCom_FD11RxSignalsSR.COMRX_IDCM_Wakeup_HCP_LV_CHARGER1_FD11
          data-send-points:
            access DSP_VeCANR_b_IDCM_Wakeup_HCP_FD11_VeCANR_b_IDCM_Wakeup_HCP_FD11: accessed-variable=VeCANR_b_IDCM_Wakeup_HCP_FD11.VeCANR_b_IDCM_Wakeup_HCP_FD11
            access DSP_VeCANR_b_IDCM_Wakeup_HCP_FD11TO_VeCANR_b_IDCM_Wakeup_HCP_FD11TO: accessed-variable=VeCANR_b_IDCM_Wakeup_HCP_FD11TO.VeCANR_b_IDCM_Wakeup_HCP_FD11TO
        SendCANR_CmdIgnSts_FD11: can-be-invoked-concurrently=true, symbol=ApplCanComAb_FD11_SendCANR_CmdIgnSts_FD11  # Transmit
          data-receive-point-by-arguments:
            access DRP_SendCANR_CmdIgnSts_FD11_SendCANR_CmdIgnSts_FD11: accessed-variable=SendCANR_CmdIgnSts_FD11.SendCANR_CmdIgnSts_FD11
            access DRP_SendCANR_CmdIgnSts_FD11Vld_SendCANR_CmdIgnSts_FD11Vld: accessed-variable=SendCANR_CmdIgnSts_FD11Vld.SendCANR_CmdIgnSts_FD11Vld
          data-send-points:
            access DSP_CanCom_FD11TxSignalsSR_COMTX_CmdIgnSts_BCM_FD_10_FD11: accessed-variable=CanCom_FD11TxSignalsSR.COMTX_CmdIgnSts_BCM_FD_10_FD11
        SendCANR_ExternTemperatureCFD11: can-be-invoked-concurrently=true, symbol=ApplCanComAb_FD11_SendCANR_ExternTemperatureCFD11  # Transmit
          data-receive-point-by-arguments:
            access DRP_SendCANR_ExternTemperatureCFD11_SendCANR_ExternTemperatureCFD11: accessed-variable=SendCANR_ExternTemperatureCFD11.SendCANR_ExternTemperatureCFD11
            access DRP_SendCANR_ExternTemperatureCFD11Vld_SendCANR_ExternTemperatureCFD11Vld: accessed-variable=SendCANR_ExternTemperatureCFD11Vld.SendCANR_ExternTemperatureCFD11Vld
          data-send-points:
            access DSP_CanCom_FD11TxSignalsSR_COMTX_ExternalTemperatureC_BCM_FD_10_FD11: accessed-variable=CanCom_FD11TxSignalsSR.COMTX_ExternalTemperatureC_BCM_FD_10_FD11
        SendCANR_OperationalModeStsFD11: can-be-invoked-concurrently=true, symbol=ApplCanComAb_FD11_SendCANR_OperationalModeStsFD11  # Transmit
          data-receive-point-by-arguments:
            access DRP_SendCANR_OperationalModeStsFD11_SendCANR_OperationalModeStsFD11: accessed-variable=SendCANR_OperationalModeStsFD11.SendCANR_OperationalModeStsFD11
            access DRP_SendCANR_OperationalModeStsFD11Vld_SendCANR_OperationalModeStsFD11Vld: accessed-variable=SendCANR_OperationalModeStsFD11Vld.SendCANR_OperationalModeStsFD11Vld
          data-send-points:
            access DSP_CanCom_FD11TxSignalsSR_COMTX_OperationalModeSts_BCM_FD_2_FD11: accessed-variable=CanCom_FD11TxSignalsSR.COMTX_OperationalModeSts_BCM_FD_2_FD11
        SendCANR_Battery_Volt_1_FD11: can-be-invoked-concurrently=true, symbol=ApplCanComAb_FD11_SendCANR_Battery_Volt_1_FD11  # Transmit
          data-receive-point-by-arguments:
            access DRP_SendCANR_Battery_Volt_1_FD11_SendCANR_Battery_Volt_1_FD11: accessed-variable=SendCANR_Battery_Volt_1_FD11.SendCANR_Battery_Volt_1_FD11
            access DRP_SendCANR_Battery_Volt_1_FD11Vld_SendCANR_Battery_Volt_1_FD11Vld: accessed-variable=SendCANR_Battery_Volt_1_FD11Vld.SendCANR_Battery_Volt_1_FD11Vld
          data-send-points:
            access DSP_CanCom_FD11TxSignalsSR_COMTX_Battery_Volt_1_BCM_FD_3_FD11: accessed-variable=CanCom_FD11TxSignalsSR.COMTX_Battery_Volt_1_BCM_FD_3_FD11
        SendCANR_IgnitionOnCounter_FD11: can-be-invoked-concurrently=true, symbol=ApplCanComAb_FD11_SendCANR_IgnitionOnCounter_FD11  # Transmit
          data-receive-point-by-arguments:
            access DRP_SendCANR_IgnitionOnCounter_FD11_SendCANR_IgnitionOnCounter_FD11: accessed-variable=SendCANR_IgnitionOnCounter_FD11.SendCANR_IgnitionOnCounter_FD11
            access DRP_SendCANR_IgnitionOnCounter_FD11Vld_SendCANR_IgnitionOnCounter_FD11Vld: accessed-variable=SendCANR_IgnitionOnCounter_FD11Vld.SendCANR_IgnitionOnCounter_FD11Vld
          data-send-points:
            access DSP_CanCom_FD11TxSignalsSR_COMTX_IgnitionOnCounter_BCM_FD_7_FD11: accessed-variable=CanCom_FD11TxSignalsSR.COMTX_IgnitionOnCounter_BCM_FD_7_FD11
        SendCANR_ExtTemp_FD11: can-be-invoked-concurrently=true, symbol=ApplCanComAb_FD11_SendCANR_ExtTemp_FD11  # Transmit
          data-receive-point-by-arguments:
            access DRP_SendCANR_ExtTemp_FD11_SendCANR_ExtTemp_FD11: accessed-variable=SendCANR_ExtTemp_FD11.SendCANR_ExtTemp_FD11
            access DRP_SendCANR_ExtTemp_FD11Vld_SendCANR_ExtTemp_FD11Vld: accessed-variable=SendCANR_ExtTemp_FD11Vld.SendCANR_ExtTemp_FD11Vld
          data-send-points:
            access DSP_CanCom_FD11TxSignalsSR_COMTX_ExternalTemperature_BCM_FD_9_FD11: accessed-variable=CanCom_FD11TxSignalsSR.COMTX_ExternalTemperature_BCM_FD_9_FD11
        SendCANR_VehicleSpeedVSOSigFD11: can-be-invoked-concurrently=true, symbol=ApplCanComAb_FD11_SendCANR_VehicleSpeedVSOSigFD11  # Transmit
          data-receive-point-by-arguments:
            access DRP_SendCANR_VehicleSpeedVSOSigFD11_SendCANR_VehicleSpeedVSOSigFD11: accessed-variable=SendCANR_VehicleSpeedVSOSigFD11.SendCANR_VehicleSpeedVSOSigFD11
            access DRP_SendCANR_VehicleSpeedVSOSigFD11Vld_SendCANR_VehicleSpeedVSOSigFD11Vld: accessed-variable=SendCANR_VehicleSpeedVSOSigFD11Vld.SendCANR_VehicleSpeedVSOSigFD11Vld
          data-send-points:
            access DSP_CanCom_FD11TxSignalsSR_COMTX_VehicleSpeedVSOSig_BRAKE_FD_2_FD11: accessed-variable=CanCom_FD11TxSignalsSR.COMTX_VehicleSpeedVSOSig_BRAKE_FD_2_FD11
        SendCANR_EPBSts_FD11: can-be-invoked-concurrently=true, symbol=ApplCanComAb_FD11_SendCANR_EPBSts_FD11  # Transmit
          data-receive-point-by-arguments:
            access DRP_SendCANR_EPBSts_FD11_SendCANR_EPBSts_FD11: accessed-variable=SendCANR_EPBSts_FD11.SendCANR_EPBSts_FD11
            access DRP_SendCANR_EPBSts_FD11Vld_SendCANR_EPBSts_FD11Vld: accessed-variable=SendCANR_EPBSts_FD11Vld.SendCANR_EPBSts_FD11Vld
          data-send-points:
            access DSP_CanCom_FD11TxSignalsSR_COMTX_EPBSts_BRAKE_FD_4_FD11: accessed-variable=CanCom_FD11TxSignalsSR.COMTX_EPBSts_BRAKE_FD_4_FD11
        SendCANR_EngineSpeed_W_FD11: can-be-invoked-concurrently=true, symbol=ApplCanComAb_FD11_SendCANR_EngineSpeed_W_FD11  # Transmit
          data-receive-point-by-arguments:
            access DRP_SendCANR_EngineSpeed_W_FD11_SendCANR_EngineSpeed_W_FD11: accessed-variable=SendCANR_EngineSpeed_W_FD11.SendCANR_EngineSpeed_W_FD11
            access DRP_SendCANR_EngineSpeed_W_FD11Vld_SendCANR_EngineSpeed_W_FD11Vld: accessed-variable=SendCANR_EngineSpeed_W_FD11Vld.SendCANR_EngineSpeed_W_FD11Vld
          data-send-points:
            access DSP_CanCom_FD11TxSignalsSR_COMTX_EngineSpeed_W_ENGINE_FD_2_FD11: accessed-variable=CanCom_FD11TxSignalsSR.COMTX_EngineSpeed_W_ENGINE_FD_2_FD11
        SendCANR_PtPrplsnActv_FD11: can-be-invoked-concurrently=true, symbol=ApplCanComAb_FD11_SendCANR_PtPrplsnActv_FD11  # Transmit
          data-receive-point-by-arguments:
            access DRP_SendCANR_PtPrplsnActv_FD11_SendCANR_PtPrplsnActv_FD11: accessed-variable=SendCANR_PtPrplsnActv_FD11.SendCANR_PtPrplsnActv_FD11
            access DRP_SendCANR_PtPrplsnActv_FD11Vld_SendCANR_PtPrplsnActv_FD11Vld: accessed-variable=SendCANR_PtPrplsnActv_FD11Vld.SendCANR_PtPrplsnActv_FD11Vld
          data-send-points:
            access DSP_CanCom_FD11TxSignalsSR_COMTX_PowertrainPrplsnActv_ENGINE_FD_2_FD11: accessed-variable=CanCom_FD11TxSignalsSR.COMTX_PowertrainPrplsnActv_ENGINE_FD_2_FD11
        SendCANR_BattVoltDeviationErr: can-be-invoked-concurrently=true, symbol=ApplCanComAb_FD11_SendCANR_BattVoltDeviationErr  # Transmit
          data-receive-point-by-arguments:
            access DRP_SendCANR_BattVoltDeviationErr_SendCANR_BattVoltDeviationErr: accessed-variable=SendCANR_BattVoltDeviationErr.SendCANR_BattVoltDeviationErr
            access DRP_SendCANR_BattVoltDeviationErrVld_SendCANR_BattVoltDeviationErrVld: accessed-variable=SendCANR_BattVoltDeviationErrVld.SendCANR_BattVoltDeviationErrVld
          data-send-points:
            access DSP_CanCom_FD11TxSignalsSR_COMTX_BattVoltDeviationErr_EVCU_CHADEMO_STATUS1_FD11: accessed-variable=CanCom_FD11TxSignalsSR.COMTX_BattVoltDeviationErr_EVCU_CHADEMO_STATUS1_FD11
        SendCANR_CdM_Chrgcurrentreqext: can-be-invoked-concurrently=true, symbol=ApplCanComAb_FD11_SendCANR_CdM_Chrgcurrentreqext  # Transmit
          data-receive-point-by-arguments:
            access DRP_SendCANR_CdM_Chrgcurrentreqext_SendCANR_CdM_Chrgcurrentreqext: accessed-variable=SendCANR_CdM_Chrgcurrentreqext.SendCANR_CdM_Chrgcurrentreqext
            access DRP_SendCANR_CdM_ChrgcurrentreqextVld_SendCANR_CdM_ChrgcurrentreqextVld: accessed-variable=SendCANR_CdM_ChrgcurrentreqextVld.SendCANR_CdM_ChrgcurrentreqextVld
          data-send-points:
            access DSP_CanCom_FD11TxSignalsSR_COMTX_CdM_Chrg_current_req_ext_EVCU_CHADEMO_STATUS1_FD11: accessed-variable=CanCom_FD11TxSignalsSR.COMTX_CdM_Chrg_current_req_ext_EVCU_CHADEMO_STATUS1_FD11
        SendCANR_CdMExtFunMinBattVolt: can-be-invoked-concurrently=true, symbol=ApplCanComAb_FD11_SendCANR_CdMExtFunMinBattVolt  # Transmit
          data-receive-point-by-arguments:
            access DRP_SendCANR_CdMExtFunMinBattVolt_SendCANR_CdMExtFunMinBattVolt: accessed-variable=SendCANR_CdMExtFunMinBattVolt.SendCANR_CdMExtFunMinBattVolt
            access DRP_SendCANR_CdMExtFunMinBattVoltVld_SendCANR_CdMExtFunMinBattVoltVld: accessed-variable=SendCANR_CdMExtFunMinBattVoltVld.SendCANR_CdMExtFunMinBattVoltVld
          data-send-points:
            access DSP_CanCom_FD11TxSignalsSR_COMTX_CdM_ExtFun_Min_Batt_Volt_EVCU_CHADEMO_STATUS1_FD11: accessed-variable=CanCom_FD11TxSignalsSR.COMTX_CdM_ExtFun_Min_Batt_Volt_EVCU_CHADEMO_STATUS1_FD11
        SendCANR_CdMExtFunVehDynCtrlCmp: can-be-invoked-concurrently=true, symbol=ApplCanComAb_FD11_SendCANR_CdMExtFunVehDynCtrlCmp  # Transmit
          data-receive-point-by-arguments:
            access DRP_SendCANR_CdMExtFunVehDynCtrlCmp_SendCANR_CdMExtFunVehDynCtrlCmp: accessed-variable=SendCANR_CdMExtFunVehDynCtrlCmp.SendCANR_CdMExtFunVehDynCtrlCmp
            access DRP_SendCANR_CdMExtFunVehDynCtrlCmpVld_SendCANR_CdMExtFunVehDynCtrlCmpVld: accessed-variable=SendCANR_CdMExtFunVehDynCtrlCmpVld.SendCANR_CdMExtFunVehDynCtrlCmpVld
          data-send-points:
            access DSP_CanCom_FD11TxSignalsSR_COMTX_CdM_ExtFun_Veh_Dyn_Control_Comp_EVCU_CHADEMO_STATUS1_FD11: accessed-variable=CanCom_FD11TxSignalsSR.COMTX_CdM_ExtFun_Veh_Dyn_Control_Comp_EVCU_CHADEMO_STATUS1_FD11
        SendCANR_CdM_ExtFunVehHCCntrCmp: can-be-invoked-concurrently=true, symbol=ApplCanComAb_FD11_SendCANR_CdM_ExtFunVehHCCntrCmp  # Transmit
          data-receive-point-by-arguments:
            access DRP_SendCANR_CdM_ExtFunVehHCCntrCmp_SendCANR_CdM_ExtFunVehHCCntrCmp: accessed-variable=SendCANR_CdM_ExtFunVehHCCntrCmp.SendCANR_CdM_ExtFunVehHCCntrCmp
            access DRP_SendCANR_CdM_ExtFunVehHCCntrCmpVld_SendCANR_CdM_ExtFunVehHCCntrCmpVld: accessed-variable=SendCANR_CdM_ExtFunVehHCCntrCmpVld.SendCANR_CdM_ExtFunVehHCCntrCmpVld
          data-send-points:
            access DSP_CanCom_FD11TxSignalsSR_COMTX_CdM_ExtFun_Veh_HC_Control_Comp_EVCU_CHADEMO_STATUS1_FD11: accessed-variable=CanCom_FD11TxSignalsSR.COMTX_CdM_ExtFun_Veh_HC_Control_Comp_EVCU_CHADEMO_STATUS1_FD11
        SendCANR_CdM_Reminedbattcpcity: can-be-invoked-concurrently=true, symbol=ApplCanComAb_FD11_SendCANR_CdM_Reminedbattcpcity  # Transmit
          data-receive-point-by-arguments:
            access DRP_SendCANR_CdM_Reminedbattcpcity_SendCANR_CdM_Reminedbattcpcity: accessed-variable=SendCANR_CdM_Reminedbattcpcity.SendCANR_CdM_Reminedbattcpcity
            access DRP_SendCANR_CdM_ReminedbattcpcityVld_SendCANR_CdM_ReminedbattcpcityVld: accessed-variable=SendCANR_CdM_ReminedbattcpcityVld.SendCANR_CdM_ReminedbattcpcityVld
          data-send-points:
            access DSP_CanCom_FD11TxSignalsSR_COMTX_CdM_Remained_batt_capacity_EVCU_CHADEMO_STATUS1_FD11: accessed-variable=CanCom_FD11TxSignalsSR.COMTX_CdM_Remained_batt_capacity_EVCU_CHADEMO_STATUS1_FD11
        SendCANR_CHAdeMOProtocol: can-be-invoked-concurrently=true, symbol=ApplCanComAb_FD11_SendCANR_CHAdeMOProtocol  # Transmit
          data-receive-point-by-arguments:
            access DRP_SendCANR_CHAdeMOProtocol_SendCANR_CHAdeMOProtocol: accessed-variable=SendCANR_CHAdeMOProtocol.SendCANR_CHAdeMOProtocol
            access DRP_SendCANR_CHAdeMOProtocolVld_SendCANR_CHAdeMOProtocolVld: accessed-variable=SendCANR_CHAdeMOProtocolVld.SendCANR_CHAdeMOProtocolVld
          data-send-points:
            access DSP_CanCom_FD11TxSignalsSR_COMTX_CHAdeMOProtocol_EVCU_CHADEMO_STATUS1_FD11: accessed-variable=CanCom_FD11TxSignalsSR.COMTX_CHAdeMOProtocol_EVCU_CHADEMO_STATUS1_FD11
        SendCANR_ChargedCurrentMin: can-be-invoked-concurrently=true, symbol=ApplCanComAb_FD11_SendCANR_ChargedCurrentMin  # Transmit
          data-receive-point-by-arguments:
            access DRP_SendCANR_ChargedCurrentMin_SendCANR_ChargedCurrentMin: accessed-variable=SendCANR_ChargedCurrentMin.SendCANR_ChargedCurrentMin
            access DRP_SendCANR_ChargedCurrentMinVld_SendCANR_ChargedCurrentMinVld: accessed-variable=SendCANR_ChargedCurrentMinVld.SendCANR_ChargedCurrentMinVld
          data-send-points:
            access DSP_CanCom_FD11TxSignalsSR_COMTX_ChargedCurrentMin_EVCU_CHADEMO_STATUS1_FD11: accessed-variable=CanCom_FD11TxSignalsSR.COMTX_ChargedCurrentMin_EVCU_CHADEMO_STATUS1_FD11
        SendCANR_ChrgdRefrncCnstnt: can-be-invoked-concurrently=true, symbol=ApplCanComAb_FD11_SendCANR_ChrgdRefrncCnstnt  # Transmit
          data-receive-point-by-arguments:
            access DRP_SendCANR_ChrgdRefrncCnstnt_SendCANR_ChrgdRefrncCnstnt: accessed-variable=SendCANR_ChrgdRefrncCnstnt.SendCANR_ChrgdRefrncCnstnt
            access DRP_SendCANR_ChrgdRefrncCnstntVld_SendCANR_ChrgdRefrncCnstntVld: accessed-variable=SendCANR_ChrgdRefrncCnstntVld.SendCANR_ChrgdRefrncCnstntVld
          data-send-points:
            access DSP_CanCom_FD11TxSignalsSR_COMTX_ChargedReferenceConstant_EVCU_CHADEMO_STATUS1_FD11: accessed-variable=CanCom_FD11TxSignalsSR.COMTX_ChargedReferenceConstant_EVCU_CHADEMO_STATUS1_FD11
        SendCANR_DisplaySOC: can-be-invoked-concurrently=true, symbol=ApplCanComAb_FD11_SendCANR_DisplaySOC  # Transmit
          data-receive-point-by-arguments:
            access DRP_SendCANR_DisplaySOC_SendCANR_DisplaySOC: accessed-variable=SendCANR_DisplaySOC.SendCANR_DisplaySOC
            access DRP_SendCANR_DisplaySOC_Vld_SendCANR_DisplaySOC_Vld: accessed-variable=SendCANR_DisplaySOC_Vld.SendCANR_DisplaySOC_Vld
          data-send-points:
            access DSP_CanCom_FD11TxSignalsSR_COMTX_DisplaySOC_EVCU_CHADEMO_STATUS1_FD11: accessed-variable=CanCom_FD11TxSignalsSR.COMTX_DisplaySOC_EVCU_CHADEMO_STATUS1_FD11
        SendCANR_EVContactorSts: can-be-invoked-concurrently=true, symbol=ApplCanComAb_FD11_SendCANR_EVContactorSts  # Transmit
          data-receive-point-by-arguments:
            access DRP_SendCANR_EVContactorSts_SendCANR_EVContactorSts: accessed-variable=SendCANR_EVContactorSts.SendCANR_EVContactorSts
            access DRP_SendCANR_EVContactorStsVld_SendCANR_EVContactorStsVld: accessed-variable=SendCANR_EVContactorStsVld.SendCANR_EVContactorStsVld
          data-send-points:
            access DSP_CanCom_FD11TxSignalsSR_COMTX_EVContactorSts_EVCU_CHADEMO_STATUS1_FD11: accessed-variable=CanCom_FD11TxSignalsSR.COMTX_EVContactorSts_EVCU_CHADEMO_STATUS1_FD11
        SendCANR_EVCU_CP3Cmd: can-be-invoked-concurrently=true, symbol=ApplCanComAb_FD11_SendCANR_EVCU_CP3Cmd  # Transmit
          data-receive-point-by-arguments:
            access DRP_SendCANR_EVCU_CP3Cmd_SendCANR_EVCU_CP3Cmd: accessed-variable=SendCANR_EVCU_CP3Cmd.SendCANR_EVCU_CP3Cmd
            access DRP_SendCANR_EVCU_CP3CmdVld_SendCANR_EVCU_CP3CmdVld: accessed-variable=SendCANR_EVCU_CP3CmdVld.SendCANR_EVCU_CP3CmdVld
          data-send-points:
            access DSP_CanCom_FD11TxSignalsSR_COMTX_EVCU_CP3Cmd_EVCU_CHADEMO_STATUS1_FD11: accessed-variable=CanCom_FD11TxSignalsSR.COMTX_EVCU_CP3Cmd_EVCU_CHADEMO_STATUS1_FD11
        SendCANR_MinBatteryPackVoltage: can-be-invoked-concurrently=true, symbol=ApplCanComAb_FD11_SendCANR_MinBatteryPackVoltage  # Transmit
          data-receive-point-by-arguments:
            access DRP_SendCANR_MinBatteryPackVoltage_SendCANR_MinBatteryPackVoltage: accessed-variable=SendCANR_MinBatteryPackVoltage.SendCANR_MinBatteryPackVoltage
            access DRP_SendCANR_MinBatteryPackVoltageVld_SendCANR_MinBatteryPackVoltageVld: accessed-variable=SendCANR_MinBatteryPackVoltageVld.SendCANR_MinBatteryPackVoltageVld
          data-send-points:
            access DSP_CanCom_FD11TxSignalsSR_COMTX_MinBatteryPackVoltage_EVCU_CHADEMO_STATUS1_FD11: accessed-variable=CanCom_FD11TxSignalsSR.COMTX_MinBatteryPackVoltage_EVCU_CHADEMO_STATUS1_FD11
        SendCANR_StopReqBeforeCharge: can-be-invoked-concurrently=true, symbol=ApplCanComAb_FD11_SendCANR_StopReqBeforeCharge  # Transmit
          data-receive-point-by-arguments:
            access DRP_SendCANR_StopReqBeforeCharge_SendCANR_StopReqBeforeCharge: accessed-variable=SendCANR_StopReqBeforeCharge.SendCANR_StopReqBeforeCharge
            access DRP_SendCANR_StopReqBeforeChargeVld_SendCANR_StopReqBeforeChargeVld: accessed-variable=SendCANR_StopReqBeforeChargeVld.SendCANR_StopReqBeforeChargeVld
          data-send-points:
            access DSP_CanCom_FD11TxSignalsSR_COMTX_StopReqBeforeCharge_EVCU_CHADEMO_STATUS1_FD11: accessed-variable=CanCom_FD11TxSignalsSR.COMTX_StopReqBeforeCharge_EVCU_CHADEMO_STATUS1_FD11
        SendCANR_TotalBatteryCapacity: can-be-invoked-concurrently=true, symbol=ApplCanComAb_FD11_SendCANR_TotalBatteryCapacity  # Transmit
          data-receive-point-by-arguments:
            access DRP_SendCANR_TotalBatteryCapacity_SendCANR_TotalBatteryCapacity: accessed-variable=SendCANR_TotalBatteryCapacity.SendCANR_TotalBatteryCapacity
            access DRP_SendCANR_TotalBatteryCapacityVld_SendCANR_TotalBatteryCapacityVld: accessed-variable=SendCANR_TotalBatteryCapacityVld.SendCANR_TotalBatteryCapacityVld
          data-send-points:
            access DSP_CanCom_FD11TxSignalsSR_COMTX_TotalBatteryCapacity_EVCU_CHADEMO_STATUS1_FD11: accessed-variable=CanCom_FD11TxSignalsSR.COMTX_TotalBatteryCapacity_EVCU_CHADEMO_STATUS1_FD11
        SendCANR_VehicleDriveSts: can-be-invoked-concurrently=true, symbol=ApplCanComAb_FD11_SendCANR_VehicleDriveSts  # Transmit
          data-receive-point-by-arguments:
            access DRP_SendCANR_VehicleDriveSts_SendCANR_VehicleDriveSts: accessed-variable=SendCANR_VehicleDriveSts.SendCANR_VehicleDriveSts
            access DRP_SendCANR_VehicleDriveStsVld_SendCANR_VehicleDriveStsVld: accessed-variable=SendCANR_VehicleDriveStsVld.SendCANR_VehicleDriveStsVld
          data-send-points:
            access DSP_CanCom_FD11TxSignalsSR_COMTX_VehicleDriveSts_EVCU_CHADEMO_STATUS1_FD11: accessed-variable=CanCom_FD11TxSignalsSR.COMTX_VehicleDriveSts_EVCU_CHADEMO_STATUS1_FD11
        SendCANR_N_PDU_7B_FD11: can-be-invoked-concurrently=true, symbol=ApplCanComAb_FD11_SendCANR_N_PDU_7B_FD11  # Transmit
          data-receive-point-by-arguments:
            access DRP_SendCANR_N_PDU_7B_FD11_SendCANR_N_PDU_7B_FD11: accessed-variable=SendCANR_N_PDU_7B_FD11.SendCANR_N_PDU_7B_FD11
            access DRP_SendCANR_N_PDU_7B_FD11Vld_SendCANR_N_PDU_7B_FD11Vld: accessed-variable=SendCANR_N_PDU_7B_FD11Vld.SendCANR_N_PDU_7B_FD11Vld
          data-send-points:
            access DSP_CanCom_FD11TxSignalsSR_COMTX_N_PDU_7B_GLIWA_MCPA_TX_FD11: accessed-variable=CanCom_FD11TxSignalsSR.COMTX_N_PDU_7B_GLIWA_MCPA_TX_FD11
        SendCANR_N_PDU_7C_FD11: can-be-invoked-concurrently=true, symbol=ApplCanComAb_FD11_SendCANR_N_PDU_7C_FD11  # Transmit
          data-receive-point-by-arguments:
            access DRP_SendCANR_N_PDU_7C_FD11_SendCANR_N_PDU_7C_FD11: accessed-variable=SendCANR_N_PDU_7C_FD11.SendCANR_N_PDU_7C_FD11
            access DRP_SendCANR_N_PDU_7C_FD11Vld_SendCANR_N_PDU_7C_FD11Vld: accessed-variable=SendCANR_N_PDU_7C_FD11Vld.SendCANR_N_PDU_7C_FD11Vld
          data-send-points:
            access DSP_CanCom_FD11TxSignalsSR_COMTX_N_PDU_7C_GLIWA_MCPB_TX_FD11: accessed-variable=CanCom_FD11TxSignalsSR.COMTX_N_PDU_7C_GLIWA_MCPB_TX_FD11
        SendCANR_N_PDU_86: can-be-invoked-concurrently=true, symbol=ApplCanComAb_FD11_SendCANR_N_PDU_86  # Transmit
          data-receive-point-by-arguments:
            access DRP_SendCANR_N_PDU_86_SendCANR_N_PDU_86: accessed-variable=SendCANR_N_PDU_86.SendCANR_N_PDU_86
            access DRP_SendCANR_N_PDU_86Vld_SendCANR_N_PDU_86Vld: accessed-variable=SendCANR_N_PDU_86Vld.SendCANR_N_PDU_86Vld
          data-send-points:
            access DSP_CanCom_FD11TxSignalsSR_COMTX_N_PDU_86_GLIWA_SGCP_TX_FD11: accessed-variable=CanCom_FD11TxSignalsSR.COMTX_N_PDU_86_GLIWA_SGCP_TX_FD11
        SendCANR_N_PDU_342_FD11: can-be-invoked-concurrently=true, symbol=ApplCanComAb_FD11_SendCANR_N_PDU_342_FD11  # Transmit
          data-receive-point-by-arguments:
            access DRP_SendCANR_N_PDU_342_FD11_SendCANR_N_PDU_342_FD11: accessed-variable=SendCANR_N_PDU_342_FD11.SendCANR_N_PDU_342_FD11
            access DRP_SendCANR_N_PDU_342_FD11Vld_SendCANR_N_PDU_342_FD11Vld: accessed-variable=SendCANR_N_PDU_342_FD11Vld.SendCANR_N_PDU_342_FD11Vld
          data-send-points:
            access DSP_CanCom_FD11TxSignalsSR_COMTX_N_PDU_342_GLIWA_T1_TX_FD11: accessed-variable=CanCom_FD11TxSignalsSR.COMTX_N_PDU_342_GLIWA_T1_TX_FD11
        SendCANR_CRC_HYBRID_DISPLAY2: can-be-invoked-concurrently=true, symbol=ApplCanComAb_FD11_SendCANR_CRC_HYBRID_DISPLAY2  # Transmit
          data-receive-point-by-arguments:
            access DRP_SendCANR_CRC_HYBRID_DISPLAY2_SendCANR_CRC_HYBRID_DISPLAY2: accessed-variable=SendCANR_CRC_HYBRID_DISPLAY2.SendCANR_CRC_HYBRID_DISPLAY2
            access DRP_SendCANR_CRC_HYBRID_DISPLAY2Vld_SendCANR_CRC_HYBRID_DISPLAY2Vld: accessed-variable=SendCANR_CRC_HYBRID_DISPLAY2Vld.SendCANR_CRC_HYBRID_DISPLAY2Vld
          data-send-points:
            access DSP_CanCom_FD11TxSignalsSR_COMTX_CRC_HYBRID_DISPLAY2_HYBRID_DISPLAY2_FD11: accessed-variable=CanCom_FD11TxSignalsSR.COMTX_CRC_HYBRID_DISPLAY2_HYBRID_DISPLAY2_FD11
        SendCANR_DischrgngSysStatusFD11: can-be-invoked-concurrently=true, symbol=ApplCanComAb_FD11_SendCANR_DischrgngSysStatusFD11  # Transmit
          data-receive-point-by-arguments:
            access DRP_SendCANR_DischrgngSysStatusFD11_SendCANR_DischrgngSysStatusFD11: accessed-variable=SendCANR_DischrgngSysStatusFD11.SendCANR_DischrgngSysStatusFD11
            access DRP_SendCANR_DischrgngSysStatusFD11Vld_SendCANR_DischrgngSysStatusFD11Vld: accessed-variable=SendCANR_DischrgngSysStatusFD11Vld.SendCANR_DischrgngSysStatusFD11Vld
          data-send-points:
            access DSP_CanCom_FD11TxSignalsSR_COMTX_DischargingSysStatus_HYBRID_DISPLAY2_FD11: accessed-variable=CanCom_FD11TxSignalsSR.COMTX_DischargingSysStatus_HYBRID_DISPLAY2_FD11
        SendCANR_LID_Status_120VSocketA: can-be-invoked-concurrently=true, symbol=ApplCanComAb_FD11_SendCANR_LID_Status_120VSocketA  # Transmit
          data-receive-point-by-arguments:
            access DRP_SendCANR_LID_Status_120VSocketA_SendCANR_LID_Status_120VSocketA: accessed-variable=SendCANR_LID_Status_120VSocketA.SendCANR_LID_Status_120VSocketA
            access DRP_SendCANR_LID_Status_120VSocketA_Vld_SendCANR_LID_Status_120VSocketA_Vld: accessed-variable=SendCANR_LID_Status_120VSocketA_Vld.SendCANR_LID_Status_120VSocketA_Vld
          data-send-points:
            access DSP_CanCom_FD11TxSignalsSR_COMTX_LID_Status_120V_Socket_A_HYBRID_DISPLAY2_FD11: accessed-variable=CanCom_FD11TxSignalsSR.COMTX_LID_Status_120V_Socket_A_HYBRID_DISPLAY2_FD11
        SendCANR_LID_Status_120VSocketB: can-be-invoked-concurrently=true, symbol=ApplCanComAb_FD11_SendCANR_LID_Status_120VSocketB  # Transmit
          data-receive-point-by-arguments:
            access DRP_SendCANR_LID_Status_120VSocketB_SendCANR_LID_Status_120VSocketB: accessed-variable=SendCANR_LID_Status_120VSocketB.SendCANR_LID_Status_120VSocketB
            access DRP_SendCANR_LID_Status_120VSocketB_Vld_SendCANR_LID_Status_120VSocketB_Vld: accessed-variable=SendCANR_LID_Status_120VSocketB_Vld.SendCANR_LID_Status_120VSocketB_Vld
          data-send-points:
            access DSP_CanCom_FD11TxSignalsSR_COMTX_LID_Status_120V_Socket_B_HYBRID_DISPLAY2_FD11: accessed-variable=CanCom_FD11TxSignalsSR.COMTX_LID_Status_120V_Socket_B_HYBRID_DISPLAY2_FD11
