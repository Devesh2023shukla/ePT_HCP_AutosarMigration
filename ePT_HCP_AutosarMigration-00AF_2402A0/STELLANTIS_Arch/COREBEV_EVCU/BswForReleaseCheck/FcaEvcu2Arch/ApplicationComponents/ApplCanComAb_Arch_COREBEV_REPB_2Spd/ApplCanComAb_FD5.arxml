[part 2 of 3: package /STLASWCs]
AUTOSAR XML (schema 4-3-0)
package /STLASWCs  (continued)
  complex device driver sw component type ApplCanComAb_FD5  (continued)
    behavior IBApplCanComAb_FD5: data-type-mapping=ADTtoIDTMapping, handle-termination-and-restart=NO-SUPPORT  (continued)
      243 x runnable:
        ApplCanComAb_FD5Inin: symbol=ApplCanComAb_FD5_ApplCanComAb_FD5Inin  # CAN SWC initialization runnable
          data-send-points:
            42 x access:
              DSP_VeRxPDU_MCPB_OBD_DTC_FD5_E2E_Sts_E2ECheckSts: accessed-variable=VeRxPDU_MCPB_OBD_DTC_FD5_E2E_Sts.E2ECheckSts
              DSP_VeRxPDU_MCPB_OBD_DTC_FD5_E2E_Sts_OpRetVal: accessed-variable=VeRxPDU_MCPB_OBD_DTC_FD5_E2E_Sts.OpRetVal
              DSP_VeRxPDU_MCPB_PROPULSION_FD5_E2E_Sts_E2ECheckSts: accessed-variable=VeRxPDU_MCPB_PROPULSION_FD5_E2E_Sts.E2ECheckSts
              DSP_VeRxPDU_MCPB_PROPULSION_FD5_E2E_Sts_OpRetVal: accessed-variable=VeRxPDU_MCPB_PROPULSION_FD5_E2E_Sts.OpRetVal
              DSP_VeRxPDU_OBCM_VDCM_FD5_E2E_Sts_E2ECheckSts: accessed-variable=VeRxPDU_OBCM_VDCM_FD5_E2E_Sts.E2ECheckSts
              DSP_VeRxPDU_OBCM_VDCM_FD5_E2E_Sts_OpRetVal: accessed-variable=VeRxPDU_OBCM_VDCM_FD5_E2E_Sts.OpRetVal
              DSP_VeRxPDU_OBCM_VDCM2_FD5_E2E_Sts_E2ECheckSts: accessed-variable=VeRxPDU_OBCM_VDCM2_FD5_E2E_Sts.E2ECheckSts
              DSP_VeRxPDU_OBCM_VDCM2_FD5_E2E_Sts_OpRetVal: accessed-variable=VeRxPDU_OBCM_VDCM2_FD5_E2E_Sts.OpRetVal
              DSP_VeRxPDU_PARK_DATA_FD5_E2E_Sts_E2ECheckSts: accessed-variable=VeRxPDU_PARK_DATA_FD5_E2E_Sts.E2ECheckSts
              DSP_VeRxPDU_PARK_DATA_FD5_E2E_Sts_OpRetVal: accessed-variable=VeRxPDU_PARK_DATA_FD5_E2E_Sts.OpRetVal
              DSP_VeRxPDU_SGCP_OBD_DTC_FD5_E2E_Sts_E2ECheckSts: accessed-variable=VeRxPDU_SGCP_OBD_DTC_FD5_E2E_Sts.E2ECheckSts
              DSP_VeRxPDU_SGCP_OBD_DTC_FD5_E2E_Sts_OpRetVal: accessed-variable=VeRxPDU_SGCP_OBD_DTC_FD5_E2E_Sts.OpRetVal
              DSP_VeRxPDU_SGCP_PROPULSION_FD5_E2E_Sts_E2ECheckSts: accessed-variable=VeRxPDU_SGCP_PROPULSION_FD5_E2E_Sts.E2ECheckSts
              DSP_VeRxPDU_SGCP_PROPULSION_FD5_E2E_Sts_OpRetVal: accessed-variable=VeRxPDU_SGCP_PROPULSION_FD5_E2E_Sts.OpRetVal
              DSP_VeRxPDU_MCPA_PROPULSION_FD5_E2E_Sts_E2ECheckSts: accessed-variable=VeRxPDU_MCPA_PROPULSION_FD5_E2E_Sts.E2ECheckSts
              DSP_VeRxPDU_MCPA_PROPULSION_FD5_E2E_Sts_OpRetVal: accessed-variable=VeRxPDU_MCPA_PROPULSION_FD5_E2E_Sts.OpRetVal
              DSP_VeRxPDU_MCPA_OBD_DTC_FD5_E2E_Sts_E2ECheckSts: accessed-variable=VeRxPDU_MCPA_OBD_DTC_FD5_E2E_Sts.E2ECheckSts
              DSP_VeRxPDU_MCPA_OBD_DTC_FD5_E2E_Sts_OpRetVal: accessed-variable=VeRxPDU_MCPA_OBD_DTC_FD5_E2E_Sts.OpRetVal
              DSP_VeRxPDU_HV_CHARGER1_FD5_E2E_Sts_E2ECheckSts: accessed-variable=VeRxPDU_HV_CHARGER1_FD5_E2E_Sts.E2ECheckSts
              DSP_VeRxPDU_HV_CHARGER1_FD5_E2E_Sts_OpRetVal: accessed-variable=VeRxPDU_HV_CHARGER1_FD5_E2E_Sts.OpRetVal
              DSP_VeRxPDU_ENGINE_HYBD_FD_4_FD5_E2E_Sts_E2ECheckSts: accessed-variable=VeRxPDU_ENGINE_HYBD_FD_4_FD5_E2E_Sts.E2ECheckSts
              DSP_VeRxPDU_ENGINE_HYBD_FD_4_FD5_E2E_Sts_OpRetVal: accessed-variable=VeRxPDU_ENGINE_HYBD_FD_4_FD5_E2E_Sts.OpRetVal
              DSP_VeRxPDU_ENGINE_HYBD_FD_3_FD5_E2E_Sts_E2ECheckSts: accessed-variable=VeRxPDU_ENGINE_HYBD_FD_3_FD5_E2E_Sts.E2ECheckSts
              DSP_VeRxPDU_ENGINE_HYBD_FD_3_FD5_E2E_Sts_OpRetVal: accessed-variable=VeRxPDU_ENGINE_HYBD_FD_3_FD5_E2E_Sts.OpRetVal
              DSP_VeRxPDU_ENGINE_HYBD_FD_1_FD5_E2E_Sts_E2ECheckSts: accessed-variable=VeRxPDU_ENGINE_HYBD_FD_1_FD5_E2E_Sts.E2ECheckSts
              DSP_VeRxPDU_ENGINE_HYBD_FD_1_FD5_E2E_Sts_OpRetVal: accessed-variable=VeRxPDU_ENGINE_HYBD_FD_1_FD5_E2E_Sts.OpRetVal
              DSP_VeRxPDU_ENGINE_FD_LHOM_FD5_E2E_Sts_E2ECheckSts: accessed-variable=VeRxPDU_ENGINE_FD_LHOM_FD5_E2E_Sts.E2ECheckSts
              DSP_VeRxPDU_ENGINE_FD_LHOM_FD5_E2E_Sts_OpRetVal: accessed-variable=VeRxPDU_ENGINE_FD_LHOM_FD5_E2E_Sts.OpRetVal
              DSP_VeRxPDU_ENGINE_FD_5_FD5_E2E_Sts_E2ECheckSts: accessed-variable=VeRxPDU_ENGINE_FD_5_FD5_E2E_Sts.E2ECheckSts
              DSP_VeRxPDU_ENGINE_FD_5_FD5_E2E_Sts_OpRetVal: accessed-variable=VeRxPDU_ENGINE_FD_5_FD5_E2E_Sts.OpRetVal
              DSP_VeRxPDU_ENGINE_FD_2_FD5_E2E_Sts_E2ECheckSts: accessed-variable=VeRxPDU_ENGINE_FD_2_FD5_E2E_Sts.E2ECheckSts
              DSP_VeRxPDU_ENGINE_FD_2_FD5_E2E_Sts_OpRetVal: accessed-variable=VeRxPDU_ENGINE_FD_2_FD5_E2E_Sts.OpRetVal
              DSP_VeRxPDU_ENGINE_FD_1_FD5_E2E_Sts_E2ECheckSts: accessed-variable=VeRxPDU_ENGINE_FD_1_FD5_E2E_Sts.E2ECheckSts
              DSP_VeRxPDU_ENGINE_FD_1_FD5_E2E_Sts_OpRetVal: accessed-variable=VeRxPDU_ENGINE_FD_1_FD5_E2E_Sts.OpRetVal
              DSP_VeRxPDU_BATTERY_HV_VLIMITS_FD5_E2E_Sts_E2ECheckSts: accessed-variable=VeRxPDU_BATTERY_HV_VLIMITS_FD5_E2E_Sts.E2ECheckSts
              DSP_VeRxPDU_BATTERY_HV_VLIMITS_FD5_E2E_Sts_OpRetVal: accessed-variable=VeRxPDU_BATTERY_HV_VLIMITS_FD5_E2E_Sts.OpRetVal
              DSP_VeRxPDU_BATTERY_HV_STATUS1_FD5_E2E_Sts_E2ECheckSts: accessed-variable=VeRxPDU_BATTERY_HV_STATUS1_FD5_E2E_Sts.E2ECheckSts
              DSP_VeRxPDU_BATTERY_HV_STATUS1_FD5_E2E_Sts_OpRetVal: accessed-variable=VeRxPDU_BATTERY_HV_STATUS1_FD5_E2E_Sts.OpRetVal
              DSP_VeRxPDU_BATTERY_HV_POWERLIMITS_FD5_E2E_Sts_E2ECheckSts: accessed-variable=VeRxPDU_BATTERY_HV_POWERLIMITS_FD5_E2E_Sts.E2ECheckSts
              DSP_VeRxPDU_BATTERY_HV_POWERLIMITS_FD5_E2E_Sts_OpRetVal: accessed-variable=VeRxPDU_BATTERY_HV_POWERLIMITS_FD5_E2E_Sts.OpRetVal
              DSP_VeRxPDU_APM_VDCM_FD5_E2E_Sts_E2ECheckSts: accessed-variable=VeRxPDU_APM_VDCM_FD5_E2E_Sts.E2ECheckSts
              DSP_VeRxPDU_APM_VDCM_FD5_E2E_Sts_OpRetVal: accessed-variable=VeRxPDU_APM_VDCM_FD5_E2E_Sts.OpRetVal
          33 x parameter access:
            SCPVA_KeCANR_b_ComTxMsg_BCM_FD_10_FD5_Enbld: accessed-parameter=KeCANR_b_ComTxMsg_BCM_FD_10_FD5_Enbld
            SCPVA_KeCANR_b_ComTxMsg_BCM_FD_2_FD5_Enbld: accessed-parameter=KeCANR_b_ComTxMsg_BCM_FD_2_FD5_Enbld
            SCPVA_KeCANR_b_ComTxMsg_BCM_FD_3_FD5_Enbld: accessed-parameter=KeCANR_b_ComTxMsg_BCM_FD_3_FD5_Enbld
            SCPVA_KeCANR_b_ComTxMsg_BCM_FD_7_FD5_Enbld: accessed-parameter=KeCANR_b_ComTxMsg_BCM_FD_7_FD5_Enbld
            SCPVA_KeCANR_b_ComTxMsg_BCM_FD_9_FD5_Enbld: accessed-parameter=KeCANR_b_ComTxMsg_BCM_FD_9_FD5_Enbld
            SCPVA_KeCANR_b_ComTxMsg_BRAKE_FD_2_FD5_Enbld: accessed-parameter=KeCANR_b_ComTxMsg_BRAKE_FD_2_FD5_Enbld
            SCPVA_KeCANR_b_ComTxMsg_BRAKE_FD_4_FD5_Enbld: accessed-parameter=KeCANR_b_ComTxMsg_BRAKE_FD_4_FD5_Enbld
            SCPVA_KeCANR_b_ComTxMsg_BRAKE_FD_5_FD5_Enbld: accessed-parameter=KeCANR_b_ComTxMsg_BRAKE_FD_5_FD5_Enbld
            SCPVA_KeCANR_b_ComTxMsg_EVCU_ISO15118_STATUS1_FD5_Enbld: accessed-parameter=KeCANR_b_ComTxMsg_EVCU_ISO15118_STATUS1_FD5_Enbld
            SCPVA_KeCANR_b_ComTxMsg_FOTA_MASTER_FD5_Enbld: accessed-parameter=KeCANR_b_ComTxMsg_FOTA_MASTER_FD5_Enbld
            SCPVA_KeCANR_b_ComTxMsg_GLIWA_MCPA_RX_FD5_Enbld: accessed-parameter=KeCANR_b_ComTxMsg_GLIWA_MCPA_RX_FD5_Enbld
            SCPVA_KeCANR_b_ComTxMsg_GLIWA_MCPB_RX_FD5_Enbld: accessed-parameter=KeCANR_b_ComTxMsg_GLIWA_MCPB_RX_FD5_Enbld
            SCPVA_KeCANR_b_ComTxMsg_HYBRID_CHARGING_COMMAND_FD5_Enbld: accessed-parameter=KeCANR_b_ComTxMsg_HYBRID_CHARGING_COMMAND_FD5_Enbld
            SCPVA_KeCANR_b_ComTxMsg_HYBRID_CHARGING_STATUS_FD5_Enbld: accessed-parameter=KeCANR_b_ComTxMsg_HYBRID_CHARGING_STATUS_FD5_Enbld
            SCPVA_KeCANR_b_ComTxMsg_HYBRID_FD_LHOM_FD5_Enbld: accessed-parameter=KeCANR_b_ComTxMsg_HYBRID_FD_LHOM_FD5_Enbld
            SCPVA_KeCANR_b_ComTxMsg_HYBRID_POWERTRAIN1_FD5_Enbld: accessed-parameter=KeCANR_b_ComTxMsg_HYBRID_POWERTRAIN1_FD5_Enbld
            SCPVA_KeCANR_b_ComTxMsg_HYBRID_POWERTRAIN5_FD5_Enbld: accessed-parameter=KeCANR_b_ComTxMsg_HYBRID_POWERTRAIN5_FD5_Enbld
            SCPVA_KeCANR_b_ComTxMsg_HYBRID_SYSTEM_EPT1_FD5_Enbld: accessed-parameter=KeCANR_b_ComTxMsg_HYBRID_SYSTEM_EPT1_FD5_Enbld
            SCPVA_KeCANR_b_ComTxMsg_HYBRID_THERMAL_COMMAND_FD5_Enbld: accessed-parameter=KeCANR_b_ComTxMsg_HYBRID_THERMAL_COMMAND_FD5_Enbld
            SCPVA_KeCANR_b_ComTxMsg_IMPACT_INFO_FD5_Enbld: accessed-parameter=KeCANR_b_ComTxMsg_IMPACT_INFO_FD5_Enbld
            SCPVA_KeCANR_b_ComTxMsg_INVTARGET_PROPULSION1_FD5_Enbld: accessed-parameter=KeCANR_b_ComTxMsg_INVTARGET_PROPULSION1_FD5_Enbld
            SCPVA_KeCANR_b_ComTxMsg_INVTARGET_PROPULSION2_FD5_Enbld: accessed-parameter=KeCANR_b_ComTxMsg_INVTARGET_PROPULSION2_FD5_Enbld
            SCPVA_KeCANR_b_ComTxMsg_IPC_FD_1_FD5_Enbld: accessed-parameter=KeCANR_b_ComTxMsg_IPC_FD_1_FD5_Enbld
            SCPVA_KeCANR_b_ComTxMsg_PT_ENERGY_FD_1_FD5_Enbld: accessed-parameter=KeCANR_b_ComTxMsg_PT_ENERGY_FD_1_FD5_Enbld
            SCPVA_KeCANR_b_ComTxMsg_PT_SYSTEM_FD_1_FD5_Enbld: accessed-parameter=KeCANR_b_ComTxMsg_PT_SYSTEM_FD_1_FD5_Enbld
            SCPVA_KeCANR_b_ComTxMsg_REAL_TIME_CLOCK_FD5_Enbld: accessed-parameter=KeCANR_b_ComTxMsg_REAL_TIME_CLOCK_FD5_Enbld
            SCPVA_KeCANR_b_ComTxMsg_RPF_FD_3_FD5_Enbld: accessed-parameter=KeCANR_b_ComTxMsg_RPF_FD_3_FD5_Enbld
            SCPVA_KeCANR_b_ComTxMsg_TELEMATIC_FD_1_FD5_Enbld: accessed-parameter=KeCANR_b_ComTxMsg_TELEMATIC_FD_1_FD5_Enbld
            SCPVA_KeCANR_b_ComTxMsg_VDCM_OBCM_FD5_Enbld: accessed-parameter=KeCANR_b_ComTxMsg_VDCM_OBCM_FD5_Enbld
            SCPVA_KeCANR_b_ComTxMsg_VDCM_OBCM2_FD5_Enbld: accessed-parameter=KeCANR_b_ComTxMsg_VDCM_OBCM2_FD5_Enbld
            SCPVA_KeCANR_b_ComTxMsg_VDCM_PWT3_FD5_Enbld: accessed-parameter=KeCANR_b_ComTxMsg_VDCM_PWT3_FD5_Enbld
            SCPVA_KeCANR_b_ComTxMsg_VIN_FD5_Enbld: accessed-parameter=KeCANR_b_ComTxMsg_VIN_FD5_Enbld
            SCPVA_KeCANR_b_ComTxMsg_CFG_DATA_CODE_REQUEST_FD5_Enbld: accessed-parameter=KeCANR_b_ComTxMsg_CFG_DATA_CODE_REQUEST_FD5_Enbld
        COMRX_ImpactHardwire_BATTERY_HV_FD5_Received: symbol=ApplCanComAb_FD5_COMRX_ImpactHardwire_BATTERY_HV_FD5_Received  # Received
          data-receive-point-by-arguments:
            access DRP_CanCom_FD5RxSignalsSR_COMRX_ImpactHardwire_BATTERY_HV_FD5: accessed-variable=CanCom_FD5RxSignalsSR.COMRX_ImpactHardwire_BATTERY_HV_FD5
          data-send-points:
            access DSP_VeCANR_b_ImpactHardwire_FD5_VeCANR_b_ImpactHardwire_FD5: accessed-variable=VeCANR_b_ImpactHardwire_FD5.VeCANR_b_ImpactHardwire_FD5
            access DSP_VeCANR_b_ImpactHardwire_FD5TO_VeCANR_b_ImpactHardwire_FD5TO: accessed-variable=VeCANR_b_ImpactHardwire_FD5TO.VeCANR_b_ImpactHardwire_FD5TO
        COMRX_ImpactHardwire_BATTERY_HV_FD5_Error: symbol=ApplCanComAb_FD5_COMRX_ImpactHardwire_BATTERY_HV_FD5_Error  # Error
          data-receive-point-by-arguments:
            access DRP_CanCom_FD5RxSignalsSR_COMRX_ImpactHardwire_BATTERY_HV_FD5: accessed-variable=CanCom_FD5RxSignalsSR.COMRX_ImpactHardwire_BATTERY_HV_FD5
          data-send-points:
            access DSP_VeCANR_b_ImpactHardwire_FD5_VeCANR_b_ImpactHardwire_FD5: accessed-variable=VeCANR_b_ImpactHardwire_FD5.VeCANR_b_ImpactHardwire_FD5
            access DSP_VeCANR_b_ImpactHardwire_FD5TO_VeCANR_b_ImpactHardwire_FD5TO: accessed-variable=VeCANR_b_ImpactHardwire_FD5TO.VeCANR_b_ImpactHardwire_FD5TO
        COMRX_ImpactHardwireV_BATTERY_HV_FD5_Received: symbol=ApplCanComAb_FD5_COMRX_ImpactHardwireV_BATTERY_HV_FD5_Received  # Received
          data-receive-point-by-arguments:
            access DRP_CanCom_FD5RxSignalsSR_COMRX_ImpactHardwireV_BATTERY_HV_FD5: accessed-variable=CanCom_FD5RxSignalsSR.COMRX_ImpactHardwireV_BATTERY_HV_FD5
          data-send-points:
            access DSP_VeCANR_b_ImpactHardwireV_FD5_VeCANR_b_ImpactHardwireV_FD5: accessed-variable=VeCANR_b_ImpactHardwireV_FD5.VeCANR_b_ImpactHardwireV_FD5
            access DSP_VeCANR_b_ImpactHardwireV_FD5TO_VeCANR_b_ImpactHardwireV_FD5TO: accessed-variable=VeCANR_b_ImpactHardwireV_FD5TO.VeCANR_b_ImpactHardwireV_FD5TO
        COMRX_ImpactHardwireV_BATTERY_HV_FD5_Error: symbol=ApplCanComAb_FD5_COMRX_ImpactHardwireV_BATTERY_HV_FD5_Error  # Error
          data-receive-point-by-arguments:
            access DRP_CanCom_FD5RxSignalsSR_COMRX_ImpactHardwireV_BATTERY_HV_FD5: accessed-variable=CanCom_FD5RxSignalsSR.COMRX_ImpactHardwireV_BATTERY_HV_FD5
          data-send-points:
            access DSP_VeCANR_b_ImpactHardwireV_FD5_VeCANR_b_ImpactHardwireV_FD5: accessed-variable=VeCANR_b_ImpactHardwireV_FD5.VeCANR_b_ImpactHardwireV_FD5
            access DSP_VeCANR_b_ImpactHardwireV_FD5TO_VeCANR_b_ImpactHardwireV_FD5TO: accessed-variable=VeCANR_b_ImpactHardwireV_FD5TO.VeCANR_b_ImpactHardwireV_FD5TO
        COMRX_BMS_HV_High_Temp_Thrsh_BATTERY_HV2_FD5_Received: symbol=ApplCanComAb_FD5_COMRX_BMS_HV_High_Temp_Thrsh_BATTERY_HV2_FD5_Received  # Received
          data-receive-point-by-arguments:
            access DRP_CanCom_FD5RxSignalsSR_COMRX_BMS_HV_High_Temp_Thrsh_BATTERY_HV2_FD5: accessed-variable=CanCom_FD5RxSignalsSR.COMRX_BMS_HV_High_Temp_Thrsh_BATTERY_HV2_FD5
          data-send-points:
            access DSP_VeCANR_T_BMS_HV_HiTempThd_FD5_VeCANR_T_BMS_HV_HiTempThd_FD5: accessed-variable=VeCANR_T_BMS_HV_HiTempThd_FD5.VeCANR_T_BMS_HV_HiTempThd_FD5
            access DSP_VeCANR_b_BMS_HV_HiTempThd_FD5TO_VeCANR_b_BMS_HV_HiTempThd_FD5TO: accessed-variable=VeCANR_b_BMS_HV_HiTempThd_FD5TO.VeCANR_b_BMS_HV_HiTempThd_FD5TO
        COMRX_BMS_HV_High_Temp_Thrsh_BATTERY_HV2_FD5_Error: symbol=ApplCanComAb_FD5_COMRX_BMS_HV_High_Temp_Thrsh_BATTERY_HV2_FD5_Error  # Error
          data-receive-point-by-arguments:
            access DRP_CanCom_FD5RxSignalsSR_COMRX_BMS_HV_High_Temp_Thrsh_BATTERY_HV2_FD5: accessed-variable=CanCom_FD5RxSignalsSR.COMRX_BMS_HV_High_Temp_Thrsh_BATTERY_HV2_FD5
          data-send-points:
            access DSP_VeCANR_T_BMS_HV_HiTempThd_FD5_VeCANR_T_BMS_HV_HiTempThd_FD5: accessed-variable=VeCANR_T_BMS_HV_HiTempThd_FD5.VeCANR_T_BMS_HV_HiTempThd_FD5
            access DSP_VeCANR_b_BMS_HV_HiTempThd_FD5TO_VeCANR_b_BMS_HV_HiTempThd_FD5TO: accessed-variable=VeCANR_b_BMS_HV_HiTempThd_FD5TO.VeCANR_b_BMS_HV_HiTempThd_FD5TO
        COMRX_BMS_HV_Low_Temp_Thrsh_BATTERY_HV2_FD5_Received: symbol=ApplCanComAb_FD5_COMRX_BMS_HV_Low_Temp_Thrsh_BATTERY_HV2_FD5_Received  # Received
          data-receive-point-by-arguments:
            access DRP_CanCom_FD5RxSignalsSR_COMRX_BMS_HV_Low_Temp_Thrsh_BATTERY_HV2_FD5: accessed-variable=CanCom_FD5RxSignalsSR.COMRX_BMS_HV_Low_Temp_Thrsh_BATTERY_HV2_FD5
          data-send-points:
            access DSP_VeCANR_T_BMS_HVLoTempThd_FD5_VeCANR_T_BMS_HVLoTempThd_FD5: accessed-variable=VeCANR_T_BMS_HVLoTempThd_FD5.VeCANR_T_BMS_HVLoTempThd_FD5
            access DSP_VeCANR_b_BMS_HVLoTempThd_FD5TO_VeCANR_b_BMS_HVLoTempThd_FD5TO: accessed-variable=VeCANR_b_BMS_HVLoTempThd_FD5TO.VeCANR_b_BMS_HVLoTempThd_FD5TO
        COMRX_BMS_HV_Low_Temp_Thrsh_BATTERY_HV2_FD5_Error: symbol=ApplCanComAb_FD5_COMRX_BMS_HV_Low_Temp_Thrsh_BATTERY_HV2_FD5_Error  # Error
          data-receive-point-by-arguments:
            access DRP_CanCom_FD5RxSignalsSR_COMRX_BMS_HV_Low_Temp_Thrsh_BATTERY_HV2_FD5: accessed-variable=CanCom_FD5RxSignalsSR.COMRX_BMS_HV_Low_Temp_Thrsh_BATTERY_HV2_FD5
          data-send-points:
            access DSP_VeCANR_T_BMS_HVLoTempThd_FD5_VeCANR_T_BMS_HVLoTempThd_FD5: accessed-variable=VeCANR_T_BMS_HVLoTempThd_FD5.VeCANR_T_BMS_HVLoTempThd_FD5
            access DSP_VeCANR_b_BMS_HVLoTempThd_FD5TO_VeCANR_b_BMS_HVLoTempThd_FD5TO: accessed-variable=VeCANR_b_BMS_HVLoTempThd_FD5TO.VeCANR_b_BMS_HVLoTempThd_FD5TO
        COMRX_BMS_HV_SOC_AccuracySts_BATTERY_HV2_FD5_Received: symbol=ApplCanComAb_FD5_COMRX_BMS_HV_SOC_AccuracySts_BATTERY_HV2_FD5_Received  # Received
          data-receive-point-by-arguments:
            access DRP_CanCom_FD5RxSignalsSR_COMRX_BMS_HV_SOC_AccuracySts_BATTERY_HV2_FD5: accessed-variable=CanCom_FD5RxSignalsSR.COMRX_BMS_HV_SOC_AccuracySts_BATTERY_HV2_FD5
          data-send-points:
            access DSP_VeCANR_e_BMS_HV_SOCAcrcyStsFD5_VeCANR_e_BMS_HV_SOCAcrcyStsFD5: accessed-variable=VeCANR_e_BMS_HV_SOCAcrcyStsFD5.VeCANR_e_BMS_HV_SOCAcrcyStsFD5
            access DSP_VeCANR_b_BMS_HV_SOCAcrcyStsFD5TO_VeCANR_b_BMS_HV_SOCAcrcyStsFD5TO: accessed-variable=VeCANR_b_BMS_HV_SOCAcrcyStsFD5TO.VeCANR_b_BMS_HV_SOCAcrcyStsFD5TO
        COMRX_BMS_HV_SOC_AccuracySts_BATTERY_HV2_FD5_Error: symbol=ApplCanComAb_FD5_COMRX_BMS_HV_SOC_AccuracySts_BATTERY_HV2_FD5_Error  # Error
          data-receive-point-by-arguments:
            access DRP_CanCom_FD5RxSignalsSR_COMRX_BMS_HV_SOC_AccuracySts_BATTERY_HV2_FD5: accessed-variable=CanCom_FD5RxSignalsSR.COMRX_BMS_HV_SOC_AccuracySts_BATTERY_HV2_FD5
          data-send-points:
            access DSP_VeCANR_e_BMS_HV_SOCAcrcyStsFD5_VeCANR_e_BMS_HV_SOCAcrcyStsFD5: accessed-variable=VeCANR_e_BMS_HV_SOCAcrcyStsFD5.VeCANR_e_BMS_HV_SOCAcrcyStsFD5
            access DSP_VeCANR_b_BMS_HV_SOCAcrcyStsFD5TO_VeCANR_b_BMS_HV_SOCAcrcyStsFD5TO: accessed-variable=VeCANR_b_BMS_HV_SOCAcrcyStsFD5TO.VeCANR_b_BMS_HV_SOCAcrcyStsFD5TO
        COMRX_BMS_HV_SOC_Max_BATTERY_HV2_FD5_Received: symbol=ApplCanComAb_FD5_COMRX_BMS_HV_SOC_Max_BATTERY_HV2_FD5_Received  # Received
          data-receive-point-by-arguments:
            access DRP_CanCom_FD5RxSignalsSR_COMRX_BMS_HV_SOC_Max_BATTERY_HV2_FD5: accessed-variable=CanCom_FD5RxSignalsSR.COMRX_BMS_HV_SOC_Max_BATTERY_HV2_FD5
          data-send-points:
            access DSP_VeCANR_Pct_BMS_HV_SOC_Max_FD5_VeCANR_Pct_BMS_HV_SOC_Max_FD5: accessed-variable=VeCANR_Pct_BMS_HV_SOC_Max_FD5.VeCANR_Pct_BMS_HV_SOC_Max_FD5
            access DSP_VeCANR_b_BMS_HV_SOC_Max_FD5TO_VeCANR_b_BMS_HV_SOC_Max_FD5TO: accessed-variable=VeCANR_b_BMS_HV_SOC_Max_FD5TO.VeCANR_b_BMS_HV_SOC_Max_FD5TO
        COMRX_BMS_HV_SOC_Max_BATTERY_HV2_FD5_Error: symbol=ApplCanComAb_FD5_COMRX_BMS_HV_SOC_Max_BATTERY_HV2_FD5_Error  # Error
          data-receive-point-by-arguments:
            access DRP_CanCom_FD5RxSignalsSR_COMRX_BMS_HV_SOC_Max_BATTERY_HV2_FD5: accessed-variable=CanCom_FD5RxSignalsSR.COMRX_BMS_HV_SOC_Max_BATTERY_HV2_FD5
          data-send-points:
            access DSP_VeCANR_Pct_BMS_HV_SOC_Max_FD5_VeCANR_Pct_BMS_HV_SOC_Max_FD5: accessed-variable=VeCANR_Pct_BMS_HV_SOC_Max_FD5.VeCANR_Pct_BMS_HV_SOC_Max_FD5
            access DSP_VeCANR_b_BMS_HV_SOC_Max_FD5TO_VeCANR_b_BMS_HV_SOC_Max_FD5TO: accessed-variable=VeCANR_b_BMS_HV_SOC_Max_FD5TO.VeCANR_b_BMS_HV_SOC_Max_FD5TO
        COMRX_BMS_HV_SOC_Min_BATTERY_HV2_FD5_Received: symbol=ApplCanComAb_FD5_COMRX_BMS_HV_SOC_Min_BATTERY_HV2_FD5_Received  # Received
          data-receive-point-by-arguments:
            access DRP_CanCom_FD5RxSignalsSR_COMRX_BMS_HV_SOC_Min_BATTERY_HV2_FD5: accessed-variable=CanCom_FD5RxSignalsSR.COMRX_BMS_HV_SOC_Min_BATTERY_HV2_FD5
          data-send-points:
            access DSP_VeCANR_Pct_BMS_HV_SOC_Min_FD5_VeCANR_Pct_BMS_HV_SOC_Min_FD5: accessed-variable=VeCANR_Pct_BMS_HV_SOC_Min_FD5.VeCANR_Pct_BMS_HV_SOC_Min_FD5
            access DSP_VeCANR_b_BMS_HV_SOC_Min_FD5TO_VeCANR_b_BMS_HV_SOC_Min_FD5TO: accessed-variable=VeCANR_b_BMS_HV_SOC_Min_FD5TO.VeCANR_b_BMS_HV_SOC_Min_FD5TO
        COMRX_BMS_HV_SOC_Min_BATTERY_HV2_FD5_Error: symbol=ApplCanComAb_FD5_COMRX_BMS_HV_SOC_Min_BATTERY_HV2_FD5_Error  # Error
          data-receive-point-by-arguments:
            access DRP_CanCom_FD5RxSignalsSR_COMRX_BMS_HV_SOC_Min_BATTERY_HV2_FD5: accessed-variable=CanCom_FD5RxSignalsSR.COMRX_BMS_HV_SOC_Min_BATTERY_HV2_FD5
          data-send-points:
            access DSP_VeCANR_Pct_BMS_HV_SOC_Min_FD5_VeCANR_Pct_BMS_HV_SOC_Min_FD5: accessed-variable=VeCANR_Pct_BMS_HV_SOC_Min_FD5.VeCANR_Pct_BMS_HV_SOC_Min_FD5
            access DSP_VeCANR_b_BMS_HV_SOC_Min_FD5TO_VeCANR_b_BMS_HV_SOC_Min_FD5TO: accessed-variable=VeCANR_b_BMS_HV_SOC_Min_FD5TO.VeCANR_b_BMS_HV_SOC_Min_FD5TO
        COMRX_HEV_OnRq_BPCM_BATTERY_HV2_FD5_Received: symbol=ApplCanComAb_FD5_COMRX_HEV_OnRq_BPCM_BATTERY_HV2_FD5_Received  # Received
          data-receive-point-by-arguments:
            access DRP_CanCom_FD5RxSignalsSR_COMRX_HEV_OnRq_BPCM_BATTERY_HV2_FD5: accessed-variable=CanCom_FD5RxSignalsSR.COMRX_HEV_OnRq_BPCM_BATTERY_HV2_FD5
          data-send-points:
            access DSP_VeCANR_b_HEV_OnRq_BPCM_FD5_VeCANR_b_HEV_OnRq_BPCM_FD5: accessed-variable=VeCANR_b_HEV_OnRq_BPCM_FD5.VeCANR_b_HEV_OnRq_BPCM_FD5
            access DSP_VeCANR_b_HEV_OnRq_BPCM_FD5TO_VeCANR_b_HEV_OnRq_BPCM_FD5TO: accessed-variable=VeCANR_b_HEV_OnRq_BPCM_FD5TO.VeCANR_b_HEV_OnRq_BPCM_FD5TO
        COMRX_HEV_OnRq_BPCM_BATTERY_HV2_FD5_Error: symbol=ApplCanComAb_FD5_COMRX_HEV_OnRq_BPCM_BATTERY_HV2_FD5_Error  # Error
          data-receive-point-by-arguments:
            access DRP_CanCom_FD5RxSignalsSR_COMRX_HEV_OnRq_BPCM_BATTERY_HV2_FD5: accessed-variable=CanCom_FD5RxSignalsSR.COMRX_HEV_OnRq_BPCM_BATTERY_HV2_FD5
          data-send-points:
            access DSP_VeCANR_b_HEV_OnRq_BPCM_FD5_VeCANR_b_HEV_OnRq_BPCM_FD5: accessed-variable=VeCANR_b_HEV_OnRq_BPCM_FD5.VeCANR_b_HEV_OnRq_BPCM_FD5
            access DSP_VeCANR_b_HEV_OnRq_BPCM_FD5TO_VeCANR_b_HEV_OnRq_BPCM_FD5TO: accessed-variable=VeCANR_b_HEV_OnRq_BPCM_FD5TO.VeCANR_b_HEV_OnRq_BPCM_FD5TO
        COMRX_HVBatCell_Voltage_High_Thrsh_BATTERY_HV2_FD5_Received: symbol=ApplCanComAb_FD5_COMRX_HVBatCell_Voltage_High_Thrsh_BATTERY_HV2_FD5_Received  # Received
          data-receive-point-by-arguments:
            access DRP_CanCom_FD5RxSignalsSR_COMRX_HVBatCell_Voltage_High_Thrsh_BATTERY_HV2_FD5: accessed-variable=CanCom_FD5RxSignalsSR.COMRX_HVBatCell_Voltage_High_Thrsh_BATTERY_HV2_FD5
          data-send-points:
            access DSP_VeCANR_d_HVBatCelVoltHiThrsFD5_VeCANR_d_HVBatCelVoltHiThrsFD5: accessed-variable=VeCANR_d_HVBatCelVoltHiThrsFD5.VeCANR_d_HVBatCelVoltHiThrsFD5
            access DSP_VeCANR_b_HVBatCelVoltHiThrsFD5TO_VeCANR_b_HVBatCelVoltHiThrsFD5TO: accessed-variable=VeCANR_b_HVBatCelVoltHiThrsFD5TO.VeCANR_b_HVBatCelVoltHiThrsFD5TO
        COMRX_HVBatCell_Voltage_High_Thrsh_BATTERY_HV2_FD5_Error: symbol=ApplCanComAb_FD5_COMRX_HVBatCell_Voltage_High_Thrsh_BATTERY_HV2_FD5_Error  # Error
          data-receive-point-by-arguments:
            access DRP_CanCom_FD5RxSignalsSR_COMRX_HVBatCell_Voltage_High_Thrsh_BATTERY_HV2_FD5: accessed-variable=CanCom_FD5RxSignalsSR.COMRX_HVBatCell_Voltage_High_Thrsh_BATTERY_HV2_FD5
          data-send-points:
            access DSP_VeCANR_d_HVBatCelVoltHiThrsFD5_VeCANR_d_HVBatCelVoltHiThrsFD5: accessed-variable=VeCANR_d_HVBatCelVoltHiThrsFD5.VeCANR_d_HVBatCelVoltHiThrsFD5
            access DSP_VeCANR_b_HVBatCelVoltHiThrsFD5TO_VeCANR_b_HVBatCelVoltHiThrsFD5TO: accessed-variable=VeCANR_b_HVBatCelVoltHiThrsFD5TO.VeCANR_b_HVBatCelVoltHiThrsFD5TO
        COMRX_HVBatCell_Voltage_Low_Thrsh_BATTERY_HV2_FD5_Received: symbol=ApplCanComAb_FD5_COMRX_HVBatCell_Voltage_Low_Thrsh_BATTERY_HV2_FD5_Received  # Received
          data-receive-point-by-arguments:
            access DRP_CanCom_FD5RxSignalsSR_COMRX_HVBatCell_Voltage_Low_Thrsh_BATTERY_HV2_FD5: accessed-variable=CanCom_FD5RxSignalsSR.COMRX_HVBatCell_Voltage_Low_Thrsh_BATTERY_HV2_FD5
          data-send-points:
            access DSP_VeCANR_d_HVBatCelVoltLoThrsFD5_VeCANR_d_HVBatCelVoltLoThrsFD5: accessed-variable=VeCANR_d_HVBatCelVoltLoThrsFD5.VeCANR_d_HVBatCelVoltLoThrsFD5
            access DSP_VeCANR_b_HVBatCelVoltLoThrsFD5TO_VeCANR_b_HVBatCelVoltLoThrsFD5TO: accessed-variable=VeCANR_b_HVBatCelVoltLoThrsFD5TO.VeCANR_b_HVBatCelVoltLoThrsFD5TO
        COMRX_HVBatCell_Voltage_Low_Thrsh_BATTERY_HV2_FD5_Error: symbol=ApplCanComAb_FD5_COMRX_HVBatCell_Voltage_Low_Thrsh_BATTERY_HV2_FD5_Error  # Error
          data-receive-point-by-arguments:
            access DRP_CanCom_FD5RxSignalsSR_COMRX_HVBatCell_Voltage_Low_Thrsh_BATTERY_HV2_FD5: accessed-variable=CanCom_FD5RxSignalsSR.COMRX_HVBatCell_Voltage_Low_Thrsh_BATTERY_HV2_FD5
          data-send-points:
            access DSP_VeCANR_d_HVBatCelVoltLoThrsFD5_VeCANR_d_HVBatCelVoltLoThrsFD5: accessed-variable=VeCANR_d_HVBatCelVoltLoThrsFD5.VeCANR_d_HVBatCelVoltLoThrsFD5
            access DSP_VeCANR_b_HVBatCelVoltLoThrsFD5TO_VeCANR_b_HVBatCelVoltLoThrsFD5TO: accessed-variable=VeCANR_b_HVBatCelVoltLoThrsFD5TO.VeCANR_b_HVBatCelVoltLoThrsFD5TO
        COMRX_OBC_Temp1_DUALCHARGER_THERMAL_FD5_Received: symbol=ApplCanComAb_FD5_COMRX_OBC_Temp1_DUALCHARGER_THERMAL_FD5_Received  # Received
          data-receive-point-by-arguments:
            access DRP_CanCom_FD5RxSignalsSR_COMRX_OBC_Temp1_DUALCHARGER_THERMAL_FD5: accessed-variable=CanCom_FD5RxSignalsSR.COMRX_OBC_Temp1_DUALCHARGER_THERMAL_FD5
          data-send-points:
            access DSP_VeCANR_T_OBC_Temp1_FD5_VeCANR_T_OBC_Temp1_FD5: accessed-variable=VeCANR_T_OBC_Temp1_FD5.VeCANR_T_OBC_Temp1_FD5
            access DSP_VeCANR_b_OBC_Temp1_FD5TO_VeCANR_b_OBC_Temp1_FD5TO: accessed-variable=VeCANR_b_OBC_Temp1_FD5TO.VeCANR_b_OBC_Temp1_FD5TO
        COMRX_OBC_Temp1_DUALCHARGER_THERMAL_FD5_Error: symbol=ApplCanComAb_FD5_COMRX_OBC_Temp1_DUALCHARGER_THERMAL_FD5_Error  # Error
          data-receive-point-by-arguments:
            access DRP_CanCom_FD5RxSignalsSR_COMRX_OBC_Temp1_DUALCHARGER_THERMAL_FD5: accessed-variable=CanCom_FD5RxSignalsSR.COMRX_OBC_Temp1_DUALCHARGER_THERMAL_FD5
          data-send-points:
            access DSP_VeCANR_T_OBC_Temp1_FD5_VeCANR_T_OBC_Temp1_FD5: accessed-variable=VeCANR_T_OBC_Temp1_FD5.VeCANR_T_OBC_Temp1_FD5
            access DSP_VeCANR_b_OBC_Temp1_FD5TO_VeCANR_b_OBC_Temp1_FD5TO: accessed-variable=VeCANR_b_OBC_Temp1_FD5TO.VeCANR_b_OBC_Temp1_FD5TO
        COMRX_OBC_Temp2_DUALCHARGER_THERMAL_FD5_Received: symbol=ApplCanComAb_FD5_COMRX_OBC_Temp2_DUALCHARGER_THERMAL_FD5_Received  # Received
          data-receive-point-by-arguments:
            access DRP_CanCom_FD5RxSignalsSR_COMRX_OBC_Temp2_DUALCHARGER_THERMAL_FD5: accessed-variable=CanCom_FD5RxSignalsSR.COMRX_OBC_Temp2_DUALCHARGER_THERMAL_FD5
          data-send-points:
            access DSP_VeCANR_T_OBC_Temp2_FD5_VeCANR_T_OBC_Temp2_FD5: accessed-variable=VeCANR_T_OBC_Temp2_FD5.VeCANR_T_OBC_Temp2_FD5
            access DSP_VeCANR_b_OBC_Temp2_FD5TO_VeCANR_b_OBC_Temp2_FD5TO: accessed-variable=VeCANR_b_OBC_Temp2_FD5TO.VeCANR_b_OBC_Temp2_FD5TO
        COMRX_OBC_Temp2_DUALCHARGER_THERMAL_FD5_Error: symbol=ApplCanComAb_FD5_COMRX_OBC_Temp2_DUALCHARGER_THERMAL_FD5_Error  # Error
          data-receive-point-by-arguments:
            access DRP_CanCom_FD5RxSignalsSR_COMRX_OBC_Temp2_DUALCHARGER_THERMAL_FD5: accessed-variable=CanCom_FD5RxSignalsSR.COMRX_OBC_Temp2_DUALCHARGER_THERMAL_FD5
          data-send-points:
            access DSP_VeCANR_T_OBC_Temp2_FD5_VeCANR_T_OBC_Temp2_FD5: accessed-variable=VeCANR_T_OBC_Temp2_FD5.VeCANR_T_OBC_Temp2_FD5
            access DSP_VeCANR_b_OBC_Temp2_FD5TO_VeCANR_b_OBC_Temp2_FD5TO: accessed-variable=VeCANR_b_OBC_Temp2_FD5TO.VeCANR_b_OBC_Temp2_FD5TO
        COMRX_OBC_Temp3_DUALCHARGER_THERMAL_FD5_Received: symbol=ApplCanComAb_FD5_COMRX_OBC_Temp3_DUALCHARGER_THERMAL_FD5_Received  # Received
          data-receive-point-by-arguments:
            access DRP_CanCom_FD5RxSignalsSR_COMRX_OBC_Temp3_DUALCHARGER_THERMAL_FD5: accessed-variable=CanCom_FD5RxSignalsSR.COMRX_OBC_Temp3_DUALCHARGER_THERMAL_FD5
          data-send-points:
            access DSP_VeCANR_T_OBC_Temp3_FD5_VeCANR_T_OBC_Temp3_FD5: accessed-variable=VeCANR_T_OBC_Temp3_FD5.VeCANR_T_OBC_Temp3_FD5
            access DSP_VeCANR_b_OBC_Temp3_FD5TO_VeCANR_b_OBC_Temp3_FD5TO: accessed-variable=VeCANR_b_OBC_Temp3_FD5TO.VeCANR_b_OBC_Temp3_FD5TO
        COMRX_OBC_Temp3_DUALCHARGER_THERMAL_FD5_Error: symbol=ApplCanComAb_FD5_COMRX_OBC_Temp3_DUALCHARGER_THERMAL_FD5_Error  # Error
          data-receive-point-by-arguments:
            access DRP_CanCom_FD5RxSignalsSR_COMRX_OBC_Temp3_DUALCHARGER_THERMAL_FD5: accessed-variable=CanCom_FD5RxSignalsSR.COMRX_OBC_Temp3_DUALCHARGER_THERMAL_FD5
          data-send-points:
            access DSP_VeCANR_T_OBC_Temp3_FD5_VeCANR_T_OBC_Temp3_FD5: accessed-variable=VeCANR_T_OBC_Temp3_FD5.VeCANR_T_OBC_Temp3_FD5
            access DSP_VeCANR_b_OBC_Temp3_FD5TO_VeCANR_b_OBC_Temp3_FD5TO: accessed-variable=VeCANR_b_OBC_Temp3_FD5TO.VeCANR_b_OBC_Temp3_FD5TO
        COMRX_OBC_Temp4_DUALCHARGER_THERMAL_FD5_Received: symbol=ApplCanComAb_FD5_COMRX_OBC_Temp4_DUALCHARGER_THERMAL_FD5_Received  # Received
          data-receive-point-by-arguments:
            access DRP_CanCom_FD5RxSignalsSR_COMRX_OBC_Temp4_DUALCHARGER_THERMAL_FD5: accessed-variable=CanCom_FD5RxSignalsSR.COMRX_OBC_Temp4_DUALCHARGER_THERMAL_FD5
          data-send-points:
            access DSP_VeCANR_T_OBC_Temp4_FD5_VeCANR_T_OBC_Temp4_FD5: accessed-variable=VeCANR_T_OBC_Temp4_FD5.VeCANR_T_OBC_Temp4_FD5
            access DSP_VeCANR_b_OBC_Temp4_FD5TO_VeCANR_b_OBC_Temp4_FD5TO: accessed-variable=VeCANR_b_OBC_Temp4_FD5TO.VeCANR_b_OBC_Temp4_FD5TO
        COMRX_OBC_Temp4_DUALCHARGER_THERMAL_FD5_Error: symbol=ApplCanComAb_FD5_COMRX_OBC_Temp4_DUALCHARGER_THERMAL_FD5_Error  # Error
          data-receive-point-by-arguments:
            access DRP_CanCom_FD5RxSignalsSR_COMRX_OBC_Temp4_DUALCHARGER_THERMAL_FD5: accessed-variable=CanCom_FD5RxSignalsSR.COMRX_OBC_Temp4_DUALCHARGER_THERMAL_FD5
          data-send-points:
            access DSP_VeCANR_T_OBC_Temp4_FD5_VeCANR_T_OBC_Temp4_FD5: accessed-variable=VeCANR_T_OBC_Temp4_FD5.VeCANR_T_OBC_Temp4_FD5
            access DSP_VeCANR_b_OBC_Temp4_FD5TO_VeCANR_b_OBC_Temp4_FD5TO: accessed-variable=VeCANR_b_OBC_Temp4_FD5TO.VeCANR_b_OBC_Temp4_FD5TO
        COMRX_N_PDU_7B_GLIWA_MCPA_TX_FD5_Received: symbol=ApplCanComAb_FD5_COMRX_N_PDU_7B_GLIWA_MCPA_TX_FD5_Received  # Received
          data-receive-point-by-arguments:
            access DRP_CanCom_FD5RxSignalsSR_COMRX_N_PDU_7B_GLIWA_MCPA_TX_FD5: accessed-variable=CanCom_FD5RxSignalsSR.COMRX_N_PDU_7B_GLIWA_MCPA_TX_FD5
          data-send-points:
            access DSP_VeCANR_cmp_N_PDU_7B_FD5_VeCANR_cmp_N_PDU_7B_FD5: accessed-variable=VeCANR_cmp_N_PDU_7B_FD5.VeCANR_cmp_N_PDU_7B_FD5
            access DSP_VeCANR_b_N_PDU_7B_FD5TO_VeCANR_b_N_PDU_7B_FD5TO: accessed-variable=VeCANR_b_N_PDU_7B_FD5TO.VeCANR_b_N_PDU_7B_FD5TO
        COMRX_N_PDU_7B_GLIWA_MCPA_TX_FD5_Error: symbol=ApplCanComAb_FD5_COMRX_N_PDU_7B_GLIWA_MCPA_TX_FD5_Error  # Error
          data-receive-point-by-arguments:
            access DRP_CanCom_FD5RxSignalsSR_COMRX_N_PDU_7B_GLIWA_MCPA_TX_FD5: accessed-variable=CanCom_FD5RxSignalsSR.COMRX_N_PDU_7B_GLIWA_MCPA_TX_FD5
          data-send-points:
            access DSP_VeCANR_cmp_N_PDU_7B_FD5_VeCANR_cmp_N_PDU_7B_FD5: accessed-variable=VeCANR_cmp_N_PDU_7B_FD5.VeCANR_cmp_N_PDU_7B_FD5
            access DSP_VeCANR_b_N_PDU_7B_FD5TO_VeCANR_b_N_PDU_7B_FD5TO: accessed-variable=VeCANR_b_N_PDU_7B_FD5TO.VeCANR_b_N_PDU_7B_FD5TO
        COMRX_N_PDU_7C_GLIWA_MCPB_TX_FD5_Received: symbol=ApplCanComAb_FD5_COMRX_N_PDU_7C_GLIWA_MCPB_TX_FD5_Received  # Received
          data-receive-point-by-arguments:
            access DRP_CanCom_FD5RxSignalsSR_COMRX_N_PDU_7C_GLIWA_MCPB_TX_FD5: accessed-variable=CanCom_FD5RxSignalsSR.COMRX_N_PDU_7C_GLIWA_MCPB_TX_FD5
          data-send-points:
            access DSP_VeCANR_cmp_N_PDU_7C_FD5_VeCANR_cmp_N_PDU_7C_FD5: accessed-variable=VeCANR_cmp_N_PDU_7C_FD5.VeCANR_cmp_N_PDU_7C_FD5
            access DSP_VeCANR_b_N_PDU_7C_FD5TO_VeCANR_b_N_PDU_7C_FD5TO: accessed-variable=VeCANR_b_N_PDU_7C_FD5TO.VeCANR_b_N_PDU_7C_FD5TO
        COMRX_N_PDU_7C_GLIWA_MCPB_TX_FD5_Error: symbol=ApplCanComAb_FD5_COMRX_N_PDU_7C_GLIWA_MCPB_TX_FD5_Error  # Error
          data-receive-point-by-arguments:
            access DRP_CanCom_FD5RxSignalsSR_COMRX_N_PDU_7C_GLIWA_MCPB_TX_FD5: accessed-variable=CanCom_FD5RxSignalsSR.COMRX_N_PDU_7C_GLIWA_MCPB_TX_FD5
          data-send-points:
            access DSP_VeCANR_cmp_N_PDU_7C_FD5_VeCANR_cmp_N_PDU_7C_FD5: accessed-variable=VeCANR_cmp_N_PDU_7C_FD5.VeCANR_cmp_N_PDU_7C_FD5
            access DSP_VeCANR_b_N_PDU_7C_FD5TO_VeCANR_b_N_PDU_7C_FD5TO: accessed-variable=VeCANR_b_N_PDU_7C_FD5TO.VeCANR_b_N_PDU_7C_FD5TO
        COMRX_HVBatSleepTime_HVBATTERY_THERMAL_FD5_Received: symbol=ApplCanComAb_FD5_COMRX_HVBatSleepTime_HVBATTERY_THERMAL_FD5_Received  # Received
          data-receive-point-by-arguments:
            access DRP_CanCom_FD5RxSignalsSR_COMRX_HVBatSleepTime_HVBATTERY_THERMAL_FD5: accessed-variable=CanCom_FD5RxSignalsSR.COMRX_HVBatSleepTime_HVBATTERY_THERMAL_FD5
          data-send-points:
            access DSP_VeCANR_t_HVBatSleepTime_FD5_VeCANR_t_HVBatSleepTime_FD5: accessed-variable=VeCANR_t_HVBatSleepTime_FD5.VeCANR_t_HVBatSleepTime_FD5
            access DSP_VeCANR_b_HVBatSleepTime_FD5TO_VeCANR_b_HVBatSleepTime_FD5TO: accessed-variable=VeCANR_b_HVBatSleepTime_FD5TO.VeCANR_b_HVBatSleepTime_FD5TO
        COMRX_HVBatSleepTime_HVBATTERY_THERMAL_FD5_Error: symbol=ApplCanComAb_FD5_COMRX_HVBatSleepTime_HVBATTERY_THERMAL_FD5_Error  # Error
          data-receive-point-by-arguments:
            access DRP_CanCom_FD5RxSignalsSR_COMRX_HVBatSleepTime_HVBATTERY_THERMAL_FD5: accessed-variable=CanCom_FD5RxSignalsSR.COMRX_HVBatSleepTime_HVBATTERY_THERMAL_FD5
          data-send-points:
            access DSP_VeCANR_t_HVBatSleepTime_FD5_VeCANR_t_HVBatSleepTime_FD5: accessed-variable=VeCANR_t_HVBatSleepTime_FD5.VeCANR_t_HVBatSleepTime_FD5
            access DSP_VeCANR_b_HVBatSleepTime_FD5TO_VeCANR_b_HVBatSleepTime_FD5TO: accessed-variable=VeCANR_b_HVBatSleepTime_FD5TO.VeCANR_b_HVBatSleepTime_FD5TO
        COMRX_ACplug_PwrMax_HV_CHARGER2_FD5_Received: symbol=ApplCanComAb_FD5_COMRX_ACplug_PwrMax_HV_CHARGER2_FD5_Received  # Received
          data-receive-point-by-arguments:
            access DRP_CanCom_FD5RxSignalsSR_COMRX_ACplug_PwrMax_HV_CHARGER2_FD5: accessed-variable=CanCom_FD5RxSignalsSR.COMRX_ACplug_PwrMax_HV_CHARGER2_FD5
          data-send-points:
            access DSP_VeCANR_P_ACplug_PwrMax_FD5_VeCANR_P_ACplug_PwrMax_FD5: accessed-variable=VeCANR_P_ACplug_PwrMax_FD5.VeCANR_P_ACplug_PwrMax_FD5
            access DSP_VeCANR_b_ACplug_PwrMax_FD5TO_VeCANR_b_ACplug_PwrMax_FD5TO: accessed-variable=VeCANR_b_ACplug_PwrMax_FD5TO.VeCANR_b_ACplug_PwrMax_FD5TO
        COMRX_ACplug_PwrMax_HV_CHARGER2_FD5_Error: symbol=ApplCanComAb_FD5_COMRX_ACplug_PwrMax_HV_CHARGER2_FD5_Error  # Error
          data-receive-point-by-arguments:
            access DRP_CanCom_FD5RxSignalsSR_COMRX_ACplug_PwrMax_HV_CHARGER2_FD5: accessed-variable=CanCom_FD5RxSignalsSR.COMRX_ACplug_PwrMax_HV_CHARGER2_FD5
          data-send-points:
            access DSP_VeCANR_P_ACplug_PwrMax_FD5_VeCANR_P_ACplug_PwrMax_FD5: accessed-variable=VeCANR_P_ACplug_PwrMax_FD5.VeCANR_P_ACplug_PwrMax_FD5
            access DSP_VeCANR_b_ACplug_PwrMax_FD5TO_VeCANR_b_ACplug_PwrMax_FD5TO: accessed-variable=VeCANR_b_ACplug_PwrMax_FD5TO.VeCANR_b_ACplug_PwrMax_FD5TO
        COMRX_Charging_WHr_HV_CHARGER2_FD5_Received: symbol=ApplCanComAb_FD5_COMRX_Charging_WHr_HV_CHARGER2_FD5_Received  # Received
          data-receive-point-by-arguments:
            access DRP_CanCom_FD5RxSignalsSR_COMRX_Charging_WHr_HV_CHARGER2_FD5: accessed-variable=CanCom_FD5RxSignalsSR.COMRX_Charging_WHr_HV_CHARGER2_FD5
          data-send-points:
            access DSP_VeCANR_cmp_Charging_WHr_FD5_VeCANR_cmp_Charging_WHr_FD5: accessed-variable=VeCANR_cmp_Charging_WHr_FD5.VeCANR_cmp_Charging_WHr_FD5
            access DSP_VeCANR_b_Charging_WHr_FD5TO_VeCANR_b_Charging_WHr_FD5TO: accessed-variable=VeCANR_b_Charging_WHr_FD5TO.VeCANR_b_Charging_WHr_FD5TO
        COMRX_Charging_WHr_HV_CHARGER2_FD5_Error: symbol=ApplCanComAb_FD5_COMRX_Charging_WHr_HV_CHARGER2_FD5_Error  # Error
          data-receive-point-by-arguments:
            access DRP_CanCom_FD5RxSignalsSR_COMRX_Charging_WHr_HV_CHARGER2_FD5: accessed-variable=CanCom_FD5RxSignalsSR.COMRX_Charging_WHr_HV_CHARGER2_FD5
          data-send-points:
            access DSP_VeCANR_cmp_Charging_WHr_FD5_VeCANR_cmp_Charging_WHr_FD5: accessed-variable=VeCANR_cmp_Charging_WHr_FD5.VeCANR_cmp_Charging_WHr_FD5
            access DSP_VeCANR_b_Charging_WHr_FD5TO_VeCANR_b_Charging_WHr_FD5TO: accessed-variable=VeCANR_b_Charging_WHr_FD5TO.VeCANR_b_Charging_WHr_FD5TO
        COMRX_ChrgFailSts_HV_CHARGER2_FD5_Received: symbol=ApplCanComAb_FD5_COMRX_ChrgFailSts_HV_CHARGER2_FD5_Received  # Received
          data-receive-point-by-arguments:
            access DRP_CanCom_FD5RxSignalsSR_COMRX_ChrgFailSts_HV_CHARGER2_FD5: accessed-variable=CanCom_FD5RxSignalsSR.COMRX_ChrgFailSts_HV_CHARGER2_FD5
          data-send-points:
            access DSP_VeCANR_e_ChrgFailSts_FD5_VeCANR_e_ChrgFailSts_FD5: accessed-variable=VeCANR_e_ChrgFailSts_FD5.VeCANR_e_ChrgFailSts_FD5
            access DSP_VeCANR_b_ChrgFailSts_FD5TO_VeCANR_b_ChrgFailSts_FD5TO: accessed-variable=VeCANR_b_ChrgFailSts_FD5TO.VeCANR_b_ChrgFailSts_FD5TO
        COMRX_ChrgFailSts_HV_CHARGER2_FD5_Error: symbol=ApplCanComAb_FD5_COMRX_ChrgFailSts_HV_CHARGER2_FD5_Error  # Error
          data-receive-point-by-arguments:
            access DRP_CanCom_FD5RxSignalsSR_COMRX_ChrgFailSts_HV_CHARGER2_FD5: accessed-variable=CanCom_FD5RxSignalsSR.COMRX_ChrgFailSts_HV_CHARGER2_FD5
          data-send-points:
            access DSP_VeCANR_e_ChrgFailSts_FD5_VeCANR_e_ChrgFailSts_FD5: accessed-variable=VeCANR_e_ChrgFailSts_FD5.VeCANR_e_ChrgFailSts_FD5
            access DSP_VeCANR_b_ChrgFailSts_FD5TO_VeCANR_b_ChrgFailSts_FD5TO: accessed-variable=VeCANR_b_ChrgFailSts_FD5TO.VeCANR_b_ChrgFailSts_FD5TO
        COMRX_OBC_CaptureEnvironmentData_HV_CHARGER2_FD5_Received: symbol=ApplCanComAb_FD5_COMRX_OBC_CaptureEnvironmentData_HV_CHARGER2_FD5_Received  # Received
          data-receive-point-by-arguments:
            access DRP_CanCom_FD5RxSignalsSR_COMRX_OBC_CaptureEnvironmentData_HV_CHARGER2_FD5: accessed-variable=CanCom_FD5RxSignalsSR.COMRX_OBC_CaptureEnvironmentData_HV_CHARGER2_FD5
          data-send-points:
            access DSP_VeCANR_b_OBC_CaptureEnvDataFD5_VeCANR_b_OBC_CaptureEnvDataFD5: accessed-variable=VeCANR_b_OBC_CaptureEnvDataFD5.VeCANR_b_OBC_CaptureEnvDataFD5
            access DSP_VeCANR_b_OBC_CaptureEnvDataFD5TO_VeCANR_b_OBC_CaptureEnvDataFD5TO: accessed-variable=VeCANR_b_OBC_CaptureEnvDataFD5TO.VeCANR_b_OBC_CaptureEnvDataFD5TO
        COMRX_OBC_CaptureEnvironmentData_HV_CHARGER2_FD5_Error: symbol=ApplCanComAb_FD5_COMRX_OBC_CaptureEnvironmentData_HV_CHARGER2_FD5_Error  # Error
          data-receive-point-by-arguments:
            access DRP_CanCom_FD5RxSignalsSR_COMRX_OBC_CaptureEnvironmentData_HV_CHARGER2_FD5: accessed-variable=CanCom_FD5RxSignalsSR.COMRX_OBC_CaptureEnvironmentData_HV_CHARGER2_FD5
          data-send-points:
            access DSP_VeCANR_b_OBC_CaptureEnvDataFD5_VeCANR_b_OBC_CaptureEnvDataFD5: accessed-variable=VeCANR_b_OBC_CaptureEnvDataFD5.VeCANR_b_OBC_CaptureEnvDataFD5
            access DSP_VeCANR_b_OBC_CaptureEnvDataFD5TO_VeCANR_b_OBC_CaptureEnvDataFD5TO: accessed-variable=VeCANR_b_OBC_CaptureEnvDataFD5TO.VeCANR_b_OBC_CaptureEnvDataFD5TO
        COMRX_OBC_ChargeFailure_HV_CHARGER2_FD5_Received: symbol=ApplCanComAb_FD5_COMRX_OBC_ChargeFailure_HV_CHARGER2_FD5_Received  # Received
          data-receive-point-by-arguments:
            access DRP_CanCom_FD5RxSignalsSR_COMRX_OBC_ChargeFailure_HV_CHARGER2_FD5: accessed-variable=CanCom_FD5RxSignalsSR.COMRX_OBC_ChargeFailure_HV_CHARGER2_FD5
          data-send-points:
            access DSP_VeCANR_b_OBC_ChargeFailure_FD5_VeCANR_b_OBC_ChargeFailure_FD5: accessed-variable=VeCANR_b_OBC_ChargeFailure_FD5.VeCANR_b_OBC_ChargeFailure_FD5
            access DSP_VeCANR_b_OBC_ChargeFailure_FD5TO_VeCANR_b_OBC_ChargeFailure_FD5TO: accessed-variable=VeCANR_b_OBC_ChargeFailure_FD5TO.VeCANR_b_OBC_ChargeFailure_FD5TO
        COMRX_OBC_ChargeFailure_HV_CHARGER2_FD5_Error: symbol=ApplCanComAb_FD5_COMRX_OBC_ChargeFailure_HV_CHARGER2_FD5_Error  # Error
          data-receive-point-by-arguments:
            access DRP_CanCom_FD5RxSignalsSR_COMRX_OBC_ChargeFailure_HV_CHARGER2_FD5: accessed-variable=CanCom_FD5RxSignalsSR.COMRX_OBC_ChargeFailure_HV_CHARGER2_FD5
          data-send-points:
            access DSP_VeCANR_b_OBC_ChargeFailure_FD5_VeCANR_b_OBC_ChargeFailure_FD5: accessed-variable=VeCANR_b_OBC_ChargeFailure_FD5.VeCANR_b_OBC_ChargeFailure_FD5
            access DSP_VeCANR_b_OBC_ChargeFailure_FD5TO_VeCANR_b_OBC_ChargeFailure_FD5TO: accessed-variable=VeCANR_b_OBC_ChargeFailure_FD5TO.VeCANR_b_OBC_ChargeFailure_FD5TO
        COMRX_OBC_ChargeTimeMin_HV_CHARGER2_FD5_Received: symbol=ApplCanComAb_FD5_COMRX_OBC_ChargeTimeMin_HV_CHARGER2_FD5_Received  # Received
          data-receive-point-by-arguments:
            access DRP_CanCom_FD5RxSignalsSR_COMRX_OBC_ChargeTimeMin_HV_CHARGER2_FD5: accessed-variable=CanCom_FD5RxSignalsSR.COMRX_OBC_ChargeTimeMin_HV_CHARGER2_FD5
          data-send-points:
            access DSP_VeCANR_t_OBC_ChargeTimeMin_FD5_VeCANR_t_OBC_ChargeTimeMin_FD5: accessed-variable=VeCANR_t_OBC_ChargeTimeMin_FD5.VeCANR_t_OBC_ChargeTimeMin_FD5
            access DSP_VeCANR_b_OBC_ChargeTimeMin_FD5TO_VeCANR_b_OBC_ChargeTimeMin_FD5TO: accessed-variable=VeCANR_b_OBC_ChargeTimeMin_FD5TO.VeCANR_b_OBC_ChargeTimeMin_FD5TO
        COMRX_OBC_ChargeTimeMin_HV_CHARGER2_FD5_Error: symbol=ApplCanComAb_FD5_COMRX_OBC_ChargeTimeMin_HV_CHARGER2_FD5_Error  # Error
          data-receive-point-by-arguments:
            access DRP_CanCom_FD5RxSignalsSR_COMRX_OBC_ChargeTimeMin_HV_CHARGER2_FD5: accessed-variable=CanCom_FD5RxSignalsSR.COMRX_OBC_ChargeTimeMin_HV_CHARGER2_FD5
          data-send-points:
            access DSP_VeCANR_t_OBC_ChargeTimeMin_FD5_VeCANR_t_OBC_ChargeTimeMin_FD5: accessed-variable=VeCANR_t_OBC_ChargeTimeMin_FD5.VeCANR_t_OBC_ChargeTimeMin_FD5
            access DSP_VeCANR_b_OBC_ChargeTimeMin_FD5TO_VeCANR_b_OBC_ChargeTimeMin_FD5TO: accessed-variable=VeCANR_b_OBC_ChargeTimeMin_FD5TO.VeCANR_b_OBC_ChargeTimeMin_FD5TO
        COMRX_OBC_ChargeTimeSec_HV_CHARGER2_FD5_Received: symbol=ApplCanComAb_FD5_COMRX_OBC_ChargeTimeSec_HV_CHARGER2_FD5_Received  # Received
          data-receive-point-by-arguments:
            access DRP_CanCom_FD5RxSignalsSR_COMRX_OBC_ChargeTimeSec_HV_CHARGER2_FD5: accessed-variable=CanCom_FD5RxSignalsSR.COMRX_OBC_ChargeTimeSec_HV_CHARGER2_FD5
          data-send-points:
            access DSP_VeCANR_t_OBC_ChargeTimeSec_FD5_VeCANR_t_OBC_ChargeTimeSec_FD5: accessed-variable=VeCANR_t_OBC_ChargeTimeSec_FD5.VeCANR_t_OBC_ChargeTimeSec_FD5
            access DSP_VeCANR_b_OBC_ChargeTimeSec_FD5TO_VeCANR_b_OBC_ChargeTimeSec_FD5TO: accessed-variable=VeCANR_b_OBC_ChargeTimeSec_FD5TO.VeCANR_b_OBC_ChargeTimeSec_FD5TO
        COMRX_OBC_ChargeTimeSec_HV_CHARGER2_FD5_Error: symbol=ApplCanComAb_FD5_COMRX_OBC_ChargeTimeSec_HV_CHARGER2_FD5_Error  # Error
          data-receive-point-by-arguments:
            access DRP_CanCom_FD5RxSignalsSR_COMRX_OBC_ChargeTimeSec_HV_CHARGER2_FD5: accessed-variable=CanCom_FD5RxSignalsSR.COMRX_OBC_ChargeTimeSec_HV_CHARGER2_FD5
          data-send-points:
            access DSP_VeCANR_t_OBC_ChargeTimeSec_FD5_VeCANR_t_OBC_ChargeTimeSec_FD5: accessed-variable=VeCANR_t_OBC_ChargeTimeSec_FD5.VeCANR_t_OBC_ChargeTimeSec_FD5
            access DSP_VeCANR_b_OBC_ChargeTimeSec_FD5TO_VeCANR_b_OBC_ChargeTimeSec_FD5TO: accessed-variable=VeCANR_b_OBC_ChargeTimeSec_FD5TO.VeCANR_b_OBC_ChargeTimeSec_FD5TO
        COMRX_OBC_ChargingFaultSts_HV_CHARGER2_FD5_Received: symbol=ApplCanComAb_FD5_COMRX_OBC_ChargingFaultSts_HV_CHARGER2_FD5_Received  # Received
          data-receive-point-by-arguments:
            access DRP_CanCom_FD5RxSignalsSR_COMRX_OBC_ChargingFaultSts_HV_CHARGER2_FD5: accessed-variable=CanCom_FD5RxSignalsSR.COMRX_OBC_ChargingFaultSts_HV_CHARGER2_FD5
          data-send-points:
            access DSP_VeCANR_e_OBC_ChrgnFaultSts_FD5_VeCANR_e_OBC_ChrgnFaultSts_FD5: accessed-variable=VeCANR_e_OBC_ChrgnFaultSts_FD5.VeCANR_e_OBC_ChrgnFaultSts_FD5
            access DSP_VeCANR_b_OBC_ChrgnFaultSts_FD5TO_VeCANR_b_OBC_ChrgnFaultSts_FD5TO: accessed-variable=VeCANR_b_OBC_ChrgnFaultSts_FD5TO.VeCANR_b_OBC_ChrgnFaultSts_FD5TO
        COMRX_OBC_ChargingFaultSts_HV_CHARGER2_FD5_Error: symbol=ApplCanComAb_FD5_COMRX_OBC_ChargingFaultSts_HV_CHARGER2_FD5_Error  # Error
          data-receive-point-by-arguments:
            access DRP_CanCom_FD5RxSignalsSR_COMRX_OBC_ChargingFaultSts_HV_CHARGER2_FD5: accessed-variable=CanCom_FD5RxSignalsSR.COMRX_OBC_ChargingFaultSts_HV_CHARGER2_FD5
          data-send-points:
            access DSP_VeCANR_e_OBC_ChrgnFaultSts_FD5_VeCANR_e_OBC_ChrgnFaultSts_FD5: accessed-variable=VeCANR_e_OBC_ChrgnFaultSts_FD5.VeCANR_e_OBC_ChrgnFaultSts_FD5
            access DSP_VeCANR_b_OBC_ChrgnFaultSts_FD5TO_VeCANR_b_OBC_ChrgnFaultSts_FD5TO: accessed-variable=VeCANR_b_OBC_ChrgnFaultSts_FD5TO.VeCANR_b_OBC_ChrgnFaultSts_FD5TO
        COMRX_OBC_CurrentFailureSts_HV_CHARGER2_FD5_Received: symbol=ApplCanComAb_FD5_COMRX_OBC_CurrentFailureSts_HV_CHARGER2_FD5_Received  # Received
          data-receive-point-by-arguments:
            access DRP_CanCom_FD5RxSignalsSR_COMRX_OBC_CurrentFailureSts_HV_CHARGER2_FD5: accessed-variable=CanCom_FD5RxSignalsSR.COMRX_OBC_CurrentFailureSts_HV_CHARGER2_FD5
          data-send-points:
            access DSP_VeCANR_b_OBC_CurrFailrSts_FD5_VeCANR_b_OBC_CurrFailrSts_FD5: accessed-variable=VeCANR_b_OBC_CurrFailrSts_FD5.VeCANR_b_OBC_CurrFailrSts_FD5
            access DSP_VeCANR_b_OBC_CurrFailrSts_FD5TO_VeCANR_b_OBC_CurrFailrSts_FD5TO: accessed-variable=VeCANR_b_OBC_CurrFailrSts_FD5TO.VeCANR_b_OBC_CurrFailrSts_FD5TO
        COMRX_OBC_CurrentFailureSts_HV_CHARGER2_FD5_Error: symbol=ApplCanComAb_FD5_COMRX_OBC_CurrentFailureSts_HV_CHARGER2_FD5_Error  # Error
          data-receive-point-by-arguments:
            access DRP_CanCom_FD5RxSignalsSR_COMRX_OBC_CurrentFailureSts_HV_CHARGER2_FD5: accessed-variable=CanCom_FD5RxSignalsSR.COMRX_OBC_CurrentFailureSts_HV_CHARGER2_FD5
          data-send-points:
            access DSP_VeCANR_b_OBC_CurrFailrSts_FD5_VeCANR_b_OBC_CurrFailrSts_FD5: accessed-variable=VeCANR_b_OBC_CurrFailrSts_FD5.VeCANR_b_OBC_CurrFailrSts_FD5
            access DSP_VeCANR_b_OBC_CurrFailrSts_FD5TO_VeCANR_b_OBC_CurrFailrSts_FD5TO: accessed-variable=VeCANR_b_OBC_CurrFailrSts_FD5TO.VeCANR_b_OBC_CurrFailrSts_FD5TO
        COMRX_OBC_EVServiceLampFlash_HV_CHARGER2_FD5_Received: symbol=ApplCanComAb_FD5_COMRX_OBC_EVServiceLampFlash_HV_CHARGER2_FD5_Received  # Received
          data-receive-point-by-arguments:
            access DRP_CanCom_FD5RxSignalsSR_COMRX_OBC_EVServiceLampFlash_HV_CHARGER2_FD5: accessed-variable=CanCom_FD5RxSignalsSR.COMRX_OBC_EVServiceLampFlash_HV_CHARGER2_FD5
          data-send-points:
            access DSP_VeCANR_b_OBC_EVServLampFls_FD5_VeCANR_b_OBC_EVServLampFls_FD5: accessed-variable=VeCANR_b_OBC_EVServLampFls_FD5.VeCANR_b_OBC_EVServLampFls_FD5
            access DSP_VeCANR_b_OBC_EVServLampFls_FD5TO_VeCANR_b_OBC_EVServLampFls_FD5TO: accessed-variable=VeCANR_b_OBC_EVServLampFls_FD5TO.VeCANR_b_OBC_EVServLampFls_FD5TO
        COMRX_OBC_EVServiceLampFlash_HV_CHARGER2_FD5_Error: symbol=ApplCanComAb_FD5_COMRX_OBC_EVServiceLampFlash_HV_CHARGER2_FD5_Error  # Error
          data-receive-point-by-arguments:
            access DRP_CanCom_FD5RxSignalsSR_COMRX_OBC_EVServiceLampFlash_HV_CHARGER2_FD5: accessed-variable=CanCom_FD5RxSignalsSR.COMRX_OBC_EVServiceLampFlash_HV_CHARGER2_FD5
          data-send-points:
            access DSP_VeCANR_b_OBC_EVServLampFls_FD5_VeCANR_b_OBC_EVServLampFls_FD5: accessed-variable=VeCANR_b_OBC_EVServLampFls_FD5.VeCANR_b_OBC_EVServLampFls_FD5
            access DSP_VeCANR_b_OBC_EVServLampFls_FD5TO_VeCANR_b_OBC_EVServLampFls_FD5TO: accessed-variable=VeCANR_b_OBC_EVServLampFls_FD5TO.VeCANR_b_OBC_EVServLampFls_FD5TO
        COMRX_OBC_EVServiceLampOn_HV_CHARGER2_FD5_Received: symbol=ApplCanComAb_FD5_COMRX_OBC_EVServiceLampOn_HV_CHARGER2_FD5_Received  # Received
          data-receive-point-by-arguments:
            access DRP_CanCom_FD5RxSignalsSR_COMRX_OBC_EVServiceLampOn_HV_CHARGER2_FD5: accessed-variable=CanCom_FD5RxSignalsSR.COMRX_OBC_EVServiceLampOn_HV_CHARGER2_FD5
          data-send-points:
            access DSP_VeCANR_b_OBC_EVServLampOn_FD5_VeCANR_b_OBC_EVServLampOn_FD5: accessed-variable=VeCANR_b_OBC_EVServLampOn_FD5.VeCANR_b_OBC_EVServLampOn_FD5
            access DSP_VeCANR_b_OBC_EVServLampOn_FD5TO_VeCANR_b_OBC_EVServLampOn_FD5TO: accessed-variable=VeCANR_b_OBC_EVServLampOn_FD5TO.VeCANR_b_OBC_EVServLampOn_FD5TO
        COMRX_OBC_EVServiceLampOn_HV_CHARGER2_FD5_Error: symbol=ApplCanComAb_FD5_COMRX_OBC_EVServiceLampOn_HV_CHARGER2_FD5_Error  # Error
          data-receive-point-by-arguments:
            access DRP_CanCom_FD5RxSignalsSR_COMRX_OBC_EVServiceLampOn_HV_CHARGER2_FD5: accessed-variable=CanCom_FD5RxSignalsSR.COMRX_OBC_EVServiceLampOn_HV_CHARGER2_FD5
          data-send-points:
            access DSP_VeCANR_b_OBC_EVServLampOn_FD5_VeCANR_b_OBC_EVServLampOn_FD5: accessed-variable=VeCANR_b_OBC_EVServLampOn_FD5.VeCANR_b_OBC_EVServLampOn_FD5
            access DSP_VeCANR_b_OBC_EVServLampOn_FD5TO_VeCANR_b_OBC_EVServLampOn_FD5TO: accessed-variable=VeCANR_b_OBC_EVServLampOn_FD5TO.VeCANR_b_OBC_EVServLampOn_FD5TO
        COMRX_OBC_FaultReason_HV_CHARGER2_FD5_Received: symbol=ApplCanComAb_FD5_COMRX_OBC_FaultReason_HV_CHARGER2_FD5_Received  # Received
          data-receive-point-by-arguments:
            access DRP_CanCom_FD5RxSignalsSR_COMRX_OBC_FaultReason_HV_CHARGER2_FD5: accessed-variable=CanCom_FD5RxSignalsSR.COMRX_OBC_FaultReason_HV_CHARGER2_FD5
          data-send-points:
            access DSP_VeCANR_e_OBC_FaultReason_FD5_VeCANR_e_OBC_FaultReason_FD5: accessed-variable=VeCANR_e_OBC_FaultReason_FD5.VeCANR_e_OBC_FaultReason_FD5
            access DSP_VeCANR_b_OBC_FaultReason_FD5TO_VeCANR_b_OBC_FaultReason_FD5TO: accessed-variable=VeCANR_b_OBC_FaultReason_FD5TO.VeCANR_b_OBC_FaultReason_FD5TO
        COMRX_OBC_FaultReason_HV_CHARGER2_FD5_Error: symbol=ApplCanComAb_FD5_COMRX_OBC_FaultReason_HV_CHARGER2_FD5_Error  # Error
          data-receive-point-by-arguments:
            access DRP_CanCom_FD5RxSignalsSR_COMRX_OBC_FaultReason_HV_CHARGER2_FD5: accessed-variable=CanCom_FD5RxSignalsSR.COMRX_OBC_FaultReason_HV_CHARGER2_FD5
          data-send-points:
            access DSP_VeCANR_e_OBC_FaultReason_FD5_VeCANR_e_OBC_FaultReason_FD5: accessed-variable=VeCANR_e_OBC_FaultReason_FD5.VeCANR_e_OBC_FaultReason_FD5
            access DSP_VeCANR_b_OBC_FaultReason_FD5TO_VeCANR_b_OBC_FaultReason_FD5TO: accessed-variable=VeCANR_b_OBC_FaultReason_FD5TO.VeCANR_b_OBC_FaultReason_FD5TO
        COMRX_OBC_GenericFailSts_HV_CHARGER2_FD5_Received: symbol=ApplCanComAb_FD5_COMRX_OBC_GenericFailSts_HV_CHARGER2_FD5_Received  # Received
          data-receive-point-by-arguments:
            access DRP_CanCom_FD5RxSignalsSR_COMRX_OBC_GenericFailSts_HV_CHARGER2_FD5: accessed-variable=CanCom_FD5RxSignalsSR.COMRX_OBC_GenericFailSts_HV_CHARGER2_FD5
          data-send-points:
            access DSP_VeCANR_b_OBC_GenericFailStsFD5_VeCANR_b_OBC_GenericFailStsFD5: accessed-variable=VeCANR_b_OBC_GenericFailStsFD5.VeCANR_b_OBC_GenericFailStsFD5
            access DSP_VeCANR_b_OBC_GenericFailStsFD5TO_VeCANR_b_OBC_GenericFailStsFD5TO: accessed-variable=VeCANR_b_OBC_GenericFailStsFD5TO.VeCANR_b_OBC_GenericFailStsFD5TO
        COMRX_OBC_GenericFailSts_HV_CHARGER2_FD5_Error: symbol=ApplCanComAb_FD5_COMRX_OBC_GenericFailSts_HV_CHARGER2_FD5_Error  # Error
          data-receive-point-by-arguments:
            access DRP_CanCom_FD5RxSignalsSR_COMRX_OBC_GenericFailSts_HV_CHARGER2_FD5: accessed-variable=CanCom_FD5RxSignalsSR.COMRX_OBC_GenericFailSts_HV_CHARGER2_FD5
          data-send-points:
            access DSP_VeCANR_b_OBC_GenericFailStsFD5_VeCANR_b_OBC_GenericFailStsFD5: accessed-variable=VeCANR_b_OBC_GenericFailStsFD5.VeCANR_b_OBC_GenericFailStsFD5
            access DSP_VeCANR_b_OBC_GenericFailStsFD5TO_VeCANR_b_OBC_GenericFailStsFD5TO: accessed-variable=VeCANR_b_OBC_GenericFailStsFD5TO.VeCANR_b_OBC_GenericFailStsFD5TO
        COMRX_OBC_IdleTimeMin_HV_CHARGER2_FD5_Received: symbol=ApplCanComAb_FD5_COMRX_OBC_IdleTimeMin_HV_CHARGER2_FD5_Received  # Received
          data-receive-point-by-arguments:
            access DRP_CanCom_FD5RxSignalsSR_COMRX_OBC_IdleTimeMin_HV_CHARGER2_FD5: accessed-variable=CanCom_FD5RxSignalsSR.COMRX_OBC_IdleTimeMin_HV_CHARGER2_FD5
          data-send-points:
            access DSP_VeCANR_t_OBC_IdleTimeMin_FD5_VeCANR_t_OBC_IdleTimeMin_FD5: accessed-variable=VeCANR_t_OBC_IdleTimeMin_FD5.VeCANR_t_OBC_IdleTimeMin_FD5
            access DSP_VeCANR_b_OBC_IdleTimeMin_FD5TO_VeCANR_b_OBC_IdleTimeMin_FD5TO: accessed-variable=VeCANR_b_OBC_IdleTimeMin_FD5TO.VeCANR_b_OBC_IdleTimeMin_FD5TO
        COMRX_OBC_IdleTimeMin_HV_CHARGER2_FD5_Error: symbol=ApplCanComAb_FD5_COMRX_OBC_IdleTimeMin_HV_CHARGER2_FD5_Error  # Error
          data-receive-point-by-arguments:
            access DRP_CanCom_FD5RxSignalsSR_COMRX_OBC_IdleTimeMin_HV_CHARGER2_FD5: accessed-variable=CanCom_FD5RxSignalsSR.COMRX_OBC_IdleTimeMin_HV_CHARGER2_FD5
          data-send-points:
            access DSP_VeCANR_t_OBC_IdleTimeMin_FD5_VeCANR_t_OBC_IdleTimeMin_FD5: accessed-variable=VeCANR_t_OBC_IdleTimeMin_FD5.VeCANR_t_OBC_IdleTimeMin_FD5
            access DSP_VeCANR_b_OBC_IdleTimeMin_FD5TO_VeCANR_b_OBC_IdleTimeMin_FD5TO: accessed-variable=VeCANR_b_OBC_IdleTimeMin_FD5TO.VeCANR_b_OBC_IdleTimeMin_FD5TO
        COMRX_OBC_IdleTimeSec_HV_CHARGER2_FD5_Received: symbol=ApplCanComAb_FD5_COMRX_OBC_IdleTimeSec_HV_CHARGER2_FD5_Received  # Received
          data-receive-point-by-arguments:
            access DRP_CanCom_FD5RxSignalsSR_COMRX_OBC_IdleTimeSec_HV_CHARGER2_FD5: accessed-variable=CanCom_FD5RxSignalsSR.COMRX_OBC_IdleTimeSec_HV_CHARGER2_FD5
          data-send-points:
            access DSP_VeCANR_t_OBC_IdleTimeSec_FD5_VeCANR_t_OBC_IdleTimeSec_FD5: accessed-variable=VeCANR_t_OBC_IdleTimeSec_FD5.VeCANR_t_OBC_IdleTimeSec_FD5
            access DSP_VeCANR_b_OBC_IdleTimeSec_FD5TO_VeCANR_b_OBC_IdleTimeSec_FD5TO: accessed-variable=VeCANR_b_OBC_IdleTimeSec_FD5TO.VeCANR_b_OBC_IdleTimeSec_FD5TO
        COMRX_OBC_IdleTimeSec_HV_CHARGER2_FD5_Error: symbol=ApplCanComAb_FD5_COMRX_OBC_IdleTimeSec_HV_CHARGER2_FD5_Error  # Error
          data-receive-point-by-arguments:
            access DRP_CanCom_FD5RxSignalsSR_COMRX_OBC_IdleTimeSec_HV_CHARGER2_FD5: accessed-variable=CanCom_FD5RxSignalsSR.COMRX_OBC_IdleTimeSec_HV_CHARGER2_FD5
          data-send-points:
            access DSP_VeCANR_t_OBC_IdleTimeSec_FD5_VeCANR_t_OBC_IdleTimeSec_FD5: accessed-variable=VeCANR_t_OBC_IdleTimeSec_FD5.VeCANR_t_OBC_IdleTimeSec_FD5
            access DSP_VeCANR_b_OBC_IdleTimeSec_FD5TO_VeCANR_b_OBC_IdleTimeSec_FD5TO: accessed-variable=VeCANR_b_OBC_IdleTimeSec_FD5TO.VeCANR_b_OBC_IdleTimeSec_FD5TO
        COMRX_OBC_Pilot_HV_CHARGER2_FD5_Received: symbol=ApplCanComAb_FD5_COMRX_OBC_Pilot_HV_CHARGER2_FD5_Received  # Received
          data-receive-point-by-arguments:
            access DRP_CanCom_FD5RxSignalsSR_COMRX_OBC_Pilot_HV_CHARGER2_FD5: accessed-variable=CanCom_FD5RxSignalsSR.COMRX_OBC_Pilot_HV_CHARGER2_FD5
          data-send-points:
            access DSP_VeCANR_U_OBC_Pilot_FD5_VeCANR_U_OBC_Pilot_FD5: accessed-variable=VeCANR_U_OBC_Pilot_FD5.VeCANR_U_OBC_Pilot_FD5
            access DSP_VeCANR_b_OBC_Pilot_FD5TO_VeCANR_b_OBC_Pilot_FD5TO: accessed-variable=VeCANR_b_OBC_Pilot_FD5TO.VeCANR_b_OBC_Pilot_FD5TO
        COMRX_OBC_Pilot_HV_CHARGER2_FD5_Error: symbol=ApplCanComAb_FD5_COMRX_OBC_Pilot_HV_CHARGER2_FD5_Error  # Error
          data-receive-point-by-arguments:
            access DRP_CanCom_FD5RxSignalsSR_COMRX_OBC_Pilot_HV_CHARGER2_FD5: accessed-variable=CanCom_FD5RxSignalsSR.COMRX_OBC_Pilot_HV_CHARGER2_FD5
          data-send-points:
            access DSP_VeCANR_U_OBC_Pilot_FD5_VeCANR_U_OBC_Pilot_FD5: accessed-variable=VeCANR_U_OBC_Pilot_FD5.VeCANR_U_OBC_Pilot_FD5
            access DSP_VeCANR_b_OBC_Pilot_FD5TO_VeCANR_b_OBC_Pilot_FD5TO: accessed-variable=VeCANR_b_OBC_Pilot_FD5TO.VeCANR_b_OBC_Pilot_FD5TO
        COMRX_OBC_Prox_HV_CHARGER2_FD5_Received: symbol=ApplCanComAb_FD5_COMRX_OBC_Prox_HV_CHARGER2_FD5_Received  # Received
          data-receive-point-by-arguments:
            access DRP_CanCom_FD5RxSignalsSR_COMRX_OBC_Prox_HV_CHARGER2_FD5: accessed-variable=CanCom_FD5RxSignalsSR.COMRX_OBC_Prox_HV_CHARGER2_FD5
          data-send-points:
            access DSP_VeCANR_U_OBC_Prox_FD5_VeCANR_U_OBC_Prox_FD5: accessed-variable=VeCANR_U_OBC_Prox_FD5.VeCANR_U_OBC_Prox_FD5
            access DSP_VeCANR_b_OBC_Prox_FD5TO_VeCANR_b_OBC_Prox_FD5TO: accessed-variable=VeCANR_b_OBC_Prox_FD5TO.VeCANR_b_OBC_Prox_FD5TO
        COMRX_OBC_Prox_HV_CHARGER2_FD5_Error: symbol=ApplCanComAb_FD5_COMRX_OBC_Prox_HV_CHARGER2_FD5_Error  # Error
          data-receive-point-by-arguments:
            access DRP_CanCom_FD5RxSignalsSR_COMRX_OBC_Prox_HV_CHARGER2_FD5: accessed-variable=CanCom_FD5RxSignalsSR.COMRX_OBC_Prox_HV_CHARGER2_FD5
          data-send-points:
            access DSP_VeCANR_U_OBC_Prox_FD5_VeCANR_U_OBC_Prox_FD5: accessed-variable=VeCANR_U_OBC_Prox_FD5.VeCANR_U_OBC_Prox_FD5
            access DSP_VeCANR_b_OBC_Prox_FD5TO_VeCANR_b_OBC_Prox_FD5TO: accessed-variable=VeCANR_b_OBC_Prox_FD5TO.VeCANR_b_OBC_Prox_FD5TO
        COMRX_OBC_WakeReason_HV_CHARGER2_FD5_Received: symbol=ApplCanComAb_FD5_COMRX_OBC_WakeReason_HV_CHARGER2_FD5_Received  # Received
          data-receive-point-by-arguments:
            access DRP_CanCom_FD5RxSignalsSR_COMRX_OBC_WakeReason_HV_CHARGER2_FD5: accessed-variable=CanCom_FD5RxSignalsSR.COMRX_OBC_WakeReason_HV_CHARGER2_FD5
          data-send-points:
            access DSP_VeCANR_e_OBC_WakeReason_FD5_VeCANR_e_OBC_WakeReason_FD5: accessed-variable=VeCANR_e_OBC_WakeReason_FD5.VeCANR_e_OBC_WakeReason_FD5
            access DSP_VeCANR_b_OBC_WakeReason_FD5TO_VeCANR_b_OBC_WakeReason_FD5TO: accessed-variable=VeCANR_b_OBC_WakeReason_FD5TO.VeCANR_b_OBC_WakeReason_FD5TO
        COMRX_OBC_WakeReason_HV_CHARGER2_FD5_Error: symbol=ApplCanComAb_FD5_COMRX_OBC_WakeReason_HV_CHARGER2_FD5_Error  # Error
          data-receive-point-by-arguments:
            access DRP_CanCom_FD5RxSignalsSR_COMRX_OBC_WakeReason_HV_CHARGER2_FD5: accessed-variable=CanCom_FD5RxSignalsSR.COMRX_OBC_WakeReason_HV_CHARGER2_FD5
          data-send-points:
            access DSP_VeCANR_e_OBC_WakeReason_FD5_VeCANR_e_OBC_WakeReason_FD5: accessed-variable=VeCANR_e_OBC_WakeReason_FD5.VeCANR_e_OBC_WakeReason_FD5
            access DSP_VeCANR_b_OBC_WakeReason_FD5TO_VeCANR_b_OBC_WakeReason_FD5TO: accessed-variable=VeCANR_b_OBC_WakeReason_FD5TO.VeCANR_b_OBC_WakeReason_FD5TO
        COMRX_OBCM_PrechargeSts_HV_CHARGER2_FD5_Received: symbol=ApplCanComAb_FD5_COMRX_OBCM_PrechargeSts_HV_CHARGER2_FD5_Received  # Received
          data-receive-point-by-arguments:
            access DRP_CanCom_FD5RxSignalsSR_COMRX_OBCM_PrechargeSts_HV_CHARGER2_FD5: accessed-variable=CanCom_FD5RxSignalsSR.COMRX_OBCM_PrechargeSts_HV_CHARGER2_FD5
          data-send-points:
            access DSP_VeCANR_e_OBCM_PrechargeSts_FD5_VeCANR_e_OBCM_PrechargeSts_FD5: accessed-variable=VeCANR_e_OBCM_PrechargeSts_FD5.VeCANR_e_OBCM_PrechargeSts_FD5
            access DSP_VeCANR_b_OBCM_PrechargeSts_FD5TO_VeCANR_b_OBCM_PrechargeSts_FD5TO: accessed-variable=VeCANR_b_OBCM_PrechargeSts_FD5TO.VeCANR_b_OBCM_PrechargeSts_FD5TO
        COMRX_OBCM_PrechargeSts_HV_CHARGER2_FD5_Error: symbol=ApplCanComAb_FD5_COMRX_OBCM_PrechargeSts_HV_CHARGER2_FD5_Error  # Error
          data-receive-point-by-arguments:
            access DRP_CanCom_FD5RxSignalsSR_COMRX_OBCM_PrechargeSts_HV_CHARGER2_FD5: accessed-variable=CanCom_FD5RxSignalsSR.COMRX_OBCM_PrechargeSts_HV_CHARGER2_FD5
          data-send-points:
            access DSP_VeCANR_e_OBCM_PrechargeSts_FD5_VeCANR_e_OBCM_PrechargeSts_FD5: accessed-variable=VeCANR_e_OBCM_PrechargeSts_FD5.VeCANR_e_OBCM_PrechargeSts_FD5
            access DSP_VeCANR_b_OBCM_PrechargeSts_FD5TO_VeCANR_b_OBCM_PrechargeSts_FD5TO: accessed-variable=VeCANR_b_OBCM_PrechargeSts_FD5TO.VeCANR_b_OBCM_PrechargeSts_FD5TO
        COMRX_OnboardChargerMode_HV_CHARGER2_FD5_Received: symbol=ApplCanComAb_FD5_COMRX_OnboardChargerMode_HV_CHARGER2_FD5_Received  # Received
          data-receive-point-by-arguments:
            access DRP_CanCom_FD5RxSignalsSR_COMRX_OnboardChargerMode_HV_CHARGER2_FD5: accessed-variable=CanCom_FD5RxSignalsSR.COMRX_OnboardChargerMode_HV_CHARGER2_FD5
          data-send-points:
            access DSP_VeCANR_e_OnboardChargerModeFD5_VeCANR_e_OnboardChargerModeFD5: accessed-variable=VeCANR_e_OnboardChargerModeFD5.VeCANR_e_OnboardChargerModeFD5
            access DSP_VeCANR_b_OnboardChargerModeFD5TO_VeCANR_b_OnboardChargerModeFD5TO: accessed-variable=VeCANR_b_OnboardChargerModeFD5TO.VeCANR_b_OnboardChargerModeFD5TO
        COMRX_OnboardChargerMode_HV_CHARGER2_FD5_Error: symbol=ApplCanComAb_FD5_COMRX_OnboardChargerMode_HV_CHARGER2_FD5_Error  # Error
          data-receive-point-by-arguments:
            access DRP_CanCom_FD5RxSignalsSR_COMRX_OnboardChargerMode_HV_CHARGER2_FD5: accessed-variable=CanCom_FD5RxSignalsSR.COMRX_OnboardChargerMode_HV_CHARGER2_FD5
          data-send-points:
            access DSP_VeCANR_e_OnboardChargerModeFD5_VeCANR_e_OnboardChargerModeFD5: accessed-variable=VeCANR_e_OnboardChargerModeFD5.VeCANR_e_OnboardChargerModeFD5
            access DSP_VeCANR_b_OnboardChargerModeFD5TO_VeCANR_b_OnboardChargerModeFD5TO: accessed-variable=VeCANR_b_OnboardChargerModeFD5TO.VeCANR_b_OnboardChargerModeFD5TO
        COMRX_OnboardChargerReady_HV_CHARGER2_FD5_Received: symbol=ApplCanComAb_FD5_COMRX_OnboardChargerReady_HV_CHARGER2_FD5_Received  # Received
          data-receive-point-by-arguments:
            access DRP_CanCom_FD5RxSignalsSR_COMRX_OnboardChargerReady_HV_CHARGER2_FD5: accessed-variable=CanCom_FD5RxSignalsSR.COMRX_OnboardChargerReady_HV_CHARGER2_FD5
          data-send-points:
            access DSP_VeCANR_e_OnboardChrgrReady_FD5_VeCANR_e_OnboardChrgrReady_FD5: accessed-variable=VeCANR_e_OnboardChrgrReady_FD5.VeCANR_e_OnboardChrgrReady_FD5
            access DSP_VeCANR_b_OnboardChrgrReady_FD5TO_VeCANR_b_OnboardChrgrReady_FD5TO: accessed-variable=VeCANR_b_OnboardChrgrReady_FD5TO.VeCANR_b_OnboardChrgrReady_FD5TO
        COMRX_OnboardChargerReady_HV_CHARGER2_FD5_Error: symbol=ApplCanComAb_FD5_COMRX_OnboardChargerReady_HV_CHARGER2_FD5_Error  # Error
          data-receive-point-by-arguments:
            access DRP_CanCom_FD5RxSignalsSR_COMRX_OnboardChargerReady_HV_CHARGER2_FD5: accessed-variable=CanCom_FD5RxSignalsSR.COMRX_OnboardChargerReady_HV_CHARGER2_FD5
          data-send-points:
            access DSP_VeCANR_e_OnboardChrgrReady_FD5_VeCANR_e_OnboardChrgrReady_FD5: accessed-variable=VeCANR_e_OnboardChrgrReady_FD5.VeCANR_e_OnboardChrgrReady_FD5
            access DSP_VeCANR_b_OnboardChrgrReady_FD5TO_VeCANR_b_OnboardChrgrReady_FD5TO: accessed-variable=VeCANR_b_OnboardChrgrReady_FD5TO.VeCANR_b_OnboardChrgrReady_FD5TO
        COMRX_Contract_Certificate_Present_IDCM_ISO15118_STATUS1_FD5_Received: symbol=ApplCanComAb_FD5_COMRX_Contract_Certificate_Present_IDCM_ISO15118_STATUS1_FD5_Received  # Received
          data-receive-point-by-arguments:
            access DRP_CanCom_FD5RxSignalsSR_COMRX_Contract_Certificate_Present_IDCM_ISO15118_STATUS1_FD5: accessed-variable=CanCom_FD5RxSignalsSR.COMRX_Contract_Certificate_Present_IDCM_ISO15118_STATUS1_FD5
          data-send-points:
            access DSP_VeCANR_b_Contract_Certi_PrntFD5_VeCANR_b_Contract_Certi_PrntFD5: accessed-variable=VeCANR_b_Contract_Certi_PrntFD5.VeCANR_b_Contract_Certi_PrntFD5
            access DSP_VeCANR_b_Contract_Certi_PrntFD5TO_VeCANR_b_Contract_Certi_PrntFD5TO: accessed-variable=VeCANR_b_Contract_Certi_PrntFD5TO.VeCANR_b_Contract_Certi_PrntFD5TO
        COMRX_Contract_Certificate_Present_IDCM_ISO15118_STATUS1_FD5_Error: symbol=ApplCanComAb_FD5_COMRX_Contract_Certificate_Present_IDCM_ISO15118_STATUS1_FD5_Error  # Error
          data-receive-point-by-arguments:
            access DRP_CanCom_FD5RxSignalsSR_COMRX_Contract_Certificate_Present_IDCM_ISO15118_STATUS1_FD5: accessed-variable=CanCom_FD5RxSignalsSR.COMRX_Contract_Certificate_Present_IDCM_ISO15118_STATUS1_FD5
          data-send-points:
            access DSP_VeCANR_b_Contract_Certi_PrntFD5_VeCANR_b_Contract_Certi_PrntFD5: accessed-variable=VeCANR_b_Contract_Certi_PrntFD5.VeCANR_b_Contract_Certi_PrntFD5
            access DSP_VeCANR_b_Contract_Certi_PrntFD5TO_VeCANR_b_Contract_Certi_PrntFD5TO: accessed-variable=VeCANR_b_Contract_Certi_PrntFD5TO.VeCANR_b_Contract_Certi_PrntFD5TO
        COMRX_EVSE_Offered_AC_Single_Phase_IDCM_ISO15118_STATUS1_FD5_Received: symbol=ApplCanComAb_FD5_COMRX_EVSE_Offered_AC_Single_Phase_IDCM_ISO15118_STATUS1_FD5_Received  # Received
          data-receive-point-by-arguments:
            access DRP_CanCom_FD5RxSignalsSR_COMRX_EVSE_Offered_AC_Single_Phase_IDCM_ISO15118_STATUS1_FD5: accessed-variable=CanCom_FD5RxSignalsSR.COMRX_EVSE_Offered_AC_Single_Phase_IDCM_ISO15118_STATUS1_FD5
          data-send-points:
            access DSP_VeCANR_b_EVSE_OfdACSingPhasFD5_VeCANR_b_EVSE_OfdACSingPhasFD5: accessed-variable=VeCANR_b_EVSE_OfdACSingPhasFD5.VeCANR_b_EVSE_OfdACSingPhasFD5
            access DSP_VeCANR_b_EVSE_OfdACSingPhasFD5TO_VeCANR_b_EVSE_OfdACSingPhasFD5TO: accessed-variable=VeCANR_b_EVSE_OfdACSingPhasFD5TO.VeCANR_b_EVSE_OfdACSingPhasFD5TO
        COMRX_EVSE_Offered_AC_Single_Phase_IDCM_ISO15118_STATUS1_FD5_Error: symbol=ApplCanComAb_FD5_COMRX_EVSE_Offered_AC_Single_Phase_IDCM_ISO15118_STATUS1_FD5_Error  # Error
          data-receive-point-by-arguments:
            access DRP_CanCom_FD5RxSignalsSR_COMRX_EVSE_Offered_AC_Single_Phase_IDCM_ISO15118_STATUS1_FD5: accessed-variable=CanCom_FD5RxSignalsSR.COMRX_EVSE_Offered_AC_Single_Phase_IDCM_ISO15118_STATUS1_FD5
          data-send-points:
            access DSP_VeCANR_b_EVSE_OfdACSingPhasFD5_VeCANR_b_EVSE_OfdACSingPhasFD5: accessed-variable=VeCANR_b_EVSE_OfdACSingPhasFD5.VeCANR_b_EVSE_OfdACSingPhasFD5
            access DSP_VeCANR_b_EVSE_OfdACSingPhasFD5TO_VeCANR_b_EVSE_OfdACSingPhasFD5TO: accessed-variable=VeCANR_b_EVSE_OfdACSingPhasFD5TO.VeCANR_b_EVSE_OfdACSingPhasFD5TO
        COMRX_EVSE_Offered_AC_Three_Phase_IDCM_ISO15118_STATUS1_FD5_Received: symbol=ApplCanComAb_FD5_COMRX_EVSE_Offered_AC_Three_Phase_IDCM_ISO15118_STATUS1_FD5_Received  # Received
          data-receive-point-by-arguments:
            access DRP_CanCom_FD5RxSignalsSR_COMRX_EVSE_Offered_AC_Three_Phase_IDCM_ISO15118_STATUS1_FD5: accessed-variable=CanCom_FD5RxSignalsSR.COMRX_EVSE_Offered_AC_Three_Phase_IDCM_ISO15118_STATUS1_FD5
          data-send-points:
            access DSP_VeCANR_b_EVSEOfdACThreePhasFD5_VeCANR_b_EVSEOfdACThreePhasFD5: accessed-variable=VeCANR_b_EVSEOfdACThreePhasFD5.VeCANR_b_EVSEOfdACThreePhasFD5
            access DSP_VeCANR_b_EVSEOfdACThreePhasFD5TO_VeCANR_b_EVSEOfdACThreePhasFD5TO: accessed-variable=VeCANR_b_EVSEOfdACThreePhasFD5TO.VeCANR_b_EVSEOfdACThreePhasFD5TO
        COMRX_EVSE_Offered_AC_Three_Phase_IDCM_ISO15118_STATUS1_FD5_Error: symbol=ApplCanComAb_FD5_COMRX_EVSE_Offered_AC_Three_Phase_IDCM_ISO15118_STATUS1_FD5_Error  # Error
          data-receive-point-by-arguments:
            access DRP_CanCom_FD5RxSignalsSR_COMRX_EVSE_Offered_AC_Three_Phase_IDCM_ISO15118_STATUS1_FD5: accessed-variable=CanCom_FD5RxSignalsSR.COMRX_EVSE_Offered_AC_Three_Phase_IDCM_ISO15118_STATUS1_FD5
          data-send-points:
            access DSP_VeCANR_b_EVSEOfdACThreePhasFD5_VeCANR_b_EVSEOfdACThreePhasFD5: accessed-variable=VeCANR_b_EVSEOfdACThreePhasFD5.VeCANR_b_EVSEOfdACThreePhasFD5
            access DSP_VeCANR_b_EVSEOfdACThreePhasFD5TO_VeCANR_b_EVSEOfdACThreePhasFD5TO: accessed-variable=VeCANR_b_EVSEOfdACThreePhasFD5TO.VeCANR_b_EVSEOfdACThreePhasFD5TO
        COMRX_CLrDiagInfo_MCPA_P_MCPA_STATUS_FD5_Received: symbol=ApplCanComAb_FD5_COMRX_CLrDiagInfo_MCPA_P_MCPA_STATUS_FD5_Received  # Received
          data-receive-point-by-arguments:
            access DRP_CanCom_FD5RxSignalsSR_COMRX_CLrDiagInfo_MCPA_P_MCPA_STATUS_FD5: accessed-variable=CanCom_FD5RxSignalsSR.COMRX_CLrDiagInfo_MCPA_P_MCPA_STATUS_FD5
          data-send-points:
            access DSP_VeCANR_b_CLrDiagInfo_MCPA_P_FD5_VeCANR_b_CLrDiagInfo_MCPA_P_FD5: accessed-variable=VeCANR_b_CLrDiagInfo_MCPA_P_FD5.VeCANR_b_CLrDiagInfo_MCPA_P_FD5
            access DSP_VeCANR_b_CLrDiagInfo_MCPA_P_FD5TO_VeCANR_b_CLrDiagInfo_MCPA_P_FD5TO: accessed-variable=VeCANR_b_CLrDiagInfo_MCPA_P_FD5TO.VeCANR_b_CLrDiagInfo_MCPA_P_FD5TO
        COMRX_CLrDiagInfo_MCPA_P_MCPA_STATUS_FD5_Error: symbol=ApplCanComAb_FD5_COMRX_CLrDiagInfo_MCPA_P_MCPA_STATUS_FD5_Error  # Error
          data-receive-point-by-arguments:
            access DRP_CanCom_FD5RxSignalsSR_COMRX_CLrDiagInfo_MCPA_P_MCPA_STATUS_FD5: accessed-variable=CanCom_FD5RxSignalsSR.COMRX_CLrDiagInfo_MCPA_P_MCPA_STATUS_FD5
          data-send-points:
            access DSP_VeCANR_b_CLrDiagInfo_MCPA_P_FD5_VeCANR_b_CLrDiagInfo_MCPA_P_FD5: accessed-variable=VeCANR_b_CLrDiagInfo_MCPA_P_FD5.VeCANR_b_CLrDiagInfo_MCPA_P_FD5
            access DSP_VeCANR_b_CLrDiagInfo_MCPA_P_FD5TO_VeCANR_b_CLrDiagInfo_MCPA_P_FD5TO: accessed-variable=VeCANR_b_CLrDiagInfo_MCPA_P_FD5TO.VeCANR_b_CLrDiagInfo_MCPA_P_FD5TO
        COMRX_CRC_MCPA_STATUS_MCPA_STATUS_FD5_Received: symbol=ApplCanComAb_FD5_COMRX_CRC_MCPA_STATUS_MCPA_STATUS_FD5_Received  # Received
          data-receive-point-by-arguments:
            access DRP_CanCom_FD5RxSignalsSR_COMRX_CRC_MCPA_STATUS_MCPA_STATUS_FD5: accessed-variable=CanCom_FD5RxSignalsSR.COMRX_CRC_MCPA_STATUS_MCPA_STATUS_FD5
          data-send-points:
            access DSP_VeCANR_y_CRC_MCPA_STATUS_FD5_VeCANR_y_CRC_MCPA_STATUS_FD5: accessed-variable=VeCANR_y_CRC_MCPA_STATUS_FD5.VeCANR_y_CRC_MCPA_STATUS_FD5
            access DSP_VeCANR_b_CRC_MCPA_STATUS_FD5TO_VeCANR_b_CRC_MCPA_STATUS_FD5TO: accessed-variable=VeCANR_b_CRC_MCPA_STATUS_FD5TO.VeCANR_b_CRC_MCPA_STATUS_FD5TO
        COMRX_CRC_MCPA_STATUS_MCPA_STATUS_FD5_Error: symbol=ApplCanComAb_FD5_COMRX_CRC_MCPA_STATUS_MCPA_STATUS_FD5_Error  # Error
          data-receive-point-by-arguments:
            access DRP_CanCom_FD5RxSignalsSR_COMRX_CRC_MCPA_STATUS_MCPA_STATUS_FD5: accessed-variable=CanCom_FD5RxSignalsSR.COMRX_CRC_MCPA_STATUS_MCPA_STATUS_FD5
          data-send-points:
            access DSP_VeCANR_y_CRC_MCPA_STATUS_FD5_VeCANR_y_CRC_MCPA_STATUS_FD5: accessed-variable=VeCANR_y_CRC_MCPA_STATUS_FD5.VeCANR_y_CRC_MCPA_STATUS_FD5
            access DSP_VeCANR_b_CRC_MCPA_STATUS_FD5TO_VeCANR_b_CRC_MCPA_STATUS_FD5TO: accessed-variable=VeCANR_b_CRC_MCPA_STATUS_FD5TO.VeCANR_b_CRC_MCPA_STATUS_FD5TO
        COMRX_MC_MCPA_STATUS_MCPA_STATUS_FD5_Received: symbol=ApplCanComAb_FD5_COMRX_MC_MCPA_STATUS_MCPA_STATUS_FD5_Received  # Received
          data-receive-point-by-arguments:
            access DRP_CanCom_FD5RxSignalsSR_COMRX_MC_MCPA_STATUS_MCPA_STATUS_FD5: accessed-variable=CanCom_FD5RxSignalsSR.COMRX_MC_MCPA_STATUS_MCPA_STATUS_FD5
          data-send-points:
            access DSP_VeCANR_y_MC_MCPA_STATUS_FD5_VeCANR_y_MC_MCPA_STATUS_FD5: accessed-variable=VeCANR_y_MC_MCPA_STATUS_FD5.VeCANR_y_MC_MCPA_STATUS_FD5
            access DSP_VeCANR_b_MC_MCPA_STATUS_FD5TO_VeCANR_b_MC_MCPA_STATUS_FD5TO: accessed-variable=VeCANR_b_MC_MCPA_STATUS_FD5TO.VeCANR_b_MC_MCPA_STATUS_FD5TO
        COMRX_MC_MCPA_STATUS_MCPA_STATUS_FD5_Error: symbol=ApplCanComAb_FD5_COMRX_MC_MCPA_STATUS_MCPA_STATUS_FD5_Error  # Error
          data-receive-point-by-arguments:
            access DRP_CanCom_FD5RxSignalsSR_COMRX_MC_MCPA_STATUS_MCPA_STATUS_FD5: accessed-variable=CanCom_FD5RxSignalsSR.COMRX_MC_MCPA_STATUS_MCPA_STATUS_FD5
          data-send-points:
            access DSP_VeCANR_y_MC_MCPA_STATUS_FD5_VeCANR_y_MC_MCPA_STATUS_FD5: accessed-variable=VeCANR_y_MC_MCPA_STATUS_FD5.VeCANR_y_MC_MCPA_STATUS_FD5
            access DSP_VeCANR_b_MC_MCPA_STATUS_FD5TO_VeCANR_b_MC_MCPA_STATUS_FD5TO: accessed-variable=VeCANR_b_MC_MCPA_STATUS_FD5TO.VeCANR_b_MC_MCPA_STATUS_FD5TO
        COMRX_MCPA_Control_Board_Temperature_P_MCPA_STATUS_FD5_Received: symbol=ApplCanComAb_FD5_COMRX_MCPA_Control_Board_Temperature_P_MCPA_STATUS_FD5_Received  # Received
          data-receive-point-by-arguments:
            access DRP_CanCom_FD5RxSignalsSR_COMRX_MCPA_Control_Board_Temperature_P_MCPA_STATUS_FD5: accessed-variable=CanCom_FD5RxSignalsSR.COMRX_MCPA_Control_Board_Temperature_P_MCPA_STATUS_FD5
          data-send-points:
            access DSP_VeCANR_T_MCPACtrlBoardTempP_FD5_VeCANR_T_MCPACtrlBoardTempP_FD5: accessed-variable=VeCANR_T_MCPACtrlBoardTempP_FD5.VeCANR_T_MCPACtrlBoardTempP_FD5
            access DSP_VeCANR_b_MCPACtrlBoardTempP_FD5TO_VeCANR_b_MCPACtrlBoardTempP_FD5TO: accessed-variable=VeCANR_b_MCPACtrlBoardTempP_FD5TO.VeCANR_b_MCPACtrlBoardTempP_FD5TO
        COMRX_MCPA_Control_Board_Temperature_P_MCPA_STATUS_FD5_Error: symbol=ApplCanComAb_FD5_COMRX_MCPA_Control_Board_Temperature_P_MCPA_STATUS_FD5_Error  # Error
          data-receive-point-by-arguments:
            access DRP_CanCom_FD5RxSignalsSR_COMRX_MCPA_Control_Board_Temperature_P_MCPA_STATUS_FD5: accessed-variable=CanCom_FD5RxSignalsSR.COMRX_MCPA_Control_Board_Temperature_P_MCPA_STATUS_FD5
          data-send-points:
            access DSP_VeCANR_T_MCPACtrlBoardTempP_FD5_VeCANR_T_MCPACtrlBoardTempP_FD5: accessed-variable=VeCANR_T_MCPACtrlBoardTempP_FD5.VeCANR_T_MCPACtrlBoardTempP_FD5
            access DSP_VeCANR_b_MCPACtrlBoardTempP_FD5TO_VeCANR_b_MCPACtrlBoardTempP_FD5TO: accessed-variable=VeCANR_b_MCPACtrlBoardTempP_FD5TO.VeCANR_b_MCPACtrlBoardTempP_FD5TO
        COMRX_MCPA_CoolantTemp_P_MCPA_STATUS_FD5_Received: symbol=ApplCanComAb_FD5_COMRX_MCPA_CoolantTemp_P_MCPA_STATUS_FD5_Received  # Received
          data-receive-point-by-arguments:
            access DRP_CanCom_FD5RxSignalsSR_COMRX_MCPA_CoolantTemp_P_MCPA_STATUS_FD5: accessed-variable=CanCom_FD5RxSignalsSR.COMRX_MCPA_CoolantTemp_P_MCPA_STATUS_FD5
          data-send-points:
            access DSP_VeCANR_T_MCPA_CoolntTmp_P_FD5_VeCANR_T_MCPA_CoolntTmp_P_FD5: accessed-variable=VeCANR_T_MCPA_CoolntTmp_P_FD5.VeCANR_T_MCPA_CoolntTmp_P_FD5
            access DSP_VeCANR_b_MCPA_CoolntTmp_P_FD5TO_VeCANR_b_MCPA_CoolntTmp_P_FD5TO: accessed-variable=VeCANR_b_MCPA_CoolntTmp_P_FD5TO.VeCANR_b_MCPA_CoolntTmp_P_FD5TO
        COMRX_MCPA_CoolantTemp_P_MCPA_STATUS_FD5_Error: symbol=ApplCanComAb_FD5_COMRX_MCPA_CoolantTemp_P_MCPA_STATUS_FD5_Error  # Error
          data-receive-point-by-arguments:
            access DRP_CanCom_FD5RxSignalsSR_COMRX_MCPA_CoolantTemp_P_MCPA_STATUS_FD5: accessed-variable=CanCom_FD5RxSignalsSR.COMRX_MCPA_CoolantTemp_P_MCPA_STATUS_FD5
          data-send-points:
            access DSP_VeCANR_T_MCPA_CoolntTmp_P_FD5_VeCANR_T_MCPA_CoolntTmp_P_FD5: accessed-variable=VeCANR_T_MCPA_CoolntTmp_P_FD5.VeCANR_T_MCPA_CoolntTmp_P_FD5
            access DSP_VeCANR_b_MCPA_CoolntTmp_P_FD5TO_VeCANR_b_MCPA_CoolntTmp_P_FD5TO: accessed-variable=VeCANR_b_MCPA_CoolntTmp_P_FD5TO.VeCANR_b_MCPA_CoolntTmp_P_FD5TO
        COMRX_MCPA_DC_Current_P_MCPA_STATUS_FD5_Received: symbol=ApplCanComAb_FD5_COMRX_MCPA_DC_Current_P_MCPA_STATUS_FD5_Received  # Received
          data-receive-point-by-arguments:
            access DRP_CanCom_FD5RxSignalsSR_COMRX_MCPA_DC_Current_P_MCPA_STATUS_FD5: accessed-variable=CanCom_FD5RxSignalsSR.COMRX_MCPA_DC_Current_P_MCPA_STATUS_FD5
          data-send-points:
            access DSP_VeCANR_I_MCPA_DC_Current_P_FD5_VeCANR_I_MCPA_DC_Current_P_FD5: accessed-variable=VeCANR_I_MCPA_DC_Current_P_FD5.VeCANR_I_MCPA_DC_Current_P_FD5
            access DSP_VeCANR_b_MCPA_DC_Current_P_FD5TO_VeCANR_b_MCPA_DC_Current_P_FD5TO: accessed-variable=VeCANR_b_MCPA_DC_Current_P_FD5TO.VeCANR_b_MCPA_DC_Current_P_FD5TO
        COMRX_MCPA_DC_Current_P_MCPA_STATUS_FD5_Error: symbol=ApplCanComAb_FD5_COMRX_MCPA_DC_Current_P_MCPA_STATUS_FD5_Error  # Error
          data-receive-point-by-arguments:
            access DRP_CanCom_FD5RxSignalsSR_COMRX_MCPA_DC_Current_P_MCPA_STATUS_FD5: accessed-variable=CanCom_FD5RxSignalsSR.COMRX_MCPA_DC_Current_P_MCPA_STATUS_FD5
          data-send-points:
            access DSP_VeCANR_I_MCPA_DC_Current_P_FD5_VeCANR_I_MCPA_DC_Current_P_FD5: accessed-variable=VeCANR_I_MCPA_DC_Current_P_FD5.VeCANR_I_MCPA_DC_Current_P_FD5
            access DSP_VeCANR_b_MCPA_DC_Current_P_FD5TO_VeCANR_b_MCPA_DC_Current_P_FD5TO: accessed-variable=VeCANR_b_MCPA_DC_Current_P_FD5TO.VeCANR_b_MCPA_DC_Current_P_FD5TO
        COMRX_MCPA_DC_Current_V_P_MCPA_STATUS_FD5_Received: symbol=ApplCanComAb_FD5_COMRX_MCPA_DC_Current_V_P_MCPA_STATUS_FD5_Received  # Received
          data-receive-point-by-arguments:
            access DRP_CanCom_FD5RxSignalsSR_COMRX_MCPA_DC_Current_V_P_MCPA_STATUS_FD5: accessed-variable=CanCom_FD5RxSignalsSR.COMRX_MCPA_DC_Current_V_P_MCPA_STATUS_FD5
          data-send-points:
            access DSP_VeCANR_b_MCPA_DC_Crrent_V_P_FD5_VeCANR_b_MCPA_DC_Crrent_V_P_FD5: accessed-variable=VeCANR_b_MCPA_DC_Crrent_V_P_FD5.VeCANR_b_MCPA_DC_Crrent_V_P_FD5
            access DSP_VeCANR_b_MCPA_DC_Crrent_V_P_FD5TO_VeCANR_b_MCPA_DC_Crrent_V_P_FD5TO: accessed-variable=VeCANR_b_MCPA_DC_Crrent_V_P_FD5TO.VeCANR_b_MCPA_DC_Crrent_V_P_FD5TO
        COMRX_MCPA_DC_Current_V_P_MCPA_STATUS_FD5_Error: symbol=ApplCanComAb_FD5_COMRX_MCPA_DC_Current_V_P_MCPA_STATUS_FD5_Error  # Error
          data-receive-point-by-arguments:
            access DRP_CanCom_FD5RxSignalsSR_COMRX_MCPA_DC_Current_V_P_MCPA_STATUS_FD5: accessed-variable=CanCom_FD5RxSignalsSR.COMRX_MCPA_DC_Current_V_P_MCPA_STATUS_FD5
          data-send-points:
            access DSP_VeCANR_b_MCPA_DC_Crrent_V_P_FD5_VeCANR_b_MCPA_DC_Crrent_V_P_FD5: accessed-variable=VeCANR_b_MCPA_DC_Crrent_V_P_FD5.VeCANR_b_MCPA_DC_Crrent_V_P_FD5
            access DSP_VeCANR_b_MCPA_DC_Crrent_V_P_FD5TO_VeCANR_b_MCPA_DC_Crrent_V_P_FD5TO: accessed-variable=VeCANR_b_MCPA_DC_Crrent_V_P_FD5TO.VeCANR_b_MCPA_DC_Crrent_V_P_FD5TO
        COMRX_MCPA_DC_Volt_V_P_MCPA_STATUS_FD5_Received: symbol=ApplCanComAb_FD5_COMRX_MCPA_DC_Volt_V_P_MCPA_STATUS_FD5_Received  # Received
          data-receive-point-by-arguments:
            access DRP_CanCom_FD5RxSignalsSR_COMRX_MCPA_DC_Volt_V_P_MCPA_STATUS_FD5: accessed-variable=CanCom_FD5RxSignalsSR.COMRX_MCPA_DC_Volt_V_P_MCPA_STATUS_FD5
          data-send-points:
            access DSP_VeCANR_b_MCPA_DC_Volt_V_P_FD5_VeCANR_b_MCPA_DC_Volt_V_P_FD5: accessed-variable=VeCANR_b_MCPA_DC_Volt_V_P_FD5.VeCANR_b_MCPA_DC_Volt_V_P_FD5
            access DSP_VeCANR_b_MCPA_DC_Volt_V_P_FD5TO_VeCANR_b_MCPA_DC_Volt_V_P_FD5TO: accessed-variable=VeCANR_b_MCPA_DC_Volt_V_P_FD5TO.VeCANR_b_MCPA_DC_Volt_V_P_FD5TO
        COMRX_MCPA_DC_Volt_V_P_MCPA_STATUS_FD5_Error: symbol=ApplCanComAb_FD5_COMRX_MCPA_DC_Volt_V_P_MCPA_STATUS_FD5_Error  # Error
          data-receive-point-by-arguments:
            access DRP_CanCom_FD5RxSignalsSR_COMRX_MCPA_DC_Volt_V_P_MCPA_STATUS_FD5: accessed-variable=CanCom_FD5RxSignalsSR.COMRX_MCPA_DC_Volt_V_P_MCPA_STATUS_FD5
          data-send-points:
            access DSP_VeCANR_b_MCPA_DC_Volt_V_P_FD5_VeCANR_b_MCPA_DC_Volt_V_P_FD5: accessed-variable=VeCANR_b_MCPA_DC_Volt_V_P_FD5.VeCANR_b_MCPA_DC_Volt_V_P_FD5
            access DSP_VeCANR_b_MCPA_DC_Volt_V_P_FD5TO_VeCANR_b_MCPA_DC_Volt_V_P_FD5TO: accessed-variable=VeCANR_b_MCPA_DC_Volt_V_P_FD5TO.VeCANR_b_MCPA_DC_Volt_V_P_FD5TO
        COMRX_MCPA_DC_Voltage_P_MCPA_STATUS_FD5_Received: symbol=ApplCanComAb_FD5_COMRX_MCPA_DC_Voltage_P_MCPA_STATUS_FD5_Received  # Received
          data-receive-point-by-arguments:
            access DRP_CanCom_FD5RxSignalsSR_COMRX_MCPA_DC_Voltage_P_MCPA_STATUS_FD5: accessed-variable=CanCom_FD5RxSignalsSR.COMRX_MCPA_DC_Voltage_P_MCPA_STATUS_FD5
          data-send-points:
            access DSP_VeCANR_U_MCPA_DC_Voltage_P_FD5_VeCANR_U_MCPA_DC_Voltage_P_FD5: accessed-variable=VeCANR_U_MCPA_DC_Voltage_P_FD5.VeCANR_U_MCPA_DC_Voltage_P_FD5
            access DSP_VeCANR_b_MCPA_DC_Voltage_P_FD5TO_VeCANR_b_MCPA_DC_Voltage_P_FD5TO: accessed-variable=VeCANR_b_MCPA_DC_Voltage_P_FD5TO.VeCANR_b_MCPA_DC_Voltage_P_FD5TO
        COMRX_MCPA_DC_Voltage_P_MCPA_STATUS_FD5_Error: symbol=ApplCanComAb_FD5_COMRX_MCPA_DC_Voltage_P_MCPA_STATUS_FD5_Error  # Error
          data-receive-point-by-arguments:
            access DRP_CanCom_FD5RxSignalsSR_COMRX_MCPA_DC_Voltage_P_MCPA_STATUS_FD5: accessed-variable=CanCom_FD5RxSignalsSR.COMRX_MCPA_DC_Voltage_P_MCPA_STATUS_FD5
          data-send-points:
            access DSP_VeCANR_U_MCPA_DC_Voltage_P_FD5_VeCANR_U_MCPA_DC_Voltage_P_FD5: accessed-variable=VeCANR_U_MCPA_DC_Voltage_P_FD5.VeCANR_U_MCPA_DC_Voltage_P_FD5
            access DSP_VeCANR_b_MCPA_DC_Voltage_P_FD5TO_VeCANR_b_MCPA_DC_Voltage_P_FD5TO: accessed-variable=VeCANR_b_MCPA_DC_Voltage_P_FD5TO.VeCANR_b_MCPA_DC_Voltage_P_FD5TO
        COMRX_MCPA_DerateReason_P_MCPA_STATUS_FD5_Received: symbol=ApplCanComAb_FD5_COMRX_MCPA_DerateReason_P_MCPA_STATUS_FD5_Received  # Received
          data-receive-point-by-arguments:
            access DRP_CanCom_FD5RxSignalsSR_COMRX_MCPA_DerateReason_P_MCPA_STATUS_FD5: accessed-variable=CanCom_FD5RxSignalsSR.COMRX_MCPA_DerateReason_P_MCPA_STATUS_FD5
          data-send-points:
            access DSP_VeCANR_e_MCPA_DrateReason_P_FD5_VeCANR_e_MCPA_DrateReason_P_FD5: accessed-variable=VeCANR_e_MCPA_DrateReason_P_FD5.VeCANR_e_MCPA_DrateReason_P_FD5
            access DSP_VeCANR_b_MCPA_DrateReason_P_FD5TO_VeCANR_b_MCPA_DrateReason_P_FD5TO: accessed-variable=VeCANR_b_MCPA_DrateReason_P_FD5TO.VeCANR_b_MCPA_DrateReason_P_FD5TO
        COMRX_MCPA_DerateReason_P_MCPA_STATUS_FD5_Error: symbol=ApplCanComAb_FD5_COMRX_MCPA_DerateReason_P_MCPA_STATUS_FD5_Error  # Error
          data-receive-point-by-arguments:
            access DRP_CanCom_FD5RxSignalsSR_COMRX_MCPA_DerateReason_P_MCPA_STATUS_FD5: accessed-variable=CanCom_FD5RxSignalsSR.COMRX_MCPA_DerateReason_P_MCPA_STATUS_FD5
          data-send-points:
            access DSP_VeCANR_e_MCPA_DrateReason_P_FD5_VeCANR_e_MCPA_DrateReason_P_FD5: accessed-variable=VeCANR_e_MCPA_DrateReason_P_FD5.VeCANR_e_MCPA_DrateReason_P_FD5
            access DSP_VeCANR_b_MCPA_DrateReason_P_FD5TO_VeCANR_b_MCPA_DrateReason_P_FD5TO: accessed-variable=VeCANR_b_MCPA_DrateReason_P_FD5TO.VeCANR_b_MCPA_DrateReason_P_FD5TO
        COMRX_MCPA_Inverter_Temp_P_MCPA_STATUS_FD5_Received: symbol=ApplCanComAb_FD5_COMRX_MCPA_Inverter_Temp_P_MCPA_STATUS_FD5_Received  # Received
          data-receive-point-by-arguments:
            access DRP_CanCom_FD5RxSignalsSR_COMRX_MCPA_Inverter_Temp_P_MCPA_STATUS_FD5: accessed-variable=CanCom_FD5RxSignalsSR.COMRX_MCPA_Inverter_Temp_P_MCPA_STATUS_FD5
          data-send-points:
            access DSP_VeCANR_T_MCPA_Invert_Temp_P_FD5_VeCANR_T_MCPA_Invert_Temp_P_FD5: accessed-variable=VeCANR_T_MCPA_Invert_Temp_P_FD5.VeCANR_T_MCPA_Invert_Temp_P_FD5
            access DSP_VeCANR_b_MCPA_Invert_Temp_P_FD5TO_VeCANR_b_MCPA_Invert_Temp_P_FD5TO: accessed-variable=VeCANR_b_MCPA_Invert_Temp_P_FD5TO.VeCANR_b_MCPA_Invert_Temp_P_FD5TO
        COMRX_MCPA_Inverter_Temp_P_MCPA_STATUS_FD5_Error: symbol=ApplCanComAb_FD5_COMRX_MCPA_Inverter_Temp_P_MCPA_STATUS_FD5_Error  # Error
          data-receive-point-by-arguments:
            access DRP_CanCom_FD5RxSignalsSR_COMRX_MCPA_Inverter_Temp_P_MCPA_STATUS_FD5: accessed-variable=CanCom_FD5RxSignalsSR.COMRX_MCPA_Inverter_Temp_P_MCPA_STATUS_FD5
          data-send-points:
            access DSP_VeCANR_T_MCPA_Invert_Temp_P_FD5_VeCANR_T_MCPA_Invert_Temp_P_FD5: accessed-variable=VeCANR_T_MCPA_Invert_Temp_P_FD5.VeCANR_T_MCPA_Invert_Temp_P_FD5
            access DSP_VeCANR_b_MCPA_Invert_Temp_P_FD5TO_VeCANR_b_MCPA_Invert_Temp_P_FD5TO: accessed-variable=VeCANR_b_MCPA_Invert_Temp_P_FD5TO.VeCANR_b_MCPA_Invert_Temp_P_FD5TO
        COMRX_MCPA_PIM_DC_Side_Busbar_Temp_P_MCPA_STATUS_FD5_Received: symbol=ApplCanComAb_FD5_COMRX_MCPA_PIM_DC_Side_Busbar_Temp_P_MCPA_STATUS_FD5_Received  # Received
          data-receive-point-by-arguments:
            access DRP_CanCom_FD5RxSignalsSR_COMRX_MCPA_PIM_DC_Side_Busbar_Temp_P_MCPA_STATUS_FD5: accessed-variable=CanCom_FD5RxSignalsSR.COMRX_MCPA_PIM_DC_Side_Busbar_Temp_P_MCPA_STATUS_FD5
          data-send-points:
            access DSP_VeCANR_T_MCPAPIMDCSdBusTempPFD5_VeCANR_T_MCPAPIMDCSdBusTempPFD5: accessed-variable=VeCANR_T_MCPAPIMDCSdBusTempPFD5.VeCANR_T_MCPAPIMDCSdBusTempPFD5
            access DSP_VeCANR_b_MCPAPIMDCSdBusTempPFD5TO_VeCANR_b_MCPAPIMDCSdBusTempPFD5TO: accessed-variable=VeCANR_b_MCPAPIMDCSdBusTempPFD5TO.VeCANR_b_MCPAPIMDCSdBusTempPFD5TO
        COMRX_MCPA_PIM_DC_Side_Busbar_Temp_P_MCPA_STATUS_FD5_Error: symbol=ApplCanComAb_FD5_COMRX_MCPA_PIM_DC_Side_Busbar_Temp_P_MCPA_STATUS_FD5_Error  # Error
          data-receive-point-by-arguments:
            access DRP_CanCom_FD5RxSignalsSR_COMRX_MCPA_PIM_DC_Side_Busbar_Temp_P_MCPA_STATUS_FD5: accessed-variable=CanCom_FD5RxSignalsSR.COMRX_MCPA_PIM_DC_Side_Busbar_Temp_P_MCPA_STATUS_FD5
          data-send-points:
            access DSP_VeCANR_T_MCPAPIMDCSdBusTempPFD5_VeCANR_T_MCPAPIMDCSdBusTempPFD5: accessed-variable=VeCANR_T_MCPAPIMDCSdBusTempPFD5.VeCANR_T_MCPAPIMDCSdBusTempPFD5
            access DSP_VeCANR_b_MCPAPIMDCSdBusTempPFD5TO_VeCANR_b_MCPAPIMDCSdBusTempPFD5TO: accessed-variable=VeCANR_b_MCPAPIMDCSdBusTempPFD5TO.VeCANR_b_MCPAPIMDCSdBusTempPFD5TO
        COMRX_MCPA_Rotor_Temperature_P_MCPA_STATUS_FD5_Received: symbol=ApplCanComAb_FD5_COMRX_MCPA_Rotor_Temperature_P_MCPA_STATUS_FD5_Received  # Received
          data-receive-point-by-arguments:
            access DRP_CanCom_FD5RxSignalsSR_COMRX_MCPA_Rotor_Temperature_P_MCPA_STATUS_FD5: accessed-variable=CanCom_FD5RxSignalsSR.COMRX_MCPA_Rotor_Temperature_P_MCPA_STATUS_FD5
          data-send-points:
            access DSP_VeCANR_T_MCPARotorTemp_P_FD5_VeCANR_T_MCPARotorTemp_P_FD5: accessed-variable=VeCANR_T_MCPARotorTemp_P_FD5.VeCANR_T_MCPARotorTemp_P_FD5
            access DSP_VeCANR_b_MCPARotorTemp_P_FD5TO_VeCANR_b_MCPARotorTemp_P_FD5TO: accessed-variable=VeCANR_b_MCPARotorTemp_P_FD5TO.VeCANR_b_MCPARotorTemp_P_FD5TO
        COMRX_MCPA_Rotor_Temperature_P_MCPA_STATUS_FD5_Error: symbol=ApplCanComAb_FD5_COMRX_MCPA_Rotor_Temperature_P_MCPA_STATUS_FD5_Error  # Error
          data-receive-point-by-arguments:
            access DRP_CanCom_FD5RxSignalsSR_COMRX_MCPA_Rotor_Temperature_P_MCPA_STATUS_FD5: accessed-variable=CanCom_FD5RxSignalsSR.COMRX_MCPA_Rotor_Temperature_P_MCPA_STATUS_FD5
          data-send-points:
            access DSP_VeCANR_T_MCPARotorTemp_P_FD5_VeCANR_T_MCPARotorTemp_P_FD5: accessed-variable=VeCANR_T_MCPARotorTemp_P_FD5.VeCANR_T_MCPARotorTemp_P_FD5
            access DSP_VeCANR_b_MCPARotorTemp_P_FD5TO_VeCANR_b_MCPARotorTemp_P_FD5TO: accessed-variable=VeCANR_b_MCPARotorTemp_P_FD5TO.VeCANR_b_MCPARotorTemp_P_FD5TO
        COMRX_MCPA_Service_Lamp_Request_P_MCPA_STATUS_FD5_Received: symbol=ApplCanComAb_FD5_COMRX_MCPA_Service_Lamp_Request_P_MCPA_STATUS_FD5_Received  # Received
          data-receive-point-by-arguments:
            access DRP_CanCom_FD5RxSignalsSR_COMRX_MCPA_Service_Lamp_Request_P_MCPA_STATUS_FD5: accessed-variable=CanCom_FD5RxSignalsSR.COMRX_MCPA_Service_Lamp_Request_P_MCPA_STATUS_FD5
          data-send-points:
            access DSP_VeCANR_b_MCPAServLampReq_P_FD5_VeCANR_b_MCPAServLampReq_P_FD5: accessed-variable=VeCANR_b_MCPAServLampReq_P_FD5.VeCANR_b_MCPAServLampReq_P_FD5
            access DSP_VeCANR_b_MCPAServLampReq_P_FD5TO_VeCANR_b_MCPAServLampReq_P_FD5TO: accessed-variable=VeCANR_b_MCPAServLampReq_P_FD5TO.VeCANR_b_MCPAServLampReq_P_FD5TO
        COMRX_MCPA_Service_Lamp_Request_P_MCPA_STATUS_FD5_Error: symbol=ApplCanComAb_FD5_COMRX_MCPA_Service_Lamp_Request_P_MCPA_STATUS_FD5_Error  # Error
          data-receive-point-by-arguments:
            access DRP_CanCom_FD5RxSignalsSR_COMRX_MCPA_Service_Lamp_Request_P_MCPA_STATUS_FD5: accessed-variable=CanCom_FD5RxSignalsSR.COMRX_MCPA_Service_Lamp_Request_P_MCPA_STATUS_FD5
          data-send-points:
            access DSP_VeCANR_b_MCPAServLampReq_P_FD5_VeCANR_b_MCPAServLampReq_P_FD5: accessed-variable=VeCANR_b_MCPAServLampReq_P_FD5.VeCANR_b_MCPAServLampReq_P_FD5
            access DSP_VeCANR_b_MCPAServLampReq_P_FD5TO_VeCANR_b_MCPAServLampReq_P_FD5TO: accessed-variable=VeCANR_b_MCPAServLampReq_P_FD5TO.VeCANR_b_MCPAServLampReq_P_FD5TO
        COMRX_CLrDiagInfo_MCPB_P_MCPB_STATUS_FD5_Received: symbol=ApplCanComAb_FD5_COMRX_CLrDiagInfo_MCPB_P_MCPB_STATUS_FD5_Received  # Received
          data-receive-point-by-arguments:
            access DRP_CanCom_FD5RxSignalsSR_COMRX_CLrDiagInfo_MCPB_P_MCPB_STATUS_FD5: accessed-variable=CanCom_FD5RxSignalsSR.COMRX_CLrDiagInfo_MCPB_P_MCPB_STATUS_FD5
          data-send-points:
            access DSP_VeCANR_b_CLrDiagInfo_MCPB_P_FD5_VeCANR_b_CLrDiagInfo_MCPB_P_FD5: accessed-variable=VeCANR_b_CLrDiagInfo_MCPB_P_FD5.VeCANR_b_CLrDiagInfo_MCPB_P_FD5
            access DSP_VeCANR_b_CLrDiagInfo_MCPB_P_FD5TO_VeCANR_b_CLrDiagInfo_MCPB_P_FD5TO: accessed-variable=VeCANR_b_CLrDiagInfo_MCPB_P_FD5TO.VeCANR_b_CLrDiagInfo_MCPB_P_FD5TO
        COMRX_CLrDiagInfo_MCPB_P_MCPB_STATUS_FD5_Error: symbol=ApplCanComAb_FD5_COMRX_CLrDiagInfo_MCPB_P_MCPB_STATUS_FD5_Error  # Error
          data-receive-point-by-arguments:
            access DRP_CanCom_FD5RxSignalsSR_COMRX_CLrDiagInfo_MCPB_P_MCPB_STATUS_FD5: accessed-variable=CanCom_FD5RxSignalsSR.COMRX_CLrDiagInfo_MCPB_P_MCPB_STATUS_FD5
          data-send-points:
            access DSP_VeCANR_b_CLrDiagInfo_MCPB_P_FD5_VeCANR_b_CLrDiagInfo_MCPB_P_FD5: accessed-variable=VeCANR_b_CLrDiagInfo_MCPB_P_FD5.VeCANR_b_CLrDiagInfo_MCPB_P_FD5
            access DSP_VeCANR_b_CLrDiagInfo_MCPB_P_FD5TO_VeCANR_b_CLrDiagInfo_MCPB_P_FD5TO: accessed-variable=VeCANR_b_CLrDiagInfo_MCPB_P_FD5TO.VeCANR_b_CLrDiagInfo_MCPB_P_FD5TO
        COMRX_CRC_MCPB_STATUS_MCPB_STATUS_FD5_Received: symbol=ApplCanComAb_FD5_COMRX_CRC_MCPB_STATUS_MCPB_STATUS_FD5_Received  # Received
          data-receive-point-by-arguments:
            access DRP_CanCom_FD5RxSignalsSR_COMRX_CRC_MCPB_STATUS_MCPB_STATUS_FD5: accessed-variable=CanCom_FD5RxSignalsSR.COMRX_CRC_MCPB_STATUS_MCPB_STATUS_FD5
          data-send-points:
            access DSP_VeCANR_y_CRC_MCPB_STATUS_FD5_VeCANR_y_CRC_MCPB_STATUS_FD5: accessed-variable=VeCANR_y_CRC_MCPB_STATUS_FD5.VeCANR_y_CRC_MCPB_STATUS_FD5
            access DSP_VeCANR_b_CRC_MCPB_STATUS_FD5TO_VeCANR_b_CRC_MCPB_STATUS_FD5TO: accessed-variable=VeCANR_b_CRC_MCPB_STATUS_FD5TO.VeCANR_b_CRC_MCPB_STATUS_FD5TO
        COMRX_CRC_MCPB_STATUS_MCPB_STATUS_FD5_Error: symbol=ApplCanComAb_FD5_COMRX_CRC_MCPB_STATUS_MCPB_STATUS_FD5_Error  # Error
          data-receive-point-by-arguments:
            access DRP_CanCom_FD5RxSignalsSR_COMRX_CRC_MCPB_STATUS_MCPB_STATUS_FD5: accessed-variable=CanCom_FD5RxSignalsSR.COMRX_CRC_MCPB_STATUS_MCPB_STATUS_FD5
          data-send-points:
            access DSP_VeCANR_y_CRC_MCPB_STATUS_FD5_VeCANR_y_CRC_MCPB_STATUS_FD5: accessed-variable=VeCANR_y_CRC_MCPB_STATUS_FD5.VeCANR_y_CRC_MCPB_STATUS_FD5
            access DSP_VeCANR_b_CRC_MCPB_STATUS_FD5TO_VeCANR_b_CRC_MCPB_STATUS_FD5TO: accessed-variable=VeCANR_b_CRC_MCPB_STATUS_FD5TO.VeCANR_b_CRC_MCPB_STATUS_FD5TO
        COMRX_MC_MCPB_STATUS_MCPB_STATUS_FD5_Received: symbol=ApplCanComAb_FD5_COMRX_MC_MCPB_STATUS_MCPB_STATUS_FD5_Received  # Received
          data-receive-point-by-arguments:
            access DRP_CanCom_FD5RxSignalsSR_COMRX_MC_MCPB_STATUS_MCPB_STATUS_FD5: accessed-variable=CanCom_FD5RxSignalsSR.COMRX_MC_MCPB_STATUS_MCPB_STATUS_FD5
          data-send-points:
            access DSP_VeCANR_y_MC_MCPB_STATUS_FD5_VeCANR_y_MC_MCPB_STATUS_FD5: accessed-variable=VeCANR_y_MC_MCPB_STATUS_FD5.VeCANR_y_MC_MCPB_STATUS_FD5
            access DSP_VeCANR_b_MC_MCPB_STATUS_FD5TO_VeCANR_b_MC_MCPB_STATUS_FD5TO: accessed-variable=VeCANR_b_MC_MCPB_STATUS_FD5TO.VeCANR_b_MC_MCPB_STATUS_FD5TO
        COMRX_MC_MCPB_STATUS_MCPB_STATUS_FD5_Error: symbol=ApplCanComAb_FD5_COMRX_MC_MCPB_STATUS_MCPB_STATUS_FD5_Error  # Error
          data-receive-point-by-arguments:
            access DRP_CanCom_FD5RxSignalsSR_COMRX_MC_MCPB_STATUS_MCPB_STATUS_FD5: accessed-variable=CanCom_FD5RxSignalsSR.COMRX_MC_MCPB_STATUS_MCPB_STATUS_FD5
          data-send-points:
            access DSP_VeCANR_y_MC_MCPB_STATUS_FD5_VeCANR_y_MC_MCPB_STATUS_FD5: accessed-variable=VeCANR_y_MC_MCPB_STATUS_FD5.VeCANR_y_MC_MCPB_STATUS_FD5
            access DSP_VeCANR_b_MC_MCPB_STATUS_FD5TO_VeCANR_b_MC_MCPB_STATUS_FD5TO: accessed-variable=VeCANR_b_MC_MCPB_STATUS_FD5TO.VeCANR_b_MC_MCPB_STATUS_FD5TO
        COMRX_MCPB_Control_Board_Temperature_P_MCPB_STATUS_FD5_Received: symbol=ApplCanComAb_FD5_COMRX_MCPB_Control_Board_Temperature_P_MCPB_STATUS_FD5_Received  # Received
          data-receive-point-by-arguments:
            access DRP_CanCom_FD5RxSignalsSR_COMRX_MCPB_Control_Board_Temperature_P_MCPB_STATUS_FD5: accessed-variable=CanCom_FD5RxSignalsSR.COMRX_MCPB_Control_Board_Temperature_P_MCPB_STATUS_FD5
          data-send-points:
            access DSP_VeCANR_y_MCPBCtrlBoardTempP_FD5_VeCANR_y_MCPBCtrlBoardTempP_FD5: accessed-variable=VeCANR_y_MCPBCtrlBoardTempP_FD5.VeCANR_y_MCPBCtrlBoardTempP_FD5
            access DSP_VeCANR_b_MCPBCtrlBoardTempP_FD5TO_VeCANR_b_MCPBCtrlBoardTempP_FD5TO: accessed-variable=VeCANR_b_MCPBCtrlBoardTempP_FD5TO.VeCANR_b_MCPBCtrlBoardTempP_FD5TO
        COMRX_MCPB_Control_Board_Temperature_P_MCPB_STATUS_FD5_Error: symbol=ApplCanComAb_FD5_COMRX_MCPB_Control_Board_Temperature_P_MCPB_STATUS_FD5_Error  # Error
          data-receive-point-by-arguments:
            access DRP_CanCom_FD5RxSignalsSR_COMRX_MCPB_Control_Board_Temperature_P_MCPB_STATUS_FD5: accessed-variable=CanCom_FD5RxSignalsSR.COMRX_MCPB_Control_Board_Temperature_P_MCPB_STATUS_FD5
          data-send-points:
            access DSP_VeCANR_y_MCPBCtrlBoardTempP_FD5_VeCANR_y_MCPBCtrlBoardTempP_FD5: accessed-variable=VeCANR_y_MCPBCtrlBoardTempP_FD5.VeCANR_y_MCPBCtrlBoardTempP_FD5
            access DSP_VeCANR_b_MCPBCtrlBoardTempP_FD5TO_VeCANR_b_MCPBCtrlBoardTempP_FD5TO: accessed-variable=VeCANR_b_MCPBCtrlBoardTempP_FD5TO.VeCANR_b_MCPBCtrlBoardTempP_FD5TO
        COMRX_MCPB_CoolantTemp_P_MCPB_STATUS_FD5_Received: symbol=ApplCanComAb_FD5_COMRX_MCPB_CoolantTemp_P_MCPB_STATUS_FD5_Received  # Received
          data-receive-point-by-arguments:
            access DRP_CanCom_FD5RxSignalsSR_COMRX_MCPB_CoolantTemp_P_MCPB_STATUS_FD5: accessed-variable=CanCom_FD5RxSignalsSR.COMRX_MCPB_CoolantTemp_P_MCPB_STATUS_FD5
          data-send-points:
            access DSP_VeCANR_T_MCPB_CoolantTemp_P_FD5_VeCANR_T_MCPB_CoolantTemp_P_FD5: accessed-variable=VeCANR_T_MCPB_CoolantTemp_P_FD5.VeCANR_T_MCPB_CoolantTemp_P_FD5
            access DSP_VeCANR_b_MCPB_CoolantTemp_P_FD5TO_VeCANR_b_MCPB_CoolantTemp_P_FD5TO: accessed-variable=VeCANR_b_MCPB_CoolantTemp_P_FD5TO.VeCANR_b_MCPB_CoolantTemp_P_FD5TO
        COMRX_MCPB_CoolantTemp_P_MCPB_STATUS_FD5_Error: symbol=ApplCanComAb_FD5_COMRX_MCPB_CoolantTemp_P_MCPB_STATUS_FD5_Error  # Error
          data-receive-point-by-arguments:
            access DRP_CanCom_FD5RxSignalsSR_COMRX_MCPB_CoolantTemp_P_MCPB_STATUS_FD5: accessed-variable=CanCom_FD5RxSignalsSR.COMRX_MCPB_CoolantTemp_P_MCPB_STATUS_FD5
          data-send-points:
            access DSP_VeCANR_T_MCPB_CoolantTemp_P_FD5_VeCANR_T_MCPB_CoolantTemp_P_FD5: accessed-variable=VeCANR_T_MCPB_CoolantTemp_P_FD5.VeCANR_T_MCPB_CoolantTemp_P_FD5
            access DSP_VeCANR_b_MCPB_CoolantTemp_P_FD5TO_VeCANR_b_MCPB_CoolantTemp_P_FD5TO: accessed-variable=VeCANR_b_MCPB_CoolantTemp_P_FD5TO.VeCANR_b_MCPB_CoolantTemp_P_FD5TO
        COMRX_MCPB_DC_Current_P_MCPB_STATUS_FD5_Received: symbol=ApplCanComAb_FD5_COMRX_MCPB_DC_Current_P_MCPB_STATUS_FD5_Received  # Received
          data-receive-point-by-arguments:
            access DRP_CanCom_FD5RxSignalsSR_COMRX_MCPB_DC_Current_P_MCPB_STATUS_FD5: accessed-variable=CanCom_FD5RxSignalsSR.COMRX_MCPB_DC_Current_P_MCPB_STATUS_FD5
          data-send-points:
            access DSP_VeCANR_I_MCPB_DC_Current_P_FD5_VeCANR_I_MCPB_DC_Current_P_FD5: accessed-variable=VeCANR_I_MCPB_DC_Current_P_FD5.VeCANR_I_MCPB_DC_Current_P_FD5
            access DSP_VeCANR_b_MCPB_DC_Current_P_FD5TO_VeCANR_b_MCPB_DC_Current_P_FD5TO: accessed-variable=VeCANR_b_MCPB_DC_Current_P_FD5TO.VeCANR_b_MCPB_DC_Current_P_FD5TO
        COMRX_MCPB_DC_Current_P_MCPB_STATUS_FD5_Error: symbol=ApplCanComAb_FD5_COMRX_MCPB_DC_Current_P_MCPB_STATUS_FD5_Error  # Error
          data-receive-point-by-arguments:
            access DRP_CanCom_FD5RxSignalsSR_COMRX_MCPB_DC_Current_P_MCPB_STATUS_FD5: accessed-variable=CanCom_FD5RxSignalsSR.COMRX_MCPB_DC_Current_P_MCPB_STATUS_FD5
          data-send-points:
            access DSP_VeCANR_I_MCPB_DC_Current_P_FD5_VeCANR_I_MCPB_DC_Current_P_FD5: accessed-variable=VeCANR_I_MCPB_DC_Current_P_FD5.VeCANR_I_MCPB_DC_Current_P_FD5
            access DSP_VeCANR_b_MCPB_DC_Current_P_FD5TO_VeCANR_b_MCPB_DC_Current_P_FD5TO: accessed-variable=VeCANR_b_MCPB_DC_Current_P_FD5TO.VeCANR_b_MCPB_DC_Current_P_FD5TO
        COMRX_MCPB_DC_Current_V_P_MCPB_STATUS_FD5_Received: symbol=ApplCanComAb_FD5_COMRX_MCPB_DC_Current_V_P_MCPB_STATUS_FD5_Received  # Received
          data-receive-point-by-arguments:
            access DRP_CanCom_FD5RxSignalsSR_COMRX_MCPB_DC_Current_V_P_MCPB_STATUS_FD5: accessed-variable=CanCom_FD5RxSignalsSR.COMRX_MCPB_DC_Current_V_P_MCPB_STATUS_FD5
          data-send-points:
            access DSP_VeCANR_b_MCPB_DC_Crrent_V_P_FD5_VeCANR_b_MCPB_DC_Crrent_V_P_FD5: accessed-variable=VeCANR_b_MCPB_DC_Crrent_V_P_FD5.VeCANR_b_MCPB_DC_Crrent_V_P_FD5
            access DSP_VeCANR_b_MCPB_DC_Crrent_V_P_FD5TO_VeCANR_b_MCPB_DC_Crrent_V_P_FD5TO: accessed-variable=VeCANR_b_MCPB_DC_Crrent_V_P_FD5TO.VeCANR_b_MCPB_DC_Crrent_V_P_FD5TO
        COMRX_MCPB_DC_Current_V_P_MCPB_STATUS_FD5_Error: symbol=ApplCanComAb_FD5_COMRX_MCPB_DC_Current_V_P_MCPB_STATUS_FD5_Error  # Error
          data-receive-point-by-arguments:
            access DRP_CanCom_FD5RxSignalsSR_COMRX_MCPB_DC_Current_V_P_MCPB_STATUS_FD5: accessed-variable=CanCom_FD5RxSignalsSR.COMRX_MCPB_DC_Current_V_P_MCPB_STATUS_FD5
          data-send-points:
            access DSP_VeCANR_b_MCPB_DC_Crrent_V_P_FD5_VeCANR_b_MCPB_DC_Crrent_V_P_FD5: accessed-variable=VeCANR_b_MCPB_DC_Crrent_V_P_FD5.VeCANR_b_MCPB_DC_Crrent_V_P_FD5
            access DSP_VeCANR_b_MCPB_DC_Crrent_V_P_FD5TO_VeCANR_b_MCPB_DC_Crrent_V_P_FD5TO: accessed-variable=VeCANR_b_MCPB_DC_Crrent_V_P_FD5TO.VeCANR_b_MCPB_DC_Crrent_V_P_FD5TO
        COMRX_MCPB_DC_Volt_V_P_MCPB_STATUS_FD5_Received: symbol=ApplCanComAb_FD5_COMRX_MCPB_DC_Volt_V_P_MCPB_STATUS_FD5_Received  # Received
          data-receive-point-by-arguments:
            access DRP_CanCom_FD5RxSignalsSR_COMRX_MCPB_DC_Volt_V_P_MCPB_STATUS_FD5: accessed-variable=CanCom_FD5RxSignalsSR.COMRX_MCPB_DC_Volt_V_P_MCPB_STATUS_FD5
          data-send-points:
            access DSP_VeCANR_b_MCPB_DC_Volt_V_P_FD5_VeCANR_b_MCPB_DC_Volt_V_P_FD5: accessed-variable=VeCANR_b_MCPB_DC_Volt_V_P_FD5.VeCANR_b_MCPB_DC_Volt_V_P_FD5
            access DSP_VeCANR_b_MCPB_DC_Volt_V_P_FD5TO_VeCANR_b_MCPB_DC_Volt_V_P_FD5TO: accessed-variable=VeCANR_b_MCPB_DC_Volt_V_P_FD5TO.VeCANR_b_MCPB_DC_Volt_V_P_FD5TO
        COMRX_MCPB_DC_Volt_V_P_MCPB_STATUS_FD5_Error: symbol=ApplCanComAb_FD5_COMRX_MCPB_DC_Volt_V_P_MCPB_STATUS_FD5_Error  # Error
          data-receive-point-by-arguments:
            access DRP_CanCom_FD5RxSignalsSR_COMRX_MCPB_DC_Volt_V_P_MCPB_STATUS_FD5: accessed-variable=CanCom_FD5RxSignalsSR.COMRX_MCPB_DC_Volt_V_P_MCPB_STATUS_FD5
          data-send-points:
            access DSP_VeCANR_b_MCPB_DC_Volt_V_P_FD5_VeCANR_b_MCPB_DC_Volt_V_P_FD5: accessed-variable=VeCANR_b_MCPB_DC_Volt_V_P_FD5.VeCANR_b_MCPB_DC_Volt_V_P_FD5
            access DSP_VeCANR_b_MCPB_DC_Volt_V_P_FD5TO_VeCANR_b_MCPB_DC_Volt_V_P_FD5TO: accessed-variable=VeCANR_b_MCPB_DC_Volt_V_P_FD5TO.VeCANR_b_MCPB_DC_Volt_V_P_FD5TO
        COMRX_MCPB_DC_Voltage_P_MCPB_STATUS_FD5_Received: symbol=ApplCanComAb_FD5_COMRX_MCPB_DC_Voltage_P_MCPB_STATUS_FD5_Received  # Received
          data-receive-point-by-arguments:
            access DRP_CanCom_FD5RxSignalsSR_COMRX_MCPB_DC_Voltage_P_MCPB_STATUS_FD5: accessed-variable=CanCom_FD5RxSignalsSR.COMRX_MCPB_DC_Voltage_P_MCPB_STATUS_FD5
          data-send-points:
            access DSP_VeCANR_U_MCPB_DC_Voltage_P_FD5_VeCANR_U_MCPB_DC_Voltage_P_FD5: accessed-variable=VeCANR_U_MCPB_DC_Voltage_P_FD5.VeCANR_U_MCPB_DC_Voltage_P_FD5
            access DSP_VeCANR_b_MCPB_DC_Voltage_P_FD5TO_VeCANR_b_MCPB_DC_Voltage_P_FD5TO: accessed-variable=VeCANR_b_MCPB_DC_Voltage_P_FD5TO.VeCANR_b_MCPB_DC_Voltage_P_FD5TO
        COMRX_MCPB_DC_Voltage_P_MCPB_STATUS_FD5_Error: symbol=ApplCanComAb_FD5_COMRX_MCPB_DC_Voltage_P_MCPB_STATUS_FD5_Error  # Error
          data-receive-point-by-arguments:
            access DRP_CanCom_FD5RxSignalsSR_COMRX_MCPB_DC_Voltage_P_MCPB_STATUS_FD5: accessed-variable=CanCom_FD5RxSignalsSR.COMRX_MCPB_DC_Voltage_P_MCPB_STATUS_FD5
          data-send-points:
            access DSP_VeCANR_U_MCPB_DC_Voltage_P_FD5_VeCANR_U_MCPB_DC_Voltage_P_FD5: accessed-variable=VeCANR_U_MCPB_DC_Voltage_P_FD5.VeCANR_U_MCPB_DC_Voltage_P_FD5
            access DSP_VeCANR_b_MCPB_DC_Voltage_P_FD5TO_VeCANR_b_MCPB_DC_Voltage_P_FD5TO: accessed-variable=VeCANR_b_MCPB_DC_Voltage_P_FD5TO.VeCANR_b_MCPB_DC_Voltage_P_FD5TO
        COMRX_MCPB_DerateReason_P_MCPB_STATUS_FD5_Received: symbol=ApplCanComAb_FD5_COMRX_MCPB_DerateReason_P_MCPB_STATUS_FD5_Received  # Received
          data-receive-point-by-arguments:
            access DRP_CanCom_FD5RxSignalsSR_COMRX_MCPB_DerateReason_P_MCPB_STATUS_FD5: accessed-variable=CanCom_FD5RxSignalsSR.COMRX_MCPB_DerateReason_P_MCPB_STATUS_FD5
          data-send-points:
            access DSP_VeCANR_e_MCPB_DrateReason_P_FD5_VeCANR_e_MCPB_DrateReason_P_FD5: accessed-variable=VeCANR_e_MCPB_DrateReason_P_FD5.VeCANR_e_MCPB_DrateReason_P_FD5
            access DSP_VeCANR_b_MCPB_DrateReason_P_FD5TO_VeCANR_b_MCPB_DrateReason_P_FD5TO: accessed-variable=VeCANR_b_MCPB_DrateReason_P_FD5TO.VeCANR_b_MCPB_DrateReason_P_FD5TO
        COMRX_MCPB_DerateReason_P_MCPB_STATUS_FD5_Error: symbol=ApplCanComAb_FD5_COMRX_MCPB_DerateReason_P_MCPB_STATUS_FD5_Error  # Error
          data-receive-point-by-arguments:
            access DRP_CanCom_FD5RxSignalsSR_COMRX_MCPB_DerateReason_P_MCPB_STATUS_FD5: accessed-variable=CanCom_FD5RxSignalsSR.COMRX_MCPB_DerateReason_P_MCPB_STATUS_FD5
          data-send-points:
            access DSP_VeCANR_e_MCPB_DrateReason_P_FD5_VeCANR_e_MCPB_DrateReason_P_FD5: accessed-variable=VeCANR_e_MCPB_DrateReason_P_FD5.VeCANR_e_MCPB_DrateReason_P_FD5
            access DSP_VeCANR_b_MCPB_DrateReason_P_FD5TO_VeCANR_b_MCPB_DrateReason_P_FD5TO: accessed-variable=VeCANR_b_MCPB_DrateReason_P_FD5TO.VeCANR_b_MCPB_DrateReason_P_FD5TO
        COMRX_MCPB_Inverter_Temp_P_MCPB_STATUS_FD5_Received: symbol=ApplCanComAb_FD5_COMRX_MCPB_Inverter_Temp_P_MCPB_STATUS_FD5_Received  # Received
          data-receive-point-by-arguments:
            access DRP_CanCom_FD5RxSignalsSR_COMRX_MCPB_Inverter_Temp_P_MCPB_STATUS_FD5: accessed-variable=CanCom_FD5RxSignalsSR.COMRX_MCPB_Inverter_Temp_P_MCPB_STATUS_FD5
          data-send-points:
            access DSP_VeCANR_T_MCPB_Invert_Temp_P_FD5_VeCANR_T_MCPB_Invert_Temp_P_FD5: accessed-variable=VeCANR_T_MCPB_Invert_Temp_P_FD5.VeCANR_T_MCPB_Invert_Temp_P_FD5
            access DSP_VeCANR_b_MCPB_Invert_Temp_P_FD5TO_VeCANR_b_MCPB_Invert_Temp_P_FD5TO: accessed-variable=VeCANR_b_MCPB_Invert_Temp_P_FD5TO.VeCANR_b_MCPB_Invert_Temp_P_FD5TO
        COMRX_MCPB_Inverter_Temp_P_MCPB_STATUS_FD5_Error: symbol=ApplCanComAb_FD5_COMRX_MCPB_Inverter_Temp_P_MCPB_STATUS_FD5_Error  # Error
          data-receive-point-by-arguments:
            access DRP_CanCom_FD5RxSignalsSR_COMRX_MCPB_Inverter_Temp_P_MCPB_STATUS_FD5: accessed-variable=CanCom_FD5RxSignalsSR.COMRX_MCPB_Inverter_Temp_P_MCPB_STATUS_FD5
          data-send-points:
            access DSP_VeCANR_T_MCPB_Invert_Temp_P_FD5_VeCANR_T_MCPB_Invert_Temp_P_FD5: accessed-variable=VeCANR_T_MCPB_Invert_Temp_P_FD5.VeCANR_T_MCPB_Invert_Temp_P_FD5
            access DSP_VeCANR_b_MCPB_Invert_Temp_P_FD5TO_VeCANR_b_MCPB_Invert_Temp_P_FD5TO: accessed-variable=VeCANR_b_MCPB_Invert_Temp_P_FD5TO.VeCANR_b_MCPB_Invert_Temp_P_FD5TO
        COMRX_MCPB_PIM_DC_Side_Busbar_Temp_P_MCPB_STATUS_FD5_Received: symbol=ApplCanComAb_FD5_COMRX_MCPB_PIM_DC_Side_Busbar_Temp_P_MCPB_STATUS_FD5_Received  # Received
          data-receive-point-by-arguments:
            access DRP_CanCom_FD5RxSignalsSR_COMRX_MCPB_PIM_DC_Side_Busbar_Temp_P_MCPB_STATUS_FD5: accessed-variable=CanCom_FD5RxSignalsSR.COMRX_MCPB_PIM_DC_Side_Busbar_Temp_P_MCPB_STATUS_FD5
          data-send-points:
            access DSP_VeCANR_T_MCPBIMDCSdBusTempPFD5_VeCANR_T_MCPBIMDCSdBusTempPFD5: accessed-variable=VeCANR_T_MCPBIMDCSdBusTempPFD5.VeCANR_T_MCPBIMDCSdBusTempPFD5
            access DSP_VeCANR_b_MCPBIMDCSdBusTempPFD5TO_VeCANR_b_MCPBIMDCSdBusTempPFD5TO: accessed-variable=VeCANR_b_MCPBIMDCSdBusTempPFD5TO.VeCANR_b_MCPBIMDCSdBusTempPFD5TO
        COMRX_MCPB_PIM_DC_Side_Busbar_Temp_P_MCPB_STATUS_FD5_Error: symbol=ApplCanComAb_FD5_COMRX_MCPB_PIM_DC_Side_Busbar_Temp_P_MCPB_STATUS_FD5_Error  # Error
          data-receive-point-by-arguments:
            access DRP_CanCom_FD5RxSignalsSR_COMRX_MCPB_PIM_DC_Side_Busbar_Temp_P_MCPB_STATUS_FD5: accessed-variable=CanCom_FD5RxSignalsSR.COMRX_MCPB_PIM_DC_Side_Busbar_Temp_P_MCPB_STATUS_FD5
          data-send-points:
            access DSP_VeCANR_T_MCPBIMDCSdBusTempPFD5_VeCANR_T_MCPBIMDCSdBusTempPFD5: accessed-variable=VeCANR_T_MCPBIMDCSdBusTempPFD5.VeCANR_T_MCPBIMDCSdBusTempPFD5
            access DSP_VeCANR_b_MCPBIMDCSdBusTempPFD5TO_VeCANR_b_MCPBIMDCSdBusTempPFD5TO: accessed-variable=VeCANR_b_MCPBIMDCSdBusTempPFD5TO.VeCANR_b_MCPBIMDCSdBusTempPFD5TO
        COMRX_MCPB_Rotor_Temperature_P_MCPB_STATUS_FD5_Received: symbol=ApplCanComAb_FD5_COMRX_MCPB_Rotor_Temperature_P_MCPB_STATUS_FD5_Received  # Received
          data-receive-point-by-arguments:
            access DRP_CanCom_FD5RxSignalsSR_COMRX_MCPB_Rotor_Temperature_P_MCPB_STATUS_FD5: accessed-variable=CanCom_FD5RxSignalsSR.COMRX_MCPB_Rotor_Temperature_P_MCPB_STATUS_FD5
          data-send-points:
            access DSP_VeCANR_T_MCPBRotorTemp_P_FD5_VeCANR_T_MCPBRotorTemp_P_FD5: accessed-variable=VeCANR_T_MCPBRotorTemp_P_FD5.VeCANR_T_MCPBRotorTemp_P_FD5
            access DSP_VeCANR_b_MCPBRotorTemp_P_FD5TO_VeCANR_b_MCPBRotorTemp_P_FD5TO: accessed-variable=VeCANR_b_MCPBRotorTemp_P_FD5TO.VeCANR_b_MCPBRotorTemp_P_FD5TO
        COMRX_MCPB_Rotor_Temperature_P_MCPB_STATUS_FD5_Error: symbol=ApplCanComAb_FD5_COMRX_MCPB_Rotor_Temperature_P_MCPB_STATUS_FD5_Error  # Error
          data-receive-point-by-arguments:
            access DRP_CanCom_FD5RxSignalsSR_COMRX_MCPB_Rotor_Temperature_P_MCPB_STATUS_FD5: accessed-variable=CanCom_FD5RxSignalsSR.COMRX_MCPB_Rotor_Temperature_P_MCPB_STATUS_FD5
          data-send-points:
            access DSP_VeCANR_T_MCPBRotorTemp_P_FD5_VeCANR_T_MCPBRotorTemp_P_FD5: accessed-variable=VeCANR_T_MCPBRotorTemp_P_FD5.VeCANR_T_MCPBRotorTemp_P_FD5
            access DSP_VeCANR_b_MCPBRotorTemp_P_FD5TO_VeCANR_b_MCPBRotorTemp_P_FD5TO: accessed-variable=VeCANR_b_MCPBRotorTemp_P_FD5TO.VeCANR_b_MCPBRotorTemp_P_FD5TO
        COMRX_MCPB_Service_Lamp_Request_P_MCPB_STATUS_FD5_Received: symbol=ApplCanComAb_FD5_COMRX_MCPB_Service_Lamp_Request_P_MCPB_STATUS_FD5_Received  # Received
          data-receive-point-by-arguments:
            access DRP_CanCom_FD5RxSignalsSR_COMRX_MCPB_Service_Lamp_Request_P_MCPB_STATUS_FD5: accessed-variable=CanCom_FD5RxSignalsSR.COMRX_MCPB_Service_Lamp_Request_P_MCPB_STATUS_FD5
          data-send-points:
            access DSP_VeCANR_b_MCPBServLampReq_P_FD5_VeCANR_b_MCPBServLampReq_P_FD5: accessed-variable=VeCANR_b_MCPBServLampReq_P_FD5.VeCANR_b_MCPBServLampReq_P_FD5
            access DSP_VeCANR_b_MCPBServLampReq_P_FD5TO_VeCANR_b_MCPBServLampReq_P_FD5TO: accessed-variable=VeCANR_b_MCPBServLampReq_P_FD5TO.VeCANR_b_MCPBServLampReq_P_FD5TO
        COMRX_MCPB_Service_Lamp_Request_P_MCPB_STATUS_FD5_Error: symbol=ApplCanComAb_FD5_COMRX_MCPB_Service_Lamp_Request_P_MCPB_STATUS_FD5_Error  # Error
          data-receive-point-by-arguments:
            access DRP_CanCom_FD5RxSignalsSR_COMRX_MCPB_Service_Lamp_Request_P_MCPB_STATUS_FD5: accessed-variable=CanCom_FD5RxSignalsSR.COMRX_MCPB_Service_Lamp_Request_P_MCPB_STATUS_FD5
          data-send-points:
            access DSP_VeCANR_b_MCPBServLampReq_P_FD5_VeCANR_b_MCPBServLampReq_P_FD5: accessed-variable=VeCANR_b_MCPBServLampReq_P_FD5.VeCANR_b_MCPBServLampReq_P_FD5
            access DSP_VeCANR_b_MCPBServLampReq_P_FD5TO_VeCANR_b_MCPBServLampReq_P_FD5TO: accessed-variable=VeCANR_b_MCPBServLampReq_P_FD5TO.VeCANR_b_MCPBServLampReq_P_FD5TO
        COMRX_V2H_HVCMS_EVSEMaxPowerLimit_RPF_FD_1_FD5_Received: symbol=ApplCanComAb_FD5_COMRX_V2H_HVCMS_EVSEMaxPowerLimit_RPF_FD_1_FD5_Received  # Received
          data-receive-point-by-arguments:
            access DRP_CanCom_FD5RxSignalsSR_COMRX_V2H_HVCMS_EVSEMaxPowerLimit_RPF_FD_1_FD5: accessed-variable=CanCom_FD5RxSignalsSR.COMRX_V2H_HVCMS_EVSEMaxPowerLimit_RPF_FD_1_FD5
          data-send-points:
            access DSP_VeCANR_P_V2H_HVCMS_EVSEMxPLtFD5_VeCANR_P_V2H_HVCMS_EVSEMxPLtFD5: accessed-variable=VeCANR_P_V2H_HVCMS_EVSEMxPLtFD5.VeCANR_P_V2H_HVCMS_EVSEMxPLtFD5
            access DSP_VeCANR_b_V2H_HVCMS_EVSEMxPLtFD5TO_VeCANR_b_V2H_HVCMS_EVSEMxPLtFD5TO: accessed-variable=VeCANR_b_V2H_HVCMS_EVSEMxPLtFD5TO.VeCANR_b_V2H_HVCMS_EVSEMxPLtFD5TO
        COMRX_V2H_HVCMS_EVSEMaxPowerLimit_RPF_FD_1_FD5_Error: symbol=ApplCanComAb_FD5_COMRX_V2H_HVCMS_EVSEMaxPowerLimit_RPF_FD_1_FD5_Error  # Error
          data-receive-point-by-arguments:
            access DRP_CanCom_FD5RxSignalsSR_COMRX_V2H_HVCMS_EVSEMaxPowerLimit_RPF_FD_1_FD5: accessed-variable=CanCom_FD5RxSignalsSR.COMRX_V2H_HVCMS_EVSEMaxPowerLimit_RPF_FD_1_FD5
          data-send-points:
            access DSP_VeCANR_P_V2H_HVCMS_EVSEMxPLtFD5_VeCANR_P_V2H_HVCMS_EVSEMxPLtFD5: accessed-variable=VeCANR_P_V2H_HVCMS_EVSEMxPLtFD5.VeCANR_P_V2H_HVCMS_EVSEMxPLtFD5
            access DSP_VeCANR_b_V2H_HVCMS_EVSEMxPLtFD5TO_VeCANR_b_V2H_HVCMS_EVSEMxPLtFD5TO: accessed-variable=VeCANR_b_V2H_HVCMS_EVSEMxPLtFD5TO.VeCANR_b_V2H_HVCMS_EVSEMxPLtFD5TO
        COMRX_CLrDiagInfo_SGCP_P_SGCP_STATUS_FD5_Received: symbol=ApplCanComAb_FD5_COMRX_CLrDiagInfo_SGCP_P_SGCP_STATUS_FD5_Received  # Received
          data-receive-point-by-arguments:
            access DRP_CanCom_FD5RxSignalsSR_COMRX_CLrDiagInfo_SGCP_P_SGCP_STATUS_FD5: accessed-variable=CanCom_FD5RxSignalsSR.COMRX_CLrDiagInfo_SGCP_P_SGCP_STATUS_FD5
          data-send-points:
            access DSP_VeCANR_b_CLrDiagInfo_SGCP_P_FD5_VeCANR_b_CLrDiagInfo_SGCP_P_FD5: accessed-variable=VeCANR_b_CLrDiagInfo_SGCP_P_FD5.VeCANR_b_CLrDiagInfo_SGCP_P_FD5
            access DSP_VeCANR_b_CLrDiagInfo_SGCP_P_FD5TO_VeCANR_b_CLrDiagInfo_SGCP_P_FD5TO: accessed-variable=VeCANR_b_CLrDiagInfo_SGCP_P_FD5TO.VeCANR_b_CLrDiagInfo_SGCP_P_FD5TO
        COMRX_CLrDiagInfo_SGCP_P_SGCP_STATUS_FD5_Error: symbol=ApplCanComAb_FD5_COMRX_CLrDiagInfo_SGCP_P_SGCP_STATUS_FD5_Error  # Error
          data-receive-point-by-arguments:
            access DRP_CanCom_FD5RxSignalsSR_COMRX_CLrDiagInfo_SGCP_P_SGCP_STATUS_FD5: accessed-variable=CanCom_FD5RxSignalsSR.COMRX_CLrDiagInfo_SGCP_P_SGCP_STATUS_FD5
          data-send-points:
            access DSP_VeCANR_b_CLrDiagInfo_SGCP_P_FD5_VeCANR_b_CLrDiagInfo_SGCP_P_FD5: accessed-variable=VeCANR_b_CLrDiagInfo_SGCP_P_FD5.VeCANR_b_CLrDiagInfo_SGCP_P_FD5
            access DSP_VeCANR_b_CLrDiagInfo_SGCP_P_FD5TO_VeCANR_b_CLrDiagInfo_SGCP_P_FD5TO: accessed-variable=VeCANR_b_CLrDiagInfo_SGCP_P_FD5TO.VeCANR_b_CLrDiagInfo_SGCP_P_FD5TO
        COMRX_CRC_SGCP_STATUS_SGCP_STATUS_FD5_Received: symbol=ApplCanComAb_FD5_COMRX_CRC_SGCP_STATUS_SGCP_STATUS_FD5_Received  # Received
          data-receive-point-by-arguments:
            access DRP_CanCom_FD5RxSignalsSR_COMRX_CRC_SGCP_STATUS_SGCP_STATUS_FD5: accessed-variable=CanCom_FD5RxSignalsSR.COMRX_CRC_SGCP_STATUS_SGCP_STATUS_FD5
          data-send-points:
            access DSP_VeCANR_y_CRC_SGCP_STATUS_FD5_VeCANR_y_CRC_SGCP_STATUS_FD5: accessed-variable=VeCANR_y_CRC_SGCP_STATUS_FD5.VeCANR_y_CRC_SGCP_STATUS_FD5
            access DSP_VeCANR_b_CRC_SGCP_STATUS_FD5TO_VeCANR_b_CRC_SGCP_STATUS_FD5TO: accessed-variable=VeCANR_b_CRC_SGCP_STATUS_FD5TO.VeCANR_b_CRC_SGCP_STATUS_FD5TO
        COMRX_CRC_SGCP_STATUS_SGCP_STATUS_FD5_Error: symbol=ApplCanComAb_FD5_COMRX_CRC_SGCP_STATUS_SGCP_STATUS_FD5_Error  # Error
          data-receive-point-by-arguments:
            access DRP_CanCom_FD5RxSignalsSR_COMRX_CRC_SGCP_STATUS_SGCP_STATUS_FD5: accessed-variable=CanCom_FD5RxSignalsSR.COMRX_CRC_SGCP_STATUS_SGCP_STATUS_FD5
          data-send-points:
            access DSP_VeCANR_y_CRC_SGCP_STATUS_FD5_VeCANR_y_CRC_SGCP_STATUS_FD5: accessed-variable=VeCANR_y_CRC_SGCP_STATUS_FD5.VeCANR_y_CRC_SGCP_STATUS_FD5
            access DSP_VeCANR_b_CRC_SGCP_STATUS_FD5TO_VeCANR_b_CRC_SGCP_STATUS_FD5TO: accessed-variable=VeCANR_b_CRC_SGCP_STATUS_FD5TO.VeCANR_b_CRC_SGCP_STATUS_FD5TO
        COMRX_MC_SGCP_STATUS_SGCP_STATUS_FD5_Received: symbol=ApplCanComAb_FD5_COMRX_MC_SGCP_STATUS_SGCP_STATUS_FD5_Received  # Received
          data-receive-point-by-arguments:
            access DRP_CanCom_FD5RxSignalsSR_COMRX_MC_SGCP_STATUS_SGCP_STATUS_FD5: accessed-variable=CanCom_FD5RxSignalsSR.COMRX_MC_SGCP_STATUS_SGCP_STATUS_FD5
          data-send-points:
            access DSP_VeCANR_y_MC_SGCP_STATUS_FD5_VeCANR_y_MC_SGCP_STATUS_FD5: accessed-variable=VeCANR_y_MC_SGCP_STATUS_FD5.VeCANR_y_MC_SGCP_STATUS_FD5
            access DSP_VeCANR_b_MC_SGCP_STATUS_FD5TO_VeCANR_b_MC_SGCP_STATUS_FD5TO: accessed-variable=VeCANR_b_MC_SGCP_STATUS_FD5TO.VeCANR_b_MC_SGCP_STATUS_FD5TO
        COMRX_MC_SGCP_STATUS_SGCP_STATUS_FD5_Error: symbol=ApplCanComAb_FD5_COMRX_MC_SGCP_STATUS_SGCP_STATUS_FD5_Error  # Error
          data-receive-point-by-arguments:
            access DRP_CanCom_FD5RxSignalsSR_COMRX_MC_SGCP_STATUS_SGCP_STATUS_FD5: accessed-variable=CanCom_FD5RxSignalsSR.COMRX_MC_SGCP_STATUS_SGCP_STATUS_FD5
          data-send-points:
            access DSP_VeCANR_y_MC_SGCP_STATUS_FD5_VeCANR_y_MC_SGCP_STATUS_FD5: accessed-variable=VeCANR_y_MC_SGCP_STATUS_FD5.VeCANR_y_MC_SGCP_STATUS_FD5
            access DSP_VeCANR_b_MC_SGCP_STATUS_FD5TO_VeCANR_b_MC_SGCP_STATUS_FD5TO: accessed-variable=VeCANR_b_MC_SGCP_STATUS_FD5TO.VeCANR_b_MC_SGCP_STATUS_FD5TO
        COMRX_SGCP_Control_Board_Temperature_P_SGCP_STATUS_FD5_Received: symbol=ApplCanComAb_FD5_COMRX_SGCP_Control_Board_Temperature_P_SGCP_STATUS_FD5_Received  # Received
          data-receive-point-by-arguments:
            access DRP_CanCom_FD5RxSignalsSR_COMRX_SGCP_Control_Board_Temperature_P_SGCP_STATUS_FD5: accessed-variable=CanCom_FD5RxSignalsSR.COMRX_SGCP_Control_Board_Temperature_P_SGCP_STATUS_FD5
          data-send-points:
            access DSP_VeCANR_T_SGCPCtrlBoardTempP_FD5_VeCANR_T_SGCPCtrlBoardTempP_FD5: accessed-variable=VeCANR_T_SGCPCtrlBoardTempP_FD5.VeCANR_T_SGCPCtrlBoardTempP_FD5
            access DSP_VeCANR_b_SGCPCtrlBoardTempP_FD5TO_VeCANR_b_SGCPCtrlBoardTempP_FD5TO: accessed-variable=VeCANR_b_SGCPCtrlBoardTempP_FD5TO.VeCANR_b_SGCPCtrlBoardTempP_FD5TO
        COMRX_SGCP_Control_Board_Temperature_P_SGCP_STATUS_FD5_Error: symbol=ApplCanComAb_FD5_COMRX_SGCP_Control_Board_Temperature_P_SGCP_STATUS_FD5_Error  # Error
          data-receive-point-by-arguments:
            access DRP_CanCom_FD5RxSignalsSR_COMRX_SGCP_Control_Board_Temperature_P_SGCP_STATUS_FD5: accessed-variable=CanCom_FD5RxSignalsSR.COMRX_SGCP_Control_Board_Temperature_P_SGCP_STATUS_FD5
          data-send-points:
            access DSP_VeCANR_T_SGCPCtrlBoardTempP_FD5_VeCANR_T_SGCPCtrlBoardTempP_FD5: accessed-variable=VeCANR_T_SGCPCtrlBoardTempP_FD5.VeCANR_T_SGCPCtrlBoardTempP_FD5
            access DSP_VeCANR_b_SGCPCtrlBoardTempP_FD5TO_VeCANR_b_SGCPCtrlBoardTempP_FD5TO: accessed-variable=VeCANR_b_SGCPCtrlBoardTempP_FD5TO.VeCANR_b_SGCPCtrlBoardTempP_FD5TO
        COMRX_SGCP_CoolantTemp_P_SGCP_STATUS_FD5_Received: symbol=ApplCanComAb_FD5_COMRX_SGCP_CoolantTemp_P_SGCP_STATUS_FD5_Received  # Received
          data-receive-point-by-arguments:
            access DRP_CanCom_FD5RxSignalsSR_COMRX_SGCP_CoolantTemp_P_SGCP_STATUS_FD5: accessed-variable=CanCom_FD5RxSignalsSR.COMRX_SGCP_CoolantTemp_P_SGCP_STATUS_FD5
          data-send-points:
            access DSP_VeCANR_T_SGCP_CoolantTemp_P_FD5_VeCANR_T_SGCP_CoolantTemp_P_FD5: accessed-variable=VeCANR_T_SGCP_CoolantTemp_P_FD5.VeCANR_T_SGCP_CoolantTemp_P_FD5
            access DSP_VeCANR_b_SGCP_CoolantTemp_P_FD5TO_VeCANR_b_SGCP_CoolantTemp_P_FD5TO: accessed-variable=VeCANR_b_SGCP_CoolantTemp_P_FD5TO.VeCANR_b_SGCP_CoolantTemp_P_FD5TO
        COMRX_SGCP_CoolantTemp_P_SGCP_STATUS_FD5_Error: symbol=ApplCanComAb_FD5_COMRX_SGCP_CoolantTemp_P_SGCP_STATUS_FD5_Error  # Error
          data-receive-point-by-arguments:
            access DRP_CanCom_FD5RxSignalsSR_COMRX_SGCP_CoolantTemp_P_SGCP_STATUS_FD5: accessed-variable=CanCom_FD5RxSignalsSR.COMRX_SGCP_CoolantTemp_P_SGCP_STATUS_FD5
          data-send-points:
            access DSP_VeCANR_T_SGCP_CoolantTemp_P_FD5_VeCANR_T_SGCP_CoolantTemp_P_FD5: accessed-variable=VeCANR_T_SGCP_CoolantTemp_P_FD5.VeCANR_T_SGCP_CoolantTemp_P_FD5
            access DSP_VeCANR_b_SGCP_CoolantTemp_P_FD5TO_VeCANR_b_SGCP_CoolantTemp_P_FD5TO: accessed-variable=VeCANR_b_SGCP_CoolantTemp_P_FD5TO.VeCANR_b_SGCP_CoolantTemp_P_FD5TO
        COMRX_SGCP_DC_Current_P_SGCP_STATUS_FD5_Received: symbol=ApplCanComAb_FD5_COMRX_SGCP_DC_Current_P_SGCP_STATUS_FD5_Received  # Received
          data-receive-point-by-arguments:
            access DRP_CanCom_FD5RxSignalsSR_COMRX_SGCP_DC_Current_P_SGCP_STATUS_FD5: accessed-variable=CanCom_FD5RxSignalsSR.COMRX_SGCP_DC_Current_P_SGCP_STATUS_FD5
          data-send-points:
            access DSP_VeCANR_I_SGCP_DC_Current_P_FD5_VeCANR_I_SGCP_DC_Current_P_FD5: accessed-variable=VeCANR_I_SGCP_DC_Current_P_FD5.VeCANR_I_SGCP_DC_Current_P_FD5
            access DSP_VeCANR_b_SGCP_DC_Current_P_FD5TO_VeCANR_b_SGCP_DC_Current_P_FD5TO: accessed-variable=VeCANR_b_SGCP_DC_Current_P_FD5TO.VeCANR_b_SGCP_DC_Current_P_FD5TO
        COMRX_SGCP_DC_Current_P_SGCP_STATUS_FD5_Error: symbol=ApplCanComAb_FD5_COMRX_SGCP_DC_Current_P_SGCP_STATUS_FD5_Error  # Error
          data-receive-point-by-arguments:
            access DRP_CanCom_FD5RxSignalsSR_COMRX_SGCP_DC_Current_P_SGCP_STATUS_FD5: accessed-variable=CanCom_FD5RxSignalsSR.COMRX_SGCP_DC_Current_P_SGCP_STATUS_FD5
          data-send-points:
            access DSP_VeCANR_I_SGCP_DC_Current_P_FD5_VeCANR_I_SGCP_DC_Current_P_FD5: accessed-variable=VeCANR_I_SGCP_DC_Current_P_FD5.VeCANR_I_SGCP_DC_Current_P_FD5
            access DSP_VeCANR_b_SGCP_DC_Current_P_FD5TO_VeCANR_b_SGCP_DC_Current_P_FD5TO: accessed-variable=VeCANR_b_SGCP_DC_Current_P_FD5TO.VeCANR_b_SGCP_DC_Current_P_FD5TO
        COMRX_SGCP_DC_Current_V_P_SGCP_STATUS_FD5_Received: symbol=ApplCanComAb_FD5_COMRX_SGCP_DC_Current_V_P_SGCP_STATUS_FD5_Received  # Received
          data-receive-point-by-arguments:
            access DRP_CanCom_FD5RxSignalsSR_COMRX_SGCP_DC_Current_V_P_SGCP_STATUS_FD5: accessed-variable=CanCom_FD5RxSignalsSR.COMRX_SGCP_DC_Current_V_P_SGCP_STATUS_FD5
          data-send-points:
            access DSP_VeCANR_b_SGCP_DC_Crrent_V_P_FD5_VeCANR_b_SGCP_DC_Crrent_V_P_FD5: accessed-variable=VeCANR_b_SGCP_DC_Crrent_V_P_FD5.VeCANR_b_SGCP_DC_Crrent_V_P_FD5
            access DSP_VeCANR_b_SGCP_DC_Crrent_V_P_FD5TO_VeCANR_b_SGCP_DC_Crrent_V_P_FD5TO: accessed-variable=VeCANR_b_SGCP_DC_Crrent_V_P_FD5TO.VeCANR_b_SGCP_DC_Crrent_V_P_FD5TO
        COMRX_SGCP_DC_Current_V_P_SGCP_STATUS_FD5_Error: symbol=ApplCanComAb_FD5_COMRX_SGCP_DC_Current_V_P_SGCP_STATUS_FD5_Error  # Error
          data-receive-point-by-arguments:
            access DRP_CanCom_FD5RxSignalsSR_COMRX_SGCP_DC_Current_V_P_SGCP_STATUS_FD5: accessed-variable=CanCom_FD5RxSignalsSR.COMRX_SGCP_DC_Current_V_P_SGCP_STATUS_FD5
          data-send-points:
            access DSP_VeCANR_b_SGCP_DC_Crrent_V_P_FD5_VeCANR_b_SGCP_DC_Crrent_V_P_FD5: accessed-variable=VeCANR_b_SGCP_DC_Crrent_V_P_FD5.VeCANR_b_SGCP_DC_Crrent_V_P_FD5
            access DSP_VeCANR_b_SGCP_DC_Crrent_V_P_FD5TO_VeCANR_b_SGCP_DC_Crrent_V_P_FD5TO: accessed-variable=VeCANR_b_SGCP_DC_Crrent_V_P_FD5TO.VeCANR_b_SGCP_DC_Crrent_V_P_FD5TO
        COMRX_SGCP_DC_Volt_V_P_SGCP_STATUS_FD5_Received: symbol=ApplCanComAb_FD5_COMRX_SGCP_DC_Volt_V_P_SGCP_STATUS_FD5_Received  # Received
          data-receive-point-by-arguments:
            access DRP_CanCom_FD5RxSignalsSR_COMRX_SGCP_DC_Volt_V_P_SGCP_STATUS_FD5: accessed-variable=CanCom_FD5RxSignalsSR.COMRX_SGCP_DC_Volt_V_P_SGCP_STATUS_FD5
          data-send-points:
            access DSP_VeCANR_b_SGCP_DC_Volt_V_P_FD5_VeCANR_b_SGCP_DC_Volt_V_P_FD5: accessed-variable=VeCANR_b_SGCP_DC_Volt_V_P_FD5.VeCANR_b_SGCP_DC_Volt_V_P_FD5
            access DSP_VeCANR_b_SGCP_DC_Volt_V_P_FD5TO_VeCANR_b_SGCP_DC_Volt_V_P_FD5TO: accessed-variable=VeCANR_b_SGCP_DC_Volt_V_P_FD5TO.VeCANR_b_SGCP_DC_Volt_V_P_FD5TO
        COMRX_SGCP_DC_Volt_V_P_SGCP_STATUS_FD5_Error: symbol=ApplCanComAb_FD5_COMRX_SGCP_DC_Volt_V_P_SGCP_STATUS_FD5_Error  # Error
          data-receive-point-by-arguments:
            access DRP_CanCom_FD5RxSignalsSR_COMRX_SGCP_DC_Volt_V_P_SGCP_STATUS_FD5: accessed-variable=CanCom_FD5RxSignalsSR.COMRX_SGCP_DC_Volt_V_P_SGCP_STATUS_FD5
          data-send-points:
            access DSP_VeCANR_b_SGCP_DC_Volt_V_P_FD5_VeCANR_b_SGCP_DC_Volt_V_P_FD5: accessed-variable=VeCANR_b_SGCP_DC_Volt_V_P_FD5.VeCANR_b_SGCP_DC_Volt_V_P_FD5
            access DSP_VeCANR_b_SGCP_DC_Volt_V_P_FD5TO_VeCANR_b_SGCP_DC_Volt_V_P_FD5TO: accessed-variable=VeCANR_b_SGCP_DC_Volt_V_P_FD5TO.VeCANR_b_SGCP_DC_Volt_V_P_FD5TO
        COMRX_SGCP_DC_Voltage_P_SGCP_STATUS_FD5_Received: symbol=ApplCanComAb_FD5_COMRX_SGCP_DC_Voltage_P_SGCP_STATUS_FD5_Received  # Received
          data-receive-point-by-arguments:
            access DRP_CanCom_FD5RxSignalsSR_COMRX_SGCP_DC_Voltage_P_SGCP_STATUS_FD5: accessed-variable=CanCom_FD5RxSignalsSR.COMRX_SGCP_DC_Voltage_P_SGCP_STATUS_FD5
          data-send-points:
            access DSP_VeCANR_U_SGCP_DC_Voltage_P_FD5_VeCANR_U_SGCP_DC_Voltage_P_FD5: accessed-variable=VeCANR_U_SGCP_DC_Voltage_P_FD5.VeCANR_U_SGCP_DC_Voltage_P_FD5
            access DSP_VeCANR_b_SGCP_DC_Voltage_P_FD5TO_VeCANR_b_SGCP_DC_Voltage_P_FD5TO: accessed-variable=VeCANR_b_SGCP_DC_Voltage_P_FD5TO.VeCANR_b_SGCP_DC_Voltage_P_FD5TO
        COMRX_SGCP_DC_Voltage_P_SGCP_STATUS_FD5_Error: symbol=ApplCanComAb_FD5_COMRX_SGCP_DC_Voltage_P_SGCP_STATUS_FD5_Error  # Error
          data-receive-point-by-arguments:
            access DRP_CanCom_FD5RxSignalsSR_COMRX_SGCP_DC_Voltage_P_SGCP_STATUS_FD5: accessed-variable=CanCom_FD5RxSignalsSR.COMRX_SGCP_DC_Voltage_P_SGCP_STATUS_FD5
          data-send-points:
            access DSP_VeCANR_U_SGCP_DC_Voltage_P_FD5_VeCANR_U_SGCP_DC_Voltage_P_FD5: accessed-variable=VeCANR_U_SGCP_DC_Voltage_P_FD5.VeCANR_U_SGCP_DC_Voltage_P_FD5
            access DSP_VeCANR_b_SGCP_DC_Voltage_P_FD5TO_VeCANR_b_SGCP_DC_Voltage_P_FD5TO: accessed-variable=VeCANR_b_SGCP_DC_Voltage_P_FD5TO.VeCANR_b_SGCP_DC_Voltage_P_FD5TO
        COMRX_SGCP_DerateReason_P_SGCP_STATUS_FD5_Received: symbol=ApplCanComAb_FD5_COMRX_SGCP_DerateReason_P_SGCP_STATUS_FD5_Received  # Received
          data-receive-point-by-arguments:
            access DRP_CanCom_FD5RxSignalsSR_COMRX_SGCP_DerateReason_P_SGCP_STATUS_FD5: accessed-variable=CanCom_FD5RxSignalsSR.COMRX_SGCP_DerateReason_P_SGCP_STATUS_FD5
          data-send-points:
            access DSP_VeCANR_e_SGCP_DrateReason_P_FD5_VeCANR_e_SGCP_DrateReason_P_FD5: accessed-variable=VeCANR_e_SGCP_DrateReason_P_FD5.VeCANR_e_SGCP_DrateReason_P_FD5
            access DSP_VeCANR_b_SGCP_DrateReason_P_FD5TO_VeCANR_b_SGCP_DrateReason_P_FD5TO: accessed-variable=VeCANR_b_SGCP_DrateReason_P_FD5TO.VeCANR_b_SGCP_DrateReason_P_FD5TO
        COMRX_SGCP_DerateReason_P_SGCP_STATUS_FD5_Error: symbol=ApplCanComAb_FD5_COMRX_SGCP_DerateReason_P_SGCP_STATUS_FD5_Error  # Error
          data-receive-point-by-arguments:
            access DRP_CanCom_FD5RxSignalsSR_COMRX_SGCP_DerateReason_P_SGCP_STATUS_FD5: accessed-variable=CanCom_FD5RxSignalsSR.COMRX_SGCP_DerateReason_P_SGCP_STATUS_FD5
          data-send-points:
            access DSP_VeCANR_e_SGCP_DrateReason_P_FD5_VeCANR_e_SGCP_DrateReason_P_FD5: accessed-variable=VeCANR_e_SGCP_DrateReason_P_FD5.VeCANR_e_SGCP_DrateReason_P_FD5
            access DSP_VeCANR_b_SGCP_DrateReason_P_FD5TO_VeCANR_b_SGCP_DrateReason_P_FD5TO: accessed-variable=VeCANR_b_SGCP_DrateReason_P_FD5TO.VeCANR_b_SGCP_DrateReason_P_FD5TO
        COMRX_SGCP_Inverter_Temp_P_SGCP_STATUS_FD5_Received: symbol=ApplCanComAb_FD5_COMRX_SGCP_Inverter_Temp_P_SGCP_STATUS_FD5_Received  # Received
          data-receive-point-by-arguments:
            access DRP_CanCom_FD5RxSignalsSR_COMRX_SGCP_Inverter_Temp_P_SGCP_STATUS_FD5: accessed-variable=CanCom_FD5RxSignalsSR.COMRX_SGCP_Inverter_Temp_P_SGCP_STATUS_FD5
          data-send-points:
            access DSP_VeCANR_T_SGCP_Invert_Temp_P_FD5_VeCANR_T_SGCP_Invert_Temp_P_FD5: accessed-variable=VeCANR_T_SGCP_Invert_Temp_P_FD5.VeCANR_T_SGCP_Invert_Temp_P_FD5
            access DSP_VeCANR_b_SGCP_Invert_Temp_P_FD5TO_VeCANR_b_SGCP_Invert_Temp_P_FD5TO: accessed-variable=VeCANR_b_SGCP_Invert_Temp_P_FD5TO.VeCANR_b_SGCP_Invert_Temp_P_FD5TO
        COMRX_SGCP_Inverter_Temp_P_SGCP_STATUS_FD5_Error: symbol=ApplCanComAb_FD5_COMRX_SGCP_Inverter_Temp_P_SGCP_STATUS_FD5_Error  # Error
          data-receive-point-by-arguments:
            access DRP_CanCom_FD5RxSignalsSR_COMRX_SGCP_Inverter_Temp_P_SGCP_STATUS_FD5: accessed-variable=CanCom_FD5RxSignalsSR.COMRX_SGCP_Inverter_Temp_P_SGCP_STATUS_FD5
          data-send-points:
            access DSP_VeCANR_T_SGCP_Invert_Temp_P_FD5_VeCANR_T_SGCP_Invert_Temp_P_FD5: accessed-variable=VeCANR_T_SGCP_Invert_Temp_P_FD5.VeCANR_T_SGCP_Invert_Temp_P_FD5
            access DSP_VeCANR_b_SGCP_Invert_Temp_P_FD5TO_VeCANR_b_SGCP_Invert_Temp_P_FD5TO: accessed-variable=VeCANR_b_SGCP_Invert_Temp_P_FD5TO.VeCANR_b_SGCP_Invert_Temp_P_FD5TO
        COMRX_SGCP_PIM_AC_Side_Busbar_Temp_P_SGCP_STATUS_FD5_Received: symbol=ApplCanComAb_FD5_COMRX_SGCP_PIM_AC_Side_Busbar_Temp_P_SGCP_STATUS_FD5_Received  # Received
          data-receive-point-by-arguments:
            access DRP_CanCom_FD5RxSignalsSR_COMRX_SGCP_PIM_AC_Side_Busbar_Temp_P_SGCP_STATUS_FD5: accessed-variable=CanCom_FD5RxSignalsSR.COMRX_SGCP_PIM_AC_Side_Busbar_Temp_P_SGCP_STATUS_FD5
          data-send-points:
            access DSP_VeCANR_y_SGCPPIMACSdBusTempPFD5_VeCANR_y_SGCPPIMACSdBusTempPFD5: accessed-variable=VeCANR_y_SGCPPIMACSdBusTempPFD5.VeCANR_y_SGCPPIMACSdBusTempPFD5
            access DSP_VeCANR_b_SGCPPIMACSdBusTempPFD5TO_VeCANR_b_SGCPPIMACSdBusTempPFD5TO: accessed-variable=VeCANR_b_SGCPPIMACSdBusTempPFD5TO.VeCANR_b_SGCPPIMACSdBusTempPFD5TO
        COMRX_SGCP_PIM_AC_Side_Busbar_Temp_P_SGCP_STATUS_FD5_Error: symbol=ApplCanComAb_FD5_COMRX_SGCP_PIM_AC_Side_Busbar_Temp_P_SGCP_STATUS_FD5_Error  # Error
          data-receive-point-by-arguments:
            access DRP_CanCom_FD5RxSignalsSR_COMRX_SGCP_PIM_AC_Side_Busbar_Temp_P_SGCP_STATUS_FD5: accessed-variable=CanCom_FD5RxSignalsSR.COMRX_SGCP_PIM_AC_Side_Busbar_Temp_P_SGCP_STATUS_FD5
          data-send-points:
            access DSP_VeCANR_y_SGCPPIMACSdBusTempPFD5_VeCANR_y_SGCPPIMACSdBusTempPFD5: accessed-variable=VeCANR_y_SGCPPIMACSdBusTempPFD5.VeCANR_y_SGCPPIMACSdBusTempPFD5
            access DSP_VeCANR_b_SGCPPIMACSdBusTempPFD5TO_VeCANR_b_SGCPPIMACSdBusTempPFD5TO: accessed-variable=VeCANR_b_SGCPPIMACSdBusTempPFD5TO.VeCANR_b_SGCPPIMACSdBusTempPFD5TO
        COMRX_SGCP_PIM_DC_Side_Busbar_Temp_P_SGCP_STATUS_FD5_Received: symbol=ApplCanComAb_FD5_COMRX_SGCP_PIM_DC_Side_Busbar_Temp_P_SGCP_STATUS_FD5_Received  # Received
          data-receive-point-by-arguments:
            access DRP_CanCom_FD5RxSignalsSR_COMRX_SGCP_PIM_DC_Side_Busbar_Temp_P_SGCP_STATUS_FD5: accessed-variable=CanCom_FD5RxSignalsSR.COMRX_SGCP_PIM_DC_Side_Busbar_Temp_P_SGCP_STATUS_FD5
          data-send-points:
            access DSP_VeCANR_T_SGCPPIMDCSdBusTempPFD5_VeCANR_T_SGCPPIMDCSdBusTempPFD5: accessed-variable=VeCANR_T_SGCPPIMDCSdBusTempPFD5.VeCANR_T_SGCPPIMDCSdBusTempPFD5
            access DSP_VeCANR_b_SGCPPIMDCSdBusTempPFD5TO_VeCANR_b_SGCPPIMDCSdBusTempPFD5TO: accessed-variable=VeCANR_b_SGCPPIMDCSdBusTempPFD5TO.VeCANR_b_SGCPPIMDCSdBusTempPFD5TO
        COMRX_SGCP_PIM_DC_Side_Busbar_Temp_P_SGCP_STATUS_FD5_Error: symbol=ApplCanComAb_FD5_COMRX_SGCP_PIM_DC_Side_Busbar_Temp_P_SGCP_STATUS_FD5_Error  # Error
          data-receive-point-by-arguments:
            access DRP_CanCom_FD5RxSignalsSR_COMRX_SGCP_PIM_DC_Side_Busbar_Temp_P_SGCP_STATUS_FD5: accessed-variable=CanCom_FD5RxSignalsSR.COMRX_SGCP_PIM_DC_Side_Busbar_Temp_P_SGCP_STATUS_FD5
          data-send-points:
            access DSP_VeCANR_T_SGCPPIMDCSdBusTempPFD5_VeCANR_T_SGCPPIMDCSdBusTempPFD5: accessed-variable=VeCANR_T_SGCPPIMDCSdBusTempPFD5.VeCANR_T_SGCPPIMDCSdBusTempPFD5
            access DSP_VeCANR_b_SGCPPIMDCSdBusTempPFD5TO_VeCANR_b_SGCPPIMDCSdBusTempPFD5TO: accessed-variable=VeCANR_b_SGCPPIMDCSdBusTempPFD5TO.VeCANR_b_SGCPPIMDCSdBusTempPFD5TO
        COMRX_SGCP_Rotor_Temperature_P_SGCP_STATUS_FD5_Received: symbol=ApplCanComAb_FD5_COMRX_SGCP_Rotor_Temperature_P_SGCP_STATUS_FD5_Received  # Received
          data-receive-point-by-arguments:
            access DRP_CanCom_FD5RxSignalsSR_COMRX_SGCP_Rotor_Temperature_P_SGCP_STATUS_FD5: accessed-variable=CanCom_FD5RxSignalsSR.COMRX_SGCP_Rotor_Temperature_P_SGCP_STATUS_FD5
          data-send-points:
            access DSP_VeCANR_T_SGCPRotorTemp_P_FD5_VeCANR_T_SGCPRotorTemp_P_FD5: accessed-variable=VeCANR_T_SGCPRotorTemp_P_FD5.VeCANR_T_SGCPRotorTemp_P_FD5
            access DSP_VeCANR_b_SGCPRotorTemp_P_FD5TO_VeCANR_b_SGCPRotorTemp_P_FD5TO: accessed-variable=VeCANR_b_SGCPRotorTemp_P_FD5TO.VeCANR_b_SGCPRotorTemp_P_FD5TO
        COMRX_SGCP_Rotor_Temperature_P_SGCP_STATUS_FD5_Error: symbol=ApplCanComAb_FD5_COMRX_SGCP_Rotor_Temperature_P_SGCP_STATUS_FD5_Error  # Error
          data-receive-point-by-arguments:
            access DRP_CanCom_FD5RxSignalsSR_COMRX_SGCP_Rotor_Temperature_P_SGCP_STATUS_FD5: accessed-variable=CanCom_FD5RxSignalsSR.COMRX_SGCP_Rotor_Temperature_P_SGCP_STATUS_FD5
          data-send-points:
            access DSP_VeCANR_T_SGCPRotorTemp_P_FD5_VeCANR_T_SGCPRotorTemp_P_FD5: accessed-variable=VeCANR_T_SGCPRotorTemp_P_FD5.VeCANR_T_SGCPRotorTemp_P_FD5
            access DSP_VeCANR_b_SGCPRotorTemp_P_FD5TO_VeCANR_b_SGCPRotorTemp_P_FD5TO: accessed-variable=VeCANR_b_SGCPRotorTemp_P_FD5TO.VeCANR_b_SGCPRotorTemp_P_FD5TO
        COMRX_SGCP_Service_Lamp_Request_P_SGCP_STATUS_FD5_Received: symbol=ApplCanComAb_FD5_COMRX_SGCP_Service_Lamp_Request_P_SGCP_STATUS_FD5_Received  # Received
          data-receive-point-by-arguments:
            access DRP_CanCom_FD5RxSignalsSR_COMRX_SGCP_Service_Lamp_Request_P_SGCP_STATUS_FD5: accessed-variable=CanCom_FD5RxSignalsSR.COMRX_SGCP_Service_Lamp_Request_P_SGCP_STATUS_FD5
          data-send-points:
            access DSP_VeCANR_b_SGCPServLampReq_P_FD5_VeCANR_b_SGCPServLampReq_P_FD5: accessed-variable=VeCANR_b_SGCPServLampReq_P_FD5.VeCANR_b_SGCPServLampReq_P_FD5
            access DSP_VeCANR_b_SGCPServLampReq_P_FD5TO_VeCANR_b_SGCPServLampReq_P_FD5TO: accessed-variable=VeCANR_b_SGCPServLampReq_P_FD5TO.VeCANR_b_SGCPServLampReq_P_FD5TO
        COMRX_SGCP_Service_Lamp_Request_P_SGCP_STATUS_FD5_Error: symbol=ApplCanComAb_FD5_COMRX_SGCP_Service_Lamp_Request_P_SGCP_STATUS_FD5_Error  # Error
          data-receive-point-by-arguments:
            access DRP_CanCom_FD5RxSignalsSR_COMRX_SGCP_Service_Lamp_Request_P_SGCP_STATUS_FD5: accessed-variable=CanCom_FD5RxSignalsSR.COMRX_SGCP_Service_Lamp_Request_P_SGCP_STATUS_FD5
          data-send-points:
            access DSP_VeCANR_b_SGCPServLampReq_P_FD5_VeCANR_b_SGCPServLampReq_P_FD5: accessed-variable=VeCANR_b_SGCPServLampReq_P_FD5.VeCANR_b_SGCPServLampReq_P_FD5
            access DSP_VeCANR_b_SGCPServLampReq_P_FD5TO_VeCANR_b_SGCPServLampReq_P_FD5TO: accessed-variable=VeCANR_b_SGCPServLampReq_P_FD5TO.VeCANR_b_SGCPServLampReq_P_FD5TO
        SendCANR_OperationalModeSts_FD5: can-be-invoked-concurrently=true, symbol=ApplCanComAb_FD5_SendCANR_OperationalModeSts_FD5  # Transmit
          data-receive-point-by-arguments:
            access DRP_SendCANR_OperationalModeSts_FD5_SendCANR_OperationalModeSts_FD5: accessed-variable=SendCANR_OperationalModeSts_FD5.SendCANR_OperationalModeSts_FD5
            access DRP_SendCANR_OperationalModeSts_FD5Vld_SendCANR_OperationalModeSts_FD5Vld: accessed-variable=SendCANR_OperationalModeSts_FD5Vld.SendCANR_OperationalModeSts_FD5Vld
          data-send-points:
            access DSP_CanCom_FD5TxSignalsSR_COMTX_OperationalModeSts_BCM_FD_2_FD5: accessed-variable=CanCom_FD5TxSignalsSR.COMTX_OperationalModeSts_BCM_FD_2_FD5
        SendCANR_Battery_Volt_1_FD5: can-be-invoked-concurrently=true, symbol=ApplCanComAb_FD5_SendCANR_Battery_Volt_1_FD5  # Transmit
          data-receive-point-by-arguments:
            access DRP_SendCANR_Battery_Volt_1_FD5_SendCANR_Battery_Volt_1_FD5: accessed-variable=SendCANR_Battery_Volt_1_FD5.SendCANR_Battery_Volt_1_FD5
            access DRP_SendCANR_Battery_Volt_1_FD5Vld_SendCANR_Battery_Volt_1_FD5Vld: accessed-variable=SendCANR_Battery_Volt_1_FD5Vld.SendCANR_Battery_Volt_1_FD5Vld
          data-send-points:
            access DSP_CanCom_FD5TxSignalsSR_COMTX_Battery_Volt_1_BCM_FD_3_FD5: accessed-variable=CanCom_FD5TxSignalsSR.COMTX_Battery_Volt_1_BCM_FD_3_FD5
        SendCANR_IgnitionOnCounter_FD5: can-be-invoked-concurrently=true, symbol=ApplCanComAb_FD5_SendCANR_IgnitionOnCounter_FD5  # Transmit
          data-receive-point-by-arguments:
            access DRP_SendCANR_IgnitionOnCounter_FD5_SendCANR_IgnitionOnCounter_FD5: accessed-variable=SendCANR_IgnitionOnCounter_FD5.SendCANR_IgnitionOnCounter_FD5
            access DRP_SendCANR_IgnitionOnCounter_FD5Vld_SendCANR_IgnitionOnCounter_FD5Vld: accessed-variable=SendCANR_IgnitionOnCounter_FD5Vld.SendCANR_IgnitionOnCounter_FD5Vld
          data-send-points:
            access DSP_CanCom_FD5TxSignalsSR_COMTX_IgnitionOnCounter_BCM_FD_7_FD5: accessed-variable=CanCom_FD5TxSignalsSR.COMTX_IgnitionOnCounter_BCM_FD_7_FD5
        SendCANR_ExtTemp_FD5: can-be-invoked-concurrently=true, symbol=ApplCanComAb_FD5_SendCANR_ExtTemp_FD5  # Transmit
          data-receive-point-by-arguments:
            access DRP_SendCANR_ExtTemp_FD5_SendCANR_ExtTemp_FD5: accessed-variable=SendCANR_ExtTemp_FD5.SendCANR_ExtTemp_FD5
            access DRP_SendCANR_ExtTemp_FD5Vld_SendCANR_ExtTemp_FD5Vld: accessed-variable=SendCANR_ExtTemp_FD5Vld.SendCANR_ExtTemp_FD5Vld
          data-send-points:
            access DSP_CanCom_FD5TxSignalsSR_COMTX_ExternalTemperature_BCM_FD_9_FD5: accessed-variable=CanCom_FD5TxSignalsSR.COMTX_ExternalTemperature_BCM_FD_9_FD5
        SendCANR_EPBSts_FD5: can-be-invoked-concurrently=true, symbol=ApplCanComAb_FD5_SendCANR_EPBSts_FD5  # Transmit
          data-receive-point-by-arguments:
            access DRP_SendCANR_EPBSts_FD5_SendCANR_EPBSts_FD5: accessed-variable=SendCANR_EPBSts_FD5.SendCANR_EPBSts_FD5
            access DRP_SendCANR_EPBSts_FD5Vld_SendCANR_EPBSts_FD5Vld: accessed-variable=SendCANR_EPBSts_FD5Vld.SendCANR_EPBSts_FD5Vld
          data-send-points:
            access DSP_CanCom_FD5TxSignalsSR_COMTX_EPBSts_BRAKE_FD_4_FD5: accessed-variable=CanCom_FD5TxSignalsSR.COMTX_EPBSts_BRAKE_FD_4_FD5
        SendCANR_ABSFailSts_FD5: can-be-invoked-concurrently=true, symbol=ApplCanComAb_FD5_SendCANR_ABSFailSts_FD5  # Transmit
          data-receive-point-by-arguments:
            access DRP_SendCANR_ABSFailSts_FD5_SendCANR_ABSFailSts_FD5: accessed-variable=SendCANR_ABSFailSts_FD5.SendCANR_ABSFailSts_FD5
            access DRP_SendCANR_ABSFailSts_FD5Vld_SendCANR_ABSFailSts_FD5Vld: accessed-variable=SendCANR_ABSFailSts_FD5Vld.SendCANR_ABSFailSts_FD5Vld
          data-send-points:
            access DSP_CanCom_FD5TxSignalsSR_COMTX_ABSFailSts_BRAKE_FD_5_FD5: accessed-variable=CanCom_FD5TxSignalsSR.COMTX_ABSFailSts_BRAKE_FD_5_FD5
        SendCANR_ESCFailSts_FD5: can-be-invoked-concurrently=true, symbol=ApplCanComAb_FD5_SendCANR_ESCFailSts_FD5  # Transmit
          data-receive-point-by-arguments:
            access DRP_SendCANR_ESCFailSts_FD5_SendCANR_ESCFailSts_FD5: accessed-variable=SendCANR_ESCFailSts_FD5.SendCANR_ESCFailSts_FD5
            access DRP_SendCANR_ESCFailSts_FD5Vld_SendCANR_ESCFailSts_FD5Vld: accessed-variable=SendCANR_ESCFailSts_FD5Vld.SendCANR_ESCFailSts_FD5Vld
          data-send-points:
            access DSP_CanCom_FD5TxSignalsSR_COMTX_ESCFailSts_BRAKE_FD_5_FD5: accessed-variable=CanCom_FD5TxSignalsSR.COMTX_ESCFailSts_BRAKE_FD_5_FD5
        SendCANR_Eamount_FD5: can-be-invoked-concurrently=true, symbol=ApplCanComAb_FD5_SendCANR_Eamount_FD5  # Transmit
          data-receive-point-by-arguments:
            access DRP_SendCANR_Eamount_FD5_SendCANR_Eamount_FD5: accessed-variable=SendCANR_Eamount_FD5.SendCANR_Eamount_FD5
            access DRP_SendCANR_Eamount_FD5Vld_SendCANR_Eamount_FD5Vld: accessed-variable=SendCANR_Eamount_FD5Vld.SendCANR_Eamount_FD5Vld
          data-send-points:
            access DSP_CanCom_FD5TxSignalsSR_COMTX_Eamount_EVCU_ISO15118_STATUS1_FD5: accessed-variable=CanCom_FD5TxSignalsSR.COMTX_Eamount_EVCU_ISO15118_STATUS1_FD5
        SendCANR_EVMaxCurrent_FD5: can-be-invoked-concurrently=true, symbol=ApplCanComAb_FD5_SendCANR_EVMaxCurrent_FD5  # Transmit
          data-receive-point-by-arguments:
            access DRP_SendCANR_EVMaxCurrent_FD5_SendCANR_EVMaxCurrent_FD5: accessed-variable=SendCANR_EVMaxCurrent_FD5.SendCANR_EVMaxCurrent_FD5
            access DRP_SendCANR_EVMaxCurrent_FD5Vld_SendCANR_EVMaxCurrent_FD5Vld: accessed-variable=SendCANR_EVMaxCurrent_FD5Vld.SendCANR_EVMaxCurrent_FD5Vld
          data-send-points:
            access DSP_CanCom_FD5TxSignalsSR_COMTX_EVMaxCurrent_EVCU_ISO15118_STATUS1_FD5: accessed-variable=CanCom_FD5TxSignalsSR.COMTX_EVMaxCurrent_EVCU_ISO15118_STATUS1_FD5
        SendCANR_EVMaxVoltage_FD5: can-be-invoked-concurrently=true, symbol=ApplCanComAb_FD5_SendCANR_EVMaxVoltage_FD5  # Transmit
          data-receive-point-by-arguments:
            access DRP_SendCANR_EVMaxVoltage_FD5_SendCANR_EVMaxVoltage_FD5: accessed-variable=SendCANR_EVMaxVoltage_FD5.SendCANR_EVMaxVoltage_FD5
            access DRP_SendCANR_EVMaxVoltage_FD5Vld_SendCANR_EVMaxVoltage_FD5Vld: accessed-variable=SendCANR_EVMaxVoltage_FD5Vld.SendCANR_EVMaxVoltage_FD5Vld
          data-send-points:
            access DSP_CanCom_FD5TxSignalsSR_COMTX_EVMaxVoltage_EVCU_ISO15118_STATUS1_FD5: accessed-variable=CanCom_FD5TxSignalsSR.COMTX_EVMaxVoltage_EVCU_ISO15118_STATUS1_FD5
        SendCANR_EVMinCurrent_FD5: can-be-invoked-concurrently=true, symbol=ApplCanComAb_FD5_SendCANR_EVMinCurrent_FD5  # Transmit
          data-receive-point-by-arguments:
            access DRP_SendCANR_EVMinCurrent_FD5_SendCANR_EVMinCurrent_FD5: accessed-variable=SendCANR_EVMinCurrent_FD5.SendCANR_EVMinCurrent_FD5
            access DRP_SendCANR_EVMinCurrent_FD5Vld_SendCANR_EVMinCurrent_FD5Vld: accessed-variable=SendCANR_EVMinCurrent_FD5Vld.SendCANR_EVMinCurrent_FD5Vld
          data-send-points:
            access DSP_CanCom_FD5TxSignalsSR_COMTX_EVMinCurrent_EVCU_ISO15118_STATUS1_FD5: accessed-variable=CanCom_FD5TxSignalsSR.COMTX_EVMinCurrent_EVCU_ISO15118_STATUS1_FD5
        SendCANR_FOTA_Status_FD5: can-be-invoked-concurrently=true, symbol=ApplCanComAb_FD5_SendCANR_FOTA_Status_FD5  # Transmit
          data-receive-point-by-arguments:
            access DRP_SendCANR_FOTA_Status_FD5_SendCANR_FOTA_Status_FD5: accessed-variable=SendCANR_FOTA_Status_FD5.SendCANR_FOTA_Status_FD5
            access DRP_SendCANR_FOTA_Status_FD5Vld_SendCANR_FOTA_Status_FD5Vld: accessed-variable=SendCANR_FOTA_Status_FD5Vld.SendCANR_FOTA_Status_FD5Vld
          data-send-points:
            access DSP_CanCom_FD5TxSignalsSR_COMTX_FOTA_Status_FOTA_MASTER_FD5: accessed-variable=CanCom_FD5TxSignalsSR.COMTX_FOTA_Status_FOTA_MASTER_FD5
        SendCANR_N_PDU_7E_FD5: can-be-invoked-concurrently=true, symbol=ApplCanComAb_FD5_SendCANR_N_PDU_7E_FD5  # Transmit
          data-receive-point-by-arguments:
            access DRP_SendCANR_N_PDU_7E_FD5_SendCANR_N_PDU_7E_FD5: accessed-variable=SendCANR_N_PDU_7E_FD5.SendCANR_N_PDU_7E_FD5
            access DRP_SendCANR_N_PDU_7E_FD5Vld_SendCANR_N_PDU_7E_FD5Vld: accessed-variable=SendCANR_N_PDU_7E_FD5Vld.SendCANR_N_PDU_7E_FD5Vld
          data-send-points:
            access DSP_CanCom_FD5TxSignalsSR_COMTX_N_PDU_7E_GLIWA_MCPA_RX_FD5: accessed-variable=CanCom_FD5TxSignalsSR.COMTX_N_PDU_7E_GLIWA_MCPA_RX_FD5
        SendCANR_N_PDU_7F_FD5: can-be-invoked-concurrently=true, symbol=ApplCanComAb_FD5_SendCANR_N_PDU_7F_FD5  # Transmit
          data-receive-point-by-arguments:
            access DRP_SendCANR_N_PDU_7F_FD5_SendCANR_N_PDU_7F_FD5: accessed-variable=SendCANR_N_PDU_7F_FD5.SendCANR_N_PDU_7F_FD5
            access DRP_SendCANR_N_PDU_7F_FD5Vld_SendCANR_N_PDU_7F_FD5Vld: accessed-variable=SendCANR_N_PDU_7F_FD5Vld.SendCANR_N_PDU_7F_FD5Vld
          data-send-points:
            access DSP_CanCom_FD5TxSignalsSR_COMTX_N_PDU_7F_GLIWA_MCPB_RX_FD5: accessed-variable=CanCom_FD5TxSignalsSR.COMTX_N_PDU_7F_GLIWA_MCPB_RX_FD5
        SendCANR_PerWakeUp_Diag_FD5: can-be-invoked-concurrently=true, symbol=ApplCanComAb_FD5_SendCANR_PerWakeUp_Diag_FD5  # Transmit
          data-receive-point-by-arguments:
            access DRP_SendCANR_PerWakeUp_Diag_FD5_SendCANR_PerWakeUp_Diag_FD5: accessed-variable=SendCANR_PerWakeUp_Diag_FD5.SendCANR_PerWakeUp_Diag_FD5
            access DRP_SendCANR_PerWakeUp_Diag_FD5Vld_SendCANR_PerWakeUp_Diag_FD5Vld: accessed-variable=SendCANR_PerWakeUp_Diag_FD5Vld.SendCANR_PerWakeUp_Diag_FD5Vld
          data-send-points:
            access DSP_CanCom_FD5TxSignalsSR_COMTX_PerWakeUp_Diag_HYBRID_SYSTEM_EPT1_FD5: accessed-variable=CanCom_FD5TxSignalsSR.COMTX_PerWakeUp_Diag_HYBRID_SYSTEM_EPT1_FD5
        SendCANR_WU_Timer_Value_FD5: can-be-invoked-concurrently=true, symbol=ApplCanComAb_FD5_SendCANR_WU_Timer_Value_FD5  # Transmit
          data-receive-point-by-arguments:
            access DRP_SendCANR_WU_Timer_Value_FD5_SendCANR_WU_Timer_Value_FD5: accessed-variable=SendCANR_WU_Timer_Value_FD5.SendCANR_WU_Timer_Value_FD5
            access DRP_SendCANR_WU_Timer_Value_FD5Vld_SendCANR_WU_Timer_Value_FD5Vld: accessed-variable=SendCANR_WU_Timer_Value_FD5Vld.SendCANR_WU_Timer_Value_FD5Vld
          data-send-points:
            access DSP_CanCom_FD5TxSignalsSR_COMTX_WU_Timer_Value_HYBRID_SYSTEM_EPT1_FD5: accessed-variable=CanCom_FD5TxSignalsSR.COMTX_WU_Timer_Value_HYBRID_SYSTEM_EPT1_FD5
        SendCANR_CRC_HYBD_THRML_CMD_FD5: can-be-invoked-concurrently=true, symbol=ApplCanComAb_FD5_SendCANR_CRC_HYBD_THRML_CMD_FD5  # Transmit
          data-receive-point-by-arguments:
            access DRP_SendCANR_CRC_HYBD_THRML_CMD_FD5_SendCANR_CRC_HYBD_THRML_CMD_FD5: accessed-variable=SendCANR_CRC_HYBD_THRML_CMD_FD5.SendCANR_CRC_HYBD_THRML_CMD_FD5
            access DRP_SendCANR_CRC_HYBD_THRML_CMD_FD5Vld_SendCANR_CRC_HYBD_THRML_CMD_FD5Vld: accessed-variable=SendCANR_CRC_HYBD_THRML_CMD_FD5Vld.SendCANR_CRC_HYBD_THRML_CMD_FD5Vld
          data-send-points:
            access DSP_CanCom_FD5TxSignalsSR_COMTX_CRC_HYBRID_THERMAL_COMMAND_HYBRID_THERMAL_COMMAND_FD5: accessed-variable=CanCom_FD5TxSignalsSR.COMTX_CRC_HYBRID_THERMAL_COMMAND_HYBRID_THERMAL_COMMAND_FD5
        SendCANR_EOPA_OIL_FlwRate_FD5: can-be-invoked-concurrently=true, symbol=ApplCanComAb_FD5_SendCANR_EOPA_OIL_FlwRate_FD5  # Transmit
          data-receive-point-by-arguments:
            access DRP_SendCANR_EOPA_OIL_FlwRate_FD5_SendCANR_EOPA_OIL_FlwRate_FD5: accessed-variable=SendCANR_EOPA_OIL_FlwRate_FD5.SendCANR_EOPA_OIL_FlwRate_FD5
            access DRP_SendCANR_EOPA_OIL_FlwRate_FD5Vld_SendCANR_EOPA_OIL_FlwRate_FD5Vld: accessed-variable=SendCANR_EOPA_OIL_FlwRate_FD5Vld.SendCANR_EOPA_OIL_FlwRate_FD5Vld
          data-send-points:
            access DSP_CanCom_FD5TxSignalsSR_COMTX_EOPA_OIL_FlwRate_HYBRID_THERMAL_COMMAND_FD5: accessed-variable=CanCom_FD5TxSignalsSR.COMTX_EOPA_OIL_FlwRate_HYBRID_THERMAL_COMMAND_FD5
        SendCANR_EOPA_OIL_TEMP_FD5: can-be-invoked-concurrently=true, symbol=ApplCanComAb_FD5_SendCANR_EOPA_OIL_TEMP_FD5  # Transmit
          data-receive-point-by-arguments:
            access DRP_SendCANR_EOPA_OIL_TEMP_FD5_SendCANR_EOPA_OIL_TEMP_FD5: accessed-variable=SendCANR_EOPA_OIL_TEMP_FD5.SendCANR_EOPA_OIL_TEMP_FD5
            access DRP_SendCANR_EOPA_OIL_TEMP_FD5Vld_SendCANR_EOPA_OIL_TEMP_FD5Vld: accessed-variable=SendCANR_EOPA_OIL_TEMP_FD5Vld.SendCANR_EOPA_OIL_TEMP_FD5Vld
          data-send-points:
            access DSP_CanCom_FD5TxSignalsSR_COMTX_EOPA_OIL_TEMP_HYBRID_THERMAL_COMMAND_FD5: accessed-variable=CanCom_FD5TxSignalsSR.COMTX_EOPA_OIL_TEMP_HYBRID_THERMAL_COMMAND_FD5
        SendCANR_EOPB_OIL_FlwRate_FD5: can-be-invoked-concurrently=true, symbol=ApplCanComAb_FD5_SendCANR_EOPB_OIL_FlwRate_FD5  # Transmit
          data-receive-point-by-arguments:
            access DRP_SendCANR_EOPB_OIL_FlwRate_FD5_SendCANR_EOPB_OIL_FlwRate_FD5: accessed-variable=SendCANR_EOPB_OIL_FlwRate_FD5.SendCANR_EOPB_OIL_FlwRate_FD5
            access DRP_SendCANR_EOPB_OIL_FlwRate_FD5Vld_SendCANR_EOPB_OIL_FlwRate_FD5Vld: accessed-variable=SendCANR_EOPB_OIL_FlwRate_FD5Vld.SendCANR_EOPB_OIL_FlwRate_FD5Vld
          data-send-points:
            access DSP_CanCom_FD5TxSignalsSR_COMTX_EOPB_OIL_FlwRate_HYBRID_THERMAL_COMMAND_FD5: accessed-variable=CanCom_FD5TxSignalsSR.COMTX_EOPB_OIL_FlwRate_HYBRID_THERMAL_COMMAND_FD5
        SendCANR_EOPB_OIL_TEMP_FD5: can-be-invoked-concurrently=true, symbol=ApplCanComAb_FD5_SendCANR_EOPB_OIL_TEMP_FD5  # Transmit
          data-receive-point-by-arguments:
            access DRP_SendCANR_EOPB_OIL_TEMP_FD5_SendCANR_EOPB_OIL_TEMP_FD5: accessed-variable=SendCANR_EOPB_OIL_TEMP_FD5.SendCANR_EOPB_OIL_TEMP_FD5
            access DRP_SendCANR_EOPB_OIL_TEMP_FD5Vld_SendCANR_EOPB_OIL_TEMP_FD5Vld: accessed-variable=SendCANR_EOPB_OIL_TEMP_FD5Vld.SendCANR_EOPB_OIL_TEMP_FD5Vld
          data-send-points:
            access DSP_CanCom_FD5TxSignalsSR_COMTX_EOPB_OIL_TEMP_HYBRID_THERMAL_COMMAND_FD5: accessed-variable=CanCom_FD5TxSignalsSR.COMTX_EOPB_OIL_TEMP_HYBRID_THERMAL_COMMAND_FD5
        SendCANR_MC_HYBD_THRML_CMD_FD5: can-be-invoked-concurrently=true, symbol=ApplCanComAb_FD5_SendCANR_MC_HYBD_THRML_CMD_FD5  # Transmit
          data-receive-point-by-arguments:
            access DRP_SendCANR_MC_HYBD_THRML_CMD_FD5_SendCANR_MC_HYBD_THRML_CMD_FD5: accessed-variable=SendCANR_MC_HYBD_THRML_CMD_FD5.SendCANR_MC_HYBD_THRML_CMD_FD5
            access DRP_SendCANR_MC_HYBD_THRML_CMD_FD5Vld_SendCANR_MC_HYBD_THRML_CMD_FD5Vld: accessed-variable=SendCANR_MC_HYBD_THRML_CMD_FD5Vld.SendCANR_MC_HYBD_THRML_CMD_FD5Vld
          data-send-points:
            access DSP_CanCom_FD5TxSignalsSR_COMTX_MessageCounter_HYBRID_THERMAL_COMMAND_HYBRID_THERMAL_COMMAND_FD5: accessed-variable=CanCom_FD5TxSignalsSR.COMTX_MessageCounter_HYBRID_THERMAL_COMMAND_HYBRID_THERMAL_COMMAND_FD5
        SendCANR_SGCP_OIL_FlwRate_FD5: can-be-invoked-concurrently=true, symbol=ApplCanComAb_FD5_SendCANR_SGCP_OIL_FlwRate_FD5  # Transmit
          data-receive-point-by-arguments:
            access DRP_SendCANR_SGCP_OIL_FlwRate_FD5_SendCANR_SGCP_OIL_FlwRate_FD5: accessed-variable=SendCANR_SGCP_OIL_FlwRate_FD5.SendCANR_SGCP_OIL_FlwRate_FD5
            access DRP_SendCANR_SGCP_OIL_FlwRate_FD5Vld_SendCANR_SGCP_OIL_FlwRate_FD5Vld: accessed-variable=SendCANR_SGCP_OIL_FlwRate_FD5Vld.SendCANR_SGCP_OIL_FlwRate_FD5Vld
          data-send-points:
            access DSP_CanCom_FD5TxSignalsSR_COMTX_SGCP_OIL_FlwRate_HYBRID_THERMAL_COMMAND_FD5: accessed-variable=CanCom_FD5TxSignalsSR.COMTX_SGCP_OIL_FlwRate_HYBRID_THERMAL_COMMAND_FD5
        SendCANR_SGCP_OIL_TEMP_FD5: can-be-invoked-concurrently=true, symbol=ApplCanComAb_FD5_SendCANR_SGCP_OIL_TEMP_FD5  # Transmit
          data-receive-point-by-arguments:
            access DRP_SendCANR_SGCP_OIL_TEMP_FD5_SendCANR_SGCP_OIL_TEMP_FD5: accessed-variable=SendCANR_SGCP_OIL_TEMP_FD5.SendCANR_SGCP_OIL_TEMP_FD5
            access DRP_SendCANR_SGCP_OIL_TEMP_FD5Vld_SendCANR_SGCP_OIL_TEMP_FD5Vld: accessed-variable=SendCANR_SGCP_OIL_TEMP_FD5Vld.SendCANR_SGCP_OIL_TEMP_FD5Vld
          data-send-points:
            access DSP_CanCom_FD5TxSignalsSR_COMTX_SGCP_OIL_TEMP_HYBRID_THERMAL_COMMAND_FD5: accessed-variable=CanCom_FD5TxSignalsSR.COMTX_SGCP_OIL_TEMP_HYBRID_THERMAL_COMMAND_FD5
        SendCANR_IMPACTCommand_FD5: can-be-invoked-concurrently=true, symbol=ApplCanComAb_FD5_SendCANR_IMPACTCommand_FD5  # Transmit
          data-receive-point-by-arguments:
            access DRP_SendCANR_IMPACTCommand_FD5_SendCANR_IMPACTCommand_FD5: accessed-variable=SendCANR_IMPACTCommand_FD5.SendCANR_IMPACTCommand_FD5
            access DRP_SendCANR_IMPACTCommand_FD5Vld_SendCANR_IMPACTCommand_FD5Vld: accessed-variable=SendCANR_IMPACTCommand_FD5Vld.SendCANR_IMPACTCommand_FD5Vld
          data-send-points:
            access DSP_CanCom_FD5TxSignalsSR_COMTX_IMPACTCommand_IMPACT_INFO_FD5: accessed-variable=CanCom_FD5TxSignalsSR.COMTX_IMPACTCommand_IMPACT_INFO_FD5
        SendCANR_IMPACTConfirm_FD5: can-be-invoked-concurrently=true, symbol=ApplCanComAb_FD5_SendCANR_IMPACTConfirm_FD5  # Transmit
          data-receive-point-by-arguments:
            access DRP_SendCANR_IMPACTConfirm_FD5_SendCANR_IMPACTConfirm_FD5: accessed-variable=SendCANR_IMPACTConfirm_FD5.SendCANR_IMPACTConfirm_FD5
            access DRP_SendCANR_IMPACTConfirm_FD5Vld_SendCANR_IMPACTConfirm_FD5Vld: accessed-variable=SendCANR_IMPACTConfirm_FD5Vld.SendCANR_IMPACTConfirm_FD5Vld
          data-send-points:
            access DSP_CanCom_FD5TxSignalsSR_COMTX_IMPACTConfirm_IMPACT_INFO_FD5: accessed-variable=CanCom_FD5TxSignalsSR.COMTX_IMPACTConfirm_IMPACT_INFO_FD5
        SendCANR_TotalOdometer_FD5: can-be-invoked-concurrently=true, symbol=ApplCanComAb_FD5_SendCANR_TotalOdometer_FD5  # Transmit
          data-receive-point-by-arguments:
            access DRP_SendCANR_TotalOdometer_FD5_SendCANR_TotalOdometer_FD5: accessed-variable=SendCANR_TotalOdometer_FD5.SendCANR_TotalOdometer_FD5
            access DRP_SendCANR_TotalOdometer_FD5Vld_SendCANR_TotalOdometer_FD5Vld: accessed-variable=SendCANR_TotalOdometer_FD5Vld.SendCANR_TotalOdometer_FD5Vld
          data-send-points:
            access DSP_CanCom_FD5TxSignalsSR_COMTX_TotalOdometer_IPC_FD_1_FD5: accessed-variable=CanCom_FD5TxSignalsSR.COMTX_TotalOdometer_IPC_FD_1_FD5
        SendCANR_Real_Time_Clock_FD5: can-be-invoked-concurrently=true, symbol=ApplCanComAb_FD5_SendCANR_Real_Time_Clock_FD5  # Transmit
          data-receive-point-by-arguments:
            access DRP_SendCANR_Real_Time_Clock_FD5_SendCANR_Real_Time_Clock_FD5: accessed-variable=SendCANR_Real_Time_Clock_FD5.SendCANR_Real_Time_Clock_FD5
            access DRP_SendCANR_Real_Time_Clock_FD5Vld_SendCANR_Real_Time_Clock_FD5Vld: accessed-variable=SendCANR_Real_Time_Clock_FD5Vld.SendCANR_Real_Time_Clock_FD5Vld
          data-send-points:
            access DSP_CanCom_FD5TxSignalsSR_COMTX_Real_Time_Clock_REAL_TIME_CLOCK_FD5: accessed-variable=CanCom_FD5TxSignalsSR.COMTX_Real_Time_Clock_REAL_TIME_CLOCK_FD5
        SendCANR_Real_Time_Validity_FD5: can-be-invoked-concurrently=true, symbol=ApplCanComAb_FD5_SendCANR_Real_Time_Validity_FD5  # Transmit
          data-receive-point-by-arguments:
            access DRP_SendCANR_Real_Time_Validity_FD5_SendCANR_Real_Time_Validity_FD5: accessed-variable=SendCANR_Real_Time_Validity_FD5.SendCANR_Real_Time_Validity_FD5
            access DRP_SendCANR_Real_Time_Validity_FD5Vld_SendCANR_Real_Time_Validity_FD5Vld: accessed-variable=SendCANR_Real_Time_Validity_FD5Vld.SendCANR_Real_Time_Validity_FD5Vld
          data-send-points:
            access DSP_CanCom_FD5TxSignalsSR_COMTX_Real_Time_Validity_REAL_TIME_CLOCK_FD5: accessed-variable=CanCom_FD5TxSignalsSR.COMTX_Real_Time_Validity_REAL_TIME_CLOCK_FD5
        SendCANR_V2H_HVCMS_EVMaxP_LtFD5: can-be-invoked-concurrently=true, symbol=ApplCanComAb_FD5_SendCANR_V2H_HVCMS_EVMaxP_LtFD5  # Transmit
          data-receive-point-by-arguments:
            access DRP_SendCANR_V2H_HVCMS_EVMaxP_LtFD5_SendCANR_V2H_HVCMS_EVMaxP_LtFD5: accessed-variable=SendCANR_V2H_HVCMS_EVMaxP_LtFD5.SendCANR_V2H_HVCMS_EVMaxP_LtFD5
            access DRP_SendCANR_V2H_HVCMS_EVMaxP_LtFD5Vld_SendCANR_V2H_HVCMS_EVMaxP_LtFD5Vld: accessed-variable=SendCANR_V2H_HVCMS_EVMaxP_LtFD5Vld.SendCANR_V2H_HVCMS_EVMaxP_LtFD5Vld
          data-send-points:
            access DSP_CanCom_FD5TxSignalsSR_COMTX_V2H_HVCMS_EVMax_P_Limit_RPF_FD_3_FD5: accessed-variable=CanCom_FD5TxSignalsSR.COMTX_V2H_HVCMS_EVMax_P_Limit_RPF_FD_3_FD5
        SendCANR_GPS_Date_Day_FD5: can-be-invoked-concurrently=true, symbol=ApplCanComAb_FD5_SendCANR_GPS_Date_Day_FD5  # Transmit
          data-receive-point-by-arguments:
            access DRP_SendCANR_GPS_Date_Day_FD5_SendCANR_GPS_Date_Day_FD5: accessed-variable=SendCANR_GPS_Date_Day_FD5.SendCANR_GPS_Date_Day_FD5
            access DRP_SendCANR_GPS_Date_Day_FD5Vld_SendCANR_GPS_Date_Day_FD5Vld: accessed-variable=SendCANR_GPS_Date_Day_FD5Vld.SendCANR_GPS_Date_Day_FD5Vld
          data-send-points:
            access DSP_CanCom_FD5TxSignalsSR_COMTX_GPS_Date_Day_TELEMATIC_FD_1_FD5: accessed-variable=CanCom_FD5TxSignalsSR.COMTX_GPS_Date_Day_TELEMATIC_FD_1_FD5
        SendCANR_GPS_Date_Month_FD5: can-be-invoked-concurrently=true, symbol=ApplCanComAb_FD5_SendCANR_GPS_Date_Month_FD5  # Transmit
          data-receive-point-by-arguments:
            access DRP_SendCANR_GPS_Date_Month_FD5_SendCANR_GPS_Date_Month_FD5: accessed-variable=SendCANR_GPS_Date_Month_FD5.SendCANR_GPS_Date_Month_FD5
            access DRP_SendCANR_GPS_Date_Month_FD5Vld_SendCANR_GPS_Date_Month_FD5Vld: accessed-variable=SendCANR_GPS_Date_Month_FD5Vld.SendCANR_GPS_Date_Month_FD5Vld
          data-send-points:
            access DSP_CanCom_FD5TxSignalsSR_COMTX_GPS_Date_Month_TELEMATIC_FD_1_FD5: accessed-variable=CanCom_FD5TxSignalsSR.COMTX_GPS_Date_Month_TELEMATIC_FD_1_FD5
        SendCANR_GPS_Date_Year_FD5: can-be-invoked-concurrently=true, symbol=ApplCanComAb_FD5_SendCANR_GPS_Date_Year_FD5  # Transmit
          data-receive-point-by-arguments:
            access DRP_SendCANR_GPS_Date_Year_FD5_SendCANR_GPS_Date_Year_FD5: accessed-variable=SendCANR_GPS_Date_Year_FD5.SendCANR_GPS_Date_Year_FD5
            access DRP_SendCANR_GPS_Date_Year_FD5Vld_SendCANR_GPS_Date_Year_FD5Vld: accessed-variable=SendCANR_GPS_Date_Year_FD5Vld.SendCANR_GPS_Date_Year_FD5Vld
          data-send-points:
            access DSP_CanCom_FD5TxSignalsSR_COMTX_GPS_Date_Year_TELEMATIC_FD_1_FD5: accessed-variable=CanCom_FD5TxSignalsSR.COMTX_GPS_Date_Year_TELEMATIC_FD_1_FD5
        SendCANR_GPS_UTC_Hour_FD5: can-be-invoked-concurrently=true, symbol=ApplCanComAb_FD5_SendCANR_GPS_UTC_Hour_FD5  # Transmit
          data-receive-point-by-arguments:
            access DRP_SendCANR_GPS_UTC_Hour_FD5_SendCANR_GPS_UTC_Hour_FD5: accessed-variable=SendCANR_GPS_UTC_Hour_FD5.SendCANR_GPS_UTC_Hour_FD5
            access DRP_SendCANR_GPS_UTC_Hour_FD5Vld_SendCANR_GPS_UTC_Hour_FD5Vld: accessed-variable=SendCANR_GPS_UTC_Hour_FD5Vld.SendCANR_GPS_UTC_Hour_FD5Vld
          data-send-points:
            access DSP_CanCom_FD5TxSignalsSR_COMTX_GPS_UTC_Hour_TELEMATIC_FD_1_FD5: accessed-variable=CanCom_FD5TxSignalsSR.COMTX_GPS_UTC_Hour_TELEMATIC_FD_1_FD5
        SendCANR_GPS_UTC_Minute_FD5: can-be-invoked-concurrently=true, symbol=ApplCanComAb_FD5_SendCANR_GPS_UTC_Minute_FD5  # Transmit
          data-receive-point-by-arguments:
            access DRP_SendCANR_GPS_UTC_Minute_FD5_SendCANR_GPS_UTC_Minute_FD5: accessed-variable=SendCANR_GPS_UTC_Minute_FD5.SendCANR_GPS_UTC_Minute_FD5
            access DRP_SendCANR_GPS_UTC_Minute_FD5Vld_SendCANR_GPS_UTC_Minute_FD5Vld: accessed-variable=SendCANR_GPS_UTC_Minute_FD5Vld.SendCANR_GPS_UTC_Minute_FD5Vld
          data-send-points:
            access DSP_CanCom_FD5TxSignalsSR_COMTX_GPS_UTC_Minute_TELEMATIC_FD_1_FD5: accessed-variable=CanCom_FD5TxSignalsSR.COMTX_GPS_UTC_Minute_TELEMATIC_FD_1_FD5
        SendCANR_GPS_UTC_Second_FD5: can-be-invoked-concurrently=true, symbol=ApplCanComAb_FD5_SendCANR_GPS_UTC_Second_FD5  # Transmit
          data-receive-point-by-arguments:
            access DRP_SendCANR_GPS_UTC_Second_FD5_SendCANR_GPS_UTC_Second_FD5: accessed-variable=SendCANR_GPS_UTC_Second_FD5.SendCANR_GPS_UTC_Second_FD5
            access DRP_SendCANR_GPS_UTC_Second_FD5Vld_SendCANR_GPS_UTC_Second_FD5Vld: accessed-variable=SendCANR_GPS_UTC_Second_FD5Vld.SendCANR_GPS_UTC_Second_FD5Vld
          data-send-points:
            access DSP_CanCom_FD5TxSignalsSR_COMTX_GPS_UTC_Second_TELEMATIC_FD_1_FD5: accessed-variable=CanCom_FD5TxSignalsSR.COMTX_GPS_UTC_Second_TELEMATIC_FD_1_FD5
        SendCANR_HVCMSBlkChrgnCmpltFD5: can-be-invoked-concurrently=true, symbol=ApplCanComAb_FD5_SendCANR_HVCMSBlkChrgnCmpltFD5  # Transmit
          data-receive-point-by-arguments:
            access DRP_SendCANR_HVCMSBlkChrgnCmpltFD5_SendCANR_HVCMSBlkChrgnCmpltFD5: accessed-variable=SendCANR_HVCMSBlkChrgnCmpltFD5.SendCANR_HVCMSBlkChrgnCmpltFD5
            access DRP_SendCANR_HVCMSBlkChrgnCmpltFD5Vld_SendCANR_HVCMSBlkChrgnCmpltFD5Vld: accessed-variable=SendCANR_HVCMSBlkChrgnCmpltFD5Vld.SendCANR_HVCMSBlkChrgnCmpltFD5Vld
          data-send-points:
            access DSP_CanCom_FD5TxSignalsSR_COMTX_HVCMS_BulkChargingComplete_VDCM_OBCM_FD5: accessed-variable=CanCom_FD5TxSignalsSR.COMTX_HVCMS_BulkChargingComplete_VDCM_OBCM_FD5
        SendCANR_HVCMS_ChrgnCompltFD5: can-be-invoked-concurrently=true, symbol=ApplCanComAb_FD5_SendCANR_HVCMS_ChrgnCompltFD5  # Transmit
          data-receive-point-by-arguments:
            access DRP_SendCANR_HVCMS_ChrgnCompltFD5_SendCANR_HVCMS_ChrgnCompltFD5: accessed-variable=SendCANR_HVCMS_ChrgnCompltFD5.SendCANR_HVCMS_ChrgnCompltFD5
            access DRP_SendCANR_HVCMS_ChrgnCompltFD5Vld_SendCANR_HVCMS_ChrgnCompltFD5Vld: accessed-variable=SendCANR_HVCMS_ChrgnCompltFD5Vld.SendCANR_HVCMS_ChrgnCompltFD5Vld
          data-send-points:
            access DSP_CanCom_FD5TxSignalsSR_COMTX_HVCMS_ChargingComplete_VDCM_OBCM_FD5: accessed-variable=CanCom_FD5TxSignalsSR.COMTX_HVCMS_ChargingComplete_VDCM_OBCM_FD5
        SendCANR_HVCMS_EVEnrgCapctFD5: can-be-invoked-concurrently=true, symbol=ApplCanComAb_FD5_SendCANR_HVCMS_EVEnrgCapctFD5  # Transmit
          data-receive-point-by-arguments:
            access DRP_SendCANR_HVCMS_EVEnrgCapctFD5_SendCANR_HVCMS_EVEnrgCapctFD5: accessed-variable=SendCANR_HVCMS_EVEnrgCapctFD5.SendCANR_HVCMS_EVEnrgCapctFD5
            access DRP_SendCANR_HVCMS_EVEnrgCapctFD5Vld_SendCANR_HVCMS_EVEnrgCapctFD5Vld: accessed-variable=SendCANR_HVCMS_EVEnrgCapctFD5Vld.SendCANR_HVCMS_EVEnrgCapctFD5Vld
          data-send-points:
            access DSP_CanCom_FD5TxSignalsSR_COMTX_HVCMS_EVEnergyCapacity_VDCM_OBCM_FD5: accessed-variable=CanCom_FD5TxSignalsSR.COMTX_HVCMS_EVEnergyCapacity_VDCM_OBCM_FD5
        SendCANR_HVCMS_EVEnergRquestFD5: can-be-invoked-concurrently=true, symbol=ApplCanComAb_FD5_SendCANR_HVCMS_EVEnergRquestFD5  # Transmit
          data-receive-point-by-arguments:
            access DRP_SendCANR_HVCMS_EVEnergRquestFD5_SendCANR_HVCMS_EVEnergRquestFD5: accessed-variable=SendCANR_HVCMS_EVEnergRquestFD5.SendCANR_HVCMS_EVEnergRquestFD5
            access DRP_SendCANR_HVCMS_EVEnergRquestFD5Vld_SendCANR_HVCMS_EVEnergRquestFD5Vld: accessed-variable=SendCANR_HVCMS_EVEnergRquestFD5Vld.SendCANR_HVCMS_EVEnergRquestFD5Vld
          data-send-points:
            access DSP_CanCom_FD5TxSignalsSR_COMTX_HVCMS_EVEnergyRequest_VDCM_OBCM_FD5: accessed-variable=CanCom_FD5TxSignalsSR.COMTX_HVCMS_EVEnergyRequest_VDCM_OBCM_FD5
        SendCANR_HVCMS_EVErrorCode_FD5: can-be-invoked-concurrently=true, symbol=ApplCanComAb_FD5_SendCANR_HVCMS_EVErrorCode_FD5  # Transmit
          data-receive-point-by-arguments:
            access DRP_SendCANR_HVCMS_EVErrorCode_FD5_SendCANR_HVCMS_EVErrorCode_FD5: accessed-variable=SendCANR_HVCMS_EVErrorCode_FD5.SendCANR_HVCMS_EVErrorCode_FD5
            access DRP_SendCANR_HVCMS_EVErrorCode_FD5Vld_SendCANR_HVCMS_EVErrorCode_FD5Vld: accessed-variable=SendCANR_HVCMS_EVErrorCode_FD5Vld.SendCANR_HVCMS_EVErrorCode_FD5Vld
          data-send-points:
            access DSP_CanCom_FD5TxSignalsSR_COMTX_HVCMS_EVErrorCode_VDCM_OBCM_FD5: accessed-variable=CanCom_FD5TxSignalsSR.COMTX_HVCMS_EVErrorCode_VDCM_OBCM_FD5
        SendCANR_HVCMS_EVMax_I_LimitFD5: can-be-invoked-concurrently=true, symbol=ApplCanComAb_FD5_SendCANR_HVCMS_EVMax_I_LimitFD5  # Transmit
          data-receive-point-by-arguments:
            access DRP_SendCANR_HVCMS_EVMax_I_LimitFD5_SendCANR_HVCMS_EVMax_I_LimitFD5: accessed-variable=SendCANR_HVCMS_EVMax_I_LimitFD5.SendCANR_HVCMS_EVMax_I_LimitFD5
            access DRP_SendCANR_HVCMS_EVMax_I_LimitFD5Vld_SendCANR_HVCMS_EVMax_I_LimitFD5Vld: accessed-variable=SendCANR_HVCMS_EVMax_I_LimitFD5Vld.SendCANR_HVCMS_EVMax_I_LimitFD5Vld
          data-send-points:
            access DSP_CanCom_FD5TxSignalsSR_COMTX_HVCMS_EVMax_I_Limit_VDCM_OBCM_FD5: accessed-variable=CanCom_FD5TxSignalsSR.COMTX_HVCMS_EVMax_I_Limit_VDCM_OBCM_FD5
        SendCANR_HVCMS_EVMax_P_LimitFD5: can-be-invoked-concurrently=true, symbol=ApplCanComAb_FD5_SendCANR_HVCMS_EVMax_P_LimitFD5  # Transmit
          data-receive-point-by-arguments:
            access DRP_SendCANR_HVCMS_EVMax_P_LimitFD5_SendCANR_HVCMS_EVMax_P_LimitFD5: accessed-variable=SendCANR_HVCMS_EVMax_P_LimitFD5.SendCANR_HVCMS_EVMax_P_LimitFD5
            access DRP_SendCANR_HVCMS_EVMax_P_LimitFD5Vld_SendCANR_HVCMS_EVMax_P_LimitFD5Vld: accessed-variable=SendCANR_HVCMS_EVMax_P_LimitFD5Vld.SendCANR_HVCMS_EVMax_P_LimitFD5Vld
          data-send-points:
            access DSP_CanCom_FD5TxSignalsSR_COMTX_HVCMS_EVMax_P_Limit_VDCM_OBCM_FD5: accessed-variable=CanCom_FD5TxSignalsSR.COMTX_HVCMS_EVMax_P_Limit_VDCM_OBCM_FD5
        SendCANR_HVCMS_EVMax_V_LimitFD5: can-be-invoked-concurrently=true, symbol=ApplCanComAb_FD5_SendCANR_HVCMS_EVMax_V_LimitFD5  # Transmit
          data-receive-point-by-arguments:
            access DRP_SendCANR_HVCMS_EVMax_V_LimitFD5_SendCANR_HVCMS_EVMax_V_LimitFD5: accessed-variable=SendCANR_HVCMS_EVMax_V_LimitFD5.SendCANR_HVCMS_EVMax_V_LimitFD5
            access DRP_SendCANR_HVCMS_EVMax_V_LimitFD5Vld_SendCANR_HVCMS_EVMax_V_LimitFD5Vld: accessed-variable=SendCANR_HVCMS_EVMax_V_LimitFD5Vld.SendCANR_HVCMS_EVMax_V_LimitFD5Vld
          data-send-points:
            access DSP_CanCom_FD5TxSignalsSR_COMTX_HVCMS_EVMax_V_Limit_VDCM_OBCM_FD5: accessed-variable=CanCom_FD5TxSignalsSR.COMTX_HVCMS_EVMax_V_Limit_VDCM_OBCM_FD5
        SendCANR_HVCMS_EVReady_FD5: can-be-invoked-concurrently=true, symbol=ApplCanComAb_FD5_SendCANR_HVCMS_EVReady_FD5  # Transmit
          data-receive-point-by-arguments:
            access DRP_SendCANR_HVCMS_EVReady_FD5_SendCANR_HVCMS_EVReady_FD5: accessed-variable=SendCANR_HVCMS_EVReady_FD5.SendCANR_HVCMS_EVReady_FD5
            access DRP_SendCANR_HVCMS_EVReady_FD5Vld_SendCANR_HVCMS_EVReady_FD5Vld: accessed-variable=SendCANR_HVCMS_EVReady_FD5Vld.SendCANR_HVCMS_EVReady_FD5Vld
          data-send-points:
            access DSP_CanCom_FD5TxSignalsSR_COMTX_HVCMS_EVReady_VDCM_OBCM_FD5: accessed-variable=CanCom_FD5TxSignalsSR.COMTX_HVCMS_EVReady_VDCM_OBCM_FD5
        SendCANR_HVCMS_EVRESS_SOC_FD5: can-be-invoked-concurrently=true, symbol=ApplCanComAb_FD5_SendCANR_HVCMS_EVRESS_SOC_FD5  # Transmit
          data-receive-point-by-arguments:
            access DRP_SendCANR_HVCMS_EVRESS_SOC_FD5_SendCANR_HVCMS_EVRESS_SOC_FD5: accessed-variable=SendCANR_HVCMS_EVRESS_SOC_FD5.SendCANR_HVCMS_EVRESS_SOC_FD5
            access DRP_SendCANR_HVCMS_EVRESS_SOC_FD5Vld_SendCANR_HVCMS_EVRESS_SOC_FD5Vld: accessed-variable=SendCANR_HVCMS_EVRESS_SOC_FD5Vld.SendCANR_HVCMS_EVRESS_SOC_FD5Vld
          data-send-points:
            access DSP_CanCom_FD5TxSignalsSR_COMTX_HVCMS_EVRESS_SOC_VDCM_OBCM_FD5: accessed-variable=CanCom_FD5TxSignalsSR.COMTX_HVCMS_EVRESS_SOC_VDCM_OBCM_FD5
        SendCANR_HVCMS_EVRESSCndtninFD5: can-be-invoked-concurrently=true, symbol=ApplCanComAb_FD5_SendCANR_HVCMS_EVRESSCndtninFD5  # Transmit
          data-receive-point-by-arguments:
            access DRP_SendCANR_HVCMS_EVRESSCndtninFD5_SendCANR_HVCMS_EVRESSCndtninFD5: accessed-variable=SendCANR_HVCMS_EVRESSCndtninFD5.SendCANR_HVCMS_EVRESSCndtninFD5
            access DRP_SendCANR_HVCMS_EVRESSCndtninFD5Vld_SendCANR_HVCMS_EVRESSCndtninFD5Vld: accessed-variable=SendCANR_HVCMS_EVRESSCndtninFD5Vld.SendCANR_HVCMS_EVRESSCndtninFD5Vld
          data-send-points:
            access DSP_CanCom_FD5TxSignalsSR_COMTX_HVCMS_EVRESSConditioning_VDCM_OBCM_FD5: accessed-variable=CanCom_FD5TxSignalsSR.COMTX_HVCMS_EVRESSConditioning_VDCM_OBCM_FD5
        SendCANR_HVCMS_EVTargetCurntFD5: can-be-invoked-concurrently=true, symbol=ApplCanComAb_FD5_SendCANR_HVCMS_EVTargetCurntFD5  # Transmit
          data-receive-point-by-arguments:
            access DRP_SendCANR_HVCMS_EVTargetCurntFD5_SendCANR_HVCMS_EVTargetCurntFD5: accessed-variable=SendCANR_HVCMS_EVTargetCurntFD5.SendCANR_HVCMS_EVTargetCurntFD5
            access DRP_SendCANR_HVCMS_EVTargetCurntFD5Vld_SendCANR_HVCMS_EVTargetCurntFD5Vld: accessed-variable=SendCANR_HVCMS_EVTargetCurntFD5Vld.SendCANR_HVCMS_EVTargetCurntFD5Vld
          data-send-points:
            access DSP_CanCom_FD5TxSignalsSR_COMTX_HVCMS_EVTargetCurrent_VDCM_OBCM_FD5: accessed-variable=CanCom_FD5TxSignalsSR.COMTX_HVCMS_EVTargetCurrent_VDCM_OBCM_FD5
        SendCANR_HVCMS_EVTargetVoltFD5: can-be-invoked-concurrently=true, symbol=ApplCanComAb_FD5_SendCANR_HVCMS_EVTargetVoltFD5  # Transmit
          data-receive-point-by-arguments:
            access DRP_SendCANR_HVCMS_EVTargetVoltFD5_SendCANR_HVCMS_EVTargetVoltFD5: accessed-variable=SendCANR_HVCMS_EVTargetVoltFD5.SendCANR_HVCMS_EVTargetVoltFD5
            access DRP_SendCANR_HVCMS_EVTargetVoltFD5Vld_SendCANR_HVCMS_EVTargetVoltFD5Vld: accessed-variable=SendCANR_HVCMS_EVTargetVoltFD5Vld.SendCANR_HVCMS_EVTargetVoltFD5Vld
          data-send-points:
            access DSP_CanCom_FD5TxSignalsSR_COMTX_HVCMS_EVTargetVoltage_VDCM_OBCM_FD5: accessed-variable=CanCom_FD5TxSignalsSR.COMTX_HVCMS_EVTargetVoltage_VDCM_OBCM_FD5
        SendCANR_HVCMSProtocolEntry1FD5: can-be-invoked-concurrently=true, symbol=ApplCanComAb_FD5_SendCANR_HVCMSProtocolEntry1FD5  # Transmit
          data-receive-point-by-arguments:
            access DRP_SendCANR_HVCMSProtocolEntry1FD5_SendCANR_HVCMSProtocolEntry1FD5: accessed-variable=SendCANR_HVCMSProtocolEntry1FD5.SendCANR_HVCMSProtocolEntry1FD5
            access DRP_SendCANR_HVCMSProtocolEntry1FD5Vld_SendCANR_HVCMSProtocolEntry1FD5Vld: accessed-variable=SendCANR_HVCMSProtocolEntry1FD5Vld.SendCANR_HVCMSProtocolEntry1FD5Vld
          data-send-points:
            access DSP_CanCom_FD5TxSignalsSR_COMTX_HVCMS_Protocol_Entry1_VDCM_OBCM_FD5: accessed-variable=CanCom_FD5TxSignalsSR.COMTX_HVCMS_Protocol_Entry1_VDCM_OBCM_FD5
        SendCANR_HVCMSProtocolEntry2FD5: can-be-invoked-concurrently=true, symbol=ApplCanComAb_FD5_SendCANR_HVCMSProtocolEntry2FD5  # Transmit
          data-receive-point-by-arguments:
            access DRP_SendCANR_HVCMSProtocolEntry2FD5_SendCANR_HVCMSProtocolEntry2FD5: accessed-variable=SendCANR_HVCMSProtocolEntry2FD5.SendCANR_HVCMSProtocolEntry2FD5
            access DRP_SendCANR_HVCMSProtocolEntry2FD5Vld_SendCANR_HVCMSProtocolEntry2FD5Vld: accessed-variable=SendCANR_HVCMSProtocolEntry2FD5Vld.SendCANR_HVCMSProtocolEntry2FD5Vld
          data-send-points:
            access DSP_CanCom_FD5TxSignalsSR_COMTX_HVCMS_Protocol_Entry2_VDCM_OBCM_FD5: accessed-variable=CanCom_FD5TxSignalsSR.COMTX_HVCMS_Protocol_Entry2_VDCM_OBCM_FD5
        SendCANR_HVCMSProtocolEntry3FD5: can-be-invoked-concurrently=true, symbol=ApplCanComAb_FD5_SendCANR_HVCMSProtocolEntry3FD5  # Transmit
          data-receive-point-by-arguments:
            access DRP_SendCANR_HVCMSProtocolEntry3FD5_SendCANR_HVCMSProtocolEntry3FD5: accessed-variable=SendCANR_HVCMSProtocolEntry3FD5.SendCANR_HVCMSProtocolEntry3FD5
            access DRP_SendCANR_HVCMSProtocolEntry3FD5Vld_SendCANR_HVCMSProtocolEntry3FD5Vld: accessed-variable=SendCANR_HVCMSProtocolEntry3FD5Vld.SendCANR_HVCMSProtocolEntry3FD5Vld
          data-send-points:
            access DSP_CanCom_FD5TxSignalsSR_COMTX_HVCMS_Protocol_Entry3_VDCM_OBCM_FD5: accessed-variable=CanCom_FD5TxSignalsSR.COMTX_HVCMS_Protocol_Entry3_VDCM_OBCM_FD5
        SendCANR_HVCMSReadyToChgStatFD5: can-be-invoked-concurrently=true, symbol=ApplCanComAb_FD5_SendCANR_HVCMSReadyToChgStatFD5  # Transmit
          data-receive-point-by-arguments:
            access DRP_SendCANR_HVCMSReadyToChgStatFD5_SendCANR_HVCMSReadyToChgStatFD5: accessed-variable=SendCANR_HVCMSReadyToChgStatFD5.SendCANR_HVCMSReadyToChgStatFD5
            access DRP_SendCANR_HVCMSReadyToChgStatFD5Vld_SendCANR_HVCMSReadyToChgStatFD5Vld: accessed-variable=SendCANR_HVCMSReadyToChgStatFD5Vld.SendCANR_HVCMSReadyToChgStatFD5Vld
          data-send-points:
            access DSP_CanCom_FD5TxSignalsSR_COMTX_HVCMS_ReadyToChargeState_VDCM_OBCM_FD5: accessed-variable=CanCom_FD5TxSignalsSR.COMTX_HVCMS_ReadyToChargeState_VDCM_OBCM_FD5
        SendCANR_HVCMSRemTimToBlkSOCFD5: can-be-invoked-concurrently=true, symbol=ApplCanComAb_FD5_SendCANR_HVCMSRemTimToBlkSOCFD5  # Transmit
          data-receive-point-by-arguments:
            access DRP_SendCANR_HVCMSRemTimToBlkSOCFD5_SendCANR_HVCMSRemTimToBlkSOCFD5: accessed-variable=SendCANR_HVCMSRemTimToBlkSOCFD5.SendCANR_HVCMSRemTimToBlkSOCFD5
            access DRP_SendCANR_HVCMSRemTimToBlkSOCFD5Vld_SendCANR_HVCMSRemTimToBlkSOCFD5Vld: accessed-variable=SendCANR_HVCMSRemTimToBlkSOCFD5Vld.SendCANR_HVCMSRemTimToBlkSOCFD5Vld
          data-send-points:
            access DSP_CanCom_FD5TxSignalsSR_COMTX_HVCMS_RemaningTimeToBulkSOC_VDCM_OBCM_FD5: accessed-variable=CanCom_FD5TxSignalsSR.COMTX_HVCMS_RemaningTimeToBulkSOC_VDCM_OBCM_FD5
        SendCANR_HVCMSRemTimToFulSOCFD5: can-be-invoked-concurrently=true, symbol=ApplCanComAb_FD5_SendCANR_HVCMSRemTimToFulSOCFD5  # Transmit
          data-receive-point-by-arguments:
            access DRP_SendCANR_HVCMSRemTimToFulSOCFD5_SendCANR_HVCMSRemTimToFulSOCFD5: accessed-variable=SendCANR_HVCMSRemTimToFulSOCFD5.SendCANR_HVCMSRemTimToFulSOCFD5
            access DRP_SendCANR_HVCMSRemTimToFulSOCFD5Vld_SendCANR_HVCMSRemTimToFulSOCFD5Vld: accessed-variable=SendCANR_HVCMSRemTimToFulSOCFD5Vld.SendCANR_HVCMSRemTimToFulSOCFD5Vld
          data-send-points:
            access DSP_CanCom_FD5TxSignalsSR_COMTX_HVCMS_RemaningTimeToFullSOC_VDCM_OBCM_FD5: accessed-variable=CanCom_FD5TxSignalsSR.COMTX_HVCMS_RemaningTimeToFullSOC_VDCM_OBCM_FD5
        SendCANR_HVCMSSlfEnrgTrnfTypFD5: can-be-invoked-concurrently=true, symbol=ApplCanComAb_FD5_SendCANR_HVCMSSlfEnrgTrnfTypFD5  # Transmit
          data-receive-point-by-arguments:
            access DRP_SendCANR_HVCMSSlfEnrgTrnfTypFD5_SendCANR_HVCMSSlfEnrgTrnfTypFD5: accessed-variable=SendCANR_HVCMSSlfEnrgTrnfTypFD5.SendCANR_HVCMSSlfEnrgTrnfTypFD5
            access DRP_SendCANR_HVCMSSlfEnrgTrnfTypFD5Vld_SendCANR_HVCMSSlfEnrgTrnfTypFD5Vld: accessed-variable=SendCANR_HVCMSSlfEnrgTrnfTypFD5Vld.SendCANR_HVCMSSlfEnrgTrnfTypFD5Vld
          data-send-points:
            access DSP_CanCom_FD5TxSignalsSR_COMTX_HVCMS_SelectedEnergyTransferType_VDCM_OBCM_FD5: accessed-variable=CanCom_FD5TxSignalsSR.COMTX_HVCMS_SelectedEnergyTransferType_VDCM_OBCM_FD5
        SendCANR_HVCMS_SeldPymntOptnFD5: can-be-invoked-concurrently=true, symbol=ApplCanComAb_FD5_SendCANR_HVCMS_SeldPymntOptnFD5  # Transmit
          data-receive-point-by-arguments:
            access DRP_SendCANR_HVCMS_SeldPymntOptnFD5_SendCANR_HVCMS_SeldPymntOptnFD5: accessed-variable=SendCANR_HVCMS_SeldPymntOptnFD5.SendCANR_HVCMS_SeldPymntOptnFD5
            access DRP_SendCANR_HVCMS_SeldPymntOptnFD5Vld_SendCANR_HVCMS_SeldPymntOptnFD5Vld: accessed-variable=SendCANR_HVCMS_SeldPymntOptnFD5Vld.SendCANR_HVCMS_SeldPymntOptnFD5Vld
          data-send-points:
            access DSP_CanCom_FD5TxSignalsSR_COMTX_HVCMS_SelectedPaymentOptn_VDCM_OBCM_FD5: accessed-variable=CanCom_FD5TxSignalsSR.COMTX_HVCMS_SelectedPaymentOptn_VDCM_OBCM_FD5
        SendCANR_HVCMSSelectedServIdFD5: can-be-invoked-concurrently=true, symbol=ApplCanComAb_FD5_SendCANR_HVCMSSelectedServIdFD5  # Transmit
          data-receive-point-by-arguments:
            access DRP_SendCANR_HVCMSSelectedServIdFD5_SendCANR_HVCMSSelectedServIdFD5: accessed-variable=SendCANR_HVCMSSelectedServIdFD5.SendCANR_HVCMSSelectedServIdFD5
            access DRP_SendCANR_HVCMSSelectedServIdFD5Vld_SendCANR_HVCMSSelectedServIdFD5Vld: accessed-variable=SendCANR_HVCMSSelectedServIdFD5Vld.SendCANR_HVCMSSelectedServIdFD5Vld
          data-send-points:
            access DSP_CanCom_FD5TxSignalsSR_COMTX_HVCMS_SelectedServiceId_VDCM_OBCM_FD5: accessed-variable=CanCom_FD5TxSignalsSR.COMTX_HVCMS_SelectedServiceId_VDCM_OBCM_FD5
        SendCANR_HVCMSServiceCatgoryFD5: can-be-invoked-concurrently=true, symbol=ApplCanComAb_FD5_SendCANR_HVCMSServiceCatgoryFD5  # Transmit
          data-receive-point-by-arguments:
            access DRP_SendCANR_HVCMSServiceCatgoryFD5_SendCANR_HVCMSServiceCatgoryFD5: accessed-variable=SendCANR_HVCMSServiceCatgoryFD5.SendCANR_HVCMSServiceCatgoryFD5
            access DRP_SendCANR_HVCMSServiceCatgoryFD5Vld_SendCANR_HVCMSServiceCatgoryFD5Vld: accessed-variable=SendCANR_HVCMSServiceCatgoryFD5Vld.SendCANR_HVCMSServiceCatgoryFD5Vld
          data-send-points:
            access DSP_CanCom_FD5TxSignalsSR_COMTX_HVCMS_ServiceCategory_VDCM_OBCM_FD5: accessed-variable=CanCom_FD5TxSignalsSR.COMTX_HVCMS_ServiceCategory_VDCM_OBCM_FD5
        SendCANR_HVCMS_ServiceScope_FD5: can-be-invoked-concurrently=true, symbol=ApplCanComAb_FD5_SendCANR_HVCMS_ServiceScope_FD5  # Transmit
          data-receive-point-by-arguments:
            access DRP_SendCANR_HVCMS_ServiceScope_FD5_SendCANR_HVCMS_ServiceScope_FD5: accessed-variable=SendCANR_HVCMS_ServiceScope_FD5.SendCANR_HVCMS_ServiceScope_FD5
            access DRP_SendCANR_HVCMS_ServiceScope_FD5Vld_SendCANR_HVCMS_ServiceScope_FD5Vld: accessed-variable=SendCANR_HVCMS_ServiceScope_FD5Vld.SendCANR_HVCMS_ServiceScope_FD5Vld
          data-send-points:
            access DSP_CanCom_FD5TxSignalsSR_COMTX_HVCMS_ServiceScope_VDCM_OBCM_FD5: accessed-variable=CanCom_FD5TxSignalsSR.COMTX_HVCMS_ServiceScope_VDCM_OBCM_FD5
        SendCANR_OBCMOutVoltSyncTgtFD15: can-be-invoked-concurrently=true, symbol=ApplCanComAb_FD5_SendCANR_OBCMOutVoltSyncTgtFD15  # Transmit
          data-receive-point-by-arguments:
            access DRP_SendCANR_OBCMOutVoltSyncTgtFD15_SendCANR_OBCMOutVoltSyncTgtFD15: accessed-variable=SendCANR_OBCMOutVoltSyncTgtFD15.SendCANR_OBCMOutVoltSyncTgtFD15
            access DRP_SendCANR_OBCMOutVoltSyncTgtFD15Vld_SendCANR_OBCMOutVoltSyncTgtFD15Vld: accessed-variable=SendCANR_OBCMOutVoltSyncTgtFD15Vld.SendCANR_OBCMOutVoltSyncTgtFD15Vld
          data-send-points:
            access DSP_CanCom_FD5TxSignalsSR_COMTX_OBCM_OutVoltageSyncTgt_VDCM_OBCM_FD5: accessed-variable=CanCom_FD5TxSignalsSR.COMTX_OBCM_OutVoltageSyncTgt_VDCM_OBCM_FD5
        SendCANR_VDCM_BattBulkSOC_FD5: can-be-invoked-concurrently=true, symbol=ApplCanComAb_FD5_SendCANR_VDCM_BattBulkSOC_FD5  # Transmit
          data-receive-point-by-arguments:
            access DRP_SendCANR_VDCM_BattBulkSOC_FD5_SendCANR_VDCM_BattBulkSOC_FD5: accessed-variable=SendCANR_VDCM_BattBulkSOC_FD5.SendCANR_VDCM_BattBulkSOC_FD5
            access DRP_SendCANR_VDCM_BattBulkSOC_FD5Vld_SendCANR_VDCM_BattBulkSOC_FD5Vld: accessed-variable=SendCANR_VDCM_BattBulkSOC_FD5Vld.SendCANR_VDCM_BattBulkSOC_FD5Vld
          data-send-points:
            access DSP_CanCom_FD5TxSignalsSR_COMTX_VDCM_BattBulkSOC_VDCM_OBCM_FD5: accessed-variable=CanCom_FD5TxSignalsSR.COMTX_VDCM_BattBulkSOC_VDCM_OBCM_FD5
        SendCANR_VDCM_CntrctAuthIDFD5: can-be-invoked-concurrently=true, symbol=ApplCanComAb_FD5_SendCANR_VDCM_CntrctAuthIDFD5  # Transmit
          data-receive-point-by-arguments:
            access DRP_SendCANR_VDCM_CntrctAuthIDFD5_SendCANR_VDCM_CntrctAuthIDFD5: accessed-variable=SendCANR_VDCM_CntrctAuthIDFD5.SendCANR_VDCM_CntrctAuthIDFD5
            access DRP_SendCANR_VDCM_CntrctAuthIDFD5Vld_SendCANR_VDCM_CntrctAuthIDFD5Vld: accessed-variable=SendCANR_VDCM_CntrctAuthIDFD5Vld.SendCANR_VDCM_CntrctAuthIDFD5Vld
          data-send-points:
            access DSP_CanCom_FD5TxSignalsSR_COMTX_VDCM_ContractAuthenticationID_VDCM_OBCM_FD5: accessed-variable=CanCom_FD5TxSignalsSR.COMTX_VDCM_ContractAuthenticationID_VDCM_OBCM_FD5
        SendCANR_VDCM_GenChallenge_FD5: can-be-invoked-concurrently=true, symbol=ApplCanComAb_FD5_SendCANR_VDCM_GenChallenge_FD5  # Transmit
          data-receive-point-by-arguments:
            access DRP_SendCANR_VDCM_GenChallenge_FD5_SendCANR_VDCM_GenChallenge_FD5: accessed-variable=SendCANR_VDCM_GenChallenge_FD5.SendCANR_VDCM_GenChallenge_FD5
            access DRP_SendCANR_VDCM_GenChallenge_FD5Vld_SendCANR_VDCM_GenChallenge_FD5Vld: accessed-variable=SendCANR_VDCM_GenChallenge_FD5Vld.SendCANR_VDCM_GenChallenge_FD5Vld
          data-send-points:
            access DSP_CanCom_FD5TxSignalsSR_COMTX_VDCM_GenChallenge_VDCM_OBCM_FD5: accessed-variable=CanCom_FD5TxSignalsSR.COMTX_VDCM_GenChallenge_VDCM_OBCM_FD5
        SendCANR_VDCMOBCDchaCurrLimFD5: can-be-invoked-concurrently=true, symbol=ApplCanComAb_FD5_SendCANR_VDCMOBCDchaCurrLimFD5  # Transmit
          data-receive-point-by-arguments:
            access DRP_SendCANR_VDCMOBCDchaCurrLimFD5_SendCANR_VDCMOBCDchaCurrLimFD5: accessed-variable=SendCANR_VDCMOBCDchaCurrLimFD5.SendCANR_VDCMOBCDchaCurrLimFD5
            access DRP_SendCANR_VDCMOBCDchaCurrLimFD5Vld_SendCANR_VDCMOBCDchaCurrLimFD5Vld: accessed-variable=SendCANR_VDCMOBCDchaCurrLimFD5Vld.SendCANR_VDCMOBCDchaCurrLimFD5Vld
          data-send-points:
            access DSP_CanCom_FD5TxSignalsSR_COMTX_VDCM_OBCDischCurrentLim_VDCM_OBCM_FD5: accessed-variable=CanCom_FD5TxSignalsSR.COMTX_VDCM_OBCDischCurrentLim_VDCM_OBCM_FD5
        SendCANR_VDCMTypeCNegotnStsFD5: can-be-invoked-concurrently=true, symbol=ApplCanComAb_FD5_SendCANR_VDCMTypeCNegotnStsFD5  # Transmit
          data-receive-point-by-arguments:
            access DRP_SendCANR_VDCMTypeCNegotnStsFD5_SendCANR_VDCMTypeCNegotnStsFD5: accessed-variable=SendCANR_VDCMTypeCNegotnStsFD5.SendCANR_VDCMTypeCNegotnStsFD5
            access DRP_SendCANR_VDCMTypeCNegotnStsFD5Vld_SendCANR_VDCMTypeCNegotnStsFD5Vld: accessed-variable=SendCANR_VDCMTypeCNegotnStsFD5Vld.SendCANR_VDCMTypeCNegotnStsFD5Vld
          data-send-points:
            access DSP_CanCom_FD5TxSignalsSR_COMTX_VDCM_TypeCNegotiationSts_VDCM_OBCM_FD5: accessed-variable=CanCom_FD5TxSignalsSR.COMTX_VDCM_TypeCNegotiationSts_VDCM_OBCM_FD5
        SendCANR_ClrLgsDiagInfo_FD5: can-be-invoked-concurrently=true, symbol=ApplCanComAb_FD5_SendCANR_ClrLgsDiagInfo_FD5  # Transmit
          data-receive-point-by-arguments:
            access DRP_SendCANR_ClrLgsDiagInfo_FD5_SendCANR_ClrLgsDiagInfo_FD5: accessed-variable=SendCANR_ClrLgsDiagInfo_FD5.SendCANR_ClrLgsDiagInfo_FD5
            access DRP_SendCANR_ClrLgsDiagInfo_FD5Vld_SendCANR_ClrLgsDiagInfo_FD5Vld: accessed-variable=SendCANR_ClrLgsDiagInfo_FD5Vld.SendCANR_ClrLgsDiagInfo_FD5Vld
          data-send-points:
            access DSP_CanCom_FD5TxSignalsSR_COMTX_ClrLgsDiagInfo_VDCM_PWT3_FD5: accessed-variable=CanCom_FD5TxSignalsSR.COMTX_ClrLgsDiagInfo_VDCM_PWT3_FD5
        SendCANR_T4_Sensor_Temp_FD5: can-be-invoked-concurrently=true, symbol=ApplCanComAb_FD5_SendCANR_T4_Sensor_Temp_FD5  # Transmit
          data-receive-point-by-arguments:
            access DRP_SendCANR_T4_Sensor_Temp_FD5_SendCANR_T4_Sensor_Temp_FD5: accessed-variable=SendCANR_T4_Sensor_Temp_FD5.SendCANR_T4_Sensor_Temp_FD5
            access DRP_SendCANR_T4_Sensor_Temp_FD5Vld_SendCANR_T4_Sensor_Temp_FD5Vld: accessed-variable=SendCANR_T4_Sensor_Temp_FD5Vld.SendCANR_T4_Sensor_Temp_FD5Vld
          data-send-points:
            access DSP_CanCom_FD5TxSignalsSR_COMTX_T4_Sensor_Temp_VDCM_PWT3_FD5: accessed-variable=CanCom_FD5TxSignalsSR.COMTX_T4_Sensor_Temp_VDCM_PWT3_FD5
        SendCANR_T7_CoolantTmpVldty_FD5: can-be-invoked-concurrently=true, symbol=ApplCanComAb_FD5_SendCANR_T7_CoolantTmpVldty_FD5  # Transmit
          data-receive-point-by-arguments:
            access DRP_SendCANR_T7_CoolantTmpVldty_FD5_SendCANR_T7_CoolantTmpVldty_FD5: accessed-variable=SendCANR_T7_CoolantTmpVldty_FD5.SendCANR_T7_CoolantTmpVldty_FD5
            access DRP_SendCANR_T7_CoolantTmpVldty_FD5Vld_SendCANR_T7_CoolantTmpVldty_FD5Vld: accessed-variable=SendCANR_T7_CoolantTmpVldty_FD5Vld.SendCANR_T7_CoolantTmpVldty_FD5Vld
          data-send-points:
            access DSP_CanCom_FD5TxSignalsSR_COMTX_T7_CoolantTempVldty_VDCM_PWT3_FD5: accessed-variable=CanCom_FD5TxSignalsSR.COMTX_T7_CoolantTempVldty_VDCM_PWT3_FD5
        SendCANR_T7_Sensor_Temp_FD5: can-be-invoked-concurrently=true, symbol=ApplCanComAb_FD5_SendCANR_T7_Sensor_Temp_FD5  # Transmit
          data-receive-point-by-arguments:
            access DRP_SendCANR_T7_Sensor_Temp_FD5_SendCANR_T7_Sensor_Temp_FD5: accessed-variable=SendCANR_T7_Sensor_Temp_FD5.SendCANR_T7_Sensor_Temp_FD5
            access DRP_SendCANR_T7_Sensor_Temp_FD5Vld_SendCANR_T7_Sensor_Temp_FD5Vld: accessed-variable=SendCANR_T7_Sensor_Temp_FD5Vld.SendCANR_T7_Sensor_Temp_FD5Vld
          data-send-points:
            access DSP_CanCom_FD5TxSignalsSR_COMTX_T7_Sensor_Temp_VDCM_PWT3_FD5: accessed-variable=CanCom_FD5TxSignalsSR.COMTX_T7_Sensor_Temp_VDCM_PWT3_FD5
        SendCANR_VIN_DATA_FD5: can-be-invoked-concurrently=true, symbol=ApplCanComAb_FD5_SendCANR_VIN_DATA_FD5  # Transmit
          data-receive-point-by-arguments:
            access DRP_SendCANR_VIN_DATA_FD5_SendCANR_VIN_DATA_FD5: accessed-variable=SendCANR_VIN_DATA_FD5.SendCANR_VIN_DATA_FD5
            access DRP_SendCANR_VIN_DATA_FD5Vld_SendCANR_VIN_DATA_FD5Vld: accessed-variable=SendCANR_VIN_DATA_FD5Vld.SendCANR_VIN_DATA_FD5Vld
          data-send-points:
            access DSP_CanCom_FD5TxSignalsSR_COMTX_VIN_DATA_VIN_FD5: accessed-variable=CanCom_FD5TxSignalsSR.COMTX_VIN_DATA_VIN_FD5
        SendCANR_VIN_MSG_FD5: can-be-invoked-concurrently=true, symbol=ApplCanComAb_FD5_SendCANR_VIN_MSG_FD5  # Transmit
          data-receive-point-by-arguments:
            access DRP_SendCANR_VIN_MSG_FD5_SendCANR_VIN_MSG_FD5: accessed-variable=SendCANR_VIN_MSG_FD5.SendCANR_VIN_MSG_FD5
            access DRP_SendCANR_VIN_MSG_FD5Vld_SendCANR_VIN_MSG_FD5Vld: accessed-variable=SendCANR_VIN_MSG_FD5Vld.SendCANR_VIN_MSG_FD5Vld
          data-send-points:
            access DSP_CanCom_FD5TxSignalsSR_COMTX_VIN_MSG_VIN_FD5: accessed-variable=CanCom_FD5TxSignalsSR.COMTX_VIN_MSG_VIN_FD5
