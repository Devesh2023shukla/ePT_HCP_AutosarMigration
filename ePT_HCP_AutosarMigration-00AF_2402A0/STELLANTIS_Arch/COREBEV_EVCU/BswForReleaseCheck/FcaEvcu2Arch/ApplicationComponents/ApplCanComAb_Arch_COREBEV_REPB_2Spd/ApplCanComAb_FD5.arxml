[part 3 of 3: packages /STLASWCs to /STLASWCs/ComSwCpts/ComPrivateInterfaces]
AUTOSAR XML (schema 4-3-0)
package /STLASWCs  (continued)
  complex device driver sw component type ApplCanComAb_FD5  (continued)
    behavior IBApplCanComAb_FD5: data-type-mapping=ADTtoIDTMapping, handle-termination-and-restart=NO-SUPPORT  (continued)
      shared-parameters:
        33 x parameter data prototype, all with type=ADTSBoolean, init-value=1:
          KeCANR_b_ComTxMsg_BCM_FD_10_FD5_Enbld
          KeCANR_b_ComTxMsg_BCM_FD_2_FD5_Enbld
          KeCANR_b_ComTxMsg_BCM_FD_3_FD5_Enbld
          KeCANR_b_ComTxMsg_BCM_FD_7_FD5_Enbld
          KeCANR_b_ComTxMsg_BCM_FD_9_FD5_Enbld
          KeCANR_b_ComTxMsg_BRAKE_FD_2_FD5_Enbld
          KeCANR_b_ComTxMsg_BRAKE_FD_4_FD5_Enbld
          KeCANR_b_ComTxMsg_BRAKE_FD_5_FD5_Enbld
          KeCANR_b_ComTxMsg_EVCU_ISO15118_STATUS1_FD5_Enbld
          KeCANR_b_ComTxMsg_FOTA_MASTER_FD5_Enbld
          KeCANR_b_ComTxMsg_GLIWA_MCPA_RX_FD5_Enbld
          KeCANR_b_ComTxMsg_GLIWA_MCPB_RX_FD5_Enbld
          KeCANR_b_ComTxMsg_HYBRID_CHARGING_COMMAND_FD5_Enbld
          KeCANR_b_ComTxMsg_HYBRID_CHARGING_STATUS_FD5_Enbld
          KeCANR_b_ComTxMsg_HYBRID_FD_LHOM_FD5_Enbld
          KeCANR_b_ComTxMsg_HYBRID_POWERTRAIN1_FD5_Enbld
          KeCANR_b_ComTxMsg_HYBRID_POWERTRAIN5_FD5_Enbld
          KeCANR_b_ComTxMsg_HYBRID_SYSTEM_EPT1_FD5_Enbld
          KeCANR_b_ComTxMsg_HYBRID_THERMAL_COMMAND_FD5_Enbld
          KeCANR_b_ComTxMsg_IMPACT_INFO_FD5_Enbld
          KeCANR_b_ComTxMsg_INVTARGET_PROPULSION1_FD5_Enbld
          KeCANR_b_ComTxMsg_INVTARGET_PROPULSION2_FD5_Enbld
          KeCANR_b_ComTxMsg_IPC_FD_1_FD5_Enbld
          KeCANR_b_ComTxMsg_PT_ENERGY_FD_1_FD5_Enbld
          KeCANR_b_ComTxMsg_PT_SYSTEM_FD_1_FD5_Enbld
          KeCANR_b_ComTxMsg_REAL_TIME_CLOCK_FD5_Enbld
          KeCANR_b_ComTxMsg_RPF_FD_3_FD5_Enbld
          KeCANR_b_ComTxMsg_TELEMATIC_FD_1_FD5_Enbld
          KeCANR_b_ComTxMsg_VDCM_OBCM_FD5_Enbld
          KeCANR_b_ComTxMsg_VDCM_OBCM2_FD5_Enbld
          KeCANR_b_ComTxMsg_VDCM_PWT3_FD5_Enbld
          KeCANR_b_ComTxMsg_VIN_FD5_Enbld
          KeCANR_b_ComTxMsg_CFG_DATA_CODE_REQUEST_FD5_Enbld
package /STLASWCs/ComSwCpts/ComDataDefinition/ComConstSpec
  157 x constant specification:
    COMRX_ACplug_PwrMax_HV_CHARGER2_FD5_Init: value-spec=Value:0
    COMRX_BMS_HV_High_Temp_Thrsh_BATTERY_HV2_FD5_Init: value-spec=Value:0
    COMRX_BMS_HV_Low_Temp_Thrsh_BATTERY_HV2_FD5_Init: value-spec=Value:0
    COMRX_BMS_HV_SOC_AccuracySts_BATTERY_HV2_FD5_Init: value-spec=Value:0
    COMRX_BMS_HV_SOC_Max_BATTERY_HV2_FD5_Init: value-spec=Value:50
    COMRX_BMS_HV_SOC_Min_BATTERY_HV2_FD5_Init: value-spec=Value:50
    COMRX_CLrDiagInfo_MCPA_P_MCPA_STATUS_FD5_Init: value-spec=Value:0
    COMRX_CLrDiagInfo_MCPB_P_MCPB_STATUS_FD5_Init: value-spec=Value:0
    COMRX_CLrDiagInfo_SGCP_P_SGCP_STATUS_FD5_Init: value-spec=Value:0
    COMRX_CRC_MCPA_STATUS_MCPA_STATUS_FD5_Init: value-spec=Value:0
    COMRX_CRC_MCPB_STATUS_MCPB_STATUS_FD5_Init: value-spec=Value:0
    COMRX_CRC_SGCP_STATUS_SGCP_STATUS_FD5_Init: value-spec=Value:0
    COMRX_Charging_WHr_HV_CHARGER2_FD5_Init: value-spec=Value:0
    COMRX_ChrgFailSts_HV_CHARGER2_FD5_Init: value-spec=Value:0
    COMRX_Contract_Certificate_Present_IDCM_ISO15118_STATUS1_FD5_Init: value-spec=Value:0
    COMRX_EVSE_Offered_AC_Single_Phase_IDCM_ISO15118_STATUS1_FD5_Init: value-spec=Value:0
    COMRX_EVSE_Offered_AC_Three_Phase_IDCM_ISO15118_STATUS1_FD5_Init: value-spec=Value:0
    COMRX_HEV_OnRq_BPCM_BATTERY_HV2_FD5_Init: value-spec=Value:0
    COMRX_HVBatCell_Voltage_High_Thrsh_BATTERY_HV2_FD5_Init: value-spec=Value:0
    COMRX_HVBatCell_Voltage_Low_Thrsh_BATTERY_HV2_FD5_Init: value-spec=Value:0
    COMRX_HVBatSleepTime_HVBATTERY_THERMAL_FD5_Init: value-spec=Value:0
    COMRX_ImpactHardwireV_BATTERY_HV_FD5_Init: value-spec=Value:0
    COMRX_ImpactHardwire_BATTERY_HV_FD5_Init: value-spec=Value:0
    COMRX_MCPA_Control_Board_Temperature_P_MCPA_STATUS_FD5_Init: value-spec=Value:255
    COMRX_MCPA_CoolantTemp_P_MCPA_STATUS_FD5_Init: value-spec=Value:0
    COMRX_MCPA_DC_Current_P_MCPA_STATUS_FD5_Init: value-spec=Value:16384
    COMRX_MCPA_DC_Current_V_P_MCPA_STATUS_FD5_Init: value-spec=Value:0
    COMRX_MCPA_DC_Volt_V_P_MCPA_STATUS_FD5_Init: value-spec=Value:0
    COMRX_MCPA_DC_Voltage_P_MCPA_STATUS_FD5_Init: value-spec=Value:0
    COMRX_MCPA_DerateReason_P_MCPA_STATUS_FD5_Init: value-spec=Value:0
    COMRX_MCPA_Inverter_Temp_P_MCPA_STATUS_FD5_Init: value-spec=Value:40
    COMRX_MCPA_PIM_DC_Side_Busbar_Temp_P_MCPA_STATUS_FD5_Init: value-spec=Value:0
    COMRX_MCPA_Rotor_Temperature_P_MCPA_STATUS_FD5_Init: value-spec=Value:255
    COMRX_MCPA_Service_Lamp_Request_P_MCPA_STATUS_FD5_Init: value-spec=Value:0
    COMRX_MCPB_Control_Board_Temperature_P_MCPB_STATUS_FD5_Init: value-spec=Value:0
    COMRX_MCPB_CoolantTemp_P_MCPB_STATUS_FD5_Init: value-spec=Value:0
    COMRX_MCPB_DC_Current_P_MCPB_STATUS_FD5_Init: value-spec=Value:16384
    COMRX_MCPB_DC_Current_V_P_MCPB_STATUS_FD5_Init: value-spec=Value:0
    COMRX_MCPB_DC_Volt_V_P_MCPB_STATUS_FD5_Init: value-spec=Value:0
    COMRX_MCPB_DC_Voltage_P_MCPB_STATUS_FD5_Init: value-spec=Value:0
    COMRX_MCPB_DerateReason_P_MCPB_STATUS_FD5_Init: value-spec=Value:0
    COMRX_MCPB_Inverter_Temp_P_MCPB_STATUS_FD5_Init: value-spec=Value:40
    COMRX_MCPB_PIM_DC_Side_Busbar_Temp_P_MCPB_STATUS_FD5_Init: value-spec=Value:0
    COMRX_MCPB_Rotor_Temperature_P_MCPB_STATUS_FD5_Init: value-spec=Value:255
    COMRX_MCPB_Service_Lamp_Request_P_MCPB_STATUS_FD5_Init: value-spec=Value:0
    COMRX_MC_MCPA_STATUS_MCPA_STATUS_FD5_Init: value-spec=Value:0
    COMRX_MC_MCPB_STATUS_MCPB_STATUS_FD5_Init: value-spec=Value:0
    COMRX_MC_SGCP_STATUS_SGCP_STATUS_FD5_Init: value-spec=Value:0
    COMRX_N_PDU_7B_GLIWA_MCPA_TX_FD5_Init: value-spec=Value:0
    COMRX_N_PDU_7C_GLIWA_MCPB_TX_FD5_Init: value-spec=Value:0
    COMRX_OBCM_PrechargeSts_HV_CHARGER2_FD5_Init: value-spec=Value:0
    COMRX_OBC_CaptureEnvironmentData_HV_CHARGER2_FD5_Init: value-spec=Value:0
    COMRX_OBC_ChargeFailure_HV_CHARGER2_FD5_Init: value-spec=Value:0
    COMRX_OBC_ChargeTimeMin_HV_CHARGER2_FD5_Init: value-spec=Value:0
    COMRX_OBC_ChargeTimeSec_HV_CHARGER2_FD5_Init: value-spec=Value:0
    COMRX_OBC_ChargingFaultSts_HV_CHARGER2_FD5_Init: value-spec=Value:0
    COMRX_OBC_CurrentFailureSts_HV_CHARGER2_FD5_Init: value-spec=Value:0
    COMRX_OBC_EVServiceLampFlash_HV_CHARGER2_FD5_Init: value-spec=Value:0
    COMRX_OBC_EVServiceLampOn_HV_CHARGER2_FD5_Init: value-spec=Value:0
    COMRX_OBC_FaultReason_HV_CHARGER2_FD5_Init: value-spec=Value:0
    COMRX_OBC_GenericFailSts_HV_CHARGER2_FD5_Init: value-spec=Value:0
    COMRX_OBC_IdleTimeMin_HV_CHARGER2_FD5_Init: value-spec=Value:0
    COMRX_OBC_IdleTimeSec_HV_CHARGER2_FD5_Init: value-spec=Value:0
    COMRX_OBC_Pilot_HV_CHARGER2_FD5_Init: value-spec=Value:0
    COMRX_OBC_Prox_HV_CHARGER2_FD5_Init: value-spec=Value:0
    COMRX_OBC_Temp{1..4}_DUALCHARGER_THERMAL_FD5_Init: value-spec=Value:0
    COMRX_OBC_WakeReason_HV_CHARGER2_FD5_Init: value-spec=Value:0
    COMRX_OnboardChargerMode_HV_CHARGER2_FD5_Init: value-spec=Value:0
    COMRX_OnboardChargerReady_HV_CHARGER2_FD5_Init: value-spec=Value:1
    COMRX_SGCP_Control_Board_Temperature_P_SGCP_STATUS_FD5_Init: value-spec=Value:255
    COMRX_SGCP_CoolantTemp_P_SGCP_STATUS_FD5_Init: value-spec=Value:0
    COMRX_SGCP_DC_Current_P_SGCP_STATUS_FD5_Init: value-spec=Value:16384
    COMRX_SGCP_DC_Current_V_P_SGCP_STATUS_FD5_Init: value-spec=Value:0
    COMRX_SGCP_DC_Volt_V_P_SGCP_STATUS_FD5_Init: value-spec=Value:0
    COMRX_SGCP_DC_Voltage_P_SGCP_STATUS_FD5_Init: value-spec=Value:0
    COMRX_SGCP_DerateReason_P_SGCP_STATUS_FD5_Init: value-spec=Value:0
    COMRX_SGCP_Inverter_Temp_P_SGCP_STATUS_FD5_Init: value-spec=Value:40
    COMRX_SGCP_PIM_AC_Side_Busbar_Temp_P_SGCP_STATUS_FD5_Init: value-spec=Value:0
    COMRX_SGCP_PIM_DC_Side_Busbar_Temp_P_SGCP_STATUS_FD5_Init: value-spec=Value:0
    COMRX_SGCP_Rotor_Temperature_P_SGCP_STATUS_FD5_Init: value-spec=Value:255
    COMRX_SGCP_Service_Lamp_Request_P_SGCP_STATUS_FD5_Init: value-spec=Value:0
    COMRX_V2H_HVCMS_EVSEMaxPowerLimit_RPF_FD_1_FD5_Init: value-spec=Value:0
    COMTX_ABSFailSts_BRAKE_FD_5_FD5_Init: value-spec=0
    COMTX_Battery_Volt_1_BCM_FD_3_FD5_Init: value-spec=0
    COMTX_CRC_HYBRID_THERMAL_COMMAND_HYBRID_THERMAL_COMMAND_FD5_Init: value-spec=0
    COMTX_ClrLgsDiagInfo_VDCM_PWT3_FD5_Init: value-spec=0
    COMTX_EOPA_OIL_FlwRate_HYBRID_THERMAL_COMMAND_FD5_Init: value-spec=0
    COMTX_EOPA_OIL_TEMP_HYBRID_THERMAL_COMMAND_FD5_Init: value-spec=0
    COMTX_EOPB_OIL_FlwRate_HYBRID_THERMAL_COMMAND_FD5_Init: value-spec=0
    COMTX_EOPB_OIL_TEMP_HYBRID_THERMAL_COMMAND_FD5_Init: value-spec=0
    COMTX_EPBSts_BRAKE_FD_4_FD5_Init: value-spec=0
    COMTX_ESCFailSts_BRAKE_FD_5_FD5_Init: value-spec=0
    COMTX_EVMaxCurrent_EVCU_ISO15118_STATUS1_FD5_Init: value-spec=0
    COMTX_EVMaxVoltage_EVCU_ISO15118_STATUS1_FD5_Init: value-spec=0
    COMTX_EVMinCurrent_EVCU_ISO15118_STATUS1_FD5_Init: value-spec=0
    COMTX_Eamount_EVCU_ISO15118_STATUS1_FD5_Init: value-spec=0
    COMTX_ExternalTemperature_BCM_FD_9_FD5_Init: value-spec=0
    COMTX_FOTA_Status_FOTA_MASTER_FD5_Init: value-spec=0
    COMTX_GPS_Date_Day_TELEMATIC_FD_1_FD5_Init: value-spec=255
    COMTX_GPS_Date_Month_TELEMATIC_FD_1_FD5_Init: value-spec=255
    COMTX_GPS_Date_Year_TELEMATIC_FD_1_FD5_Init: value-spec=65535
    COMTX_GPS_UTC_Hour_TELEMATIC_FD_1_FD5_Init: value-spec=255
    COMTX_GPS_UTC_Minute_TELEMATIC_FD_1_FD5_Init: value-spec=255
    COMTX_GPS_UTC_Second_TELEMATIC_FD_1_FD5_Init: value-spec=65535
    COMTX_HVCMS_BulkChargingComplete_VDCM_OBCM_FD5_Init: value-spec=0
    COMTX_HVCMS_ChargingComplete_VDCM_OBCM_FD5_Init: value-spec=0
    COMTX_HVCMS_EVEnergyCapacity_VDCM_OBCM_FD5_Init: value-spec=0
    COMTX_HVCMS_EVEnergyRequest_VDCM_OBCM_FD5_Init: value-spec=131071
    COMTX_HVCMS_EVErrorCode_VDCM_OBCM_FD5_Init: value-spec=0
    COMTX_HVCMS_EVMax_I_Limit_VDCM_OBCM_FD5_Init: value-spec=0
    COMTX_HVCMS_EVMax_P_Limit_VDCM_OBCM_FD5_Init: value-spec=0
    COMTX_HVCMS_EVMax_V_Limit_VDCM_OBCM_FD5_Init: value-spec=0
    COMTX_HVCMS_EVRESSConditioning_VDCM_OBCM_FD5_Init: value-spec=0
    COMTX_HVCMS_EVRESS_SOC_VDCM_OBCM_FD5_Init: value-spec=0
    COMTX_HVCMS_EVReady_VDCM_OBCM_FD5_Init: value-spec=0
    COMTX_HVCMS_EVTargetCurrent_VDCM_OBCM_FD5_Init: value-spec=0
    COMTX_HVCMS_EVTargetVoltage_VDCM_OBCM_FD5_Init: value-spec=0
    COMTX_HVCMS_Protocol_Entry{1..3}_VDCM_OBCM_FD5_Init: value-spec=0
    COMTX_HVCMS_ReadyToChargeState_VDCM_OBCM_FD5_Init: value-spec=0
    COMTX_HVCMS_RemaningTimeToBulkSOC_VDCM_OBCM_FD5_Init: value-spec=0
    COMTX_HVCMS_RemaningTimeToFullSOC_VDCM_OBCM_FD5_Init: value-spec=0
    COMTX_HVCMS_SelectedEnergyTransferType_VDCM_OBCM_FD5_Init: value-spec=0
    COMTX_HVCMS_SelectedPaymentOptn_VDCM_OBCM_FD5_Init: value-spec=0
    COMTX_HVCMS_SelectedServiceId_VDCM_OBCM_FD5_Init: value-spec=0
    COMTX_HVCMS_ServiceCategory_VDCM_OBCM_FD5_Init: value-spec=0
    COMTX_HVCMS_ServiceScope_VDCM_OBCM_FD5_Init: value-spec=0
    COMTX_IMPACTCommand_IMPACT_INFO_FD5_Init: value-spec=0
    COMTX_IMPACTConfirm_IMPACT_INFO_FD5_Init: value-spec=1
    COMTX_IgnitionOnCounter_BCM_FD_7_FD5_Init: value-spec=0
    COMTX_MessageCounter_HYBRID_THERMAL_COMMAND_HYBRID_THERMAL_COMMAND_FD5_Init: value-spec=0
    COMTX_N_PDU_7E_GLIWA_MCPA_RX_FD5_Init: value-spec=0
    COMTX_N_PDU_7F_GLIWA_MCPB_RX_FD5_Init: value-spec=0
    COMTX_OBCM_OutVoltageSyncTgt_VDCM_OBCM_FD5_Init: value-spec=0
    COMTX_OperationalModeSts_BCM_FD_2_FD5_Init: value-spec=0
    COMTX_PerWakeUp_Diag_HYBRID_SYSTEM_EPT1_FD5_Init: value-spec=0
    COMTX_Real_Time_Clock_REAL_TIME_CLOCK_FD5_Init: value-spec=0
    COMTX_Real_Time_Validity_REAL_TIME_CLOCK_FD5_Init: value-spec=0
    COMTX_SGCP_OIL_FlwRate_HYBRID_THERMAL_COMMAND_FD5_Init: value-spec=0
    COMTX_SGCP_OIL_TEMP_HYBRID_THERMAL_COMMAND_FD5_Init: value-spec=0
    COMTX_T4_Sensor_Temp_VDCM_PWT3_FD5_Init: value-spec=0
    COMTX_T7_CoolantTempVldty_VDCM_PWT3_FD5_Init: value-spec=0
    COMTX_T7_Sensor_Temp_VDCM_PWT3_FD5_Init: value-spec=0
    COMTX_TotalOdometer_IPC_FD_1_FD5_Init: value-spec=0
    COMTX_V2H_HVCMS_EVMax_P_Limit_RPF_FD_3_FD5_Init: value-spec=0
    COMTX_VDCM_BattBulkSOC_VDCM_OBCM_FD5_Init: value-spec=0
    COMTX_VDCM_ContractAuthenticationID_VDCM_OBCM_FD5_Init: value-spec=0
    COMTX_VDCM_GenChallenge_VDCM_OBCM_FD5_Init: value-spec=0
    COMTX_VDCM_OBCDischCurrentLim_VDCM_OBCM_FD5_Init: value-spec=815
    COMTX_VDCM_TypeCNegotiationSts_VDCM_OBCM_FD5_Init: value-spec=0
    COMTX_VIN_DATA_VIN_FD5_Init: value-spec=0
    COMTX_VIN_MSG_VIN_FD5_Init: value-spec=3
    COMTX_WU_Timer_Value_HYBRID_SYSTEM_EPT1_FD5_Init: value-spec=0
package /STLASWCs/ComSwCpts/ComDataDefinition/ComImpDataType
  157 x impl type, all with category=TYPE_REFERENCE:
    IDTSABSFailSts_BRAKE_FD_5_FD5: implementation-data-type=boolean
    IDTSACplug_PwrMax_HV_CHARGER2_FD5: implementation-data-type=uint16, invalid-value=Value:65535
    IDTSBMS_HV_High_Temp_Thrsh_BATTERY_HV2_FD5: implementation-data-type=uint16
    IDTSBMS_HV_Low_Temp_Thrsh_BATTERY_HV2_FD5: implementation-data-type=uint16
    IDTSBMS_HV_SOC_AccuracySts_BATTERY_HV2_FD5: implementation-data-type=uint8, invalid-value=Value:3
    IDTSBMS_HV_SOC_Max_BATTERY_HV2_FD5: implementation-data-type=uint8
    IDTSBMS_HV_SOC_Min_BATTERY_HV2_FD5: implementation-data-type=uint8
    IDTSBattery_Volt_1_BCM_FD_3_FD5: implementation-data-type=uint16, invalid-value=Value:511
    IDTSCLrDiagInfo_MCPA_P_MCPA_STATUS_FD5: implementation-data-type=boolean
    IDTSCLrDiagInfo_MCPB_P_MCPB_STATUS_FD5: implementation-data-type=boolean
    IDTSCLrDiagInfo_SGCP_P_SGCP_STATUS_FD5: implementation-data-type=boolean
    IDTSCRC_HYBRID_THERMAL_COMMAND_HYBRID_THERMAL_COMMAND_FD5: implementation-data-type=uint8
    IDTSCRC_MCPA_STATUS_MCPA_STATUS_FD5: implementation-data-type=uint8
    IDTSCRC_MCPB_STATUS_MCPB_STATUS_FD5: implementation-data-type=uint8
    IDTSCRC_SGCP_STATUS_SGCP_STATUS_FD5: implementation-data-type=uint8
    IDTSCharging_WHr_HV_CHARGER2_FD5: implementation-data-type=uint16, invalid-value=Value:65535
    IDTSChrgFailSts_HV_CHARGER2_FD5: implementation-data-type=uint8, invalid-value=Value:7
    IDTSClrLgsDiagInfo_VDCM_PWT3_FD5: implementation-data-type=boolean
    IDTSContract_Certificate_Present_IDCM_ISO15118_STATUS1_FD5: implementation-data-type=boolean
    IDTSEOPA_OIL_FlwRate_HYBRID_THERMAL_COMMAND_FD5: implementation-data-type=uint8, invalid-value=Value:255
    IDTSEOPA_OIL_TEMP_HYBRID_THERMAL_COMMAND_FD5: implementation-data-type=uint8, invalid-value=Value:255
    IDTSEOPB_OIL_FlwRate_HYBRID_THERMAL_COMMAND_FD5: implementation-data-type=uint8, invalid-value=Value:255
    IDTSEOPB_OIL_TEMP_HYBRID_THERMAL_COMMAND_FD5: implementation-data-type=uint8, invalid-value=Value:255
    IDTSEPBSts_BRAKE_FD_4_FD5: implementation-data-type=uint8, invalid-value=Value:15
    IDTSESCFailSts_BRAKE_FD_5_FD5: implementation-data-type=boolean
    IDTSEVMaxCurrent_EVCU_ISO15118_STATUS1_FD5: implementation-data-type=uint16, invalid-value=Value:511
    IDTSEVMaxVoltage_EVCU_ISO15118_STATUS1_FD5: implementation-data-type=uint16, invalid-value=Value:1023
    IDTSEVMinCurrent_EVCU_ISO15118_STATUS1_FD5: implementation-data-type=uint16, invalid-value=Value:511
    IDTSEVSE_Offered_AC_Single_Phase_IDCM_ISO15118_STATUS1_FD5: implementation-data-type=boolean
    IDTSEVSE_Offered_AC_Three_Phase_IDCM_ISO15118_STATUS1_FD5: implementation-data-type=boolean
    IDTSEamount_EVCU_ISO15118_STATUS1_FD5: implementation-data-type=uint32, invalid-value=Value:262143
    IDTSExternalTemperature_BCM_FD_9_FD5: implementation-data-type=uint16, invalid-value=Value:511
    IDTSFOTA_Status_FOTA_MASTER_FD5: implementation-data-type=uint8
    IDTSGPS_Date_Day_TELEMATIC_FD_1_FD5: implementation-data-type=uint8, invalid-value=Value:255
    IDTSGPS_Date_Month_TELEMATIC_FD_1_FD5: implementation-data-type=uint8, invalid-value=Value:255
    IDTSGPS_Date_Year_TELEMATIC_FD_1_FD5: implementation-data-type=uint16, invalid-value=Value:65535
    IDTSGPS_UTC_Hour_TELEMATIC_FD_1_FD5: implementation-data-type=uint8, invalid-value=Value:255
    IDTSGPS_UTC_Minute_TELEMATIC_FD_1_FD5: implementation-data-type=uint8, invalid-value=Value:255
    IDTSGPS_UTC_Second_TELEMATIC_FD_1_FD5: implementation-data-type=uint16, invalid-value=Value:65535
    IDTSHEV_OnRq_BPCM_BATTERY_HV2_FD5: implementation-data-type=boolean
    IDTSHVBatCell_Voltage_High_Thrsh_BATTERY_HV2_FD5: implementation-data-type=uint16
    IDTSHVBatCell_Voltage_Low_Thrsh_BATTERY_HV2_FD5: implementation-data-type=uint16
    IDTSHVBatSleepTime_HVBATTERY_THERMAL_FD5: implementation-data-type=uint8, invalid-value=Value:255
    IDTSHVCMS_BulkChargingComplete_VDCM_OBCM_FD5: implementation-data-type=boolean
    IDTSHVCMS_ChargingComplete_VDCM_OBCM_FD5: implementation-data-type=boolean
    IDTSHVCMS_EVEnergyCapacity_VDCM_OBCM_FD5: implementation-data-type=uint32, invalid-value=Value:131071
    IDTSHVCMS_EVEnergyRequest_VDCM_OBCM_FD5: implementation-data-type=uint32, invalid-value=Value:131071
    IDTSHVCMS_EVErrorCode_VDCM_OBCM_FD5: implementation-data-type=uint8, invalid-value=Value:15
    IDTSHVCMS_EVMax_I_Limit_VDCM_OBCM_FD5: implementation-data-type=uint16, invalid-value=Value:1023
    IDTSHVCMS_EVMax_P_Limit_VDCM_OBCM_FD5: implementation-data-type=uint32, invalid-value=Value:16777215
    IDTSHVCMS_EVMax_V_Limit_VDCM_OBCM_FD5: implementation-data-type=uint16, invalid-value=Value:16383
    IDTSHVCMS_EVRESSConditioning_VDCM_OBCM_FD5: implementation-data-type=boolean
    IDTSHVCMS_EVRESS_SOC_VDCM_OBCM_FD5: implementation-data-type=uint16, invalid-value=Value:4095
    IDTSHVCMS_EVReady_VDCM_OBCM_FD5: implementation-data-type=boolean
    IDTSHVCMS_EVTargetCurrent_VDCM_OBCM_FD5: implementation-data-type=uint16, invalid-value=Value:1023
    IDTSHVCMS_EVTargetVoltage_VDCM_OBCM_FD5: implementation-data-type=uint16, invalid-value=Value:16383
    IDTSHVCMS_Protocol_Entry{1..3}_VDCM_OBCM_FD5: implementation-data-type=uint16, invalid-value=Value:65535
    IDTSHVCMS_ReadyToChargeState_VDCM_OBCM_FD5: implementation-data-type=boolean
    IDTSHVCMS_RemaningTimeToBulkSOC_VDCM_OBCM_FD5: implementation-data-type=uint16, invalid-value=Value:65535
    IDTSHVCMS_RemaningTimeToFullSOC_VDCM_OBCM_FD5: implementation-data-type=uint16, invalid-value=Value:65535
    IDTSHVCMS_SelectedEnergyTransferType_VDCM_OBCM_FD5: implementation-data-type=uint8, invalid-value=Value:15
    IDTSHVCMS_SelectedPaymentOptn_VDCM_OBCM_FD5: implementation-data-type=uint8, invalid-value=Value:3
    IDTSHVCMS_SelectedServiceId_VDCM_OBCM_FD5: implementation-data-type=uint16
    IDTSHVCMS_ServiceCategory_VDCM_OBCM_FD5: implementation-data-type=uint8, invalid-value=Value:15
    IDTSHVCMS_ServiceScope_VDCM_OBCM_FD5: implementation-data-type=uint16, invalid-value=Value:65535
    IDTSIMPACTCommand_IMPACT_INFO_FD5: implementation-data-type=boolean
    IDTSIMPACTConfirm_IMPACT_INFO_FD5: implementation-data-type=boolean
    IDTSIgnitionOnCounter_BCM_FD_7_FD5: implementation-data-type=uint16
    IDTSImpactHardwireV_BATTERY_HV_FD5: implementation-data-type=boolean
    IDTSImpactHardwire_BATTERY_HV_FD5: implementation-data-type=boolean
    IDTSMCPA_Control_Board_Temperature_P_MCPA_STATUS_FD5: implementation-data-type=uint8, invalid-value=Value:255
    IDTSMCPA_CoolantTemp_P_MCPA_STATUS_FD5: implementation-data-type=uint16, invalid-value=Value:2047
    IDTSMCPA_DC_Current_P_MCPA_STATUS_FD5: implementation-data-type=uint16
    IDTSMCPA_DC_Current_V_P_MCPA_STATUS_FD5: implementation-data-type=boolean
    IDTSMCPA_DC_Volt_V_P_MCPA_STATUS_FD5: implementation-data-type=boolean
    IDTSMCPA_DC_Voltage_P_MCPA_STATUS_FD5: implementation-data-type=uint16, invalid-value=Value:1023
    IDTSMCPA_DerateReason_P_MCPA_STATUS_FD5: implementation-data-type=uint8
    IDTSMCPA_Inverter_Temp_P_MCPA_STATUS_FD5: implementation-data-type=uint8, invalid-value=Value:255
    IDTSMCPA_PIM_DC_Side_Busbar_Temp_P_MCPA_STATUS_FD5: implementation-data-type=uint8, invalid-value=Value:255
    IDTSMCPA_Rotor_Temperature_P_MCPA_STATUS_FD5: implementation-data-type=uint8, invalid-value=Value:255
    IDTSMCPA_Service_Lamp_Request_P_MCPA_STATUS_FD5: implementation-data-type=boolean
    IDTSMCPB_Control_Board_Temperature_P_MCPB_STATUS_FD5: implementation-data-type=uint8, invalid-value=Value:255
    IDTSMCPB_CoolantTemp_P_MCPB_STATUS_FD5: implementation-data-type=uint16, invalid-value=Value:2047
    IDTSMCPB_DC_Current_P_MCPB_STATUS_FD5: implementation-data-type=uint16
    IDTSMCPB_DC_Current_V_P_MCPB_STATUS_FD5: implementation-data-type=boolean
    IDTSMCPB_DC_Volt_V_P_MCPB_STATUS_FD5: implementation-data-type=boolean
    IDTSMCPB_DC_Voltage_P_MCPB_STATUS_FD5: implementation-data-type=uint16, invalid-value=Value:1023
    IDTSMCPB_DerateReason_P_MCPB_STATUS_FD5: implementation-data-type=uint8
    IDTSMCPB_Inverter_Temp_P_MCPB_STATUS_FD5: implementation-data-type=uint8, invalid-value=Value:255
    IDTSMCPB_PIM_DC_Side_Busbar_Temp_P_MCPB_STATUS_FD5: implementation-data-type=uint8, invalid-value=Value:255
    IDTSMCPB_Rotor_Temperature_P_MCPB_STATUS_FD5: implementation-data-type=uint8, invalid-value=Value:255
    IDTSMCPB_Service_Lamp_Request_P_MCPB_STATUS_FD5: implementation-data-type=boolean
    IDTSMC_MCPA_STATUS_MCPA_STATUS_FD5: implementation-data-type=uint8
    IDTSMC_MCPB_STATUS_MCPB_STATUS_FD5: implementation-data-type=uint8
    IDTSMC_SGCP_STATUS_SGCP_STATUS_FD5: implementation-data-type=uint8
    IDTSMessageCounter_HYBRID_THERMAL_COMMAND_HYBRID_THERMAL_COMMAND_FD5: implementation-data-type=uint8
    IDTSN_PDU_7B_GLIWA_MCPA_TX_FD5: implementation-data-type=uint64
    IDTSN_PDU_7C_GLIWA_MCPB_TX_FD5: implementation-data-type=uint64
    IDTSN_PDU_7E_GLIWA_MCPA_RX_FD5: implementation-data-type=uint64
    IDTSN_PDU_7F_GLIWA_MCPB_RX_FD5: implementation-data-type=uint64
    IDTSOBCM_OutVoltageSyncTgt_VDCM_OBCM_FD5: implementation-data-type=uint16, invalid-value=Value:1023
    IDTSOBCM_PrechargeSts_HV_CHARGER2_FD5: implementation-data-type=uint8
    IDTSOBC_CaptureEnvironmentData_HV_CHARGER2_FD5: implementation-data-type=boolean
    IDTSOBC_ChargeFailure_HV_CHARGER2_FD5: implementation-data-type=boolean
    IDTSOBC_ChargeTimeMin_HV_CHARGER2_FD5: implementation-data-type=uint16, invalid-value=Value:65535
    IDTSOBC_ChargeTimeSec_HV_CHARGER2_FD5: implementation-data-type=uint16, invalid-value=Value:65535
    IDTSOBC_ChargingFaultSts_HV_CHARGER2_FD5: implementation-data-type=uint8
    IDTSOBC_CurrentFailureSts_HV_CHARGER2_FD5: implementation-data-type=boolean
    IDTSOBC_EVServiceLampFlash_HV_CHARGER2_FD5: implementation-data-type=boolean
    IDTSOBC_EVServiceLampOn_HV_CHARGER2_FD5: implementation-data-type=boolean
    IDTSOBC_FaultReason_HV_CHARGER2_FD5: implementation-data-type=uint8, invalid-value=Value:127
    IDTSOBC_GenericFailSts_HV_CHARGER2_FD5: implementation-data-type=boolean
    IDTSOBC_IdleTimeMin_HV_CHARGER2_FD5: implementation-data-type=uint16, invalid-value=Value:65535
    IDTSOBC_IdleTimeSec_HV_CHARGER2_FD5: implementation-data-type=uint16, invalid-value=Value:65535
    IDTSOBC_Pilot_HV_CHARGER2_FD5: implementation-data-type=uint8
    IDTSOBC_Prox_HV_CHARGER2_FD5: implementation-data-type=uint8
    IDTSOBC_Temp{1..4}_DUALCHARGER_THERMAL_FD5: implementation-data-type=uint8, invalid-value=Value:255
    IDTSOBC_WakeReason_HV_CHARGER2_FD5: implementation-data-type=uint8
    IDTSOnboardChargerMode_HV_CHARGER2_FD5: implementation-data-type=uint8
    IDTSOnboardChargerReady_HV_CHARGER2_FD5: implementation-data-type=uint8, invalid-value=Value:3
    IDTSOperationalModeSts_BCM_FD_2_FD5: implementation-data-type=uint8, invalid-value=Value:15
    IDTSPerWakeUp_Diag_HYBRID_SYSTEM_EPT1_FD5: implementation-data-type=uint16
    IDTSReal_Time_Clock_REAL_TIME_CLOCK_FD5: implementation-data-type=uint32, invalid-value=Value:4294967295
    IDTSReal_Time_Validity_REAL_TIME_CLOCK_FD5: implementation-data-type=boolean
    IDTSSGCP_Control_Board_Temperature_P_SGCP_STATUS_FD5: implementation-data-type=uint8, invalid-value=Value:255
    IDTSSGCP_CoolantTemp_P_SGCP_STATUS_FD5: implementation-data-type=uint16, invalid-value=Value:2047
    IDTSSGCP_DC_Current_P_SGCP_STATUS_FD5: implementation-data-type=uint16
    IDTSSGCP_DC_Current_V_P_SGCP_STATUS_FD5: implementation-data-type=boolean
    IDTSSGCP_DC_Volt_V_P_SGCP_STATUS_FD5: implementation-data-type=boolean
    IDTSSGCP_DC_Voltage_P_SGCP_STATUS_FD5: implementation-data-type=uint16, invalid-value=Value:1023
    IDTSSGCP_DerateReason_P_SGCP_STATUS_FD5: implementation-data-type=uint8
    IDTSSGCP_Inverter_Temp_P_SGCP_STATUS_FD5: implementation-data-type=uint8, invalid-value=Value:255
    IDTSSGCP_OIL_FlwRate_HYBRID_THERMAL_COMMAND_FD5: implementation-data-type=uint8, invalid-value=Value:255
    IDTSSGCP_OIL_TEMP_HYBRID_THERMAL_COMMAND_FD5: implementation-data-type=uint8, invalid-value=Value:255
    IDTSSGCP_PIM_AC_Side_Busbar_Temp_P_SGCP_STATUS_FD5: implementation-data-type=uint8, invalid-value=Value:255
    IDTSSGCP_PIM_DC_Side_Busbar_Temp_P_SGCP_STATUS_FD5: implementation-data-type=uint8, invalid-value=Value:255
    IDTSSGCP_Rotor_Temperature_P_SGCP_STATUS_FD5: implementation-data-type=uint8, invalid-value=Value:255
    IDTSSGCP_Service_Lamp_Request_P_SGCP_STATUS_FD5: implementation-data-type=boolean
    IDTST4_Sensor_Temp_VDCM_PWT3_FD5: implementation-data-type=uint16
    IDTST7_CoolantTempVldty_VDCM_PWT3_FD5: implementation-data-type=boolean
    IDTST7_Sensor_Temp_VDCM_PWT3_FD5: implementation-data-type=uint16
    IDTSTotalOdometer_IPC_FD_1_FD5: implementation-data-type=uint32
    IDTSV2H_HVCMS_EVMax_P_Limit_RPF_FD_3_FD5: implementation-data-type=uint16
    IDTSV2H_HVCMS_EVSEMaxPowerLimit_RPF_FD_1_FD5: implementation-data-type=uint16
    IDTSVDCM_BattBulkSOC_VDCM_OBCM_FD5: implementation-data-type=uint16
    IDTSVDCM_ContractAuthenticationID_VDCM_OBCM_FD5: implementation-data-type=uint16
    IDTSVDCM_GenChallenge_VDCM_OBCM_FD5: implementation-data-type=uint16
    IDTSVDCM_OBCDischCurrentLim_VDCM_OBCM_FD5: implementation-data-type=uint16
    IDTSVDCM_TypeCNegotiationSts_VDCM_OBCM_FD5: implementation-data-type=uint8
    IDTSVIN_DATA_VIN_FD5: implementation-data-type=uint64
    IDTSVIN_MSG_VIN_FD5: implementation-data-type=uint8, invalid-value=Value:3
    IDTSWU_Timer_Value_HYBRID_SYSTEM_EPT1_FD5: implementation-data-type=uint16
package /STLASWCs/ComSwCpts/ComPrivateInterfaces
  sender receiver interface CanCom_FD5RxSignalsSR
    85 x data, all with category=TYPE_REFERENCE, sw-calibration-access=READ-ONLY:
      COMRX_ImpactHardwire_BATTERY_HV_FD5: type=IDTSImpactHardwire_BATTERY_HV_FD5
      COMRX_ImpactHardwireV_BATTERY_HV_FD5: type=IDTSImpactHardwireV_BATTERY_HV_FD5
      COMRX_BMS_HV_High_Temp_Thrsh_BATTERY_HV2_FD5: type=IDTSBMS_HV_High_Temp_Thrsh_BATTERY_HV2_FD5
      COMRX_BMS_HV_Low_Temp_Thrsh_BATTERY_HV2_FD5: type=IDTSBMS_HV_Low_Temp_Thrsh_BATTERY_HV2_FD5
      COMRX_BMS_HV_SOC_AccuracySts_BATTERY_HV2_FD5: type=IDTSBMS_HV_SOC_AccuracySts_BATTERY_HV2_FD5
      COMRX_BMS_HV_SOC_Max_BATTERY_HV2_FD5: type=IDTSBMS_HV_SOC_Max_BATTERY_HV2_FD5
      COMRX_BMS_HV_SOC_Min_BATTERY_HV2_FD5: type=IDTSBMS_HV_SOC_Min_BATTERY_HV2_FD5
      COMRX_HEV_OnRq_BPCM_BATTERY_HV2_FD5: type=IDTSHEV_OnRq_BPCM_BATTERY_HV2_FD5
      COMRX_HVBatCell_Voltage_High_Thrsh_BATTERY_HV2_FD5: type=IDTSHVBatCell_Voltage_High_Thrsh_BATTERY_HV2_FD5
      COMRX_HVBatCell_Voltage_Low_Thrsh_BATTERY_HV2_FD5: type=IDTSHVBatCell_Voltage_Low_Thrsh_BATTERY_HV2_FD5
      COMRX_OBC_Temp{1..4}_DUALCHARGER_THERMAL_FD5: type=IDTSOBC_Temp{1..4}_DUALCHARGER_THERMAL_FD5
      COMRX_N_PDU_7B_GLIWA_MCPA_TX_FD5: type=IDTSN_PDU_7B_GLIWA_MCPA_TX_FD5
      COMRX_N_PDU_7C_GLIWA_MCPB_TX_FD5: type=IDTSN_PDU_7C_GLIWA_MCPB_TX_FD5
      COMRX_HVBatSleepTime_HVBATTERY_THERMAL_FD5: type=IDTSHVBatSleepTime_HVBATTERY_THERMAL_FD5
      COMRX_ACplug_PwrMax_HV_CHARGER2_FD5: type=IDTSACplug_PwrMax_HV_CHARGER2_FD5
      COMRX_Charging_WHr_HV_CHARGER2_FD5: type=IDTSCharging_WHr_HV_CHARGER2_FD5
      COMRX_ChrgFailSts_HV_CHARGER2_FD5: type=IDTSChrgFailSts_HV_CHARGER2_FD5
      COMRX_OBC_CaptureEnvironmentData_HV_CHARGER2_FD5: type=IDTSOBC_CaptureEnvironmentData_HV_CHARGER2_FD5
      COMRX_OBC_ChargeFailure_HV_CHARGER2_FD5: type=IDTSOBC_ChargeFailure_HV_CHARGER2_FD5
      COMRX_OBC_ChargeTimeMin_HV_CHARGER2_FD5: type=IDTSOBC_ChargeTimeMin_HV_CHARGER2_FD5
      COMRX_OBC_ChargeTimeSec_HV_CHARGER2_FD5: type=IDTSOBC_ChargeTimeSec_HV_CHARGER2_FD5
      COMRX_OBC_ChargingFaultSts_HV_CHARGER2_FD5: type=IDTSOBC_ChargingFaultSts_HV_CHARGER2_FD5
      COMRX_OBC_CurrentFailureSts_HV_CHARGER2_FD5: type=IDTSOBC_CurrentFailureSts_HV_CHARGER2_FD5
      COMRX_OBC_EVServiceLampFlash_HV_CHARGER2_FD5: type=IDTSOBC_EVServiceLampFlash_HV_CHARGER2_FD5
      COMRX_OBC_EVServiceLampOn_HV_CHARGER2_FD5: type=IDTSOBC_EVServiceLampOn_HV_CHARGER2_FD5
      COMRX_OBC_FaultReason_HV_CHARGER2_FD5: type=IDTSOBC_FaultReason_HV_CHARGER2_FD5
      COMRX_OBC_GenericFailSts_HV_CHARGER2_FD5: type=IDTSOBC_GenericFailSts_HV_CHARGER2_FD5
      COMRX_OBC_IdleTimeMin_HV_CHARGER2_FD5: type=IDTSOBC_IdleTimeMin_HV_CHARGER2_FD5
      COMRX_OBC_IdleTimeSec_HV_CHARGER2_FD5: type=IDTSOBC_IdleTimeSec_HV_CHARGER2_FD5
      COMRX_OBC_Pilot_HV_CHARGER2_FD5: type=IDTSOBC_Pilot_HV_CHARGER2_FD5
      COMRX_OBC_Prox_HV_CHARGER2_FD5: type=IDTSOBC_Prox_HV_CHARGER2_FD5
      COMRX_OBC_WakeReason_HV_CHARGER2_FD5: type=IDTSOBC_WakeReason_HV_CHARGER2_FD5
      COMRX_OBCM_PrechargeSts_HV_CHARGER2_FD5: type=IDTSOBCM_PrechargeSts_HV_CHARGER2_FD5
      COMRX_OnboardChargerMode_HV_CHARGER2_FD5: type=IDTSOnboardChargerMode_HV_CHARGER2_FD5
      COMRX_OnboardChargerReady_HV_CHARGER2_FD5: type=IDTSOnboardChargerReady_HV_CHARGER2_FD5
      COMRX_Contract_Certificate_Present_IDCM_ISO15118_STATUS1_FD5: type=IDTSContract_Certificate_Present_IDCM_ISO15118_STATUS1_FD5
      COMRX_EVSE_Offered_AC_Single_Phase_IDCM_ISO15118_STATUS1_FD5: type=IDTSEVSE_Offered_AC_Single_Phase_IDCM_ISO15118_STATUS1_FD5
      COMRX_EVSE_Offered_AC_Three_Phase_IDCM_ISO15118_STATUS1_FD5: type=IDTSEVSE_Offered_AC_Three_Phase_IDCM_ISO15118_STATUS1_FD5
      COMRX_CLrDiagInfo_MCPA_P_MCPA_STATUS_FD5: type=IDTSCLrDiagInfo_MCPA_P_MCPA_STATUS_FD5
      COMRX_CRC_MCPA_STATUS_MCPA_STATUS_FD5: type=IDTSCRC_MCPA_STATUS_MCPA_STATUS_FD5
      COMRX_MC_MCPA_STATUS_MCPA_STATUS_FD5: type=IDTSMC_MCPA_STATUS_MCPA_STATUS_FD5
      COMRX_MCPA_Control_Board_Temperature_P_MCPA_STATUS_FD5: type=IDTSMCPA_Control_Board_Temperature_P_MCPA_STATUS_FD5
      COMRX_MCPA_CoolantTemp_P_MCPA_STATUS_FD5: type=IDTSMCPA_CoolantTemp_P_MCPA_STATUS_FD5
      COMRX_MCPA_DC_Current_P_MCPA_STATUS_FD5: type=IDTSMCPA_DC_Current_P_MCPA_STATUS_FD5
      COMRX_MCPA_DC_Current_V_P_MCPA_STATUS_FD5: type=IDTSMCPA_DC_Current_V_P_MCPA_STATUS_FD5
      COMRX_MCPA_DC_Volt_V_P_MCPA_STATUS_FD5: type=IDTSMCPA_DC_Volt_V_P_MCPA_STATUS_FD5
      COMRX_MCPA_DC_Voltage_P_MCPA_STATUS_FD5: type=IDTSMCPA_DC_Voltage_P_MCPA_STATUS_FD5
      COMRX_MCPA_DerateReason_P_MCPA_STATUS_FD5: type=IDTSMCPA_DerateReason_P_MCPA_STATUS_FD5
      COMRX_MCPA_Inverter_Temp_P_MCPA_STATUS_FD5: type=IDTSMCPA_Inverter_Temp_P_MCPA_STATUS_FD5
      COMRX_MCPA_PIM_DC_Side_Busbar_Temp_P_MCPA_STATUS_FD5: type=IDTSMCPA_PIM_DC_Side_Busbar_Temp_P_MCPA_STATUS_FD5
      COMRX_MCPA_Rotor_Temperature_P_MCPA_STATUS_FD5: type=IDTSMCPA_Rotor_Temperature_P_MCPA_STATUS_FD5
      COMRX_MCPA_Service_Lamp_Request_P_MCPA_STATUS_FD5: type=IDTSMCPA_Service_Lamp_Request_P_MCPA_STATUS_FD5
      COMRX_CLrDiagInfo_MCPB_P_MCPB_STATUS_FD5: type=IDTSCLrDiagInfo_MCPB_P_MCPB_STATUS_FD5
      COMRX_CRC_MCPB_STATUS_MCPB_STATUS_FD5: type=IDTSCRC_MCPB_STATUS_MCPB_STATUS_FD5
      COMRX_MC_MCPB_STATUS_MCPB_STATUS_FD5: type=IDTSMC_MCPB_STATUS_MCPB_STATUS_FD5
      COMRX_MCPB_Control_Board_Temperature_P_MCPB_STATUS_FD5: type=IDTSMCPB_Control_Board_Temperature_P_MCPB_STATUS_FD5
      COMRX_MCPB_CoolantTemp_P_MCPB_STATUS_FD5: type=IDTSMCPB_CoolantTemp_P_MCPB_STATUS_FD5
      COMRX_MCPB_DC_Current_P_MCPB_STATUS_FD5: type=IDTSMCPB_DC_Current_P_MCPB_STATUS_FD5
      COMRX_MCPB_DC_Current_V_P_MCPB_STATUS_FD5: type=IDTSMCPB_DC_Current_V_P_MCPB_STATUS_FD5
      COMRX_MCPB_DC_Volt_V_P_MCPB_STATUS_FD5: type=IDTSMCPB_DC_Volt_V_P_MCPB_STATUS_FD5
      COMRX_MCPB_DC_Voltage_P_MCPB_STATUS_FD5: type=IDTSMCPB_DC_Voltage_P_MCPB_STATUS_FD5
      COMRX_MCPB_DerateReason_P_MCPB_STATUS_FD5: type=IDTSMCPB_DerateReason_P_MCPB_STATUS_FD5
      COMRX_MCPB_Inverter_Temp_P_MCPB_STATUS_FD5: type=IDTSMCPB_Inverter_Temp_P_MCPB_STATUS_FD5
      COMRX_MCPB_PIM_DC_Side_Busbar_Temp_P_MCPB_STATUS_FD5: type=IDTSMCPB_PIM_DC_Side_Busbar_Temp_P_MCPB_STATUS_FD5
      COMRX_MCPB_Rotor_Temperature_P_MCPB_STATUS_FD5: type=IDTSMCPB_Rotor_Temperature_P_MCPB_STATUS_FD5
      COMRX_MCPB_Service_Lamp_Request_P_MCPB_STATUS_FD5: type=IDTSMCPB_Service_Lamp_Request_P_MCPB_STATUS_FD5
      COMRX_V2H_HVCMS_EVSEMaxPowerLimit_RPF_FD_1_FD5: type=IDTSV2H_HVCMS_EVSEMaxPowerLimit_RPF_FD_1_FD5
      COMRX_CLrDiagInfo_SGCP_P_SGCP_STATUS_FD5: type=IDTSCLrDiagInfo_SGCP_P_SGCP_STATUS_FD5
      COMRX_CRC_SGCP_STATUS_SGCP_STATUS_FD5: type=IDTSCRC_SGCP_STATUS_SGCP_STATUS_FD5
      COMRX_MC_SGCP_STATUS_SGCP_STATUS_FD5: type=IDTSMC_SGCP_STATUS_SGCP_STATUS_FD5
      COMRX_SGCP_Control_Board_Temperature_P_SGCP_STATUS_FD5: type=IDTSSGCP_Control_Board_Temperature_P_SGCP_STATUS_FD5
      COMRX_SGCP_CoolantTemp_P_SGCP_STATUS_FD5: type=IDTSSGCP_CoolantTemp_P_SGCP_STATUS_FD5
      COMRX_SGCP_DC_Current_P_SGCP_STATUS_FD5: type=IDTSSGCP_DC_Current_P_SGCP_STATUS_FD5
      COMRX_SGCP_DC_Current_V_P_SGCP_STATUS_FD5: type=IDTSSGCP_DC_Current_V_P_SGCP_STATUS_FD5
      COMRX_SGCP_DC_Volt_V_P_SGCP_STATUS_FD5: type=IDTSSGCP_DC_Volt_V_P_SGCP_STATUS_FD5
      COMRX_SGCP_DC_Voltage_P_SGCP_STATUS_FD5: type=IDTSSGCP_DC_Voltage_P_SGCP_STATUS_FD5
      COMRX_SGCP_DerateReason_P_SGCP_STATUS_FD5: type=IDTSSGCP_DerateReason_P_SGCP_STATUS_FD5
      COMRX_SGCP_Inverter_Temp_P_SGCP_STATUS_FD5: type=IDTSSGCP_Inverter_Temp_P_SGCP_STATUS_FD5
      COMRX_SGCP_PIM_AC_Side_Busbar_Temp_P_SGCP_STATUS_FD5: type=IDTSSGCP_PIM_AC_Side_Busbar_Temp_P_SGCP_STATUS_FD5
      COMRX_SGCP_PIM_DC_Side_Busbar_Temp_P_SGCP_STATUS_FD5: type=IDTSSGCP_PIM_DC_Side_Busbar_Temp_P_SGCP_STATUS_FD5
      COMRX_SGCP_Rotor_Temperature_P_SGCP_STATUS_FD5: type=IDTSSGCP_Rotor_Temperature_P_SGCP_STATUS_FD5
      COMRX_SGCP_Service_Lamp_Request_P_SGCP_STATUS_FD5: type=IDTSSGCP_Service_Lamp_Request_P_SGCP_STATUS_FD5
    invalidation-policys:
      data-element=COMRX_ImpactHardwire_BATTERY_HV_FD5, handle-invalid=DONT-INVALIDATE
      data-element=COMRX_ImpactHardwireV_BATTERY_HV_FD5, handle-invalid=DONT-INVALIDATE
      data-element=COMRX_BMS_HV_High_Temp_Thrsh_BATTERY_HV2_FD5, handle-invalid=DONT-INVALIDATE
      data-element=COMRX_BMS_HV_Low_Temp_Thrsh_BATTERY_HV2_FD5, handle-invalid=DONT-INVALIDATE
      data-element=COMRX_BMS_HV_SOC_AccuracySts_BATTERY_HV2_FD5, handle-invalid=KEEP
      data-element=COMRX_BMS_HV_SOC_Max_BATTERY_HV2_FD5, handle-invalid=DONT-INVALIDATE
      data-element=COMRX_BMS_HV_SOC_Min_BATTERY_HV2_FD5, handle-invalid=DONT-INVALIDATE
      data-element=COMRX_HEV_OnRq_BPCM_BATTERY_HV2_FD5, handle-invalid=DONT-INVALIDATE
      data-element=COMRX_HVBatCell_Voltage_High_Thrsh_BATTERY_HV2_FD5, handle-invalid=DONT-INVALIDATE
      data-element=COMRX_HVBatCell_Voltage_Low_Thrsh_BATTERY_HV2_FD5, handle-invalid=DONT-INVALIDATE
      data-element=COMRX_OBC_Temp{1..4}_DUALCHARGER_THERMAL_FD5, handle-invalid=KEEP
      data-element=COMRX_N_PDU_7B_GLIWA_MCPA_TX_FD5, handle-invalid=DONT-INVALIDATE
      data-element=COMRX_N_PDU_7C_GLIWA_MCPB_TX_FD5, handle-invalid=DONT-INVALIDATE
      data-element=COMRX_HVBatSleepTime_HVBATTERY_THERMAL_FD5, handle-invalid=KEEP
      data-element=COMRX_ACplug_PwrMax_HV_CHARGER2_FD5, handle-invalid=KEEP
      data-element=COMRX_Charging_WHr_HV_CHARGER2_FD5, handle-invalid=KEEP
      data-element=COMRX_ChrgFailSts_HV_CHARGER2_FD5, handle-invalid=KEEP
      data-element=COMRX_OBC_CaptureEnvironmentData_HV_CHARGER2_FD5, handle-invalid=DONT-INVALIDATE
      data-element=COMRX_OBC_ChargeFailure_HV_CHARGER2_FD5, handle-invalid=DONT-INVALIDATE
      data-element=COMRX_OBC_ChargeTimeMin_HV_CHARGER2_FD5, handle-invalid=KEEP
      data-element=COMRX_OBC_ChargeTimeSec_HV_CHARGER2_FD5, handle-invalid=KEEP
      data-element=COMRX_OBC_ChargingFaultSts_HV_CHARGER2_FD5, handle-invalid=DONT-INVALIDATE
      data-element=COMRX_OBC_CurrentFailureSts_HV_CHARGER2_FD5, handle-invalid=DONT-INVALIDATE
      data-element=COMRX_OBC_EVServiceLampFlash_HV_CHARGER2_FD5, handle-invalid=DONT-INVALIDATE
      data-element=COMRX_OBC_EVServiceLampOn_HV_CHARGER2_FD5, handle-invalid=DONT-INVALIDATE
      data-element=COMRX_OBC_FaultReason_HV_CHARGER2_FD5, handle-invalid=KEEP
      data-element=COMRX_OBC_GenericFailSts_HV_CHARGER2_FD5, handle-invalid=DONT-INVALIDATE
      data-element=COMRX_OBC_IdleTimeMin_HV_CHARGER2_FD5, handle-invalid=KEEP
      data-element=COMRX_OBC_IdleTimeSec_HV_CHARGER2_FD5, handle-invalid=KEEP
      data-element=COMRX_OBC_Pilot_HV_CHARGER2_FD5, handle-invalid=DONT-INVALIDATE
      data-element=COMRX_OBC_Prox_HV_CHARGER2_FD5, handle-invalid=DONT-INVALIDATE
      data-element=COMRX_OBC_WakeReason_HV_CHARGER2_FD5, handle-invalid=DONT-INVALIDATE
      data-element=COMRX_OBCM_PrechargeSts_HV_CHARGER2_FD5, handle-invalid=DONT-INVALIDATE
      data-element=COMRX_OnboardChargerMode_HV_CHARGER2_FD5, handle-invalid=DONT-INVALIDATE
      data-element=COMRX_OnboardChargerReady_HV_CHARGER2_FD5, handle-invalid=KEEP
      data-element=COMRX_Contract_Certificate_Present_IDCM_ISO15118_STATUS1_FD5, handle-invalid=DONT-INVALIDATE
      data-element=COMRX_EVSE_Offered_AC_Single_Phase_IDCM_ISO15118_STATUS1_FD5, handle-invalid=DONT-INVALIDATE
      data-element=COMRX_EVSE_Offered_AC_Three_Phase_IDCM_ISO15118_STATUS1_FD5, handle-invalid=DONT-INVALIDATE
      data-element=COMRX_CLrDiagInfo_MCPA_P_MCPA_STATUS_FD5, handle-invalid=DONT-INVALIDATE
      data-element=COMRX_CRC_MCPA_STATUS_MCPA_STATUS_FD5, handle-invalid=DONT-INVALIDATE
      data-element=COMRX_MC_MCPA_STATUS_MCPA_STATUS_FD5, handle-invalid=DONT-INVALIDATE
      data-element=COMRX_MCPA_Control_Board_Temperature_P_MCPA_STATUS_FD5, handle-invalid=KEEP
      data-element=COMRX_MCPA_CoolantTemp_P_MCPA_STATUS_FD5, handle-invalid=KEEP
      data-element=COMRX_MCPA_DC_Current_P_MCPA_STATUS_FD5, handle-invalid=DONT-INVALIDATE
      data-element=COMRX_MCPA_DC_Current_V_P_MCPA_STATUS_FD5, handle-invalid=DONT-INVALIDATE
      data-element=COMRX_MCPA_DC_Volt_V_P_MCPA_STATUS_FD5, handle-invalid=DONT-INVALIDATE
      data-element=COMRX_MCPA_DC_Voltage_P_MCPA_STATUS_FD5, handle-invalid=KEEP
      data-element=COMRX_MCPA_DerateReason_P_MCPA_STATUS_FD5, handle-invalid=DONT-INVALIDATE
      data-element=COMRX_MCPA_Inverter_Temp_P_MCPA_STATUS_FD5, handle-invalid=KEEP
      data-element=COMRX_MCPA_PIM_DC_Side_Busbar_Temp_P_MCPA_STATUS_FD5, handle-invalid=KEEP
      data-element=COMRX_MCPA_Rotor_Temperature_P_MCPA_STATUS_FD5, handle-invalid=KEEP
      data-element=COMRX_MCPA_Service_Lamp_Request_P_MCPA_STATUS_FD5, handle-invalid=DONT-INVALIDATE
      data-element=COMRX_CLrDiagInfo_MCPB_P_MCPB_STATUS_FD5, handle-invalid=DONT-INVALIDATE
      data-element=COMRX_CRC_MCPB_STATUS_MCPB_STATUS_FD5, handle-invalid=DONT-INVALIDATE
      data-element=COMRX_MC_MCPB_STATUS_MCPB_STATUS_FD5, handle-invalid=DONT-INVALIDATE
      data-element=COMRX_MCPB_Control_Board_Temperature_P_MCPB_STATUS_FD5, handle-invalid=KEEP
      data-element=COMRX_MCPB_CoolantTemp_P_MCPB_STATUS_FD5, handle-invalid=KEEP
      data-element=COMRX_MCPB_DC_Current_P_MCPB_STATUS_FD5, handle-invalid=DONT-INVALIDATE
      data-element=COMRX_MCPB_DC_Current_V_P_MCPB_STATUS_FD5, handle-invalid=DONT-INVALIDATE
      data-element=COMRX_MCPB_DC_Volt_V_P_MCPB_STATUS_FD5, handle-invalid=DONT-INVALIDATE
      data-element=COMRX_MCPB_DC_Voltage_P_MCPB_STATUS_FD5, handle-invalid=KEEP
      data-element=COMRX_MCPB_DerateReason_P_MCPB_STATUS_FD5, handle-invalid=DONT-INVALIDATE
      data-element=COMRX_MCPB_Inverter_Temp_P_MCPB_STATUS_FD5, handle-invalid=KEEP
      data-element=COMRX_MCPB_PIM_DC_Side_Busbar_Temp_P_MCPB_STATUS_FD5, handle-invalid=KEEP
      data-element=COMRX_MCPB_Rotor_Temperature_P_MCPB_STATUS_FD5, handle-invalid=KEEP
      data-element=COMRX_MCPB_Service_Lamp_Request_P_MCPB_STATUS_FD5, handle-invalid=DONT-INVALIDATE
      data-element=COMRX_V2H_HVCMS_EVSEMaxPowerLimit_RPF_FD_1_FD5, handle-invalid=DONT-INVALIDATE
      data-element=COMRX_CLrDiagInfo_SGCP_P_SGCP_STATUS_FD5, handle-invalid=DONT-INVALIDATE
      data-element=COMRX_CRC_SGCP_STATUS_SGCP_STATUS_FD5, handle-invalid=DONT-INVALIDATE
      data-element=COMRX_MC_SGCP_STATUS_SGCP_STATUS_FD5, handle-invalid=DONT-INVALIDATE
      data-element=COMRX_SGCP_Control_Board_Temperature_P_SGCP_STATUS_FD5, handle-invalid=KEEP
      data-element=COMRX_SGCP_CoolantTemp_P_SGCP_STATUS_FD5, handle-invalid=KEEP
      data-element=COMRX_SGCP_DC_Current_P_SGCP_STATUS_FD5, handle-invalid=DONT-INVALIDATE
      data-element=COMRX_SGCP_DC_Current_V_P_SGCP_STATUS_FD5, handle-invalid=DONT-INVALIDATE
      data-element=COMRX_SGCP_DC_Volt_V_P_SGCP_STATUS_FD5, handle-invalid=DONT-INVALIDATE
      data-element=COMRX_SGCP_DC_Voltage_P_SGCP_STATUS_FD5, handle-invalid=KEEP
      data-element=COMRX_SGCP_DerateReason_P_SGCP_STATUS_FD5, handle-invalid=DONT-INVALIDATE
      data-element=COMRX_SGCP_Inverter_Temp_P_SGCP_STATUS_FD5, handle-invalid=KEEP
      data-element=COMRX_SGCP_PIM_AC_Side_Busbar_Temp_P_SGCP_STATUS_FD5, handle-invalid=KEEP
      data-element=COMRX_SGCP_PIM_DC_Side_Busbar_Temp_P_SGCP_STATUS_FD5, handle-invalid=KEEP
      data-element=COMRX_SGCP_Rotor_Temperature_P_SGCP_STATUS_FD5, handle-invalid=KEEP
      data-element=COMRX_SGCP_Service_Lamp_Request_P_SGCP_STATUS_FD5, handle-invalid=DONT-INVALIDATE
  sender receiver interface CanCom_FD5TxSignalsSR
    72 x data, all with category=TYPE_REFERENCE, sw-calibration-access=READ-ONLY:
      COMTX_OperationalModeSts_BCM_FD_2_FD5: type=IDTSOperationalModeSts_BCM_FD_2_FD5, init-value=COMTX_OperationalModeSts_BCM_FD_2_FD5Value:0  # Raw signal data to be transmitted over the CAN bus for the Signal OperationalModeSts
      COMTX_Battery_Volt_1_BCM_FD_3_FD5: type=IDTSBattery_Volt_1_BCM_FD_3_FD5, init-value=COMTX_Battery_Volt_1_BCM_FD_3_FD5Value:0  # Raw signal data to be transmitted over the CAN bus for the Signal Battery_Volt_1
      COMTX_IgnitionOnCounter_BCM_FD_7_FD5: type=IDTSIgnitionOnCounter_BCM_FD_7_FD5, init-value=COMTX_IgnitionOnCounter_BCM_FD_7_FD5Value:0  # Raw signal data to be transmitted over the CAN bus for the Signal IgnitionOnCounter
      COMTX_ExternalTemperature_BCM_FD_9_FD5: type=IDTSExternalTemperature_BCM_FD_9_FD5, init-value=COMTX_ExternalTemperature_BCM_FD_9_FD5Value:0  # Raw signal data to be transmitted over the CAN bus for the Signal ExternalTemperature
      COMTX_EPBSts_BRAKE_FD_4_FD5: type=IDTSEPBSts_BRAKE_FD_4_FD5, init-value=COMTX_EPBSts_BRAKE_FD_4_FD5Value:0  # Raw signal data to be transmitted over the CAN bus for the Signal EPBSts
      COMTX_ABSFailSts_BRAKE_FD_5_FD5: type=IDTSABSFailSts_BRAKE_FD_5_FD5, init-value=COMTX_ABSFailSts_BRAKE_FD_5_FD5Value:0  # Raw signal data to be transmitted over the CAN bus for the Signal ABSFailSts
      COMTX_ESCFailSts_BRAKE_FD_5_FD5: type=IDTSESCFailSts_BRAKE_FD_5_FD5, init-value=COMTX_ESCFailSts_BRAKE_FD_5_FD5Value:0  # Raw signal data to be transmitted over the CAN bus for the Signal ESCFailSts
      COMTX_Eamount_EVCU_ISO15118_STATUS1_FD5: type=IDTSEamount_EVCU_ISO15118_STATUS1_FD5, init-value=COMTX_Eamount_EVCU_ISO15118_STATUS1_FD5Value:0  # Raw signal data to be transmitted over the CAN bus for the Signal Eamount
      COMTX_EVMaxCurrent_EVCU_ISO15118_STATUS1_FD5: type=IDTSEVMaxCurrent_EVCU_ISO15118_STATUS1_FD5, init-value=COMTX_EVMaxCurrent_EVCU_ISO15118_STATUS1_FD5Value:0  # Raw signal data to be transmitted over the CAN bus for the Signal EVMaxCurrent
      COMTX_EVMaxVoltage_EVCU_ISO15118_STATUS1_FD5: type=IDTSEVMaxVoltage_EVCU_ISO15118_STATUS1_FD5, init-value=COMTX_EVMaxVoltage_EVCU_ISO15118_STATUS1_FD5Value:0  # Raw signal data to be transmitted over the CAN bus for the Signal EVMaxVoltage
      COMTX_EVMinCurrent_EVCU_ISO15118_STATUS1_FD5: type=IDTSEVMinCurrent_EVCU_ISO15118_STATUS1_FD5, init-value=COMTX_EVMinCurrent_EVCU_ISO15118_STATUS1_FD5Value:0  # Raw signal data to be transmitted over the CAN bus for the Signal EVMinCurrent
      COMTX_FOTA_Status_FOTA_MASTER_FD5: type=IDTSFOTA_Status_FOTA_MASTER_FD5, init-value=COMTX_FOTA_Status_FOTA_MASTER_FD5Value:0  # Raw signal data to be transmitted over the CAN bus for the Signal FOTA_Status
      COMTX_N_PDU_7E_GLIWA_MCPA_RX_FD5: type=IDTSN_PDU_7E_GLIWA_MCPA_RX_FD5, init-value=COMTX_N_PDU_7E_GLIWA_MCPA_RX_FD5Value:0  # Raw signal data to be transmitted over the CAN bus for the Signal N_PDU_7E
      COMTX_N_PDU_7F_GLIWA_MCPB_RX_FD5: type=IDTSN_PDU_7F_GLIWA_MCPB_RX_FD5, init-value=COMTX_N_PDU_7F_GLIWA_MCPB_RX_FD5Value:0  # Raw signal data to be transmitted over the CAN bus for the Signal N_PDU_7F
      COMTX_PerWakeUp_Diag_HYBRID_SYSTEM_EPT1_FD5: type=IDTSPerWakeUp_Diag_HYBRID_SYSTEM_EPT1_FD5, init-value=COMTX_PerWakeUp_Diag_HYBRID_SYSTEM_EPT1_FD5Value:0  # Raw signal data to be transmitted over the CAN bus for the Signal PerWakeUp_Diag
      COMTX_WU_Timer_Value_HYBRID_SYSTEM_EPT1_FD5: type=IDTSWU_Timer_Value_HYBRID_SYSTEM_EPT1_FD5, init-value=COMTX_WU_Timer_Value_HYBRID_SYSTEM_EPT1_FD5Value:0  # Raw signal data to be transmitted over the CAN bus for the Signal WU_Timer_Value
      COMTX_CRC_HYBRID_THERMAL_COMMAND_HYBRID_THERMAL_COMMAND_FD5: type=IDTSCRC_HYBRID_THERMAL_COMMAND_HYBRID_THERMAL_COMMAND_FD5, init-value=COMTX_CRC_HYBRID_THERMAL_COMMAND_HYBRID_THERMAL_COMMAND_FD5Value:0  # Raw signal data to be transmitted over the CAN bus for the Signal CRC_HYBRID_THERMAL_COMMAND
      COMTX_EOPA_OIL_FlwRate_HYBRID_THERMAL_COMMAND_FD5: type=IDTSEOPA_OIL_FlwRate_HYBRID_THERMAL_COMMAND_FD5, init-value=COMTX_EOPA_OIL_FlwRate_HYBRID_THERMAL_COMMAND_FD5Value:0  # Raw signal data to be transmitted over the CAN bus for the Signal EOPA_OIL_FlwRate
      COMTX_EOPA_OIL_TEMP_HYBRID_THERMAL_COMMAND_FD5: type=IDTSEOPA_OIL_TEMP_HYBRID_THERMAL_COMMAND_FD5, init-value=COMTX_EOPA_OIL_TEMP_HYBRID_THERMAL_COMMAND_FD5Value:0  # Raw signal data to be transmitted over the CAN bus for the Signal EOPA_OIL_TEMP
      COMTX_EOPB_OIL_FlwRate_HYBRID_THERMAL_COMMAND_FD5: type=IDTSEOPB_OIL_FlwRate_HYBRID_THERMAL_COMMAND_FD5, init-value=COMTX_EOPB_OIL_FlwRate_HYBRID_THERMAL_COMMAND_FD5Value:0  # Raw signal data to be transmitted over the CAN bus for the Signal EOPB_OIL_FlwRate
      COMTX_EOPB_OIL_TEMP_HYBRID_THERMAL_COMMAND_FD5: type=IDTSEOPB_OIL_TEMP_HYBRID_THERMAL_COMMAND_FD5, init-value=COMTX_EOPB_OIL_TEMP_HYBRID_THERMAL_COMMAND_FD5Value:0  # Raw signal data to be transmitted over the CAN bus for the Signal EOPB_OIL_TEMP
      COMTX_MessageCounter_HYBRID_THERMAL_COMMAND_HYBRID_THERMAL_COMMAND_FD5: type=IDTSMessageCounter_HYBRID_THERMAL_COMMAND_HYBRID_THERMAL_COMMAND_FD5, init-value=COMTX_MessageCounter_HYBRID_THERMAL_COMMAND_HYBRID_THERMAL_COMMAND_FD5Value:0  # Raw signal data to be transmitted over the CAN bus for the Signal MessageCounter_HYBRID_THERMAL_COMMAND
      COMTX_SGCP_OIL_FlwRate_HYBRID_THERMAL_COMMAND_FD5: type=IDTSSGCP_OIL_FlwRate_HYBRID_THERMAL_COMMAND_FD5, init-value=COMTX_SGCP_OIL_FlwRate_HYBRID_THERMAL_COMMAND_FD5Value:0  # Raw signal data to be transmitted over the CAN bus for the Signal SGCP_OIL_FlwRate
      COMTX_SGCP_OIL_TEMP_HYBRID_THERMAL_COMMAND_FD5: type=IDTSSGCP_OIL_TEMP_HYBRID_THERMAL_COMMAND_FD5, init-value=COMTX_SGCP_OIL_TEMP_HYBRID_THERMAL_COMMAND_FD5Value:0  # Raw signal data to be transmitted over the CAN bus for the Signal SGCP_OIL_TEMP
      COMTX_IMPACTCommand_IMPACT_INFO_FD5: type=IDTSIMPACTCommand_IMPACT_INFO_FD5, init-value=COMTX_IMPACTCommand_IMPACT_INFO_FD5Value:0  # Raw signal data to be transmitted over the CAN bus for the Signal IMPACTCommand
      COMTX_IMPACTConfirm_IMPACT_INFO_FD5: type=IDTSIMPACTConfirm_IMPACT_INFO_FD5, init-value=COMTX_IMPACTConfirm_IMPACT_INFO_FD5Value:1  # Raw signal data to be transmitted over the CAN bus for the Signal IMPACTConfirm
      COMTX_TotalOdometer_IPC_FD_1_FD5: type=IDTSTotalOdometer_IPC_FD_1_FD5, init-value=COMTX_TotalOdometer_IPC_FD_1_FD5Value:0  # Raw signal data to be transmitted over the CAN bus for the Signal TotalOdometer
      COMTX_Real_Time_Clock_REAL_TIME_CLOCK_FD5: type=IDTSReal_Time_Clock_REAL_TIME_CLOCK_FD5, init-value=COMTX_Real_Time_Clock_REAL_TIME_CLOCK_FD5Value:0  # Raw signal data to be transmitted over the CAN bus for the Signal Real_Time_Clock
      COMTX_Real_Time_Validity_REAL_TIME_CLOCK_FD5: type=IDTSReal_Time_Validity_REAL_TIME_CLOCK_FD5, init-value=COMTX_Real_Time_Validity_REAL_TIME_CLOCK_FD5Value:0  # Raw signal data to be transmitted over the CAN bus for the Signal Real_Time_Validity
      COMTX_V2H_HVCMS_EVMax_P_Limit_RPF_FD_3_FD5: type=IDTSV2H_HVCMS_EVMax_P_Limit_RPF_FD_3_FD5, init-value=COMTX_V2H_HVCMS_EVMax_P_Limit_RPF_FD_3_FD5Value:0  # Raw signal data to be transmitted over the CAN bus for the Signal V2H_HVCMS_EVMax_P_Limit
      COMTX_GPS_Date_Day_TELEMATIC_FD_1_FD5: type=IDTSGPS_Date_Day_TELEMATIC_FD_1_FD5, init-value=COMTX_GPS_Date_Day_TELEMATIC_FD_1_FD5Value:255  # Raw signal data to be transmitted over the CAN bus for the Signal GPS_Date_Day
      COMTX_GPS_Date_Month_TELEMATIC_FD_1_FD5: type=IDTSGPS_Date_Month_TELEMATIC_FD_1_FD5, init-value=COMTX_GPS_Date_Month_TELEMATIC_FD_1_FD5Value:255  # Raw signal data to be transmitted over the CAN bus for the Signal GPS_Date_Month
      COMTX_GPS_Date_Year_TELEMATIC_FD_1_FD5: type=IDTSGPS_Date_Year_TELEMATIC_FD_1_FD5, init-value=COMTX_GPS_Date_Year_TELEMATIC_FD_1_FD5Value:65535  # Raw signal data to be transmitted over the CAN bus for the Signal GPS_Date_Year
      COMTX_GPS_UTC_Hour_TELEMATIC_FD_1_FD5: type=IDTSGPS_UTC_Hour_TELEMATIC_FD_1_FD5, init-value=COMTX_GPS_UTC_Hour_TELEMATIC_FD_1_FD5Value:255  # Raw signal data to be transmitted over the CAN bus for the Signal GPS_UTC_Hour
      COMTX_GPS_UTC_Minute_TELEMATIC_FD_1_FD5: type=IDTSGPS_UTC_Minute_TELEMATIC_FD_1_FD5, init-value=COMTX_GPS_UTC_Minute_TELEMATIC_FD_1_FD5Value:255  # Raw signal data to be transmitted over the CAN bus for the Signal GPS_UTC_Minute
      COMTX_GPS_UTC_Second_TELEMATIC_FD_1_FD5: type=IDTSGPS_UTC_Second_TELEMATIC_FD_1_FD5, init-value=COMTX_GPS_UTC_Second_TELEMATIC_FD_1_FD5Value:65535  # Raw signal data to be transmitted over the CAN bus for the Signal GPS_UTC_Second
      COMTX_HVCMS_BulkChargingComplete_VDCM_OBCM_FD5: type=IDTSHVCMS_BulkChargingComplete_VDCM_OBCM_FD5, init-value=COMTX_HVCMS_BulkChargingComplete_VDCM_OBCM_FD5Value:0  # Raw signal data to be transmitted over the CAN bus for the Signal HVCMS_BulkChargingComplete
      COMTX_HVCMS_ChargingComplete_VDCM_OBCM_FD5: type=IDTSHVCMS_ChargingComplete_VDCM_OBCM_FD5, init-value=COMTX_HVCMS_ChargingComplete_VDCM_OBCM_FD5Value:0  # Raw signal data to be transmitted over the CAN bus for the Signal HVCMS_ChargingComplete
      COMTX_HVCMS_EVEnergyCapacity_VDCM_OBCM_FD5: type=IDTSHVCMS_EVEnergyCapacity_VDCM_OBCM_FD5, init-value=COMTX_HVCMS_EVEnergyCapacity_VDCM_OBCM_FD5Value:0  # Raw signal data to be transmitted over the CAN bus for the Signal HVCMS_EVEnergyCapacity
      COMTX_HVCMS_EVEnergyRequest_VDCM_OBCM_FD5: type=IDTSHVCMS_EVEnergyRequest_VDCM_OBCM_FD5, init-value=COMTX_HVCMS_EVEnergyRequest_VDCM_OBCM_FD5Value:131071  # Raw signal data to be transmitted over the CAN bus for the Signal HVCMS_EVEnergyRequest
      COMTX_HVCMS_EVErrorCode_VDCM_OBCM_FD5: type=IDTSHVCMS_EVErrorCode_VDCM_OBCM_FD5, init-value=COMTX_HVCMS_EVErrorCode_VDCM_OBCM_FD5Value:0  # Raw signal data to be transmitted over the CAN bus for the Signal HVCMS_EVErrorCode
      COMTX_HVCMS_EVMax_I_Limit_VDCM_OBCM_FD5: type=IDTSHVCMS_EVMax_I_Limit_VDCM_OBCM_FD5, init-value=COMTX_HVCMS_EVMax_I_Limit_VDCM_OBCM_FD5Value:0  # Raw signal data to be transmitted over the CAN bus for the Signal HVCMS_EVMax_I_Limit
      COMTX_HVCMS_EVMax_P_Limit_VDCM_OBCM_FD5: type=IDTSHVCMS_EVMax_P_Limit_VDCM_OBCM_FD5, init-value=COMTX_HVCMS_EVMax_P_Limit_VDCM_OBCM_FD5Value:0  # Raw signal data to be transmitted over the CAN bus for the Signal HVCMS_EVMax_P_Limit
      COMTX_HVCMS_EVMax_V_Limit_VDCM_OBCM_FD5: type=IDTSHVCMS_EVMax_V_Limit_VDCM_OBCM_FD5, init-value=COMTX_HVCMS_EVMax_V_Limit_VDCM_OBCM_FD5Value:0  # Raw signal data to be transmitted over the CAN bus for the Signal HVCMS_EVMax_V_Limit
      COMTX_HVCMS_EVReady_VDCM_OBCM_FD5: type=IDTSHVCMS_EVReady_VDCM_OBCM_FD5, init-value=COMTX_HVCMS_EVReady_VDCM_OBCM_FD5Value:0  # Raw signal data to be transmitted over the CAN bus for the Signal HVCMS_EVReady
      COMTX_HVCMS_EVRESS_SOC_VDCM_OBCM_FD5: type=IDTSHVCMS_EVRESS_SOC_VDCM_OBCM_FD5, init-value=COMTX_HVCMS_EVRESS_SOC_VDCM_OBCM_FD5Value:0  # Raw signal data to be transmitted over the CAN bus for the Signal HVCMS_EVRESS_SOC
      COMTX_HVCMS_EVRESSConditioning_VDCM_OBCM_FD5: type=IDTSHVCMS_EVRESSConditioning_VDCM_OBCM_FD5, init-value=COMTX_HVCMS_EVRESSConditioning_VDCM_OBCM_FD5Value:0  # Raw signal data to be transmitted over the CAN bus for the Signal HVCMS_EVRESSConditioning
      COMTX_HVCMS_EVTargetCurrent_VDCM_OBCM_FD5: type=IDTSHVCMS_EVTargetCurrent_VDCM_OBCM_FD5, init-value=COMTX_HVCMS_EVTargetCurrent_VDCM_OBCM_FD5Value:0  # Raw signal data to be transmitted over the CAN bus for the Signal HVCMS_EVTargetCurrent
      COMTX_HVCMS_EVTargetVoltage_VDCM_OBCM_FD5: type=IDTSHVCMS_EVTargetVoltage_VDCM_OBCM_FD5, init-value=COMTX_HVCMS_EVTargetVoltage_VDCM_OBCM_FD5Value:0  # Raw signal data to be transmitted over the CAN bus for the Signal HVCMS_EVTargetVoltage
      COMTX_HVCMS_Protocol_Entry{1..3}_VDCM_OBCM_FD5: type=IDTSHVCMS_Protocol_Entry{1..3}_VDCM_OBCM_FD5, init-value=COMTX_HVCMS_Protocol_Entry{1..3}_VDCM_OBCM_FD5Value:0  # Raw signal data to be transmitted over the CAN bus for the Signal HVCMS_Protocol_Entry{1..3}
      COMTX_HVCMS_ReadyToChargeState_VDCM_OBCM_FD5: type=IDTSHVCMS_ReadyToChargeState_VDCM_OBCM_FD5, init-value=COMTX_HVCMS_ReadyToChargeState_VDCM_OBCM_FD5Value:0  # Raw signal data to be transmitted over the CAN bus for the Signal HVCMS_ReadyToChargeState
      COMTX_HVCMS_RemaningTimeToBulkSOC_VDCM_OBCM_FD5: type=IDTSHVCMS_RemaningTimeToBulkSOC_VDCM_OBCM_FD5, init-value=COMTX_HVCMS_RemaningTimeToBulkSOC_VDCM_OBCM_FD5Value:0  # Raw signal data to be transmitted over the CAN bus for the Signal HVCMS_RemaningTimeToBulkSOC
      COMTX_HVCMS_RemaningTimeToFullSOC_VDCM_OBCM_FD5: type=IDTSHVCMS_RemaningTimeToFullSOC_VDCM_OBCM_FD5, init-value=COMTX_HVCMS_RemaningTimeToFullSOC_VDCM_OBCM_FD5Value:0  # Raw signal data to be transmitted over the CAN bus for the Signal HVCMS_RemaningTimeToFullSOC
      COMTX_HVCMS_SelectedEnergyTransferType_VDCM_OBCM_FD5: type=IDTSHVCMS_SelectedEnergyTransferType_VDCM_OBCM_FD5, init-value=COMTX_HVCMS_SelectedEnergyTransferType_VDCM_OBCM_FD5Value:0  # Raw signal data to be transmitted over the CAN bus for the Signal HVCMS_SelectedEnergyTransferType
      COMTX_HVCMS_SelectedPaymentOptn_VDCM_OBCM_FD5: type=IDTSHVCMS_SelectedPaymentOptn_VDCM_OBCM_FD5, init-value=COMTX_HVCMS_SelectedPaymentOptn_VDCM_OBCM_FD5Value:0  # Raw signal data to be transmitted over the CAN bus for the Signal HVCMS_SelectedPaymentOptn
      COMTX_HVCMS_SelectedServiceId_VDCM_OBCM_FD5: type=IDTSHVCMS_SelectedServiceId_VDCM_OBCM_FD5, init-value=COMTX_HVCMS_SelectedServiceId_VDCM_OBCM_FD5Value:0  # Raw signal data to be transmitted over the CAN bus for the Signal HVCMS_SelectedServiceId
      COMTX_HVCMS_ServiceCategory_VDCM_OBCM_FD5: type=IDTSHVCMS_ServiceCategory_VDCM_OBCM_FD5, init-value=COMTX_HVCMS_ServiceCategory_VDCM_OBCM_FD5Value:0  # Raw signal data to be transmitted over the CAN bus for the Signal HVCMS_ServiceCategory
      COMTX_HVCMS_ServiceScope_VDCM_OBCM_FD5: type=IDTSHVCMS_ServiceScope_VDCM_OBCM_FD5, init-value=COMTX_HVCMS_ServiceScope_VDCM_OBCM_FD5Value:0  # Raw signal data to be transmitted over the CAN bus for the Signal HVCMS_ServiceScope
      COMTX_OBCM_OutVoltageSyncTgt_VDCM_OBCM_FD5: type=IDTSOBCM_OutVoltageSyncTgt_VDCM_OBCM_FD5, init-value=COMTX_OBCM_OutVoltageSyncTgt_VDCM_OBCM_FD5Value:0  # Raw signal data to be transmitted over the CAN bus for the Signal OBCM_OutVoltageSyncTgt
      COMTX_VDCM_BattBulkSOC_VDCM_OBCM_FD5: type=IDTSVDCM_BattBulkSOC_VDCM_OBCM_FD5, init-value=COMTX_VDCM_BattBulkSOC_VDCM_OBCM_FD5Value:0  # Raw signal data to be transmitted over the CAN bus for the Signal VDCM_BattBulkSOC
      COMTX_VDCM_ContractAuthenticationID_VDCM_OBCM_FD5: type=IDTSVDCM_ContractAuthenticationID_VDCM_OBCM_FD5, init-value=COMTX_VDCM_ContractAuthenticationID_VDCM_OBCM_FD5Value:0  # Raw signal data to be transmitted over the CAN bus for the Signal VDCM_ContractAuthenticationID
      COMTX_VDCM_GenChallenge_VDCM_OBCM_FD5: type=IDTSVDCM_GenChallenge_VDCM_OBCM_FD5, init-value=COMTX_VDCM_GenChallenge_VDCM_OBCM_FD5Value:0  # Raw signal data to be transmitted over the CAN bus for the Signal VDCM_GenChallenge
      COMTX_VDCM_OBCDischCurrentLim_VDCM_OBCM_FD5: type=IDTSVDCM_OBCDischCurrentLim_VDCM_OBCM_FD5, init-value=COMTX_VDCM_OBCDischCurrentLim_VDCM_OBCM_FD5Value:815  # Raw signal data to be transmitted over the CAN bus for the Signal VDCM_OBCDischCurrentLim
      COMTX_VDCM_TypeCNegotiationSts_VDCM_OBCM_FD5: type=IDTSVDCM_TypeCNegotiationSts_VDCM_OBCM_FD5, init-value=COMTX_VDCM_TypeCNegotiationSts_VDCM_OBCM_FD5Value:0  # Raw signal data to be transmitted over the CAN bus for the Signal VDCM_TypeCNegotiationSts
      COMTX_ClrLgsDiagInfo_VDCM_PWT3_FD5: type=IDTSClrLgsDiagInfo_VDCM_PWT3_FD5, init-value=COMTX_ClrLgsDiagInfo_VDCM_PWT3_FD5Value:0  # Raw signal data to be transmitted over the CAN bus for the Signal ClrLgsDiagInfo
      COMTX_T4_Sensor_Temp_VDCM_PWT3_FD5: type=IDTST4_Sensor_Temp_VDCM_PWT3_FD5, init-value=COMTX_T4_Sensor_Temp_VDCM_PWT3_FD5Value:0  # Raw signal data to be transmitted over the CAN bus for the Signal T4_Sensor_Temp
      COMTX_T7_CoolantTempVldty_VDCM_PWT3_FD5: type=IDTST7_CoolantTempVldty_VDCM_PWT3_FD5, init-value=COMTX_T7_CoolantTempVldty_VDCM_PWT3_FD5Value:0  # Raw signal data to be transmitted over the CAN bus for the Signal T7_CoolantTempVldty
      COMTX_T7_Sensor_Temp_VDCM_PWT3_FD5: type=IDTST7_Sensor_Temp_VDCM_PWT3_FD5, init-value=COMTX_T7_Sensor_Temp_VDCM_PWT3_FD5Value:0  # Raw signal data to be transmitted over the CAN bus for the Signal T7_Sensor_Temp
      COMTX_VIN_DATA_VIN_FD5: type=IDTSVIN_DATA_VIN_FD5, init-value=COMTX_VIN_DATA_VIN_FD5Value:0  # Raw signal data to be transmitted over the CAN bus for the Signal VIN_DATA
      COMTX_VIN_MSG_VIN_FD5: type=IDTSVIN_MSG_VIN_FD5, init-value=COMTX_VIN_MSG_VIN_FD5Value:3  # Raw signal data to be transmitted over the CAN bus for the Signal VIN_MSG
    invalidation-policys:
      data-element=COMTX_OperationalModeSts_BCM_FD_2_FD5, handle-invalid=KEEP
      data-element=COMTX_Battery_Volt_1_BCM_FD_3_FD5, handle-invalid=KEEP
      data-element=COMTX_IgnitionOnCounter_BCM_FD_7_FD5, handle-invalid=DONT-INVALIDATE
      data-element=COMTX_ExternalTemperature_BCM_FD_9_FD5, handle-invalid=KEEP
      data-element=COMTX_EPBSts_BRAKE_FD_4_FD5, handle-invalid=KEEP
      data-element=COMTX_ABSFailSts_BRAKE_FD_5_FD5, handle-invalid=DONT-INVALIDATE
      data-element=COMTX_ESCFailSts_BRAKE_FD_5_FD5, handle-invalid=DONT-INVALIDATE
      data-element=COMTX_Eamount_EVCU_ISO15118_STATUS1_FD5, handle-invalid=KEEP
      data-element=COMTX_EVMaxCurrent_EVCU_ISO15118_STATUS1_FD5, handle-invalid=KEEP
      data-element=COMTX_EVMaxVoltage_EVCU_ISO15118_STATUS1_FD5, handle-invalid=KEEP
      data-element=COMTX_EVMinCurrent_EVCU_ISO15118_STATUS1_FD5, handle-invalid=KEEP
      data-element=COMTX_FOTA_Status_FOTA_MASTER_FD5, handle-invalid=DONT-INVALIDATE
      data-element=COMTX_N_PDU_7E_GLIWA_MCPA_RX_FD5, handle-invalid=DONT-INVALIDATE
      data-element=COMTX_N_PDU_7F_GLIWA_MCPB_RX_FD5, handle-invalid=DONT-INVALIDATE
      data-element=COMTX_PerWakeUp_Diag_HYBRID_SYSTEM_EPT1_FD5, handle-invalid=DONT-INVALIDATE
      data-element=COMTX_WU_Timer_Value_HYBRID_SYSTEM_EPT1_FD5, handle-invalid=DONT-INVALIDATE
      data-element=COMTX_CRC_HYBRID_THERMAL_COMMAND_HYBRID_THERMAL_COMMAND_FD5, handle-invalid=DONT-INVALIDATE
      data-element=COMTX_EOPA_OIL_FlwRate_HYBRID_THERMAL_COMMAND_FD5, handle-invalid=KEEP
      data-element=COMTX_EOPA_OIL_TEMP_HYBRID_THERMAL_COMMAND_FD5, handle-invalid=KEEP
      data-element=COMTX_EOPB_OIL_FlwRate_HYBRID_THERMAL_COMMAND_FD5, handle-invalid=KEEP
      data-element=COMTX_EOPB_OIL_TEMP_HYBRID_THERMAL_COMMAND_FD5, handle-invalid=KEEP
      data-element=COMTX_MessageCounter_HYBRID_THERMAL_COMMAND_HYBRID_THERMAL_COMMAND_FD5, handle-invalid=DONT-INVALIDATE
      data-element=COMTX_SGCP_OIL_FlwRate_HYBRID_THERMAL_COMMAND_FD5, handle-invalid=KEEP
      data-element=COMTX_SGCP_OIL_TEMP_HYBRID_THERMAL_COMMAND_FD5, handle-invalid=KEEP
      data-element=COMTX_IMPACTCommand_IMPACT_INFO_FD5, handle-invalid=DONT-INVALIDATE
      data-element=COMTX_IMPACTConfirm_IMPACT_INFO_FD5, handle-invalid=DONT-INVALIDATE
      data-element=COMTX_TotalOdometer_IPC_FD_1_FD5, handle-invalid=DONT-INVALIDATE
      data-element=COMTX_Real_Time_Clock_REAL_TIME_CLOCK_FD5, handle-invalid=KEEP
      data-element=COMTX_Real_Time_Validity_REAL_TIME_CLOCK_FD5, handle-invalid=DONT-INVALIDATE
      data-element=COMTX_V2H_HVCMS_EVMax_P_Limit_RPF_FD_3_FD5, handle-invalid=DONT-INVALIDATE
      data-element=COMTX_GPS_Date_Day_TELEMATIC_FD_1_FD5, handle-invalid=KEEP
      data-element=COMTX_GPS_Date_Month_TELEMATIC_FD_1_FD5, handle-invalid=KEEP
      data-element=COMTX_GPS_Date_Year_TELEMATIC_FD_1_FD5, handle-invalid=KEEP
      data-element=COMTX_GPS_UTC_Hour_TELEMATIC_FD_1_FD5, handle-invalid=KEEP
      data-element=COMTX_GPS_UTC_Minute_TELEMATIC_FD_1_FD5, handle-invalid=KEEP
      data-element=COMTX_GPS_UTC_Second_TELEMATIC_FD_1_FD5, handle-invalid=KEEP
      data-element=COMTX_HVCMS_BulkChargingComplete_VDCM_OBCM_FD5, handle-invalid=DONT-INVALIDATE
      data-element=COMTX_HVCMS_ChargingComplete_VDCM_OBCM_FD5, handle-invalid=DONT-INVALIDATE
      data-element=COMTX_HVCMS_EVEnergyCapacity_VDCM_OBCM_FD5, handle-invalid=KEEP
      data-element=COMTX_HVCMS_EVEnergyRequest_VDCM_OBCM_FD5, handle-invalid=KEEP
      data-element=COMTX_HVCMS_EVErrorCode_VDCM_OBCM_FD5, handle-invalid=KEEP
      data-element=COMTX_HVCMS_EVMax_I_Limit_VDCM_OBCM_FD5, handle-invalid=KEEP
      data-element=COMTX_HVCMS_EVMax_P_Limit_VDCM_OBCM_FD5, handle-invalid=KEEP
      data-element=COMTX_HVCMS_EVMax_V_Limit_VDCM_OBCM_FD5, handle-invalid=KEEP
      data-element=COMTX_HVCMS_EVReady_VDCM_OBCM_FD5, handle-invalid=DONT-INVALIDATE
      data-element=COMTX_HVCMS_EVRESS_SOC_VDCM_OBCM_FD5, handle-invalid=KEEP
      data-element=COMTX_HVCMS_EVRESSConditioning_VDCM_OBCM_FD5, handle-invalid=DONT-INVALIDATE
      data-element=COMTX_HVCMS_EVTargetCurrent_VDCM_OBCM_FD5, handle-invalid=KEEP
      data-element=COMTX_HVCMS_EVTargetVoltage_VDCM_OBCM_FD5, handle-invalid=KEEP
      data-element=COMTX_HVCMS_Protocol_Entry{1..3}_VDCM_OBCM_FD5, handle-invalid=KEEP
      data-element=COMTX_HVCMS_ReadyToChargeState_VDCM_OBCM_FD5, handle-invalid=DONT-INVALIDATE
      data-element=COMTX_HVCMS_RemaningTimeToBulkSOC_VDCM_OBCM_FD5, handle-invalid=KEEP
      data-element=COMTX_HVCMS_RemaningTimeToFullSOC_VDCM_OBCM_FD5, handle-invalid=KEEP
      data-element=COMTX_HVCMS_SelectedEnergyTransferType_VDCM_OBCM_FD5, handle-invalid=KEEP
      data-element=COMTX_HVCMS_SelectedPaymentOptn_VDCM_OBCM_FD5, handle-invalid=KEEP
      data-element=COMTX_HVCMS_SelectedServiceId_VDCM_OBCM_FD5, handle-invalid=DONT-INVALIDATE
      data-element=COMTX_HVCMS_ServiceCategory_VDCM_OBCM_FD5, handle-invalid=KEEP
      data-element=COMTX_HVCMS_ServiceScope_VDCM_OBCM_FD5, handle-invalid=KEEP
      data-element=COMTX_OBCM_OutVoltageSyncTgt_VDCM_OBCM_FD5, handle-invalid=KEEP
      data-element=COMTX_VDCM_BattBulkSOC_VDCM_OBCM_FD5, handle-invalid=DONT-INVALIDATE
      data-element=COMTX_VDCM_ContractAuthenticationID_VDCM_OBCM_FD5, handle-invalid=DONT-INVALIDATE
      data-element=COMTX_VDCM_GenChallenge_VDCM_OBCM_FD5, handle-invalid=DONT-INVALIDATE
      data-element=COMTX_VDCM_OBCDischCurrentLim_VDCM_OBCM_FD5, handle-invalid=DONT-INVALIDATE
      data-element=COMTX_VDCM_TypeCNegotiationSts_VDCM_OBCM_FD5, handle-invalid=DONT-INVALIDATE
      data-element=COMTX_ClrLgsDiagInfo_VDCM_PWT3_FD5, handle-invalid=DONT-INVALIDATE
      data-element=COMTX_T4_Sensor_Temp_VDCM_PWT3_FD5, handle-invalid=DONT-INVALIDATE
      data-element=COMTX_T7_CoolantTempVldty_VDCM_PWT3_FD5, handle-invalid=DONT-INVALIDATE
      data-element=COMTX_T7_Sensor_Temp_VDCM_PWT3_FD5, handle-invalid=DONT-INVALIDATE
      data-element=COMTX_VIN_DATA_VIN_FD5, handle-invalid=DONT-INVALIDATE
      data-element=COMTX_VIN_MSG_VIN_FD5, handle-invalid=KEEP
