[part 2 of 2: packages /STLASWCs/ComSwCpts/ComDataDefinition/ComConstSpec to /STLASWCs/ComSwCpts/ComPrivateInterfaces]
AUTOSAR XML (schema 4-3-0)
package /STLASWCs/ComSwCpts/ComDataDefinition/ComConstSpec
  84 x constant specification:
    COMRX_CLrDiagInfo_MCPA_P_MCPA_STATUS_FD16_Init: value-spec=Value:0
    COMRX_CLrDiagInfo_MCPB_P_MCPB_STATUS_FD16_Init: value-spec=Value:0
    COMRX_CLrDiagInfo_SGCP_P_SGCP_STATUS_FD16_Init: value-spec=Value:0
    COMRX_CRC_MCPA_STATUS_MCPA_STATUS_FD16_Init: value-spec=Value:0
    COMRX_CRC_MCPB_STATUS_MCPB_STATUS_FD16_Init: value-spec=Value:0
    COMRX_CRC_SGCP_STATUS_SGCP_STATUS_FD16_Init: value-spec=Value:0
    COMRX_MCPA_Control_Board_Temperature_P_MCPA_STATUS_FD16_Init: value-spec=Value:255
    COMRX_MCPA_CoolantTemp_P_MCPA_STATUS_FD16_Init: value-spec=Value:0
    COMRX_MCPA_DC_Current_P_MCPA_STATUS_FD16_Init: value-spec=Value:16384
    COMRX_MCPA_DC_Current_V_P_MCPA_STATUS_FD16_Init: value-spec=Value:0
    COMRX_MCPA_DC_Volt_V_P_MCPA_STATUS_FD16_Init: value-spec=Value:0
    COMRX_MCPA_DC_Voltage_P_MCPA_STATUS_FD16_Init: value-spec=Value:0
    COMRX_MCPA_DerateReason_P_MCPA_STATUS_FD16_Init: value-spec=Value:0
    COMRX_MCPA_Inverter_Temp_P_MCPA_STATUS_FD16_Init: value-spec=Value:40
    COMRX_MCPA_PIM_DC_Side_Busbar_Temp_P_MCPA_STATUS_FD16_Init: value-spec=Value:0
    COMRX_MCPA_Rotor_Temperature_P_MCPA_STATUS_FD16_Init: value-spec=Value:255
    COMRX_MCPA_Service_Lamp_Request_P_MCPA_STATUS_FD16_Init: value-spec=Value:0
    COMRX_MCPB_Control_Board_Temperature_P_MCPB_STATUS_FD16_Init: value-spec=Value:0
    COMRX_MCPB_CoolantTemp_P_MCPB_STATUS_FD16_Init: value-spec=Value:0
    COMRX_MCPB_DC_Current_P_MCPB_STATUS_FD16_Init: value-spec=Value:16384
    COMRX_MCPB_DC_Current_V_P_MCPB_STATUS_FD16_Init: value-spec=Value:0
    COMRX_MCPB_DC_Volt_V_P_MCPB_STATUS_FD16_Init: value-spec=Value:0
    COMRX_MCPB_DC_Voltage_P_MCPB_STATUS_FD16_Init: value-spec=Value:0
    COMRX_MCPB_DerateReason_P_MCPB_STATUS_FD16_Init: value-spec=Value:0
    COMRX_MCPB_Inverter_Temp_P_MCPB_STATUS_FD16_Init: value-spec=Value:40
    COMRX_MCPB_PIM_DC_Side_Busbar_Temp_P_MCPB_STATUS_FD16_Init: value-spec=Value:0
    COMRX_MCPB_Rotor_Temperature_P_MCPB_STATUS_FD16_Init: value-spec=Value:255
    COMRX_MCPB_Service_Lamp_Request_P_MCPB_STATUS_FD16_Init: value-spec=Value:0
    COMRX_MC_MCPA_STATUS_MCPA_STATUS_FD16_Init: value-spec=Value:0
    COMRX_MC_MCPB_STATUS_MCPB_STATUS_FD16_Init: value-spec=Value:0
    COMRX_MC_SGCP_STATUS_SGCP_STATUS_FD16_Init: value-spec=Value:0
    COMRX_N_PDU_7B_GLIWA_MCPA_TX_FD16_Init: value-spec=Value:0
    COMRX_N_PDU_7C_GLIWA_MCPB_TX_FD16_Init: value-spec=Value:0
    COMRX_N_PDU_86_GLIWA_SGCP_TX_FD16_Init: value-spec=Value:0
    COMRX_SGCP_Control_Board_Temperature_P_SGCP_STATUS_FD16_Init: value-spec=Value:255
    COMRX_SGCP_CoolantTemp_P_SGCP_STATUS_FD16_Init: value-spec=Value:0
    COMRX_SGCP_DC_Current_P_SGCP_STATUS_FD16_Init: value-spec=Value:16384
    COMRX_SGCP_DC_Current_V_P_SGCP_STATUS_FD16_Init: value-spec=Value:0
    COMRX_SGCP_DC_Volt_V_P_SGCP_STATUS_FD16_Init: value-spec=Value:0
    COMRX_SGCP_DC_Voltage_P_SGCP_STATUS_FD16_Init: value-spec=Value:0
    COMRX_SGCP_DerateReason_P_SGCP_STATUS_FD16_Init: value-spec=Value:0
    COMRX_SGCP_Inverter_Temp_P_SGCP_STATUS_FD16_Init: value-spec=Value:40
    COMRX_SGCP_PIM_AC_Side_Busbar_Temp_P_SGCP_STATUS_FD16_Init: value-spec=Value:0
    COMRX_SGCP_PIM_DC_Side_Busbar_Temp_P_SGCP_STATUS_FD16_Init: value-spec=Value:0
    COMRX_SGCP_Rotor_Temperature_P_SGCP_STATUS_FD16_Init: value-spec=Value:255
    COMRX_SGCP_Service_Lamp_Request_P_SGCP_STATUS_FD16_Init: value-spec=Value:0
    COMTX_ABSFailSts_BRAKE_FD_5_FD16_Init: value-spec=0
    COMTX_CRC_BCM10_BCM_FD_10_FD16_Init: value-spec=0
    COMTX_CRC_HYBRID_THERMAL_COMMAND_HYBRID_THERMAL_COMMAND_FD16_Init: value-spec=0
    COMTX_CmdIgnSts_BCM_FD_10_FD16_Init: value-spec=0
    COMTX_EOPA_OIL_FlwRate_HYBRID_THERMAL_COMMAND_FD16_Init: value-spec=0
    COMTX_EOPA_OIL_TEMP_HYBRID_THERMAL_COMMAND_FD16_Init: value-spec=0
    COMTX_EOPB_OIL_FlwRate_HYBRID_THERMAL_COMMAND_FD16_Init: value-spec=0
    COMTX_EOPB_OIL_TEMP_HYBRID_THERMAL_COMMAND_FD16_Init: value-spec=0
    COMTX_EPBSts_BRAKE_FD_4_FD16_Init: value-spec=0
    COMTX_ESCFailSts_BRAKE_FD_5_FD16_Init: value-spec=0
    COMTX_ExternalTemperature_BCM_FD_9_FD16_Init: value-spec=0
    COMTX_GPS_Date_Day_TELEMATIC_FD_1_FD16_Init: value-spec=255
    COMTX_GPS_Date_Month_TELEMATIC_FD_1_FD16_Init: value-spec=255
    COMTX_GPS_Date_Year_TELEMATIC_FD_1_FD16_Init: value-spec=65535
    COMTX_GPS_UTC_Hour_TELEMATIC_FD_1_FD16_Init: value-spec=255
    COMTX_GPS_UTC_Minute_TELEMATIC_FD_1_FD16_Init: value-spec=255
    COMTX_GPS_UTC_Second_TELEMATIC_FD_1_FD16_Init: value-spec=65535
    COMTX_IMPACTCommand_IMPACT_INFO_FD16_Init: value-spec=0
    COMTX_IMPACTConfirm_IMPACT_INFO_FD16_Init: value-spec=1
    COMTX_MessageCounter_BCM10_BCM_FD_10_FD16_Init: value-spec=0
    COMTX_MessageCounter_HYBRID_THERMAL_COMMAND_HYBRID_THERMAL_COMMAND_FD16_Init: value-spec=0
    COMTX_N_PDU_7E_GLIWA_MCPA_RX_FD16_Init: value-spec=0
    COMTX_N_PDU_7F_GLIWA_MCPB_RX_FD16_Init: value-spec=0
    COMTX_N_PDU_81_GLIWA_SGCP_RX_FD16_Init: value-spec=0
    COMTX_OperationalModeSts_BCM_FD_2_FD16_Init: value-spec=0
    COMTX_PerWakeUp_Diag_HYBRID_SYSTEM_EPT1_FD16_Init: value-spec=0
    COMTX_RELSD_TgtTrq_VEHDYN_FD_1_FD16_Init: value-spec=0
    COMTX_Real_Time_Clock_REAL_TIME_CLOCK_FD16_Init: value-spec=0
    COMTX_Real_Time_Validity_REAL_TIME_CLOCK_FD16_Init: value-spec=0
    COMTX_SGCP_OIL_FlwRate_HYBRID_THERMAL_COMMAND_FD16_Init: value-spec=0
    COMTX_SGCP_OIL_TEMP_HYBRID_THERMAL_COMMAND_FD16_Init: value-spec=0
    COMTX_T4_Sensor_Temp_VDCM_PWT3_FD16_Init: value-spec=0
    COMTX_T7_CoolantTempVldty_VDCM_PWT3_FD16_Init: value-spec=0
    COMTX_T7_Sensor_Temp_VDCM_PWT3_FD16_Init: value-spec=0
    COMTX_TotalOdometer_IPC_FD_1_FD16_Init: value-spec=0
    COMTX_VIN_DATA_VIN_FD16_Init: value-spec=0
    COMTX_VIN_MSG_VIN_FD16_Init: value-spec=3
    COMTX_WU_Timer_Value_HYBRID_SYSTEM_EPT1_FD16_Init: value-spec=0
package /STLASWCs/ComSwCpts/ComDataDefinition/ComImpDataType
  84 x impl type, all with category=TYPE_REFERENCE:
    IDTSABSFailSts_BRAKE_FD_5_FD16: implementation-data-type=boolean
    IDTSCLrDiagInfo_MCPA_P_MCPA_STATUS_FD16: implementation-data-type=boolean
    IDTSCLrDiagInfo_MCPB_P_MCPB_STATUS_FD16: implementation-data-type=boolean
    IDTSCLrDiagInfo_SGCP_P_SGCP_STATUS_FD16: implementation-data-type=boolean
    IDTSCRC_BCM10_BCM_FD_10_FD16: implementation-data-type=uint8
    IDTSCRC_HYBRID_THERMAL_COMMAND_HYBRID_THERMAL_COMMAND_FD16: implementation-data-type=uint8
    IDTSCRC_MCPA_STATUS_MCPA_STATUS_FD16: implementation-data-type=uint8
    IDTSCRC_MCPB_STATUS_MCPB_STATUS_FD16: implementation-data-type=uint8
    IDTSCRC_SGCP_STATUS_SGCP_STATUS_FD16: implementation-data-type=uint8
    IDTSCmdIgnSts_BCM_FD_10_FD16: implementation-data-type=uint8, invalid-value=Value:7
    IDTSEOPA_OIL_FlwRate_HYBRID_THERMAL_COMMAND_FD16: implementation-data-type=uint8, invalid-value=Value:255
    IDTSEOPA_OIL_TEMP_HYBRID_THERMAL_COMMAND_FD16: implementation-data-type=uint8, invalid-value=Value:255
    IDTSEOPB_OIL_FlwRate_HYBRID_THERMAL_COMMAND_FD16: implementation-data-type=uint8, invalid-value=Value:255
    IDTSEOPB_OIL_TEMP_HYBRID_THERMAL_COMMAND_FD16: implementation-data-type=uint8, invalid-value=Value:255
    IDTSEPBSts_BRAKE_FD_4_FD16: implementation-data-type=uint8, invalid-value=Value:15
    IDTSESCFailSts_BRAKE_FD_5_FD16: implementation-data-type=boolean
    IDTSExternalTemperature_BCM_FD_9_FD16: implementation-data-type=uint16, invalid-value=Value:511
    IDTSGPS_Date_Day_TELEMATIC_FD_1_FD16: implementation-data-type=uint8, invalid-value=Value:255
    IDTSGPS_Date_Month_TELEMATIC_FD_1_FD16: implementation-data-type=uint8, invalid-value=Value:255
    IDTSGPS_Date_Year_TELEMATIC_FD_1_FD16: implementation-data-type=uint16, invalid-value=Value:65535
    IDTSGPS_UTC_Hour_TELEMATIC_FD_1_FD16: implementation-data-type=uint8, invalid-value=Value:255
    IDTSGPS_UTC_Minute_TELEMATIC_FD_1_FD16: implementation-data-type=uint8, invalid-value=Value:255
    IDTSGPS_UTC_Second_TELEMATIC_FD_1_FD16: implementation-data-type=uint16, invalid-value=Value:65535
    IDTSIMPACTCommand_IMPACT_INFO_FD16: implementation-data-type=boolean
    IDTSIMPACTConfirm_IMPACT_INFO_FD16: implementation-data-type=boolean
    IDTSMCPA_Control_Board_Temperature_P_MCPA_STATUS_FD16: implementation-data-type=uint8, invalid-value=Value:255
    IDTSMCPA_CoolantTemp_P_MCPA_STATUS_FD16: implementation-data-type=uint16, invalid-value=Value:2047
    IDTSMCPA_DC_Current_P_MCPA_STATUS_FD16: implementation-data-type=uint16
    IDTSMCPA_DC_Current_V_P_MCPA_STATUS_FD16: implementation-data-type=boolean
    IDTSMCPA_DC_Volt_V_P_MCPA_STATUS_FD16: implementation-data-type=boolean
    IDTSMCPA_DC_Voltage_P_MCPA_STATUS_FD16: implementation-data-type=uint16, invalid-value=Value:1023
    IDTSMCPA_DerateReason_P_MCPA_STATUS_FD16: implementation-data-type=uint8
    IDTSMCPA_Inverter_Temp_P_MCPA_STATUS_FD16: implementation-data-type=uint8, invalid-value=Value:255
    IDTSMCPA_PIM_DC_Side_Busbar_Temp_P_MCPA_STATUS_FD16: implementation-data-type=uint8, invalid-value=Value:255
    IDTSMCPA_Rotor_Temperature_P_MCPA_STATUS_FD16: implementation-data-type=uint8, invalid-value=Value:255
    IDTSMCPA_Service_Lamp_Request_P_MCPA_STATUS_FD16: implementation-data-type=boolean
    IDTSMCPB_Control_Board_Temperature_P_MCPB_STATUS_FD16: implementation-data-type=uint8, invalid-value=Value:255
    IDTSMCPB_CoolantTemp_P_MCPB_STATUS_FD16: implementation-data-type=uint16, invalid-value=Value:2047
    IDTSMCPB_DC_Current_P_MCPB_STATUS_FD16: implementation-data-type=uint16
    IDTSMCPB_DC_Current_V_P_MCPB_STATUS_FD16: implementation-data-type=boolean
    IDTSMCPB_DC_Volt_V_P_MCPB_STATUS_FD16: implementation-data-type=boolean
    IDTSMCPB_DC_Voltage_P_MCPB_STATUS_FD16: implementation-data-type=uint16, invalid-value=Value:1023
    IDTSMCPB_DerateReason_P_MCPB_STATUS_FD16: implementation-data-type=uint8
    IDTSMCPB_Inverter_Temp_P_MCPB_STATUS_FD16: implementation-data-type=uint8, invalid-value=Value:255
    IDTSMCPB_PIM_DC_Side_Busbar_Temp_P_MCPB_STATUS_FD16: implementation-data-type=uint8, invalid-value=Value:255
    IDTSMCPB_Rotor_Temperature_P_MCPB_STATUS_FD16: implementation-data-type=uint8, invalid-value=Value:255
    IDTSMCPB_Service_Lamp_Request_P_MCPB_STATUS_FD16: implementation-data-type=boolean
    IDTSMC_MCPA_STATUS_MCPA_STATUS_FD16: implementation-data-type=uint8
    IDTSMC_MCPB_STATUS_MCPB_STATUS_FD16: implementation-data-type=uint8
    IDTSMC_SGCP_STATUS_SGCP_STATUS_FD16: implementation-data-type=uint8
    IDTSMessageCounter_BCM10_BCM_FD_10_FD16: implementation-data-type=uint8
    IDTSMessageCounter_HYBRID_THERMAL_COMMAND_HYBRID_THERMAL_COMMAND_FD16: implementation-data-type=uint8
    IDTSN_PDU_7B_GLIWA_MCPA_TX_FD16: implementation-data-type=uint64
    IDTSN_PDU_7C_GLIWA_MCPB_TX_FD16: implementation-data-type=uint64
    IDTSN_PDU_7E_GLIWA_MCPA_RX_FD16: implementation-data-type=uint64
    IDTSN_PDU_7F_GLIWA_MCPB_RX_FD16: implementation-data-type=uint64
    IDTSN_PDU_81_GLIWA_SGCP_RX_FD16: implementation-data-type=uint64
    IDTSN_PDU_86_GLIWA_SGCP_TX_FD16: implementation-data-type=uint64
    IDTSOperationalModeSts_BCM_FD_2_FD16: implementation-data-type=uint8, invalid-value=Value:15
    IDTSPerWakeUp_Diag_HYBRID_SYSTEM_EPT1_FD16: implementation-data-type=uint16
    IDTSRELSD_TgtTrq_VEHDYN_FD_1_FD16: implementation-data-type=uint16, invalid-value=Value:511
    IDTSReal_Time_Clock_REAL_TIME_CLOCK_FD16: implementation-data-type=uint32, invalid-value=Value:4294967295
    IDTSReal_Time_Validity_REAL_TIME_CLOCK_FD16: implementation-data-type=boolean
    IDTSSGCP_Control_Board_Temperature_P_SGCP_STATUS_FD16: implementation-data-type=uint8, invalid-value=Value:255
    IDTSSGCP_CoolantTemp_P_SGCP_STATUS_FD16: implementation-data-type=uint16, invalid-value=Value:2047
    IDTSSGCP_DC_Current_P_SGCP_STATUS_FD16: implementation-data-type=uint16
    IDTSSGCP_DC_Current_V_P_SGCP_STATUS_FD16: implementation-data-type=boolean
    IDTSSGCP_DC_Volt_V_P_SGCP_STATUS_FD16: implementation-data-type=boolean
    IDTSSGCP_DC_Voltage_P_SGCP_STATUS_FD16: implementation-data-type=uint16, invalid-value=Value:1023
    IDTSSGCP_DerateReason_P_SGCP_STATUS_FD16: implementation-data-type=uint8
    IDTSSGCP_Inverter_Temp_P_SGCP_STATUS_FD16: implementation-data-type=uint8, invalid-value=Value:255
    IDTSSGCP_OIL_FlwRate_HYBRID_THERMAL_COMMAND_FD16: implementation-data-type=uint8, invalid-value=Value:255
    IDTSSGCP_OIL_TEMP_HYBRID_THERMAL_COMMAND_FD16: implementation-data-type=uint8, invalid-value=Value:255
    IDTSSGCP_PIM_AC_Side_Busbar_Temp_P_SGCP_STATUS_FD16: implementation-data-type=uint8, invalid-value=Value:255
    IDTSSGCP_PIM_DC_Side_Busbar_Temp_P_SGCP_STATUS_FD16: implementation-data-type=uint8, invalid-value=Value:255
    IDTSSGCP_Rotor_Temperature_P_SGCP_STATUS_FD16: implementation-data-type=uint8, invalid-value=Value:255
    IDTSSGCP_Service_Lamp_Request_P_SGCP_STATUS_FD16: implementation-data-type=boolean
    IDTST4_Sensor_Temp_VDCM_PWT3_FD16: implementation-data-type=uint16
    IDTST7_CoolantTempVldty_VDCM_PWT3_FD16: implementation-data-type=boolean
    IDTST7_Sensor_Temp_VDCM_PWT3_FD16: implementation-data-type=uint16
    IDTSTotalOdometer_IPC_FD_1_FD16: implementation-data-type=uint32
    IDTSVIN_DATA_VIN_FD16: implementation-data-type=uint64
    IDTSVIN_MSG_VIN_FD16: implementation-data-type=uint8, invalid-value=Value:3
    IDTSWU_Timer_Value_HYBRID_SYSTEM_EPT1_FD16: implementation-data-type=uint16
package /STLASWCs/ComSwCpts/ComPrivateInterfaces
  sender receiver interface CanCom_FD16RxSignalsSR
    46 x data, all with category=TYPE_REFERENCE, sw-calibration-access=READ-ONLY:
      COMRX_N_PDU_7B_GLIWA_MCPA_TX_FD16: type=IDTSN_PDU_7B_GLIWA_MCPA_TX_FD16
      COMRX_N_PDU_7C_GLIWA_MCPB_TX_FD16: type=IDTSN_PDU_7C_GLIWA_MCPB_TX_FD16
      COMRX_N_PDU_86_GLIWA_SGCP_TX_FD16: type=IDTSN_PDU_86_GLIWA_SGCP_TX_FD16
      COMRX_CLrDiagInfo_MCPA_P_MCPA_STATUS_FD16: type=IDTSCLrDiagInfo_MCPA_P_MCPA_STATUS_FD16
      COMRX_CRC_MCPA_STATUS_MCPA_STATUS_FD16: type=IDTSCRC_MCPA_STATUS_MCPA_STATUS_FD16
      COMRX_MC_MCPA_STATUS_MCPA_STATUS_FD16: type=IDTSMC_MCPA_STATUS_MCPA_STATUS_FD16
      COMRX_MCPA_Control_Board_Temperature_P_MCPA_STATUS_FD16: type=IDTSMCPA_Control_Board_Temperature_P_MCPA_STATUS_FD16
      COMRX_MCPA_CoolantTemp_P_MCPA_STATUS_FD16: type=IDTSMCPA_CoolantTemp_P_MCPA_STATUS_FD16
      COMRX_MCPA_DC_Current_P_MCPA_STATUS_FD16: type=IDTSMCPA_DC_Current_P_MCPA_STATUS_FD16
      COMRX_MCPA_DC_Current_V_P_MCPA_STATUS_FD16: type=IDTSMCPA_DC_Current_V_P_MCPA_STATUS_FD16
      COMRX_MCPA_DC_Volt_V_P_MCPA_STATUS_FD16: type=IDTSMCPA_DC_Volt_V_P_MCPA_STATUS_FD16
      COMRX_MCPA_DC_Voltage_P_MCPA_STATUS_FD16: type=IDTSMCPA_DC_Voltage_P_MCPA_STATUS_FD16
      COMRX_MCPA_DerateReason_P_MCPA_STATUS_FD16: type=IDTSMCPA_DerateReason_P_MCPA_STATUS_FD16
      COMRX_MCPA_Inverter_Temp_P_MCPA_STATUS_FD16: type=IDTSMCPA_Inverter_Temp_P_MCPA_STATUS_FD16
      COMRX_MCPA_PIM_DC_Side_Busbar_Temp_P_MCPA_STATUS_FD16: type=IDTSMCPA_PIM_DC_Side_Busbar_Temp_P_MCPA_STATUS_FD16
      COMRX_MCPA_Rotor_Temperature_P_MCPA_STATUS_FD16: type=IDTSMCPA_Rotor_Temperature_P_MCPA_STATUS_FD16
      COMRX_MCPA_Service_Lamp_Request_P_MCPA_STATUS_FD16: type=IDTSMCPA_Service_Lamp_Request_P_MCPA_STATUS_FD16
      COMRX_CLrDiagInfo_MCPB_P_MCPB_STATUS_FD16: type=IDTSCLrDiagInfo_MCPB_P_MCPB_STATUS_FD16
      COMRX_CRC_MCPB_STATUS_MCPB_STATUS_FD16: type=IDTSCRC_MCPB_STATUS_MCPB_STATUS_FD16
      COMRX_MC_MCPB_STATUS_MCPB_STATUS_FD16: type=IDTSMC_MCPB_STATUS_MCPB_STATUS_FD16
      COMRX_MCPB_Control_Board_Temperature_P_MCPB_STATUS_FD16: type=IDTSMCPB_Control_Board_Temperature_P_MCPB_STATUS_FD16
      COMRX_MCPB_CoolantTemp_P_MCPB_STATUS_FD16: type=IDTSMCPB_CoolantTemp_P_MCPB_STATUS_FD16
      COMRX_MCPB_DC_Current_P_MCPB_STATUS_FD16: type=IDTSMCPB_DC_Current_P_MCPB_STATUS_FD16
      COMRX_MCPB_DC_Current_V_P_MCPB_STATUS_FD16: type=IDTSMCPB_DC_Current_V_P_MCPB_STATUS_FD16
      COMRX_MCPB_DC_Volt_V_P_MCPB_STATUS_FD16: type=IDTSMCPB_DC_Volt_V_P_MCPB_STATUS_FD16
      COMRX_MCPB_DC_Voltage_P_MCPB_STATUS_FD16: type=IDTSMCPB_DC_Voltage_P_MCPB_STATUS_FD16
      COMRX_MCPB_DerateReason_P_MCPB_STATUS_FD16: type=IDTSMCPB_DerateReason_P_MCPB_STATUS_FD16
      COMRX_MCPB_Inverter_Temp_P_MCPB_STATUS_FD16: type=IDTSMCPB_Inverter_Temp_P_MCPB_STATUS_FD16
      COMRX_MCPB_PIM_DC_Side_Busbar_Temp_P_MCPB_STATUS_FD16: type=IDTSMCPB_PIM_DC_Side_Busbar_Temp_P_MCPB_STATUS_FD16
      COMRX_MCPB_Rotor_Temperature_P_MCPB_STATUS_FD16: type=IDTSMCPB_Rotor_Temperature_P_MCPB_STATUS_FD16
      COMRX_MCPB_Service_Lamp_Request_P_MCPB_STATUS_FD16: type=IDTSMCPB_Service_Lamp_Request_P_MCPB_STATUS_FD16
      COMRX_CLrDiagInfo_SGCP_P_SGCP_STATUS_FD16: type=IDTSCLrDiagInfo_SGCP_P_SGCP_STATUS_FD16
      COMRX_CRC_SGCP_STATUS_SGCP_STATUS_FD16: type=IDTSCRC_SGCP_STATUS_SGCP_STATUS_FD16
      COMRX_MC_SGCP_STATUS_SGCP_STATUS_FD16: type=IDTSMC_SGCP_STATUS_SGCP_STATUS_FD16
      COMRX_SGCP_Control_Board_Temperature_P_SGCP_STATUS_FD16: type=IDTSSGCP_Control_Board_Temperature_P_SGCP_STATUS_FD16
      COMRX_SGCP_CoolantTemp_P_SGCP_STATUS_FD16: type=IDTSSGCP_CoolantTemp_P_SGCP_STATUS_FD16
      COMRX_SGCP_DC_Current_P_SGCP_STATUS_FD16: type=IDTSSGCP_DC_Current_P_SGCP_STATUS_FD16
      COMRX_SGCP_DC_Current_V_P_SGCP_STATUS_FD16: type=IDTSSGCP_DC_Current_V_P_SGCP_STATUS_FD16
      COMRX_SGCP_DC_Volt_V_P_SGCP_STATUS_FD16: type=IDTSSGCP_DC_Volt_V_P_SGCP_STATUS_FD16
      COMRX_SGCP_DC_Voltage_P_SGCP_STATUS_FD16: type=IDTSSGCP_DC_Voltage_P_SGCP_STATUS_FD16
      COMRX_SGCP_DerateReason_P_SGCP_STATUS_FD16: type=IDTSSGCP_DerateReason_P_SGCP_STATUS_FD16
      COMRX_SGCP_Inverter_Temp_P_SGCP_STATUS_FD16: type=IDTSSGCP_Inverter_Temp_P_SGCP_STATUS_FD16
      COMRX_SGCP_PIM_AC_Side_Busbar_Temp_P_SGCP_STATUS_FD16: type=IDTSSGCP_PIM_AC_Side_Busbar_Temp_P_SGCP_STATUS_FD16
      COMRX_SGCP_PIM_DC_Side_Busbar_Temp_P_SGCP_STATUS_FD16: type=IDTSSGCP_PIM_DC_Side_Busbar_Temp_P_SGCP_STATUS_FD16
      COMRX_SGCP_Rotor_Temperature_P_SGCP_STATUS_FD16: type=IDTSSGCP_Rotor_Temperature_P_SGCP_STATUS_FD16
      COMRX_SGCP_Service_Lamp_Request_P_SGCP_STATUS_FD16: type=IDTSSGCP_Service_Lamp_Request_P_SGCP_STATUS_FD16
    invalidation-policys:
      data-element=COMRX_N_PDU_7B_GLIWA_MCPA_TX_FD16, handle-invalid=DONT-INVALIDATE
      data-element=COMRX_N_PDU_7C_GLIWA_MCPB_TX_FD16, handle-invalid=DONT-INVALIDATE
      data-element=COMRX_N_PDU_86_GLIWA_SGCP_TX_FD16, handle-invalid=DONT-INVALIDATE
      data-element=COMRX_CLrDiagInfo_MCPA_P_MCPA_STATUS_FD16, handle-invalid=DONT-INVALIDATE
      data-element=COMRX_CRC_MCPA_STATUS_MCPA_STATUS_FD16, handle-invalid=DONT-INVALIDATE
      data-element=COMRX_MC_MCPA_STATUS_MCPA_STATUS_FD16, handle-invalid=DONT-INVALIDATE
      data-element=COMRX_MCPA_Control_Board_Temperature_P_MCPA_STATUS_FD16, handle-invalid=KEEP
      data-element=COMRX_MCPA_CoolantTemp_P_MCPA_STATUS_FD16, handle-invalid=KEEP
      data-element=COMRX_MCPA_DC_Current_P_MCPA_STATUS_FD16, handle-invalid=DONT-INVALIDATE
      data-element=COMRX_MCPA_DC_Current_V_P_MCPA_STATUS_FD16, handle-invalid=DONT-INVALIDATE
      data-element=COMRX_MCPA_DC_Volt_V_P_MCPA_STATUS_FD16, handle-invalid=DONT-INVALIDATE
      data-element=COMRX_MCPA_DC_Voltage_P_MCPA_STATUS_FD16, handle-invalid=KEEP
      data-element=COMRX_MCPA_DerateReason_P_MCPA_STATUS_FD16, handle-invalid=DONT-INVALIDATE
      data-element=COMRX_MCPA_Inverter_Temp_P_MCPA_STATUS_FD16, handle-invalid=KEEP
      data-element=COMRX_MCPA_PIM_DC_Side_Busbar_Temp_P_MCPA_STATUS_FD16, handle-invalid=KEEP
      data-element=COMRX_MCPA_Rotor_Temperature_P_MCPA_STATUS_FD16, handle-invalid=KEEP
      data-element=COMRX_MCPA_Service_Lamp_Request_P_MCPA_STATUS_FD16, handle-invalid=DONT-INVALIDATE
      data-element=COMRX_CLrDiagInfo_MCPB_P_MCPB_STATUS_FD16, handle-invalid=DONT-INVALIDATE
      data-element=COMRX_CRC_MCPB_STATUS_MCPB_STATUS_FD16, handle-invalid=DONT-INVALIDATE
      data-element=COMRX_MC_MCPB_STATUS_MCPB_STATUS_FD16, handle-invalid=DONT-INVALIDATE
      data-element=COMRX_MCPB_Control_Board_Temperature_P_MCPB_STATUS_FD16, handle-invalid=KEEP
      data-element=COMRX_MCPB_CoolantTemp_P_MCPB_STATUS_FD16, handle-invalid=KEEP
      data-element=COMRX_MCPB_DC_Current_P_MCPB_STATUS_FD16, handle-invalid=DONT-INVALIDATE
      data-element=COMRX_MCPB_DC_Current_V_P_MCPB_STATUS_FD16, handle-invalid=DONT-INVALIDATE
      data-element=COMRX_MCPB_DC_Volt_V_P_MCPB_STATUS_FD16, handle-invalid=DONT-INVALIDATE
      data-element=COMRX_MCPB_DC_Voltage_P_MCPB_STATUS_FD16, handle-invalid=KEEP
      data-element=COMRX_MCPB_DerateReason_P_MCPB_STATUS_FD16, handle-invalid=DONT-INVALIDATE
      data-element=COMRX_MCPB_Inverter_Temp_P_MCPB_STATUS_FD16, handle-invalid=KEEP
      data-element=COMRX_MCPB_PIM_DC_Side_Busbar_Temp_P_MCPB_STATUS_FD16, handle-invalid=KEEP
      data-element=COMRX_MCPB_Rotor_Temperature_P_MCPB_STATUS_FD16, handle-invalid=KEEP
      data-element=COMRX_MCPB_Service_Lamp_Request_P_MCPB_STATUS_FD16, handle-invalid=DONT-INVALIDATE
      data-element=COMRX_CLrDiagInfo_SGCP_P_SGCP_STATUS_FD16, handle-invalid=DONT-INVALIDATE
      data-element=COMRX_CRC_SGCP_STATUS_SGCP_STATUS_FD16, handle-invalid=DONT-INVALIDATE
      data-element=COMRX_MC_SGCP_STATUS_SGCP_STATUS_FD16, handle-invalid=DONT-INVALIDATE
      data-element=COMRX_SGCP_Control_Board_Temperature_P_SGCP_STATUS_FD16, handle-invalid=KEEP
      data-element=COMRX_SGCP_CoolantTemp_P_SGCP_STATUS_FD16, handle-invalid=KEEP
      data-element=COMRX_SGCP_DC_Current_P_SGCP_STATUS_FD16, handle-invalid=DONT-INVALIDATE
      data-element=COMRX_SGCP_DC_Current_V_P_SGCP_STATUS_FD16, handle-invalid=DONT-INVALIDATE
      data-element=COMRX_SGCP_DC_Volt_V_P_SGCP_STATUS_FD16, handle-invalid=DONT-INVALIDATE
      data-element=COMRX_SGCP_DC_Voltage_P_SGCP_STATUS_FD16, handle-invalid=KEEP
      data-element=COMRX_SGCP_DerateReason_P_SGCP_STATUS_FD16, handle-invalid=DONT-INVALIDATE
      data-element=COMRX_SGCP_Inverter_Temp_P_SGCP_STATUS_FD16, handle-invalid=KEEP
      data-element=COMRX_SGCP_PIM_AC_Side_Busbar_Temp_P_SGCP_STATUS_FD16, handle-invalid=KEEP
      data-element=COMRX_SGCP_PIM_DC_Side_Busbar_Temp_P_SGCP_STATUS_FD16, handle-invalid=KEEP
      data-element=COMRX_SGCP_Rotor_Temperature_P_SGCP_STATUS_FD16, handle-invalid=KEEP
      data-element=COMRX_SGCP_Service_Lamp_Request_P_SGCP_STATUS_FD16, handle-invalid=DONT-INVALIDATE
  sender receiver interface CanCom_FD16TxSignalsSR
    38 x data, all with category=TYPE_REFERENCE, sw-calibration-access=READ-ONLY:
      COMTX_CmdIgnSts_BCM_FD_10_FD16: type=IDTSCmdIgnSts_BCM_FD_10_FD16, init-value=COMTX_CmdIgnSts_BCM_FD_10_FD16Value:0  # Raw signal data to be transmitted over the CAN bus for the Signal CmdIgnSts
      COMTX_CRC_BCM10_BCM_FD_10_FD16: type=IDTSCRC_BCM10_BCM_FD_10_FD16, init-value=COMTX_CRC_BCM10_BCM_FD_10_FD16Value:0  # Raw signal data to be transmitted over the CAN bus for the Signal CRC_BCM10
      COMTX_MessageCounter_BCM10_BCM_FD_10_FD16: type=IDTSMessageCounter_BCM10_BCM_FD_10_FD16, init-value=COMTX_MessageCounter_BCM10_BCM_FD_10_FD16Value:0  # Raw signal data to be transmitted over the CAN bus for the Signal MessageCounter_BCM10
      COMTX_OperationalModeSts_BCM_FD_2_FD16: type=IDTSOperationalModeSts_BCM_FD_2_FD16, init-value=COMTX_OperationalModeSts_BCM_FD_2_FD16Value:0  # Raw signal data to be transmitted over the CAN bus for the Signal OperationalModeSts
      COMTX_ExternalTemperature_BCM_FD_9_FD16: type=IDTSExternalTemperature_BCM_FD_9_FD16, init-value=COMTX_ExternalTemperature_BCM_FD_9_FD16Value:0  # Raw signal data to be transmitted over the CAN bus for the Signal ExternalTemperature
      COMTX_EPBSts_BRAKE_FD_4_FD16: type=IDTSEPBSts_BRAKE_FD_4_FD16, init-value=COMTX_EPBSts_BRAKE_FD_4_FD16Value:0  # Raw signal data to be transmitted over the CAN bus for the Signal EPBSts
      COMTX_ABSFailSts_BRAKE_FD_5_FD16: type=IDTSABSFailSts_BRAKE_FD_5_FD16, init-value=COMTX_ABSFailSts_BRAKE_FD_5_FD16Value:0  # Raw signal data to be transmitted over the CAN bus for the Signal ABSFailSts
      COMTX_ESCFailSts_BRAKE_FD_5_FD16: type=IDTSESCFailSts_BRAKE_FD_5_FD16, init-value=COMTX_ESCFailSts_BRAKE_FD_5_FD16Value:0  # Raw signal data to be transmitted over the CAN bus for the Signal ESCFailSts
      COMTX_N_PDU_7E_GLIWA_MCPA_RX_FD16: type=IDTSN_PDU_7E_GLIWA_MCPA_RX_FD16, init-value=COMTX_N_PDU_7E_GLIWA_MCPA_RX_FD16Value:0  # Raw signal data to be transmitted over the CAN bus for the Signal N_PDU_7E
      COMTX_N_PDU_7F_GLIWA_MCPB_RX_FD16: type=IDTSN_PDU_7F_GLIWA_MCPB_RX_FD16, init-value=COMTX_N_PDU_7F_GLIWA_MCPB_RX_FD16Value:0  # Raw signal data to be transmitted over the CAN bus for the Signal N_PDU_7F
      COMTX_N_PDU_81_GLIWA_SGCP_RX_FD16: type=IDTSN_PDU_81_GLIWA_SGCP_RX_FD16, init-value=COMTX_N_PDU_81_GLIWA_SGCP_RX_FD16Value:0  # Raw signal data to be transmitted over the CAN bus for the Signal N_PDU_81
      COMTX_PerWakeUp_Diag_HYBRID_SYSTEM_EPT1_FD16: type=IDTSPerWakeUp_Diag_HYBRID_SYSTEM_EPT1_FD16, init-value=COMTX_PerWakeUp_Diag_HYBRID_SYSTEM_EPT1_FD16Value:0  # Raw signal data to be transmitted over the CAN bus for the Signal PerWakeUp_Diag
      COMTX_WU_Timer_Value_HYBRID_SYSTEM_EPT1_FD16: type=IDTSWU_Timer_Value_HYBRID_SYSTEM_EPT1_FD16, init-value=COMTX_WU_Timer_Value_HYBRID_SYSTEM_EPT1_FD16Value:0  # Raw signal data to be transmitted over the CAN bus for the Signal WU_Timer_Value
      COMTX_CRC_HYBRID_THERMAL_COMMAND_HYBRID_THERMAL_COMMAND_FD16: type=IDTSCRC_HYBRID_THERMAL_COMMAND_HYBRID_THERMAL_COMMAND_FD16, init-value=COMTX_CRC_HYBRID_THERMAL_COMMAND_HYBRID_THERMAL_COMMAND_FD16Value:0  # Raw signal data to be transmitted over the CAN bus for the Signal CRC_HYBRID_THERMAL_COMMAND
      COMTX_EOPA_OIL_FlwRate_HYBRID_THERMAL_COMMAND_FD16: type=IDTSEOPA_OIL_FlwRate_HYBRID_THERMAL_COMMAND_FD16, init-value=COMTX_EOPA_OIL_FlwRate_HYBRID_THERMAL_COMMAND_FD16Value:0  # Raw signal data to be transmitted over the CAN bus for the Signal EOPA_OIL_FlwRate
      COMTX_EOPA_OIL_TEMP_HYBRID_THERMAL_COMMAND_FD16: type=IDTSEOPA_OIL_TEMP_HYBRID_THERMAL_COMMAND_FD16, init-value=COMTX_EOPA_OIL_TEMP_HYBRID_THERMAL_COMMAND_FD16Value:0  # Raw signal data to be transmitted over the CAN bus for the Signal EOPA_OIL_TEMP
      COMTX_EOPB_OIL_FlwRate_HYBRID_THERMAL_COMMAND_FD16: type=IDTSEOPB_OIL_FlwRate_HYBRID_THERMAL_COMMAND_FD16, init-value=COMTX_EOPB_OIL_FlwRate_HYBRID_THERMAL_COMMAND_FD16Value:0  # Raw signal data to be transmitted over the CAN bus for the Signal EOPB_OIL_FlwRate
      COMTX_EOPB_OIL_TEMP_HYBRID_THERMAL_COMMAND_FD16: type=IDTSEOPB_OIL_TEMP_HYBRID_THERMAL_COMMAND_FD16, init-value=COMTX_EOPB_OIL_TEMP_HYBRID_THERMAL_COMMAND_FD16Value:0  # Raw signal data to be transmitted over the CAN bus for the Signal EOPB_OIL_TEMP
      COMTX_MessageCounter_HYBRID_THERMAL_COMMAND_HYBRID_THERMAL_COMMAND_FD16: type=IDTSMessageCounter_HYBRID_THERMAL_COMMAND_HYBRID_THERMAL_COMMAND_FD16, init-value=COMTX_MessageCounter_HYBRID_THERMAL_COMMAND_HYBRID_THERMAL_COMMAND_FD16Value:0  # Raw signal data to be transmitted over the CAN bus for the Signal MessageCounter_HYBRID_THERMAL_COMMAND
      COMTX_SGCP_OIL_FlwRate_HYBRID_THERMAL_COMMAND_FD16: type=IDTSSGCP_OIL_FlwRate_HYBRID_THERMAL_COMMAND_FD16, init-value=COMTX_SGCP_OIL_FlwRate_HYBRID_THERMAL_COMMAND_FD16Value:0  # Raw signal data to be transmitted over the CAN bus for the Signal SGCP_OIL_FlwRate
      COMTX_SGCP_OIL_TEMP_HYBRID_THERMAL_COMMAND_FD16: type=IDTSSGCP_OIL_TEMP_HYBRID_THERMAL_COMMAND_FD16, init-value=COMTX_SGCP_OIL_TEMP_HYBRID_THERMAL_COMMAND_FD16Value:0  # Raw signal data to be transmitted over the CAN bus for the Signal SGCP_OIL_TEMP
      COMTX_IMPACTCommand_IMPACT_INFO_FD16: type=IDTSIMPACTCommand_IMPACT_INFO_FD16, init-value=COMTX_IMPACTCommand_IMPACT_INFO_FD16Value:0  # Raw signal data to be transmitted over the CAN bus for the Signal IMPACTCommand
      COMTX_IMPACTConfirm_IMPACT_INFO_FD16: type=IDTSIMPACTConfirm_IMPACT_INFO_FD16, init-value=COMTX_IMPACTConfirm_IMPACT_INFO_FD16Value:1  # Raw signal data to be transmitted over the CAN bus for the Signal IMPACTConfirm
      COMTX_TotalOdometer_IPC_FD_1_FD16: type=IDTSTotalOdometer_IPC_FD_1_FD16, init-value=COMTX_TotalOdometer_IPC_FD_1_FD16Value:0  # Raw signal data to be transmitted over the CAN bus for the Signal TotalOdometer
      COMTX_Real_Time_Clock_REAL_TIME_CLOCK_FD16: type=IDTSReal_Time_Clock_REAL_TIME_CLOCK_FD16, init-value=COMTX_Real_Time_Clock_REAL_TIME_CLOCK_FD16Value:0  # Raw signal data to be transmitted over the CAN bus for the Signal Real_Time_Clock
      COMTX_Real_Time_Validity_REAL_TIME_CLOCK_FD16: type=IDTSReal_Time_Validity_REAL_TIME_CLOCK_FD16, init-value=COMTX_Real_Time_Validity_REAL_TIME_CLOCK_FD16Value:0  # Raw signal data to be transmitted over the CAN bus for the Signal Real_Time_Validity
      COMTX_GPS_Date_Day_TELEMATIC_FD_1_FD16: type=IDTSGPS_Date_Day_TELEMATIC_FD_1_FD16, init-value=COMTX_GPS_Date_Day_TELEMATIC_FD_1_FD16Value:255  # Raw signal data to be transmitted over the CAN bus for the Signal GPS_Date_Day
      COMTX_GPS_Date_Month_TELEMATIC_FD_1_FD16: type=IDTSGPS_Date_Month_TELEMATIC_FD_1_FD16, init-value=COMTX_GPS_Date_Month_TELEMATIC_FD_1_FD16Value:255  # Raw signal data to be transmitted over the CAN bus for the Signal GPS_Date_Month
      COMTX_GPS_Date_Year_TELEMATIC_FD_1_FD16: type=IDTSGPS_Date_Year_TELEMATIC_FD_1_FD16, init-value=COMTX_GPS_Date_Year_TELEMATIC_FD_1_FD16Value:65535  # Raw signal data to be transmitted over the CAN bus for the Signal GPS_Date_Year
      COMTX_GPS_UTC_Hour_TELEMATIC_FD_1_FD16: type=IDTSGPS_UTC_Hour_TELEMATIC_FD_1_FD16, init-value=COMTX_GPS_UTC_Hour_TELEMATIC_FD_1_FD16Value:255  # Raw signal data to be transmitted over the CAN bus for the Signal GPS_UTC_Hour
      COMTX_GPS_UTC_Minute_TELEMATIC_FD_1_FD16: type=IDTSGPS_UTC_Minute_TELEMATIC_FD_1_FD16, init-value=COMTX_GPS_UTC_Minute_TELEMATIC_FD_1_FD16Value:255  # Raw signal data to be transmitted over the CAN bus for the Signal GPS_UTC_Minute
      COMTX_GPS_UTC_Second_TELEMATIC_FD_1_FD16: type=IDTSGPS_UTC_Second_TELEMATIC_FD_1_FD16, init-value=COMTX_GPS_UTC_Second_TELEMATIC_FD_1_FD16Value:65535  # Raw signal data to be transmitted over the CAN bus for the Signal GPS_UTC_Second
      COMTX_T4_Sensor_Temp_VDCM_PWT3_FD16: type=IDTST4_Sensor_Temp_VDCM_PWT3_FD16, init-value=COMTX_T4_Sensor_Temp_VDCM_PWT3_FD16Value:0  # Raw signal data to be transmitted over the CAN bus for the Signal T4_Sensor_Temp
      COMTX_T7_CoolantTempVldty_VDCM_PWT3_FD16: type=IDTST7_CoolantTempVldty_VDCM_PWT3_FD16, init-value=COMTX_T7_CoolantTempVldty_VDCM_PWT3_FD16Value:0  # Raw signal data to be transmitted over the CAN bus for the Signal T7_CoolantTempVldty
      COMTX_T7_Sensor_Temp_VDCM_PWT3_FD16: type=IDTST7_Sensor_Temp_VDCM_PWT3_FD16, init-value=COMTX_T7_Sensor_Temp_VDCM_PWT3_FD16Value:0  # Raw signal data to be transmitted over the CAN bus for the Signal T7_Sensor_Temp
      COMTX_RELSD_TgtTrq_VEHDYN_FD_1_FD16: type=IDTSRELSD_TgtTrq_VEHDYN_FD_1_FD16, init-value=COMTX_RELSD_TgtTrq_VEHDYN_FD_1_FD16Value:0  # Raw signal data to be transmitted over the CAN bus for the Signal RELSD_TgtTrq
      COMTX_VIN_DATA_VIN_FD16: type=IDTSVIN_DATA_VIN_FD16, init-value=COMTX_VIN_DATA_VIN_FD16Value:0  # Raw signal data to be transmitted over the CAN bus for the Signal VIN_DATA
      COMTX_VIN_MSG_VIN_FD16: type=IDTSVIN_MSG_VIN_FD16, init-value=COMTX_VIN_MSG_VIN_FD16Value:3  # Raw signal data to be transmitted over the CAN bus for the Signal VIN_MSG
    invalidation-policys:
      data-element=COMTX_CmdIgnSts_BCM_FD_10_FD16, handle-invalid=KEEP
      data-element=COMTX_CRC_BCM10_BCM_FD_10_FD16, handle-invalid=DONT-INVALIDATE
      data-element=COMTX_MessageCounter_BCM10_BCM_FD_10_FD16, handle-invalid=DONT-INVALIDATE
      data-element=COMTX_OperationalModeSts_BCM_FD_2_FD16, handle-invalid=KEEP
      data-element=COMTX_ExternalTemperature_BCM_FD_9_FD16, handle-invalid=KEEP
      data-element=COMTX_EPBSts_BRAKE_FD_4_FD16, handle-invalid=KEEP
      data-element=COMTX_ABSFailSts_BRAKE_FD_5_FD16, handle-invalid=DONT-INVALIDATE
      data-element=COMTX_ESCFailSts_BRAKE_FD_5_FD16, handle-invalid=DONT-INVALIDATE
      data-element=COMTX_N_PDU_7E_GLIWA_MCPA_RX_FD16, handle-invalid=DONT-INVALIDATE
      data-element=COMTX_N_PDU_7F_GLIWA_MCPB_RX_FD16, handle-invalid=DONT-INVALIDATE
      data-element=COMTX_N_PDU_81_GLIWA_SGCP_RX_FD16, handle-invalid=DONT-INVALIDATE
      data-element=COMTX_PerWakeUp_Diag_HYBRID_SYSTEM_EPT1_FD16, handle-invalid=DONT-INVALIDATE
      data-element=COMTX_WU_Timer_Value_HYBRID_SYSTEM_EPT1_FD16, handle-invalid=DONT-INVALIDATE
      data-element=COMTX_CRC_HYBRID_THERMAL_COMMAND_HYBRID_THERMAL_COMMAND_FD16, handle-invalid=DONT-INVALIDATE
      data-element=COMTX_EOPA_OIL_FlwRate_HYBRID_THERMAL_COMMAND_FD16, handle-invalid=KEEP
      data-element=COMTX_EOPA_OIL_TEMP_HYBRID_THERMAL_COMMAND_FD16, handle-invalid=KEEP
      data-element=COMTX_EOPB_OIL_FlwRate_HYBRID_THERMAL_COMMAND_FD16, handle-invalid=KEEP
      data-element=COMTX_EOPB_OIL_TEMP_HYBRID_THERMAL_COMMAND_FD16, handle-invalid=KEEP
      data-element=COMTX_MessageCounter_HYBRID_THERMAL_COMMAND_HYBRID_THERMAL_COMMAND_FD16, handle-invalid=DONT-INVALIDATE
      data-element=COMTX_SGCP_OIL_FlwRate_HYBRID_THERMAL_COMMAND_FD16, handle-invalid=KEEP
      data-element=COMTX_SGCP_OIL_TEMP_HYBRID_THERMAL_COMMAND_FD16, handle-invalid=KEEP
      data-element=COMTX_IMPACTCommand_IMPACT_INFO_FD16, handle-invalid=DONT-INVALIDATE
      data-element=COMTX_IMPACTConfirm_IMPACT_INFO_FD16, handle-invalid=DONT-INVALIDATE
      data-element=COMTX_TotalOdometer_IPC_FD_1_FD16, handle-invalid=DONT-INVALIDATE
      data-element=COMTX_Real_Time_Clock_REAL_TIME_CLOCK_FD16, handle-invalid=KEEP
      data-element=COMTX_Real_Time_Validity_REAL_TIME_CLOCK_FD16, handle-invalid=DONT-INVALIDATE
      data-element=COMTX_GPS_Date_Day_TELEMATIC_FD_1_FD16, handle-invalid=KEEP
      data-element=COMTX_GPS_Date_Month_TELEMATIC_FD_1_FD16, handle-invalid=KEEP
      data-element=COMTX_GPS_Date_Year_TELEMATIC_FD_1_FD16, handle-invalid=KEEP
      data-element=COMTX_GPS_UTC_Hour_TELEMATIC_FD_1_FD16, handle-invalid=KEEP
      data-element=COMTX_GPS_UTC_Minute_TELEMATIC_FD_1_FD16, handle-invalid=KEEP
      data-element=COMTX_GPS_UTC_Second_TELEMATIC_FD_1_FD16, handle-invalid=KEEP
      data-element=COMTX_T4_Sensor_Temp_VDCM_PWT3_FD16, handle-invalid=DONT-INVALIDATE
      data-element=COMTX_T7_CoolantTempVldty_VDCM_PWT3_FD16, handle-invalid=DONT-INVALIDATE
      data-element=COMTX_T7_Sensor_Temp_VDCM_PWT3_FD16, handle-invalid=DONT-INVALIDATE
      data-element=COMTX_RELSD_TgtTrq_VEHDYN_FD_1_FD16, handle-invalid=KEEP
      data-element=COMTX_VIN_DATA_VIN_FD16, handle-invalid=DONT-INVALIDATE
      data-element=COMTX_VIN_MSG_VIN_FD16, handle-invalid=KEEP
