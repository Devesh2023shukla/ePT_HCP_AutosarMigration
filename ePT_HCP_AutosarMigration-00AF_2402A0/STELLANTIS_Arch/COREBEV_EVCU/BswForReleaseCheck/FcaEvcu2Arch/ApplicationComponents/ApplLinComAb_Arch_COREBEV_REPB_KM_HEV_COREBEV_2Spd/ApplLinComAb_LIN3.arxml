[part 3 of 3: packages /STLASWCs to /STLASWCs/ComSwCpts/ComPrivateInterfaces]
AUTOSAR XML (schema 4-3-0)
package /STLASWCs  (continued)
  complex device driver sw component type ApplLinComAb_LIN3  (continued)
    behavior IBApplLinComAb_LIN3: data-type-mapping=[MG_LinEquid_Mapping, ADTtoIDTMapping, BswMMappingSet], handle-termination-and-restart=NO-SUPPORT  (continued)
      334 x runnable:  (continued)
        COMRXL_PECP2_LMP_HM_AN_ON_PECP2_STAT_GLOBAL_Lin3_Error: symbol=ApplLinComAb_LIN3_COMRXL_PECP2_LMP_HM_AN_ON_PECP2_STAT_GLOBAL_Lin3_Error  # Error -
          data-receive-point-by-arguments:
            access DRP_Lin3ComRxSignalsSR_COMRXL_PECP2_LMP_HM_AN_ON_PECP2_STAT_GLOBAL_Lin3: accessed-variable=Lin3ComRxSignalsSR.COMRXL_PECP2_LMP_HM_AN_ON_PECP2_STAT_GLOBAL_Lin3
          data-send-points:
            access DSP_VeLINR_e_PECP2_LMP_HM_AN_ON_VeLINR_e_PECP2_LMP_HM_AN_ON: accessed-variable=VeLINR_e_PECP2_LMP_HM_AN_ON.VeLINR_e_PECP2_LMP_HM_AN_ON
            access DSP_VeLINR_b_PECP2_LMP_HM_AN_ON_TO_VeLINR_b_PECP2_LMP_HM_AN_ON_TO: accessed-variable=VeLINR_b_PECP2_LMP_HM_AN_ON_TO.VeLINR_b_PECP2_LMP_HM_AN_ON_TO
          read-local-variables:
            access IRVRA_VeLINR_d_LIN_SlavePrsnt_LIN3: accessed-variable=VeLINR_d_LIN_SlavePrsnt_LIN3
        COMRXL_PECP2_AIR_PRE_ERR_PECP2_STAT_GLOBAL_Lin3_Received: symbol=ApplLinComAb_LIN3_COMRXL_PECP2_AIR_PRE_ERR_PECP2_STAT_GLOBAL_Lin3_Received  # Received -
          data-receive-point-by-arguments:
            access DRP_Lin3ComRxSignalsSR_COMRXL_PECP2_AIR_PRE_ERR_PECP2_STAT_GLOBAL_Lin3: accessed-variable=Lin3ComRxSignalsSR.COMRXL_PECP2_AIR_PRE_ERR_PECP2_STAT_GLOBAL_Lin3
          data-send-points:
            access DSP_VeLINR_e_PECP2_AIR_PRE_ERR_VeLINR_e_PECP2_AIR_PRE_ERR: accessed-variable=VeLINR_e_PECP2_AIR_PRE_ERR.VeLINR_e_PECP2_AIR_PRE_ERR
            access DSP_VeLINR_b_PECP2_AIR_PRE_ERR_TO_VeLINR_b_PECP2_AIR_PRE_ERR_TO: accessed-variable=VeLINR_b_PECP2_AIR_PRE_ERR_TO.VeLINR_b_PECP2_AIR_PRE_ERR_TO
        COMRXL_PECP2_AIR_PRE_ERR_PECP2_STAT_GLOBAL_Lin3_Error: symbol=ApplLinComAb_LIN3_COMRXL_PECP2_AIR_PRE_ERR_PECP2_STAT_GLOBAL_Lin3_Error  # Error -
          data-receive-point-by-arguments:
            access DRP_Lin3ComRxSignalsSR_COMRXL_PECP2_AIR_PRE_ERR_PECP2_STAT_GLOBAL_Lin3: accessed-variable=Lin3ComRxSignalsSR.COMRXL_PECP2_AIR_PRE_ERR_PECP2_STAT_GLOBAL_Lin3
          data-send-points:
            access DSP_VeLINR_e_PECP2_AIR_PRE_ERR_VeLINR_e_PECP2_AIR_PRE_ERR: accessed-variable=VeLINR_e_PECP2_AIR_PRE_ERR.VeLINR_e_PECP2_AIR_PRE_ERR
            access DSP_VeLINR_b_PECP2_AIR_PRE_ERR_TO_VeLINR_b_PECP2_AIR_PRE_ERR_TO: accessed-variable=VeLINR_b_PECP2_AIR_PRE_ERR_TO.VeLINR_b_PECP2_AIR_PRE_ERR_TO
          read-local-variables:
            access IRVRA_VeLINR_d_LIN_SlavePrsnt_LIN3: accessed-variable=VeLINR_d_LIN_SlavePrsnt_LIN3
        COMRXL_PECP2_OVR_TMP_ERR_PECP2_STAT_GLOBAL_Lin3_Received: symbol=ApplLinComAb_LIN3_COMRXL_PECP2_OVR_TMP_ERR_PECP2_STAT_GLOBAL_Lin3_Received  # Received -
          data-receive-point-by-arguments:
            access DRP_Lin3ComRxSignalsSR_COMRXL_PECP2_OVR_TMP_ERR_PECP2_STAT_GLOBAL_Lin3: accessed-variable=Lin3ComRxSignalsSR.COMRXL_PECP2_OVR_TMP_ERR_PECP2_STAT_GLOBAL_Lin3
          data-send-points:
            access DSP_VeLINR_e_PECP2_OVR_TMP_ERR_VeLINR_e_PECP2_OVR_TMP_ERR: accessed-variable=VeLINR_e_PECP2_OVR_TMP_ERR.VeLINR_e_PECP2_OVR_TMP_ERR
            access DSP_VeLINR_b_PECP2_OVR_TMP_ERR_TO_VeLINR_b_PECP2_OVR_TMP_ERR_TO: accessed-variable=VeLINR_b_PECP2_OVR_TMP_ERR_TO.VeLINR_b_PECP2_OVR_TMP_ERR_TO
        COMRXL_PECP2_OVR_TMP_ERR_PECP2_STAT_GLOBAL_Lin3_Error: symbol=ApplLinComAb_LIN3_COMRXL_PECP2_OVR_TMP_ERR_PECP2_STAT_GLOBAL_Lin3_Error  # Error -
          data-receive-point-by-arguments:
            access DRP_Lin3ComRxSignalsSR_COMRXL_PECP2_OVR_TMP_ERR_PECP2_STAT_GLOBAL_Lin3: accessed-variable=Lin3ComRxSignalsSR.COMRXL_PECP2_OVR_TMP_ERR_PECP2_STAT_GLOBAL_Lin3
          data-send-points:
            access DSP_VeLINR_e_PECP2_OVR_TMP_ERR_VeLINR_e_PECP2_OVR_TMP_ERR: accessed-variable=VeLINR_e_PECP2_OVR_TMP_ERR.VeLINR_e_PECP2_OVR_TMP_ERR
            access DSP_VeLINR_b_PECP2_OVR_TMP_ERR_TO_VeLINR_b_PECP2_OVR_TMP_ERR_TO: accessed-variable=VeLINR_b_PECP2_OVR_TMP_ERR_TO.VeLINR_b_PECP2_OVR_TMP_ERR_TO
          read-local-variables:
            access IRVRA_VeLINR_d_LIN_SlavePrsnt_LIN3: accessed-variable=VeLINR_d_LIN_SlavePrsnt_LIN3
        COMRXL_PECP2_OVR_CUR_ERR_PECP2_STAT_GLOBAL_Lin3_Received: symbol=ApplLinComAb_LIN3_COMRXL_PECP2_OVR_CUR_ERR_PECP2_STAT_GLOBAL_Lin3_Received  # Received -
          data-receive-point-by-arguments:
            access DRP_Lin3ComRxSignalsSR_COMRXL_PECP2_OVR_CUR_ERR_PECP2_STAT_GLOBAL_Lin3: accessed-variable=Lin3ComRxSignalsSR.COMRXL_PECP2_OVR_CUR_ERR_PECP2_STAT_GLOBAL_Lin3
          data-send-points:
            access DSP_VeLINR_e_PECP2_OVR_CUR_ERR_VeLINR_e_PECP2_OVR_CUR_ERR: accessed-variable=VeLINR_e_PECP2_OVR_CUR_ERR.VeLINR_e_PECP2_OVR_CUR_ERR
            access DSP_VeLINR_b_PECP2_OVR_CUR_ERR_TO_VeLINR_b_PECP2_OVR_CUR_ERR_TO: accessed-variable=VeLINR_b_PECP2_OVR_CUR_ERR_TO.VeLINR_b_PECP2_OVR_CUR_ERR_TO
        COMRXL_PECP2_OVR_CUR_ERR_PECP2_STAT_GLOBAL_Lin3_Error: symbol=ApplLinComAb_LIN3_COMRXL_PECP2_OVR_CUR_ERR_PECP2_STAT_GLOBAL_Lin3_Error  # Error -
          data-receive-point-by-arguments:
            access DRP_Lin3ComRxSignalsSR_COMRXL_PECP2_OVR_CUR_ERR_PECP2_STAT_GLOBAL_Lin3: accessed-variable=Lin3ComRxSignalsSR.COMRXL_PECP2_OVR_CUR_ERR_PECP2_STAT_GLOBAL_Lin3
          data-send-points:
            access DSP_VeLINR_e_PECP2_OVR_CUR_ERR_VeLINR_e_PECP2_OVR_CUR_ERR: accessed-variable=VeLINR_e_PECP2_OVR_CUR_ERR.VeLINR_e_PECP2_OVR_CUR_ERR
            access DSP_VeLINR_b_PECP2_OVR_CUR_ERR_TO_VeLINR_b_PECP2_OVR_CUR_ERR_TO: accessed-variable=VeLINR_b_PECP2_OVR_CUR_ERR_TO.VeLINR_b_PECP2_OVR_CUR_ERR_TO
          read-local-variables:
            access IRVRA_VeLINR_d_LIN_SlavePrsnt_LIN3: accessed-variable=VeLINR_d_LIN_SlavePrsnt_LIN3
        COMRXL_PECP2_DR_RN_ERR_PECP2_STAT_GLOBAL_Lin3_Received: symbol=ApplLinComAb_LIN3_COMRXL_PECP2_DR_RN_ERR_PECP2_STAT_GLOBAL_Lin3_Received  # Received -
          data-receive-point-by-arguments:
            access DRP_Lin3ComRxSignalsSR_COMRXL_PECP2_DR_RN_ERR_PECP2_STAT_GLOBAL_Lin3: accessed-variable=Lin3ComRxSignalsSR.COMRXL_PECP2_DR_RN_ERR_PECP2_STAT_GLOBAL_Lin3
          data-send-points:
            access DSP_VeLINR_e_PECP2_DR_RN_ERR_VeLINR_e_PECP2_DR_RN_ERR: accessed-variable=VeLINR_e_PECP2_DR_RN_ERR.VeLINR_e_PECP2_DR_RN_ERR
            access DSP_VeLINR_b_PECP2_DR_RN_ERR_TO_VeLINR_b_PECP2_DR_RN_ERR_TO: accessed-variable=VeLINR_b_PECP2_DR_RN_ERR_TO.VeLINR_b_PECP2_DR_RN_ERR_TO
        COMRXL_PECP2_DR_RN_ERR_PECP2_STAT_GLOBAL_Lin3_Error: symbol=ApplLinComAb_LIN3_COMRXL_PECP2_DR_RN_ERR_PECP2_STAT_GLOBAL_Lin3_Error  # Error -
          data-receive-point-by-arguments:
            access DRP_Lin3ComRxSignalsSR_COMRXL_PECP2_DR_RN_ERR_PECP2_STAT_GLOBAL_Lin3: accessed-variable=Lin3ComRxSignalsSR.COMRXL_PECP2_DR_RN_ERR_PECP2_STAT_GLOBAL_Lin3
          data-send-points:
            access DSP_VeLINR_e_PECP2_DR_RN_ERR_VeLINR_e_PECP2_DR_RN_ERR: accessed-variable=VeLINR_e_PECP2_DR_RN_ERR.VeLINR_e_PECP2_DR_RN_ERR
            access DSP_VeLINR_b_PECP2_DR_RN_ERR_TO_VeLINR_b_PECP2_DR_RN_ERR_TO: accessed-variable=VeLINR_b_PECP2_DR_RN_ERR_TO.VeLINR_b_PECP2_DR_RN_ERR_TO
          read-local-variables:
            access IRVRA_VeLINR_d_LIN_SlavePrsnt_LIN3: accessed-variable=VeLINR_d_LIN_SlavePrsnt_LIN3
        COMRXL_PECP2_VLTG_ERR_PECP2_STAT_GLOBAL_Lin3_Received: symbol=ApplLinComAb_LIN3_COMRXL_PECP2_VLTG_ERR_PECP2_STAT_GLOBAL_Lin3_Received  # Received -
          data-receive-point-by-arguments:
            access DRP_Lin3ComRxSignalsSR_COMRXL_PECP2_VLTG_ERR_PECP2_STAT_GLOBAL_Lin3: accessed-variable=Lin3ComRxSignalsSR.COMRXL_PECP2_VLTG_ERR_PECP2_STAT_GLOBAL_Lin3
          data-send-points:
            access DSP_VeLINR_e_PECP2_VLTG_ERR_VeLINR_e_PECP2_VLTG_ERR: accessed-variable=VeLINR_e_PECP2_VLTG_ERR.VeLINR_e_PECP2_VLTG_ERR
            access DSP_VeLINR_b_PECP2_VLTG_ERR_TO_VeLINR_b_PECP2_VLTG_ERR_TO: accessed-variable=VeLINR_b_PECP2_VLTG_ERR_TO.VeLINR_b_PECP2_VLTG_ERR_TO
        COMRXL_PECP2_VLTG_ERR_PECP2_STAT_GLOBAL_Lin3_Error: symbol=ApplLinComAb_LIN3_COMRXL_PECP2_VLTG_ERR_PECP2_STAT_GLOBAL_Lin3_Error  # Error -
          data-receive-point-by-arguments:
            access DRP_Lin3ComRxSignalsSR_COMRXL_PECP2_VLTG_ERR_PECP2_STAT_GLOBAL_Lin3: accessed-variable=Lin3ComRxSignalsSR.COMRXL_PECP2_VLTG_ERR_PECP2_STAT_GLOBAL_Lin3
          data-send-points:
            access DSP_VeLINR_e_PECP2_VLTG_ERR_VeLINR_e_PECP2_VLTG_ERR: accessed-variable=VeLINR_e_PECP2_VLTG_ERR.VeLINR_e_PECP2_VLTG_ERR
            access DSP_VeLINR_b_PECP2_VLTG_ERR_TO_VeLINR_b_PECP2_VLTG_ERR_TO: accessed-variable=VeLINR_b_PECP2_VLTG_ERR_TO.VeLINR_b_PECP2_VLTG_ERR_TO
          read-local-variables:
            access IRVRA_VeLINR_d_LIN_SlavePrsnt_LIN3: accessed-variable=VeLINR_d_LIN_SlavePrsnt_LIN3
        COMRXL_PECP2_DBLK_ACTV_PECP2_STAT_GLOBAL_Lin3_Received: symbol=ApplLinComAb_LIN3_COMRXL_PECP2_DBLK_ACTV_PECP2_STAT_GLOBAL_Lin3_Received  # Received -
          data-receive-point-by-arguments:
            access DRP_Lin3ComRxSignalsSR_COMRXL_PECP2_DBLK_ACTV_PECP2_STAT_GLOBAL_Lin3: accessed-variable=Lin3ComRxSignalsSR.COMRXL_PECP2_DBLK_ACTV_PECP2_STAT_GLOBAL_Lin3
          data-send-points:
            access DSP_VeLINR_e_PECP2_DBLK_ACTV_VeLINR_e_PECP2_DBLK_ACTV: accessed-variable=VeLINR_e_PECP2_DBLK_ACTV.VeLINR_e_PECP2_DBLK_ACTV
            access DSP_VeLINR_b_PECP2_DBLK_ACTV_TO_VeLINR_b_PECP2_DBLK_ACTV_TO: accessed-variable=VeLINR_b_PECP2_DBLK_ACTV_TO.VeLINR_b_PECP2_DBLK_ACTV_TO
        COMRXL_PECP2_DBLK_ACTV_PECP2_STAT_GLOBAL_Lin3_Error: symbol=ApplLinComAb_LIN3_COMRXL_PECP2_DBLK_ACTV_PECP2_STAT_GLOBAL_Lin3_Error  # Error -
          data-receive-point-by-arguments:
            access DRP_Lin3ComRxSignalsSR_COMRXL_PECP2_DBLK_ACTV_PECP2_STAT_GLOBAL_Lin3: accessed-variable=Lin3ComRxSignalsSR.COMRXL_PECP2_DBLK_ACTV_PECP2_STAT_GLOBAL_Lin3
          data-send-points:
            access DSP_VeLINR_e_PECP2_DBLK_ACTV_VeLINR_e_PECP2_DBLK_ACTV: accessed-variable=VeLINR_e_PECP2_DBLK_ACTV.VeLINR_e_PECP2_DBLK_ACTV
            access DSP_VeLINR_b_PECP2_DBLK_ACTV_TO_VeLINR_b_PECP2_DBLK_ACTV_TO: accessed-variable=VeLINR_b_PECP2_DBLK_ACTV_TO.VeLINR_b_PECP2_DBLK_ACTV_TO
          read-local-variables:
            access IRVRA_VeLINR_d_LIN_SlavePrsnt_LIN3: accessed-variable=VeLINR_d_LIN_SlavePrsnt_LIN3
        COMRXL_PECP2_MONTRNG_RPM_PECP2_STAT_GLOBAL_Lin3_Received: symbol=ApplLinComAb_LIN3_COMRXL_PECP2_MONTRNG_RPM_PECP2_STAT_GLOBAL_Lin3_Received  # Received -
          data-receive-point-by-arguments:
            access DRP_Lin3ComRxSignalsSR_COMRXL_PECP2_MONTRNG_RPM_PECP2_STAT_GLOBAL_Lin3: accessed-variable=Lin3ComRxSignalsSR.COMRXL_PECP2_MONTRNG_RPM_PECP2_STAT_GLOBAL_Lin3
          data-send-points:
            access DSP_VeLINR_e_PECP2_MONTRNG_RPM_VeLINR_e_PECP2_MONTRNG_RPM: accessed-variable=VeLINR_e_PECP2_MONTRNG_RPM.VeLINR_e_PECP2_MONTRNG_RPM
            access DSP_VeLINR_b_PECP2_MONTRNG_RPM_TO_VeLINR_b_PECP2_MONTRNG_RPM_TO: accessed-variable=VeLINR_b_PECP2_MONTRNG_RPM_TO.VeLINR_b_PECP2_MONTRNG_RPM_TO
        COMRXL_PECP2_MONTRNG_RPM_PECP2_STAT_GLOBAL_Lin3_Error: symbol=ApplLinComAb_LIN3_COMRXL_PECP2_MONTRNG_RPM_PECP2_STAT_GLOBAL_Lin3_Error  # Error -
          data-receive-point-by-arguments:
            access DRP_Lin3ComRxSignalsSR_COMRXL_PECP2_MONTRNG_RPM_PECP2_STAT_GLOBAL_Lin3: accessed-variable=Lin3ComRxSignalsSR.COMRXL_PECP2_MONTRNG_RPM_PECP2_STAT_GLOBAL_Lin3
          data-send-points:
            access DSP_VeLINR_e_PECP2_MONTRNG_RPM_VeLINR_e_PECP2_MONTRNG_RPM: accessed-variable=VeLINR_e_PECP2_MONTRNG_RPM.VeLINR_e_PECP2_MONTRNG_RPM
            access DSP_VeLINR_b_PECP2_MONTRNG_RPM_TO_VeLINR_b_PECP2_MONTRNG_RPM_TO: accessed-variable=VeLINR_b_PECP2_MONTRNG_RPM_TO.VeLINR_b_PECP2_MONTRNG_RPM_TO
          read-local-variables:
            access IRVRA_VeLINR_d_LIN_SlavePrsnt_LIN3: accessed-variable=VeLINR_d_LIN_SlavePrsnt_LIN3
        COMRXL_PECP2_NODE_ERR_PECP2_STAT_GLOBAL_Lin3_Received: symbol=ApplLinComAb_LIN3_COMRXL_PECP2_NODE_ERR_PECP2_STAT_GLOBAL_Lin3_Received  # Received -
          data-receive-point-by-arguments:
            access DRP_Lin3ComRxSignalsSR_COMRXL_PECP2_NODE_ERR_PECP2_STAT_GLOBAL_Lin3: accessed-variable=Lin3ComRxSignalsSR.COMRXL_PECP2_NODE_ERR_PECP2_STAT_GLOBAL_Lin3
          data-send-points:
            access DSP_VeLINR_e_PECP2_NODE_ERR_VeLINR_e_PECP2_NODE_ERR: accessed-variable=VeLINR_e_PECP2_NODE_ERR.VeLINR_e_PECP2_NODE_ERR
            access DSP_VeLINR_b_PECP2_NODE_ERR_TO_VeLINR_b_PECP2_NODE_ERR_TO: accessed-variable=VeLINR_b_PECP2_NODE_ERR_TO.VeLINR_b_PECP2_NODE_ERR_TO
        COMRXL_PECP2_NODE_ERR_PECP2_STAT_GLOBAL_Lin3_Error: symbol=ApplLinComAb_LIN3_COMRXL_PECP2_NODE_ERR_PECP2_STAT_GLOBAL_Lin3_Error  # Error -
          data-receive-point-by-arguments:
            access DRP_Lin3ComRxSignalsSR_COMRXL_PECP2_NODE_ERR_PECP2_STAT_GLOBAL_Lin3: accessed-variable=Lin3ComRxSignalsSR.COMRXL_PECP2_NODE_ERR_PECP2_STAT_GLOBAL_Lin3
          data-send-points:
            access DSP_VeLINR_e_PECP2_NODE_ERR_VeLINR_e_PECP2_NODE_ERR: accessed-variable=VeLINR_e_PECP2_NODE_ERR.VeLINR_e_PECP2_NODE_ERR
            access DSP_VeLINR_b_PECP2_NODE_ERR_TO_VeLINR_b_PECP2_NODE_ERR_TO: accessed-variable=VeLINR_b_PECP2_NODE_ERR_TO.VeLINR_b_PECP2_NODE_ERR_TO
          read-local-variables:
            access IRVRA_VeLINR_d_LIN_SlavePrsnt_LIN3: accessed-variable=VeLINR_d_LIN_SlavePrsnt_LIN3
        COMRXL_PECP2_POST_RUN_STAT_PECP2_STAT_GLOBAL_Lin3_Received: symbol=ApplLinComAb_LIN3_COMRXL_PECP2_POST_RUN_STAT_PECP2_STAT_GLOBAL_Lin3_Received  # Received -
          data-receive-point-by-arguments:
            access DRP_Lin3ComRxSignalsSR_COMRXL_PECP2_POST_RUN_STAT_PECP2_STAT_GLOBAL_Lin3: accessed-variable=Lin3ComRxSignalsSR.COMRXL_PECP2_POST_RUN_STAT_PECP2_STAT_GLOBAL_Lin3
          data-send-points:
            access DSP_VeLINR_e_PECP2_POST_RUN_STAT_VeLINR_e_PECP2_POST_RUN_STAT: accessed-variable=VeLINR_e_PECP2_POST_RUN_STAT.VeLINR_e_PECP2_POST_RUN_STAT
            access DSP_VeLINR_b_PECP2_POST_RUN_STAT_TO_VeLINR_b_PECP2_POST_RUN_STAT_TO: accessed-variable=VeLINR_b_PECP2_POST_RUN_STAT_TO.VeLINR_b_PECP2_POST_RUN_STAT_TO
        COMRXL_PECP2_POST_RUN_STAT_PECP2_STAT_GLOBAL_Lin3_Error: symbol=ApplLinComAb_LIN3_COMRXL_PECP2_POST_RUN_STAT_PECP2_STAT_GLOBAL_Lin3_Error  # Error -
          data-receive-point-by-arguments:
            access DRP_Lin3ComRxSignalsSR_COMRXL_PECP2_POST_RUN_STAT_PECP2_STAT_GLOBAL_Lin3: accessed-variable=Lin3ComRxSignalsSR.COMRXL_PECP2_POST_RUN_STAT_PECP2_STAT_GLOBAL_Lin3
          data-send-points:
            access DSP_VeLINR_e_PECP2_POST_RUN_STAT_VeLINR_e_PECP2_POST_RUN_STAT: accessed-variable=VeLINR_e_PECP2_POST_RUN_STAT.VeLINR_e_PECP2_POST_RUN_STAT
            access DSP_VeLINR_b_PECP2_POST_RUN_STAT_TO_VeLINR_b_PECP2_POST_RUN_STAT_TO: accessed-variable=VeLINR_b_PECP2_POST_RUN_STAT_TO.VeLINR_b_PECP2_POST_RUN_STAT_TO
          read-local-variables:
            access IRVRA_VeLINR_d_LIN_SlavePrsnt_LIN3: accessed-variable=VeLINR_d_LIN_SlavePrsnt_LIN3
        COMRXL_RsErr_PECP2_PUMP_PECP2_STAT_GLOBAL_Lin3_Received: symbol=ApplLinComAb_LIN3_COMRXL_RsErr_PECP2_PUMP_PECP2_STAT_GLOBAL_Lin3_Received  # Received -
          data-receive-point-by-arguments:
            access DRP_Lin3ComRxSignalsSR_COMRXL_RsErr_PECP2_PUMP_PECP2_STAT_GLOBAL_Lin3: accessed-variable=Lin3ComRxSignalsSR.COMRXL_RsErr_PECP2_PUMP_PECP2_STAT_GLOBAL_Lin3
          data-send-points:
            access DSP_VeLINR_b_RsErr_PECP2_PUMP_VeLINR_b_RsErr_PECP2_PUMP: accessed-variable=VeLINR_b_RsErr_PECP2_PUMP.VeLINR_b_RsErr_PECP2_PUMP
            access DSP_VeLINR_b_RsErr_PECP2_PUMP_TO_VeLINR_b_RsErr_PECP2_PUMP_TO: accessed-variable=VeLINR_b_RsErr_PECP2_PUMP_TO.VeLINR_b_RsErr_PECP2_PUMP_TO
        COMRXL_RsErr_PECP2_PUMP_PECP2_STAT_GLOBAL_Lin3_Error: symbol=ApplLinComAb_LIN3_COMRXL_RsErr_PECP2_PUMP_PECP2_STAT_GLOBAL_Lin3_Error  # Error -
          data-receive-point-by-arguments:
            access DRP_Lin3ComRxSignalsSR_COMRXL_RsErr_PECP2_PUMP_PECP2_STAT_GLOBAL_Lin3: accessed-variable=Lin3ComRxSignalsSR.COMRXL_RsErr_PECP2_PUMP_PECP2_STAT_GLOBAL_Lin3
          data-send-points:
            access DSP_VeLINR_b_RsErr_PECP2_PUMP_VeLINR_b_RsErr_PECP2_PUMP: accessed-variable=VeLINR_b_RsErr_PECP2_PUMP.VeLINR_b_RsErr_PECP2_PUMP
            access DSP_VeLINR_b_RsErr_PECP2_PUMP_TO_VeLINR_b_RsErr_PECP2_PUMP_TO: accessed-variable=VeLINR_b_RsErr_PECP2_PUMP_TO.VeLINR_b_RsErr_PECP2_PUMP_TO
          read-local-variables:
            access IRVRA_VeLINR_d_LIN_SlavePrsnt_LIN3: accessed-variable=VeLINR_d_LIN_SlavePrsnt_LIN3
        COMRXL_PECP2_VERSION_PECP2_VER_Lin3_Received: symbol=ApplLinComAb_LIN3_COMRXL_PECP2_VERSION_PECP2_VER_Lin3_Received  # Received -
          data-receive-point-by-arguments:
            access DRP_Lin3ComRxSignalsSR_COMRXL_PECP2_VERSION_PECP2_VER_Lin3: accessed-variable=Lin3ComRxSignalsSR.COMRXL_PECP2_VERSION_PECP2_VER_Lin3
          data-send-points:
            access DSP_VeLINR_y_PECP2_VERSION_VeLINR_y_PECP2_VERSION: accessed-variable=VeLINR_y_PECP2_VERSION.VeLINR_y_PECP2_VERSION
            access DSP_VeLINR_b_PECP2_VERSION_TO_VeLINR_b_PECP2_VERSION_TO: accessed-variable=VeLINR_b_PECP2_VERSION_TO.VeLINR_b_PECP2_VERSION_TO
        COMRXL_PECP2_VERSION_PECP2_VER_Lin3_Error: symbol=ApplLinComAb_LIN3_COMRXL_PECP2_VERSION_PECP2_VER_Lin3_Error  # Error -
          data-receive-point-by-arguments:
            access DRP_Lin3ComRxSignalsSR_COMRXL_PECP2_VERSION_PECP2_VER_Lin3: accessed-variable=Lin3ComRxSignalsSR.COMRXL_PECP2_VERSION_PECP2_VER_Lin3
          data-send-points:
            access DSP_VeLINR_y_PECP2_VERSION_VeLINR_y_PECP2_VERSION: accessed-variable=VeLINR_y_PECP2_VERSION.VeLINR_y_PECP2_VERSION
            access DSP_VeLINR_b_PECP2_VERSION_TO_VeLINR_b_PECP2_VERSION_TO: accessed-variable=VeLINR_b_PECP2_VERSION_TO.VeLINR_b_PECP2_VERSION_TO
          read-local-variables:
            access IRVRA_VeLINR_d_LIN_SlavePrsnt_LIN3: accessed-variable=VeLINR_d_LIN_SlavePrsnt_LIN3
        COMRXL_PECP2_SUPPLIER_PECP2_VER_Lin3_Received: symbol=ApplLinComAb_LIN3_COMRXL_PECP2_SUPPLIER_PECP2_VER_Lin3_Received  # Received -
          data-receive-point-by-arguments:
            access DRP_Lin3ComRxSignalsSR_COMRXL_PECP2_SUPPLIER_PECP2_VER_Lin3: accessed-variable=Lin3ComRxSignalsSR.COMRXL_PECP2_SUPPLIER_PECP2_VER_Lin3
          data-send-points:
            access DSP_VeLINR_e_PECP2_SUPPLIER_VeLINR_e_PECP2_SUPPLIER: accessed-variable=VeLINR_e_PECP2_SUPPLIER.VeLINR_e_PECP2_SUPPLIER
            access DSP_VeLINR_b_PECP2_SUPPLIER_TO_VeLINR_b_PECP2_SUPPLIER_TO: accessed-variable=VeLINR_b_PECP2_SUPPLIER_TO.VeLINR_b_PECP2_SUPPLIER_TO
        COMRXL_PECP2_SUPPLIER_PECP2_VER_Lin3_Error: symbol=ApplLinComAb_LIN3_COMRXL_PECP2_SUPPLIER_PECP2_VER_Lin3_Error  # Error -
          data-receive-point-by-arguments:
            access DRP_Lin3ComRxSignalsSR_COMRXL_PECP2_SUPPLIER_PECP2_VER_Lin3: accessed-variable=Lin3ComRxSignalsSR.COMRXL_PECP2_SUPPLIER_PECP2_VER_Lin3
          data-send-points:
            access DSP_VeLINR_e_PECP2_SUPPLIER_VeLINR_e_PECP2_SUPPLIER: accessed-variable=VeLINR_e_PECP2_SUPPLIER.VeLINR_e_PECP2_SUPPLIER
            access DSP_VeLINR_b_PECP2_SUPPLIER_TO_VeLINR_b_PECP2_SUPPLIER_TO: accessed-variable=VeLINR_b_PECP2_SUPPLIER_TO.VeLINR_b_PECP2_SUPPLIER_TO
          read-local-variables:
            access IRVRA_VeLINR_d_LIN_SlavePrsnt_LIN3: accessed-variable=VeLINR_d_LIN_SlavePrsnt_LIN3
        COMRXL_PowerPanel2_Button_State_PowerPanel2_STAT_Lin3_Received: symbol=ApplLinComAb_LIN3_COMRXL_PowerPanel2_Button_State_PowerPanel2_STAT_Lin3_Received  # Received -
          data-receive-point-by-arguments:
            access DRP_Lin3ComRxSignalsSR_COMRXL_PowerPanel2_Button_State_PowerPanel2_STAT_Lin3: accessed-variable=Lin3ComRxSignalsSR.COMRXL_PowerPanel2_Button_State_PowerPanel2_STAT_Lin3
          data-send-points:
            access DSP_VeLINR_b_PowerPanel2ButtonState_VeLINR_b_PowerPanel2ButtonState: accessed-variable=VeLINR_b_PowerPanel2ButtonState.VeLINR_b_PowerPanel2ButtonState
            access DSP_VeLINR_b_PowerPanel2ButtonStateTO_VeLINR_b_PowerPanel2ButtonStateTO: accessed-variable=VeLINR_b_PowerPanel2ButtonStateTO.VeLINR_b_PowerPanel2ButtonStateTO
        COMRXL_PowerPanel2_Button_State_PowerPanel2_STAT_Lin3_Error: symbol=ApplLinComAb_LIN3_COMRXL_PowerPanel2_Button_State_PowerPanel2_STAT_Lin3_Error  # Error -
          data-receive-point-by-arguments:
            access DRP_Lin3ComRxSignalsSR_COMRXL_PowerPanel2_Button_State_PowerPanel2_STAT_Lin3: accessed-variable=Lin3ComRxSignalsSR.COMRXL_PowerPanel2_Button_State_PowerPanel2_STAT_Lin3
          data-send-points:
            access DSP_VeLINR_b_PowerPanel2ButtonState_VeLINR_b_PowerPanel2ButtonState: accessed-variable=VeLINR_b_PowerPanel2ButtonState.VeLINR_b_PowerPanel2ButtonState
            access DSP_VeLINR_b_PowerPanel2ButtonStateTO_VeLINR_b_PowerPanel2ButtonStateTO: accessed-variable=VeLINR_b_PowerPanel2ButtonStateTO.VeLINR_b_PowerPanel2ButtonStateTO
          read-local-variables:
            access IRVRA_VeLINR_d_LIN_SlavePrsnt_LIN3: accessed-variable=VeLINR_d_LIN_SlavePrsnt_LIN3
        COMRXL_PowerPanel2_Lid_Switch_Sts_120A_PowerPanel2_STAT_Lin3_Received: symbol=ApplLinComAb_LIN3_COMRXL_PowerPanel2_Lid_Switch_Sts_120A_PowerPanel2_STAT_Lin3_Received  # Received -
          data-receive-point-by-arguments:
            access DRP_Lin3ComRxSignalsSR_COMRXL_PowerPanel2_Lid_Switch_Sts_120A_PowerPanel2_STAT_Lin3: accessed-variable=Lin3ComRxSignalsSR.COMRXL_PowerPanel2_Lid_Switch_Sts_120A_PowerPanel2_STAT_Lin3
          data-send-points:
            access DSP_VeLINR_b_PwrPanel2LidSwtSts120A_VeLINR_b_PwrPanel2LidSwtSts120A: accessed-variable=VeLINR_b_PwrPanel2LidSwtSts120A.VeLINR_b_PwrPanel2LidSwtSts120A
            access DSP_VeLINR_b_PwrPanel2LidSwtSts120A_TO_VeLINR_b_PwrPanel2LidSwtSts120A_TO: accessed-variable=VeLINR_b_PwrPanel2LidSwtSts120A_TO.VeLINR_b_PwrPanel2LidSwtSts120A_TO
        COMRXL_PowerPanel2_Lid_Switch_Sts_120A_PowerPanel2_STAT_Lin3_Error: symbol=ApplLinComAb_LIN3_COMRXL_PowerPanel2_Lid_Switch_Sts_120A_PowerPanel2_STAT_Lin3_Error  # Error -
          data-receive-point-by-arguments:
            access DRP_Lin3ComRxSignalsSR_COMRXL_PowerPanel2_Lid_Switch_Sts_120A_PowerPanel2_STAT_Lin3: accessed-variable=Lin3ComRxSignalsSR.COMRXL_PowerPanel2_Lid_Switch_Sts_120A_PowerPanel2_STAT_Lin3
          data-send-points:
            access DSP_VeLINR_b_PwrPanel2LidSwtSts120A_VeLINR_b_PwrPanel2LidSwtSts120A: accessed-variable=VeLINR_b_PwrPanel2LidSwtSts120A.VeLINR_b_PwrPanel2LidSwtSts120A
            access DSP_VeLINR_b_PwrPanel2LidSwtSts120A_TO_VeLINR_b_PwrPanel2LidSwtSts120A_TO: accessed-variable=VeLINR_b_PwrPanel2LidSwtSts120A_TO.VeLINR_b_PwrPanel2LidSwtSts120A_TO
          read-local-variables:
            access IRVRA_VeLINR_d_LIN_SlavePrsnt_LIN3: accessed-variable=VeLINR_d_LIN_SlavePrsnt_LIN3
        COMRXL_PowerPanel2_Lid_Switch_Sts_120B_PowerPanel2_STAT_Lin3_Received: symbol=ApplLinComAb_LIN3_COMRXL_PowerPanel2_Lid_Switch_Sts_120B_PowerPanel2_STAT_Lin3_Received  # Received -
          data-receive-point-by-arguments:
            access DRP_Lin3ComRxSignalsSR_COMRXL_PowerPanel2_Lid_Switch_Sts_120B_PowerPanel2_STAT_Lin3: accessed-variable=Lin3ComRxSignalsSR.COMRXL_PowerPanel2_Lid_Switch_Sts_120B_PowerPanel2_STAT_Lin3
          data-send-points:
            access DSP_VeLINR_b_PwrPanel2LidSwtSts120B_VeLINR_b_PwrPanel2LidSwtSts120B: accessed-variable=VeLINR_b_PwrPanel2LidSwtSts120B.VeLINR_b_PwrPanel2LidSwtSts120B
            access DSP_VeLINR_b_PwrPanel2LidSwtSts120B_TO_VeLINR_b_PwrPanel2LidSwtSts120B_TO: accessed-variable=VeLINR_b_PwrPanel2LidSwtSts120B_TO.VeLINR_b_PwrPanel2LidSwtSts120B_TO
        COMRXL_PowerPanel2_Lid_Switch_Sts_120B_PowerPanel2_STAT_Lin3_Error: symbol=ApplLinComAb_LIN3_COMRXL_PowerPanel2_Lid_Switch_Sts_120B_PowerPanel2_STAT_Lin3_Error  # Error -
          data-receive-point-by-arguments:
            access DRP_Lin3ComRxSignalsSR_COMRXL_PowerPanel2_Lid_Switch_Sts_120B_PowerPanel2_STAT_Lin3: accessed-variable=Lin3ComRxSignalsSR.COMRXL_PowerPanel2_Lid_Switch_Sts_120B_PowerPanel2_STAT_Lin3
          data-send-points:
            access DSP_VeLINR_b_PwrPanel2LidSwtSts120B_VeLINR_b_PwrPanel2LidSwtSts120B: accessed-variable=VeLINR_b_PwrPanel2LidSwtSts120B.VeLINR_b_PwrPanel2LidSwtSts120B
            access DSP_VeLINR_b_PwrPanel2LidSwtSts120B_TO_VeLINR_b_PwrPanel2LidSwtSts120B_TO: accessed-variable=VeLINR_b_PwrPanel2LidSwtSts120B_TO.VeLINR_b_PwrPanel2LidSwtSts120B_TO
          read-local-variables:
            access IRVRA_VeLINR_d_LIN_SlavePrsnt_LIN3: accessed-variable=VeLINR_d_LIN_SlavePrsnt_LIN3
        COMRXL_PowerPanel2_Lid_Switch_Sts_240_PowerPanel2_STAT_Lin3_Received: symbol=ApplLinComAb_LIN3_COMRXL_PowerPanel2_Lid_Switch_Sts_240_PowerPanel2_STAT_Lin3_Received  # Received -
          data-receive-point-by-arguments:
            access DRP_Lin3ComRxSignalsSR_COMRXL_PowerPanel2_Lid_Switch_Sts_240_PowerPanel2_STAT_Lin3: accessed-variable=Lin3ComRxSignalsSR.COMRXL_PowerPanel2_Lid_Switch_Sts_240_PowerPanel2_STAT_Lin3
          data-send-points:
            access DSP_VeLINR_b_PwrPanel2LidSwtSts240_VeLINR_b_PwrPanel2LidSwtSts240: accessed-variable=VeLINR_b_PwrPanel2LidSwtSts240.VeLINR_b_PwrPanel2LidSwtSts240
            access DSP_VeLINR_b_PwrPanel2LidSwtSts240TO_VeLINR_b_PwrPanel2LidSwtSts240TO: accessed-variable=VeLINR_b_PwrPanel2LidSwtSts240TO.VeLINR_b_PwrPanel2LidSwtSts240TO
        COMRXL_PowerPanel2_Lid_Switch_Sts_240_PowerPanel2_STAT_Lin3_Error: symbol=ApplLinComAb_LIN3_COMRXL_PowerPanel2_Lid_Switch_Sts_240_PowerPanel2_STAT_Lin3_Error  # Error -
          data-receive-point-by-arguments:
            access DRP_Lin3ComRxSignalsSR_COMRXL_PowerPanel2_Lid_Switch_Sts_240_PowerPanel2_STAT_Lin3: accessed-variable=Lin3ComRxSignalsSR.COMRXL_PowerPanel2_Lid_Switch_Sts_240_PowerPanel2_STAT_Lin3
          data-send-points:
            access DSP_VeLINR_b_PwrPanel2LidSwtSts240_VeLINR_b_PwrPanel2LidSwtSts240: accessed-variable=VeLINR_b_PwrPanel2LidSwtSts240.VeLINR_b_PwrPanel2LidSwtSts240
            access DSP_VeLINR_b_PwrPanel2LidSwtSts240TO_VeLINR_b_PwrPanel2LidSwtSts240TO: accessed-variable=VeLINR_b_PwrPanel2LidSwtSts240TO.VeLINR_b_PwrPanel2LidSwtSts240TO
          read-local-variables:
            access IRVRA_VeLINR_d_LIN_SlavePrsnt_LIN3: accessed-variable=VeLINR_d_LIN_SlavePrsnt_LIN3
        COMRXL_PowerPanel2_AC_Present_Sens1_PowerPanel2_STAT_Lin3_Received: symbol=ApplLinComAb_LIN3_COMRXL_PowerPanel2_AC_Present_Sens1_PowerPanel2_STAT_Lin3_Received  # Received -
          data-receive-point-by-arguments:
            access DRP_Lin3ComRxSignalsSR_COMRXL_PowerPanel2_AC_Present_Sens1_PowerPanel2_STAT_Lin3: accessed-variable=Lin3ComRxSignalsSR.COMRXL_PowerPanel2_AC_Present_Sens1_PowerPanel2_STAT_Lin3
          data-send-points:
            access DSP_VeLINR_b_PwrPanel2AC_PrsntSens1_VeLINR_b_PwrPanel2AC_PrsntSens1: accessed-variable=VeLINR_b_PwrPanel2AC_PrsntSens1.VeLINR_b_PwrPanel2AC_PrsntSens1
            access DSP_VeLINR_b_PwrPanel2AC_PrsntSens1TO_VeLINR_b_PwrPanel2AC_PrsntSens1TO: accessed-variable=VeLINR_b_PwrPanel2AC_PrsntSens1TO.VeLINR_b_PwrPanel2AC_PrsntSens1TO
        COMRXL_PowerPanel2_AC_Present_Sens1_PowerPanel2_STAT_Lin3_Error: symbol=ApplLinComAb_LIN3_COMRXL_PowerPanel2_AC_Present_Sens1_PowerPanel2_STAT_Lin3_Error  # Error -
          data-receive-point-by-arguments:
            access DRP_Lin3ComRxSignalsSR_COMRXL_PowerPanel2_AC_Present_Sens1_PowerPanel2_STAT_Lin3: accessed-variable=Lin3ComRxSignalsSR.COMRXL_PowerPanel2_AC_Present_Sens1_PowerPanel2_STAT_Lin3
          data-send-points:
            access DSP_VeLINR_b_PwrPanel2AC_PrsntSens1_VeLINR_b_PwrPanel2AC_PrsntSens1: accessed-variable=VeLINR_b_PwrPanel2AC_PrsntSens1.VeLINR_b_PwrPanel2AC_PrsntSens1
            access DSP_VeLINR_b_PwrPanel2AC_PrsntSens1TO_VeLINR_b_PwrPanel2AC_PrsntSens1TO: accessed-variable=VeLINR_b_PwrPanel2AC_PrsntSens1TO.VeLINR_b_PwrPanel2AC_PrsntSens1TO
          read-local-variables:
            access IRVRA_VeLINR_d_LIN_SlavePrsnt_LIN3: accessed-variable=VeLINR_d_LIN_SlavePrsnt_LIN3
        COMRXL_PowerPanel2_AC_Present_Sens2_PowerPanel2_STAT_Lin3_Received: symbol=ApplLinComAb_LIN3_COMRXL_PowerPanel2_AC_Present_Sens2_PowerPanel2_STAT_Lin3_Received  # Received -
          data-receive-point-by-arguments:
            access DRP_Lin3ComRxSignalsSR_COMRXL_PowerPanel2_AC_Present_Sens2_PowerPanel2_STAT_Lin3: accessed-variable=Lin3ComRxSignalsSR.COMRXL_PowerPanel2_AC_Present_Sens2_PowerPanel2_STAT_Lin3
          data-send-points:
            access DSP_VeLINR_b_PwrPanel2AC_PrsntSens2_VeLINR_b_PwrPanel2AC_PrsntSens2: accessed-variable=VeLINR_b_PwrPanel2AC_PrsntSens2.VeLINR_b_PwrPanel2AC_PrsntSens2
            access DSP_VeLINR_b_PwrPanel2AC_PrsntSens2TO_VeLINR_b_PwrPanel2AC_PrsntSens2TO: accessed-variable=VeLINR_b_PwrPanel2AC_PrsntSens2TO.VeLINR_b_PwrPanel2AC_PrsntSens2TO
        COMRXL_PowerPanel2_AC_Present_Sens2_PowerPanel2_STAT_Lin3_Error: symbol=ApplLinComAb_LIN3_COMRXL_PowerPanel2_AC_Present_Sens2_PowerPanel2_STAT_Lin3_Error  # Error -
          data-receive-point-by-arguments:
            access DRP_Lin3ComRxSignalsSR_COMRXL_PowerPanel2_AC_Present_Sens2_PowerPanel2_STAT_Lin3: accessed-variable=Lin3ComRxSignalsSR.COMRXL_PowerPanel2_AC_Present_Sens2_PowerPanel2_STAT_Lin3
          data-send-points:
            access DSP_VeLINR_b_PwrPanel2AC_PrsntSens2_VeLINR_b_PwrPanel2AC_PrsntSens2: accessed-variable=VeLINR_b_PwrPanel2AC_PrsntSens2.VeLINR_b_PwrPanel2AC_PrsntSens2
            access DSP_VeLINR_b_PwrPanel2AC_PrsntSens2TO_VeLINR_b_PwrPanel2AC_PrsntSens2TO: accessed-variable=VeLINR_b_PwrPanel2AC_PrsntSens2TO.VeLINR_b_PwrPanel2AC_PrsntSens2TO
          read-local-variables:
            access IRVRA_VeLINR_d_LIN_SlavePrsnt_LIN3: accessed-variable=VeLINR_d_LIN_SlavePrsnt_LIN3
        COMRXL_PowerPanel2_Fault_Reason_PowerPanel2_STAT_Lin3_Received: symbol=ApplLinComAb_LIN3_COMRXL_PowerPanel2_Fault_Reason_PowerPanel2_STAT_Lin3_Received  # Received -
          data-receive-point-by-arguments:
            access DRP_Lin3ComRxSignalsSR_COMRXL_PowerPanel2_Fault_Reason_PowerPanel2_STAT_Lin3: accessed-variable=Lin3ComRxSignalsSR.COMRXL_PowerPanel2_Fault_Reason_PowerPanel2_STAT_Lin3
          data-send-points:
            access DSP_VeLINR_e_PwrPanel2_Fault_Reason_VeLINR_e_PwrPanel2_Fault_Reason: accessed-variable=VeLINR_e_PwrPanel2_Fault_Reason.VeLINR_e_PwrPanel2_Fault_Reason
            access DSP_VeLINR_b_PwrPanel2_Fault_ReasonTO_VeLINR_b_PwrPanel2_Fault_ReasonTO: accessed-variable=VeLINR_b_PwrPanel2_Fault_ReasonTO.VeLINR_b_PwrPanel2_Fault_ReasonTO
        COMRXL_PowerPanel2_Fault_Reason_PowerPanel2_STAT_Lin3_Error: symbol=ApplLinComAb_LIN3_COMRXL_PowerPanel2_Fault_Reason_PowerPanel2_STAT_Lin3_Error  # Error -
          data-receive-point-by-arguments:
            access DRP_Lin3ComRxSignalsSR_COMRXL_PowerPanel2_Fault_Reason_PowerPanel2_STAT_Lin3: accessed-variable=Lin3ComRxSignalsSR.COMRXL_PowerPanel2_Fault_Reason_PowerPanel2_STAT_Lin3
          data-send-points:
            access DSP_VeLINR_e_PwrPanel2_Fault_Reason_VeLINR_e_PwrPanel2_Fault_Reason: accessed-variable=VeLINR_e_PwrPanel2_Fault_Reason.VeLINR_e_PwrPanel2_Fault_Reason
            access DSP_VeLINR_b_PwrPanel2_Fault_ReasonTO_VeLINR_b_PwrPanel2_Fault_ReasonTO: accessed-variable=VeLINR_b_PwrPanel2_Fault_ReasonTO.VeLINR_b_PwrPanel2_Fault_ReasonTO
          read-local-variables:
            access IRVRA_VeLINR_d_LIN_SlavePrsnt_LIN3: accessed-variable=VeLINR_d_LIN_SlavePrsnt_LIN3
        COMRXL_RsErr_SPP2_PowerPanel2_STAT_Lin3_Received: symbol=ApplLinComAb_LIN3_COMRXL_RsErr_SPP2_PowerPanel2_STAT_Lin3_Received  # Received -
          data-receive-point-by-arguments:
            access DRP_Lin3ComRxSignalsSR_COMRXL_RsErr_SPP2_PowerPanel2_STAT_Lin3: accessed-variable=Lin3ComRxSignalsSR.COMRXL_RsErr_SPP2_PowerPanel2_STAT_Lin3
          data-send-points:
            access DSP_VeLINR_b_RsErr_SPP2_VeLINR_b_RsErr_SPP2: accessed-variable=VeLINR_b_RsErr_SPP2.VeLINR_b_RsErr_SPP2
            access DSP_VeLINR_b_RsErr_SPP2TO_VeLINR_b_RsErr_SPP2TO: accessed-variable=VeLINR_b_RsErr_SPP2TO.VeLINR_b_RsErr_SPP2TO
        COMRXL_RsErr_SPP2_PowerPanel2_STAT_Lin3_Error: symbol=ApplLinComAb_LIN3_COMRXL_RsErr_SPP2_PowerPanel2_STAT_Lin3_Error  # Error -
          data-receive-point-by-arguments:
            access DRP_Lin3ComRxSignalsSR_COMRXL_RsErr_SPP2_PowerPanel2_STAT_Lin3: accessed-variable=Lin3ComRxSignalsSR.COMRXL_RsErr_SPP2_PowerPanel2_STAT_Lin3
          data-send-points:
            access DSP_VeLINR_b_RsErr_SPP2_VeLINR_b_RsErr_SPP2: accessed-variable=VeLINR_b_RsErr_SPP2.VeLINR_b_RsErr_SPP2
            access DSP_VeLINR_b_RsErr_SPP2TO_VeLINR_b_RsErr_SPP2TO: accessed-variable=VeLINR_b_RsErr_SPP2TO.VeLINR_b_RsErr_SPP2TO
          read-local-variables:
            access IRVRA_VeLINR_d_LIN_SlavePrsnt_LIN3: accessed-variable=VeLINR_d_LIN_SlavePrsnt_LIN3
        SendLINR_AGS_PosRq: can-be-invoked-concurrently=true, symbol=ApplLinComAb_LIN3_SendLINR_AGS_PosRq  # Transmit
          data-receive-point-by-arguments:
            access DRP_SendLINR_AGS_PosRq_SendLINR_AGS_PosRq: accessed-variable=SendLINR_AGS_PosRq.SendLINR_AGS_PosRq
            access DRP_SendLINR_AGS_PosRqVld_SendLINR_AGS_PosRqVld: accessed-variable=SendLINR_AGS_PosRqVld.SendLINR_AGS_PosRqVld
          data-send-points:
            access DSP_Lin3ComTxSignalsSR_COMTXL_AGS_PosRq_ECM_AGS_DEMAND_Lin3: accessed-variable=Lin3ComTxSignalsSR.COMTXL_AGS_PosRq_ECM_AGS_DEMAND_Lin3
        SendLINR_AGS_CalRq: can-be-invoked-concurrently=true, symbol=ApplLinComAb_LIN3_SendLINR_AGS_CalRq  # Transmit
          data-receive-point-by-arguments:
            access DRP_SendLINR_AGS_CalRq_SendLINR_AGS_CalRq: accessed-variable=SendLINR_AGS_CalRq.SendLINR_AGS_CalRq
            access DRP_SendLINR_AGS_CalRqVld_SendLINR_AGS_CalRqVld: accessed-variable=SendLINR_AGS_CalRqVld.SendLINR_AGS_CalRqVld
          data-send-points:
            access DSP_Lin3ComTxSignalsSR_COMTXL_AGS_CalRq_ECM_AGS_DEMAND_Lin3: accessed-variable=Lin3ComTxSignalsSR.COMTXL_AGS_CalRq_ECM_AGS_DEMAND_Lin3
        SendLINR_AGS_BoostRq: can-be-invoked-concurrently=true, symbol=ApplLinComAb_LIN3_SendLINR_AGS_BoostRq  # Transmit
          data-receive-point-by-arguments:
            access DRP_SendLINR_AGS_BoostRq_SendLINR_AGS_BoostRq: accessed-variable=SendLINR_AGS_BoostRq.SendLINR_AGS_BoostRq
            access DRP_SendLINR_AGS_BoostRqVld_SendLINR_AGS_BoostRqVld: accessed-variable=SendLINR_AGS_BoostRqVld.SendLINR_AGS_BoostRqVld
          data-send-points:
            access DSP_Lin3ComTxSignalsSR_COMTXL_AGS_BoostRq_ECM_AGS_DEMAND_Lin3: accessed-variable=Lin3ComTxSignalsSR.COMTXL_AGS_BoostRq_ECM_AGS_DEMAND_Lin3
        SendLINR_M2SRes2Bit: can-be-invoked-concurrently=true, symbol=ApplLinComAb_LIN3_SendLINR_M2SRes2Bit  # Transmit
          data-receive-point-by-arguments:
            access DRP_SendLINR_M2SRes2Bit_SendLINR_M2SRes2Bit: accessed-variable=SendLINR_M2SRes2Bit.SendLINR_M2SRes2Bit
            access DRP_SendLINR_M2SRes2BitVld_SendLINR_M2SRes2BitVld: accessed-variable=SendLINR_M2SRes2BitVld.SendLINR_M2SRes2BitVld
          data-send-points:
            access DSP_Lin3ComTxSignalsSR_COMTXL_M2SRes2Bit_ECM_AGS_DEMAND_Lin3: accessed-variable=Lin3ComTxSignalsSR.COMTXL_M2SRes2Bit_ECM_AGS_DEMAND_Lin3
        SendLINR_M2SResByte1: can-be-invoked-concurrently=true, symbol=ApplLinComAb_LIN3_SendLINR_M2SResByte1  # Transmit
          data-receive-point-by-arguments:
            access DRP_SendLINR_M2SResByte1_SendLINR_M2SResByte1: accessed-variable=SendLINR_M2SResByte1.SendLINR_M2SResByte1
            access DRP_SendLINR_M2SResByte1Vld_SendLINR_M2SResByte1Vld: accessed-variable=SendLINR_M2SResByte1Vld.SendLINR_M2SResByte1Vld
          data-send-points:
            access DSP_Lin3ComTxSignalsSR_COMTXL_M2SResByte1_ECM_AGS_DEMAND_Lin3: accessed-variable=Lin3ComTxSignalsSR.COMTXL_M2SResByte1_ECM_AGS_DEMAND_Lin3
        SendLINR_M2SResByte2: can-be-invoked-concurrently=true, symbol=ApplLinComAb_LIN3_SendLINR_M2SResByte2  # Transmit
          data-receive-point-by-arguments:
            access DRP_SendLINR_M2SResByte2_SendLINR_M2SResByte2: accessed-variable=SendLINR_M2SResByte2.SendLINR_M2SResByte2
            access DRP_SendLINR_M2SResByte2Vld_SendLINR_M2SResByte2Vld: accessed-variable=SendLINR_M2SResByte2Vld.SendLINR_M2SResByte2Vld
          data-send-points:
            access DSP_Lin3ComTxSignalsSR_COMTXL_M2SResByte2_ECM_AGS_DEMAND_Lin3: accessed-variable=Lin3ComTxSignalsSR.COMTXL_M2SResByte2_ECM_AGS_DEMAND_Lin3
        SendLINR_M2SResByte3: can-be-invoked-concurrently=true, symbol=ApplLinComAb_LIN3_SendLINR_M2SResByte3  # Transmit
          data-receive-point-by-arguments:
            access DRP_SendLINR_M2SResByte3_SendLINR_M2SResByte3: accessed-variable=SendLINR_M2SResByte3.SendLINR_M2SResByte3
            access DRP_SendLINR_M2SResByte3Vld_SendLINR_M2SResByte3Vld: accessed-variable=SendLINR_M2SResByte3Vld.SendLINR_M2SResByte3Vld
          data-send-points:
            access DSP_Lin3ComTxSignalsSR_COMTXL_M2SResByte3_ECM_AGS_DEMAND_Lin3: accessed-variable=Lin3ComTxSignalsSR.COMTXL_M2SResByte3_ECM_AGS_DEMAND_Lin3
        SendLINR_CEXV_PosRq: can-be-invoked-concurrently=true, symbol=ApplLinComAb_LIN3_SendLINR_CEXV_PosRq  # Transmit
          data-receive-point-by-arguments:
            access DRP_SendLINR_CEXV_PosRq_SendLINR_CEXV_PosRq: accessed-variable=SendLINR_CEXV_PosRq.SendLINR_CEXV_PosRq
            access DRP_SendLINR_CEXV_PosRqVld_SendLINR_CEXV_PosRqVld: accessed-variable=SendLINR_CEXV_PosRqVld.SendLINR_CEXV_PosRqVld
          data-send-points:
            access DSP_Lin3ComTxSignalsSR_COMTXL_CEXV_PosRq_CEXV_REQ_Lin3: accessed-variable=Lin3ComTxSignalsSR.COMTXL_CEXV_PosRq_CEXV_REQ_Lin3
        SendLINR_CEXV_CalCmd: can-be-invoked-concurrently=true, symbol=ApplLinComAb_LIN3_SendLINR_CEXV_CalCmd  # Transmit
          data-receive-point-by-arguments:
            access DRP_SendLINR_CEXV_CalCmd_SendLINR_CEXV_CalCmd: accessed-variable=SendLINR_CEXV_CalCmd.SendLINR_CEXV_CalCmd
            access DRP_SendLINR_CEXV_CalCmdVld_SendLINR_CEXV_CalCmdVld: accessed-variable=SendLINR_CEXV_CalCmdVld.SendLINR_CEXV_CalCmdVld
          data-send-points:
            access DSP_Lin3ComTxSignalsSR_COMTXL_CEXV_CalCmd_CEXV_REQ_Lin3: accessed-variable=Lin3ComTxSignalsSR.COMTXL_CEXV_CalCmd_CEXV_REQ_Lin3
        SendLINR_CPIM_SET_IND1: can-be-invoked-concurrently=true, symbol=ApplLinComAb_LIN3_SendLINR_CPIM_SET_IND1  # Transmit
          data-receive-point-by-arguments:
            access DRP_SendLINR_CPIM_SET_IND1_SendLINR_CPIM_SET_IND1: accessed-variable=SendLINR_CPIM_SET_IND1.SendLINR_CPIM_SET_IND1
            access DRP_SendLINR_CPIM_SET_IND1Vld_SendLINR_CPIM_SET_IND1Vld: accessed-variable=SendLINR_CPIM_SET_IND1Vld.SendLINR_CPIM_SET_IND1Vld
          data-send-points:
            access DSP_Lin3ComTxSignalsSR_COMTXL_CPIM_SET_IND1_HCP_CPIM_COMMAND_Lin3: accessed-variable=Lin3ComTxSignalsSR.COMTXL_CPIM_SET_IND1_HCP_CPIM_COMMAND_Lin3
        SendLINR_CPIM_SET_IND2: can-be-invoked-concurrently=true, symbol=ApplLinComAb_LIN3_SendLINR_CPIM_SET_IND2  # Transmit
          data-receive-point-by-arguments:
            access DRP_SendLINR_CPIM_SET_IND2_SendLINR_CPIM_SET_IND2: accessed-variable=SendLINR_CPIM_SET_IND2.SendLINR_CPIM_SET_IND2
            access DRP_SendLINR_CPIM_SET_IND2Vld_SendLINR_CPIM_SET_IND2Vld: accessed-variable=SendLINR_CPIM_SET_IND2Vld.SendLINR_CPIM_SET_IND2Vld
          data-send-points:
            access DSP_Lin3ComTxSignalsSR_COMTXL_CPIM_SET_IND2_HCP_CPIM_COMMAND_Lin3: accessed-variable=Lin3ComTxSignalsSR.COMTXL_CPIM_SET_IND2_HCP_CPIM_COMMAND_Lin3
        SendLINR_CPIM_SET_IND3: can-be-invoked-concurrently=true, symbol=ApplLinComAb_LIN3_SendLINR_CPIM_SET_IND3  # Transmit
          data-receive-point-by-arguments:
            access DRP_SendLINR_CPIM_SET_IND3_SendLINR_CPIM_SET_IND3: accessed-variable=SendLINR_CPIM_SET_IND3.SendLINR_CPIM_SET_IND3
            access DRP_SendLINR_CPIM_SET_IND3Vld_SendLINR_CPIM_SET_IND3Vld: accessed-variable=SendLINR_CPIM_SET_IND3Vld.SendLINR_CPIM_SET_IND3Vld
          data-send-points:
            access DSP_Lin3ComTxSignalsSR_COMTXL_CPIM_SET_IND3_HCP_CPIM_COMMAND_Lin3: accessed-variable=Lin3ComTxSignalsSR.COMTXL_CPIM_SET_IND3_HCP_CPIM_COMMAND_Lin3
        SendLINR_CPIM_SET_IND4: can-be-invoked-concurrently=true, symbol=ApplLinComAb_LIN3_SendLINR_CPIM_SET_IND4  # Transmit
          data-receive-point-by-arguments:
            access DRP_SendLINR_CPIM_SET_IND4_SendLINR_CPIM_SET_IND4: accessed-variable=SendLINR_CPIM_SET_IND4.SendLINR_CPIM_SET_IND4
            access DRP_SendLINR_CPIM_SET_IND4Vld_SendLINR_CPIM_SET_IND4Vld: accessed-variable=SendLINR_CPIM_SET_IND4Vld.SendLINR_CPIM_SET_IND4Vld
          data-send-points:
            access DSP_Lin3ComTxSignalsSR_COMTXL_CPIM_SET_IND4_HCP_CPIM_COMMAND_Lin3: accessed-variable=Lin3ComTxSignalsSR.COMTXL_CPIM_SET_IND4_HCP_CPIM_COMMAND_Lin3
        SendLINR_CPIM_SET_IND5: can-be-invoked-concurrently=true, symbol=ApplLinComAb_LIN3_SendLINR_CPIM_SET_IND5  # Transmit
          data-receive-point-by-arguments:
            access DRP_SendLINR_CPIM_SET_IND5_SendLINR_CPIM_SET_IND5: accessed-variable=SendLINR_CPIM_SET_IND5.SendLINR_CPIM_SET_IND5
            access DRP_SendLINR_CPIM_SET_IND5Vld_SendLINR_CPIM_SET_IND5Vld: accessed-variable=SendLINR_CPIM_SET_IND5Vld.SendLINR_CPIM_SET_IND5Vld
          data-send-points:
            access DSP_Lin3ComTxSignalsSR_COMTXL_CPIM_SET_IND5_HCP_CPIM_COMMAND_Lin3: accessed-variable=Lin3ComTxSignalsSR.COMTXL_CPIM_SET_IND5_HCP_CPIM_COMMAND_Lin3
        SendLINR_CPIM_Blink_Rate: can-be-invoked-concurrently=true, symbol=ApplLinComAb_LIN3_SendLINR_CPIM_Blink_Rate  # Transmit
          data-receive-point-by-arguments:
            access DRP_SendLINR_CPIM_Blink_Rate_SendLINR_CPIM_Blink_Rate: accessed-variable=SendLINR_CPIM_Blink_Rate.SendLINR_CPIM_Blink_Rate
            access DRP_SendLINR_CPIM_Blink_RateVld_SendLINR_CPIM_Blink_RateVld: accessed-variable=SendLINR_CPIM_Blink_RateVld.SendLINR_CPIM_Blink_RateVld
          data-send-points:
            access DSP_Lin3ComTxSignalsSR_COMTXL_CPIM_Blink_Rate_HCP_CPIM_COMMAND_Lin3: accessed-variable=Lin3ComTxSignalsSR.COMTXL_CPIM_Blink_Rate_HCP_CPIM_COMMAND_Lin3
        SendLINR_CPIM_IND_Color: can-be-invoked-concurrently=true, symbol=ApplLinComAb_LIN3_SendLINR_CPIM_IND_Color  # Transmit
          data-receive-point-by-arguments:
            access DRP_SendLINR_CPIM_IND_Color_SendLINR_CPIM_IND_Color: accessed-variable=SendLINR_CPIM_IND_Color.SendLINR_CPIM_IND_Color
            access DRP_SendLINR_CPIM_IND_ColorVld_SendLINR_CPIM_IND_ColorVld: accessed-variable=SendLINR_CPIM_IND_ColorVld.SendLINR_CPIM_IND_ColorVld
          data-send-points:
            access DSP_Lin3ComTxSignalsSR_COMTXL_CPIM_IND_Color_HCP_CPIM_COMMAND_Lin3: accessed-variable=Lin3ComTxSignalsSR.COMTXL_CPIM_IND_Color_HCP_CPIM_COMMAND_Lin3
        SendLINR_ChrgPortLock_Cmd: can-be-invoked-concurrently=true, symbol=ApplLinComAb_LIN3_SendLINR_ChrgPortLock_Cmd  # Transmit
          data-receive-point-by-arguments:
            access DRP_SendLINR_ChrgPortLock_Cmd_SendLINR_ChrgPortLock_Cmd: accessed-variable=SendLINR_ChrgPortLock_Cmd.SendLINR_ChrgPortLock_Cmd
            access DRP_SendLINR_ChrgPortLock_CmdVld_SendLINR_ChrgPortLock_CmdVld: accessed-variable=SendLINR_ChrgPortLock_CmdVld.SendLINR_ChrgPortLock_CmdVld
          data-send-points:
            access DSP_Lin3ComTxSignalsSR_COMTXL_ChrgPortLock_Cmd_HCP_CPIM_COMMAND_Lin3: accessed-variable=Lin3ComTxSignalsSR.COMTXL_ChrgPortLock_Cmd_HCP_CPIM_COMMAND_Lin3
        SendLINR_Set_Icon1_cmd: can-be-invoked-concurrently=true, symbol=ApplLinComAb_LIN3_SendLINR_Set_Icon1_cmd  # Transmit
          data-receive-point-by-arguments:
            access DRP_SendLINR_Set_Icon1_cmd_SendLINR_Set_Icon1_cmd: accessed-variable=SendLINR_Set_Icon1_cmd.SendLINR_Set_Icon1_cmd
            access DRP_SendLINR_Set_Icon1_cmdVld_SendLINR_Set_Icon1_cmdVld: accessed-variable=SendLINR_Set_Icon1_cmdVld.SendLINR_Set_Icon1_cmdVld
          data-send-points:
            access DSP_Lin3ComTxSignalsSR_COMTXL_Set_Icon1_cmd_HCP_CPIM_COMMAND_Lin3: accessed-variable=Lin3ComTxSignalsSR.COMTXL_Set_Icon1_cmd_HCP_CPIM_COMMAND_Lin3
        SendLINR_Set_Icon2_cmd: can-be-invoked-concurrently=true, symbol=ApplLinComAb_LIN3_SendLINR_Set_Icon2_cmd  # Transmit
          data-receive-point-by-arguments:
            access DRP_SendLINR_Set_Icon2_cmd_SendLINR_Set_Icon2_cmd: accessed-variable=SendLINR_Set_Icon2_cmd.SendLINR_Set_Icon2_cmd
            access DRP_SendLINR_Set_Icon2_cmdVld_SendLINR_Set_Icon2_cmdVld: accessed-variable=SendLINR_Set_Icon2_cmdVld.SendLINR_Set_Icon2_cmdVld
          data-send-points:
            access DSP_Lin3ComTxSignalsSR_COMTXL_Set_Icon2_cmd_HCP_CPIM_COMMAND_Lin3: accessed-variable=Lin3ComTxSignalsSR.COMTXL_Set_Icon2_cmd_HCP_CPIM_COMMAND_Lin3
        SendLINR_DAY_LGT_MD_CPIM: can-be-invoked-concurrently=true, symbol=ApplLinComAb_LIN3_SendLINR_DAY_LGT_MD_CPIM  # Transmit
          data-receive-point-by-arguments:
            access DRP_SendLINR_DAY_LGT_MD_CPIM_SendLINR_DAY_LGT_MD_CPIM: accessed-variable=SendLINR_DAY_LGT_MD_CPIM.SendLINR_DAY_LGT_MD_CPIM
            access DRP_SendLINR_DAY_LGT_MD_CPIM_Vld_SendLINR_DAY_LGT_MD_CPIM_Vld: accessed-variable=SendLINR_DAY_LGT_MD_CPIM_Vld.SendLINR_DAY_LGT_MD_CPIM_Vld
          data-send-points:
            access DSP_Lin3ComTxSignalsSR_COMTXL_DAY_LGT_MD_CPIM_HCP_CPIM_COMMAND_Lin3: accessed-variable=Lin3ComTxSignalsSR.COMTXL_DAY_LGT_MD_CPIM_HCP_CPIM_COMMAND_Lin3
        SendLINR_Backlight_Cmd: can-be-invoked-concurrently=true, symbol=ApplLinComAb_LIN3_SendLINR_Backlight_Cmd  # Transmit
          data-receive-point-by-arguments:
            access DRP_SendLINR_Backlight_Cmd_SendLINR_Backlight_Cmd: accessed-variable=SendLINR_Backlight_Cmd.SendLINR_Backlight_Cmd
            access DRP_SendLINR_Backlight_CmdVld_SendLINR_Backlight_CmdVld: accessed-variable=SendLINR_Backlight_CmdVld.SendLINR_Backlight_CmdVld
          data-send-points:
            access DSP_Lin3ComTxSignalsSR_COMTXL_Backlight_Cmd_HCP_CPIM_COMMAND_Lin3: accessed-variable=Lin3ComTxSignalsSR.COMTXL_Backlight_Cmd_HCP_CPIM_COMMAND_Lin3
        SendLINR_HvWtrHeatrPwrCnsAllwd: can-be-invoked-concurrently=true, symbol=ApplLinComAb_LIN3_SendLINR_HvWtrHeatrPwrCnsAllwd  # Transmit
          data-receive-point-by-arguments:
            access DRP_SendLINR_HvWtrHeatrPwrCnsAllwd_SendLINR_HvWtrHeatrPwrCnsAllwd: accessed-variable=SendLINR_HvWtrHeatrPwrCnsAllwd.SendLINR_HvWtrHeatrPwrCnsAllwd
            access DRP_SendLINR_HvWtrHeatrPwrCnsAllwdVld_SendLINR_HvWtrHeatrPwrCnsAllwdVld: accessed-variable=SendLINR_HvWtrHeatrPwrCnsAllwdVld.SendLINR_HvWtrHeatrPwrCnsAllwdVld
          data-send-points:
            access DSP_Lin3ComTxSignalsSR_COMTXL_HvWtrHeatrPwrCnsAllwd_CCMLIN18Fr02_Lin3: accessed-variable=Lin3ComTxSignalsSR.COMTXL_HvWtrHeatrPwrCnsAllwd_CCMLIN18Fr02_Lin3
        SendLINR_HvWtrHeatrWtrTDes: can-be-invoked-concurrently=true, symbol=ApplLinComAb_LIN3_SendLINR_HvWtrHeatrWtrTDes  # Transmit
          data-receive-point-by-arguments:
            access DRP_SendLINR_HvWtrHeatrWtrTDes_SendLINR_HvWtrHeatrWtrTDes: accessed-variable=SendLINR_HvWtrHeatrWtrTDes.SendLINR_HvWtrHeatrWtrTDes
            access DRP_SendLINR_HvWtrHeatrWtrTDesVld_SendLINR_HvWtrHeatrWtrTDesVld: accessed-variable=SendLINR_HvWtrHeatrWtrTDesVld.SendLINR_HvWtrHeatrWtrTDesVld
          data-send-points:
            access DSP_Lin3ComTxSignalsSR_COMTXL_HvWtrHeatrWtrTDes_CCMLIN18Fr02_Lin3: accessed-variable=Lin3ComTxSignalsSR.COMTXL_HvWtrHeatrWtrTDes_CCMLIN18Fr02_Lin3
        SendLINR_HvCooltHeatrEnad: can-be-invoked-concurrently=true, symbol=ApplLinComAb_LIN3_SendLINR_HvCooltHeatrEnad  # Transmit
          data-receive-point-by-arguments:
            access DRP_SendLINR_HvCooltHeatrEnad_SendLINR_HvCooltHeatrEnad: accessed-variable=SendLINR_HvCooltHeatrEnad.SendLINR_HvCooltHeatrEnad
            access DRP_SendLINR_HvCooltHeatrEnadVld_SendLINR_HvCooltHeatrEnadVld: accessed-variable=SendLINR_HvCooltHeatrEnadVld.SendLINR_HvCooltHeatrEnadVld
          data-send-points:
            access DSP_Lin3ComTxSignalsSR_COMTXL_HvCooltHeatrEnad_CCMLIN18Fr02_Lin3: accessed-variable=Lin3ComTxSignalsSR.COMTXL_HvCooltHeatrEnad_CCMLIN18Fr02_Lin3
        SendLINR_HVH_OverheatUnlock: can-be-invoked-concurrently=true, symbol=ApplLinComAb_LIN3_SendLINR_HVH_OverheatUnlock  # Transmit
          data-receive-point-by-arguments:
            access DRP_SendLINR_HVH_OverheatUnlock_SendLINR_HVH_OverheatUnlock: accessed-variable=SendLINR_HVH_OverheatUnlock.SendLINR_HVH_OverheatUnlock
            access DRP_SendLINR_HVH_OverheatUnlockVld_SendLINR_HVH_OverheatUnlockVld: accessed-variable=SendLINR_HVH_OverheatUnlockVld.SendLINR_HVH_OverheatUnlockVld
          data-send-points:
            access DSP_Lin3ComTxSignalsSR_COMTXL_HVH_OverheatUnlock_CCMLIN18Fr02_Lin3: accessed-variable=Lin3ComTxSignalsSR.COMTXL_HVH_OverheatUnlock_CCMLIN18Fr02_Lin3
        SendLINR_EOPB_RPM_COM: can-be-invoked-concurrently=true, symbol=ApplLinComAb_LIN3_SendLINR_EOPB_RPM_COM  # Transmit
          data-receive-point-by-arguments:
            access DRP_SendLINR_EOPB_RPM_COM_SendLINR_EOPB_RPM_COM: accessed-variable=SendLINR_EOPB_RPM_COM.SendLINR_EOPB_RPM_COM
            access DRP_SendLINR_EOPB_RPM_COM_Vld_SendLINR_EOPB_RPM_COM_Vld: accessed-variable=SendLINR_EOPB_RPM_COM_Vld.SendLINR_EOPB_RPM_COM_Vld
          data-send-points:
            access DSP_Lin3ComTxSignalsSR_COMTXL_EOPB_RPM_COM_EOPB_REQ_Lin3: accessed-variable=Lin3ComTxSignalsSR.COMTXL_EOPB_RPM_COM_EOPB_REQ_Lin3
        SendLINR_EOPB_POST_RUN_COM: can-be-invoked-concurrently=true, symbol=ApplLinComAb_LIN3_SendLINR_EOPB_POST_RUN_COM  # Transmit
          data-receive-point-by-arguments:
            access DRP_SendLINR_EOPB_POST_RUN_COM_SendLINR_EOPB_POST_RUN_COM: accessed-variable=SendLINR_EOPB_POST_RUN_COM.SendLINR_EOPB_POST_RUN_COM
            access DRP_SendLINR_EOPB_POST_RUN_COM_Vld_SendLINR_EOPB_POST_RUN_COM_Vld: accessed-variable=SendLINR_EOPB_POST_RUN_COM_Vld.SendLINR_EOPB_POST_RUN_COM_Vld
          data-send-points:
            access DSP_Lin3ComTxSignalsSR_COMTXL_EOPB_POST_RUN_COM_EOPB_REQ_Lin3: accessed-variable=Lin3ComTxSignalsSR.COMTXL_EOPB_POST_RUN_COM_EOPB_REQ_Lin3
        SendLINR_HTLBV_PosRq: can-be-invoked-concurrently=true, symbol=ApplLinComAb_LIN3_SendLINR_HTLBV_PosRq  # Transmit
          data-receive-point-by-arguments:
            access DRP_SendLINR_HTLBV_PosRq_SendLINR_HTLBV_PosRq: accessed-variable=SendLINR_HTLBV_PosRq.SendLINR_HTLBV_PosRq
            access DRP_SendLINR_HTLBV_PosRqVld_SendLINR_HTLBV_PosRqVld: accessed-variable=SendLINR_HTLBV_PosRqVld.SendLINR_HTLBV_PosRqVld
          data-send-points:
            access DSP_Lin3ComTxSignalsSR_COMTXL_HTLBV_PosRq_HTLBV_REQ_Lin3: accessed-variable=Lin3ComTxSignalsSR.COMTXL_HTLBV_PosRq_HTLBV_REQ_Lin3
        SendLINR_HTLBV_PosSv: can-be-invoked-concurrently=true, symbol=ApplLinComAb_LIN3_SendLINR_HTLBV_PosSv  # Transmit
          data-receive-point-by-arguments:
            access DRP_SendLINR_HTLBV_PosSv_SendLINR_HTLBV_PosSv: accessed-variable=SendLINR_HTLBV_PosSv.SendLINR_HTLBV_PosSv
            access DRP_SendLINR_HTLBV_PosSvVld_SendLINR_HTLBV_PosSvVld: accessed-variable=SendLINR_HTLBV_PosSvVld.SendLINR_HTLBV_PosSvVld
          data-send-points:
            access DSP_Lin3ComTxSignalsSR_COMTXL_HTLBV_PosSv_HTLBV_REQ_Lin3: accessed-variable=Lin3ComTxSignalsSR.COMTXL_HTLBV_PosSv_HTLBV_REQ_Lin3
        SendLINR_HTLBV_CalRq: can-be-invoked-concurrently=true, symbol=ApplLinComAb_LIN3_SendLINR_HTLBV_CalRq  # Transmit
          data-receive-point-by-arguments:
            access DRP_SendLINR_HTLBV_CalRq_SendLINR_HTLBV_CalRq: accessed-variable=SendLINR_HTLBV_CalRq.SendLINR_HTLBV_CalRq
            access DRP_SendLINR_HTLBV_CalRqVld_SendLINR_HTLBV_CalRqVld: accessed-variable=SendLINR_HTLBV_CalRqVld.SendLINR_HTLBV_CalRqVld
          data-send-points:
            access DSP_Lin3ComTxSignalsSR_COMTXL_HTLBV_CalRq_HTLBV_REQ_Lin3: accessed-variable=Lin3ComTxSignalsSR.COMTXL_HTLBV_CalRq_HTLBV_REQ_Lin3
        SendLINR_PECP2_RPM_REQ_PERCT: can-be-invoked-concurrently=true, symbol=ApplLinComAb_LIN3_SendLINR_PECP2_RPM_REQ_PERCT  # Transmit
          data-receive-point-by-arguments:
            access DRP_SendLINR_PECP2_RPM_REQ_PERCT_SendLINR_PECP2_RPM_REQ_PERCT: accessed-variable=SendLINR_PECP2_RPM_REQ_PERCT.SendLINR_PECP2_RPM_REQ_PERCT
            access DRP_SendLINR_PECP2_RPM_REQ_PERCT_Vld_SendLINR_PECP2_RPM_REQ_PERCT_Vld: accessed-variable=SendLINR_PECP2_RPM_REQ_PERCT_Vld.SendLINR_PECP2_RPM_REQ_PERCT_Vld
          data-send-points:
            access DSP_Lin3ComTxSignalsSR_COMTXL_PECP2_RPM_REQ_PERCT_PECP2_REQ_GLOBAL_Lin3: accessed-variable=Lin3ComTxSignalsSR.COMTXL_PECP2_RPM_REQ_PERCT_PECP2_REQ_GLOBAL_Lin3
        SendLINR_PECP2_POST_RUN_REQ: can-be-invoked-concurrently=true, symbol=ApplLinComAb_LIN3_SendLINR_PECP2_POST_RUN_REQ  # Transmit
          data-receive-point-by-arguments:
            access DRP_SendLINR_PECP2_POST_RUN_REQ_SendLINR_PECP2_POST_RUN_REQ: accessed-variable=SendLINR_PECP2_POST_RUN_REQ.SendLINR_PECP2_POST_RUN_REQ
            access DRP_SendLINR_PECP2_POST_RUN_REQ_Vld_SendLINR_PECP2_POST_RUN_REQ_Vld: accessed-variable=SendLINR_PECP2_POST_RUN_REQ_Vld.SendLINR_PECP2_POST_RUN_REQ_Vld
          data-send-points:
            access DSP_Lin3ComTxSignalsSR_COMTXL_PECP2_POST_RUN_REQ_PECP2_REQ_GLOBAL_Lin3: accessed-variable=Lin3ComTxSignalsSR.COMTXL_PECP2_POST_RUN_REQ_PECP2_REQ_GLOBAL_Lin3
        SendLINR_PECP2_FL_SAFE_ACTVT: can-be-invoked-concurrently=true, symbol=ApplLinComAb_LIN3_SendLINR_PECP2_FL_SAFE_ACTVT  # Transmit
          data-receive-point-by-arguments:
            access DRP_SendLINR_PECP2_FL_SAFE_ACTVT_SendLINR_PECP2_FL_SAFE_ACTVT: accessed-variable=SendLINR_PECP2_FL_SAFE_ACTVT.SendLINR_PECP2_FL_SAFE_ACTVT
            access DRP_SendLINR_PECP2_FL_SAFE_ACTVT_Vld_SendLINR_PECP2_FL_SAFE_ACTVT_Vld: accessed-variable=SendLINR_PECP2_FL_SAFE_ACTVT_Vld.SendLINR_PECP2_FL_SAFE_ACTVT_Vld
          data-send-points:
            access DSP_Lin3ComTxSignalsSR_COMTXL_PECP2_FL_SAFE_ACTVT_PECP2_REQ_GLOBAL_Lin3: accessed-variable=Lin3ComTxSignalsSR.COMTXL_PECP2_FL_SAFE_ACTVT_PECP2_REQ_GLOBAL_Lin3
        SendLINR_PowerPanel2_LED_A_Cmnd: can-be-invoked-concurrently=true, symbol=ApplLinComAb_LIN3_SendLINR_PowerPanel2_LED_A_Cmnd  # Transmit
          data-receive-point-by-arguments:
            access DRP_SendLINR_PowerPanel2_LED_A_Cmnd_SendLINR_PowerPanel2_LED_A_Cmnd: accessed-variable=SendLINR_PowerPanel2_LED_A_Cmnd.SendLINR_PowerPanel2_LED_A_Cmnd
            access DRP_SendLINR_PowerPanel2_LED_A_CmndVld_SendLINR_PowerPanel2_LED_A_CmndVld: accessed-variable=SendLINR_PowerPanel2_LED_A_CmndVld.SendLINR_PowerPanel2_LED_A_CmndVld
          data-send-points:
            access DSP_Lin3ComTxSignalsSR_COMTXL_PowerPanel2_LED_A_Command_PowerPanel2_REQ_Lin3: accessed-variable=Lin3ComTxSignalsSR.COMTXL_PowerPanel2_LED_A_Command_PowerPanel2_REQ_Lin3
        SendLINR_PowerPanel2_LED_B_Cmnd: can-be-invoked-concurrently=true, symbol=ApplLinComAb_LIN3_SendLINR_PowerPanel2_LED_B_Cmnd  # Transmit
          data-receive-point-by-arguments:
            access DRP_SendLINR_PowerPanel2_LED_B_Cmnd_SendLINR_PowerPanel2_LED_B_Cmnd: accessed-variable=SendLINR_PowerPanel2_LED_B_Cmnd.SendLINR_PowerPanel2_LED_B_Cmnd
            access DRP_SendLINR_PowerPanel2_LED_B_CmndVld_SendLINR_PowerPanel2_LED_B_CmndVld: accessed-variable=SendLINR_PowerPanel2_LED_B_CmndVld.SendLINR_PowerPanel2_LED_B_CmndVld
          data-send-points:
            access DSP_Lin3ComTxSignalsSR_COMTXL_PowerPanel2_LED_B_Command_PowerPanel2_REQ_Lin3: accessed-variable=Lin3ComTxSignalsSR.COMTXL_PowerPanel2_LED_B_Command_PowerPanel2_REQ_Lin3
        SendLINR_DAY_LGT_MD_PowerPanel2: can-be-invoked-concurrently=true, symbol=ApplLinComAb_LIN3_SendLINR_DAY_LGT_MD_PowerPanel2  # Transmit
          data-receive-point-by-arguments:
            access DRP_SendLINR_DAY_LGT_MD_PowerPanel2_SendLINR_DAY_LGT_MD_PowerPanel2: accessed-variable=SendLINR_DAY_LGT_MD_PowerPanel2.SendLINR_DAY_LGT_MD_PowerPanel2
            access DRP_SendLINR_DAY_LGT_MD_PowerPanel2Vld_SendLINR_DAY_LGT_MD_PowerPanel2Vld: accessed-variable=SendLINR_DAY_LGT_MD_PowerPanel2Vld.SendLINR_DAY_LGT_MD_PowerPanel2Vld
          data-send-points:
            access DSP_Lin3ComTxSignalsSR_COMTXL_DAY_LGT_MD_PowerPanel2_PowerPanel2_REQ_Lin3: accessed-variable=Lin3ComTxSignalsSR.COMTXL_DAY_LGT_MD_PowerPanel2_PowerPanel2_REQ_Lin3
        SignalLINR_AGS_RdyForSleep: symbol=ApplLinComAb_LIN3_SignalLINR_AGS_RdyForSleep  # AGS is ready for sleep. Set it's bit in Lin slave ready to sleep.Transmit
          data-receive-point-by-arguments:
            access DRP_SignalLINR_AGS_RdyForSleep_SignalLINR_AGS_RdyForSleep: accessed-variable=SignalLINR_AGS_RdyForSleep.SignalLINR_AGS_RdyForSleep
          mode-access-point mode-group=MdulPwrMod.AppMode_MDGP_ESH_Mode:
            ident MAP_MdulPwrMod_AppMode_MDGP_ESH_Mode
          parameter access CPA_KeCFGR_b_LIN3_Equid: accessed-parameter=KeCFGR_b_LIN3_Equid.KeCFGR_b_LIN3_Equid
          read-local-variables:
            access IRVRA_VeLINR_d_LIN_SlavePrsnt_LIN3: accessed-variable=VeLINR_d_LIN_SlavePrsnt_LIN3
            access IRVRA_VeLINR_d_LIN_SlaveRdyToSleep_LIN3: accessed-variable=VeLINR_d_LIN_SlaveRdyToSleep_LIN3
          sync call SSCP_GetRteMode_GetMODR_b_InPostRunMode: operation=GetRteMode.GetMODR_b_InPostRunMode, timeout=0.01
          written-local-variables:
            access IRVWA_VeLINR_d_LIN_SlaveRdyToSleep_LIN3: accessed-variable=VeLINR_d_LIN_SlaveRdyToSleep_LIN3
        SignalLINR_CEXV_RdyForSleep: symbol=ApplLinComAb_LIN3_SignalLINR_CEXV_RdyForSleep  # CEXV is ready for sleep. Set it's bit in Lin slave ready to sleep.Transmit
          data-receive-point-by-arguments:
            access DRP_SignalLINR_CEXV_RdyForSleep_SignalLINR_CEXV_RdyForSleep: accessed-variable=SignalLINR_CEXV_RdyForSleep.SignalLINR_CEXV_RdyForSleep
          mode-access-point mode-group=MdulPwrMod.AppMode_MDGP_ESH_Mode:
            ident MAP_MdulPwrMod_AppMode_MDGP_ESH_Mode
          parameter access CPA_KeCFGR_b_LIN3_Equid: accessed-parameter=KeCFGR_b_LIN3_Equid.KeCFGR_b_LIN3_Equid
          read-local-variables:
            access IRVRA_VeLINR_d_LIN_SlavePrsnt_LIN3: accessed-variable=VeLINR_d_LIN_SlavePrsnt_LIN3
            access IRVRA_VeLINR_d_LIN_SlaveRdyToSleep_LIN3: accessed-variable=VeLINR_d_LIN_SlaveRdyToSleep_LIN3
          sync call SSCP_GetRteMode_GetMODR_b_InPostRunMode: operation=GetRteMode.GetMODR_b_InPostRunMode, timeout=0.01
          written-local-variables:
            access IRVWA_VeLINR_d_LIN_SlaveRdyToSleep_LIN3: accessed-variable=VeLINR_d_LIN_SlaveRdyToSleep_LIN3
        SignalLINR_CPIM_RdyForSleep: symbol=ApplLinComAb_LIN3_SignalLINR_CPIM_RdyForSleep  # CPIM is ready for sleep. Set it's bit in Lin slave ready to sleep.Transmit
          data-receive-point-by-arguments:
            access DRP_SignalLINR_CPIM_RdyForSleep_SignalLINR_CPIM_RdyForSleep: accessed-variable=SignalLINR_CPIM_RdyForSleep.SignalLINR_CPIM_RdyForSleep
          mode-access-point mode-group=MdulPwrMod.AppMode_MDGP_ESH_Mode:
            ident MAP_MdulPwrMod_AppMode_MDGP_ESH_Mode
          parameter access CPA_KeCFGR_b_LIN3_Equid: accessed-parameter=KeCFGR_b_LIN3_Equid.KeCFGR_b_LIN3_Equid
          read-local-variables:
            access IRVRA_VeLINR_d_LIN_SlavePrsnt_LIN3: accessed-variable=VeLINR_d_LIN_SlavePrsnt_LIN3
            access IRVRA_VeLINR_d_LIN_SlaveRdyToSleep_LIN3: accessed-variable=VeLINR_d_LIN_SlaveRdyToSleep_LIN3
          sync call SSCP_GetRteMode_GetMODR_b_InPostRunMode: operation=GetRteMode.GetMODR_b_InPostRunMode, timeout=0.01
          written-local-variables:
            access IRVWA_VeLINR_d_LIN_SlaveRdyToSleep_LIN3: accessed-variable=VeLINR_d_LIN_SlaveRdyToSleep_LIN3
        SignalLINR_ECH_RdyForSleep: symbol=ApplLinComAb_LIN3_SignalLINR_ECH_RdyForSleep  # ECH is ready for sleep. Set it's bit in Lin slave ready to sleep.Transmit
          data-receive-point-by-arguments:
            access DRP_SignalLINR_ECH_RdyForSleep_SignalLINR_ECH_RdyForSleep: accessed-variable=SignalLINR_ECH_RdyForSleep.SignalLINR_ECH_RdyForSleep
          mode-access-point mode-group=MdulPwrMod.AppMode_MDGP_ESH_Mode:
            ident MAP_MdulPwrMod_AppMode_MDGP_ESH_Mode
          parameter access CPA_KeCFGR_b_LIN3_Equid: accessed-parameter=KeCFGR_b_LIN3_Equid.KeCFGR_b_LIN3_Equid
          read-local-variables:
            access IRVRA_VeLINR_d_LIN_SlavePrsnt_LIN3: accessed-variable=VeLINR_d_LIN_SlavePrsnt_LIN3
            access IRVRA_VeLINR_d_LIN_SlaveRdyToSleep_LIN3: accessed-variable=VeLINR_d_LIN_SlaveRdyToSleep_LIN3
          sync call SSCP_GetRteMode_GetMODR_b_InPostRunMode: operation=GetRteMode.GetMODR_b_InPostRunMode, timeout=0.01
          written-local-variables:
            access IRVWA_VeLINR_d_LIN_SlaveRdyToSleep_LIN3: accessed-variable=VeLINR_d_LIN_SlaveRdyToSleep_LIN3
        SignalLINR_EOPB_RdyForSleep: symbol=ApplLinComAb_LIN3_SignalLINR_EOPB_RdyForSleep  # EOPB is ready for sleep. Set it's bit in Lin slave ready to sleep.Transmit
          data-receive-point-by-arguments:
            access DRP_SignalLINR_EOPB_RdyForSleep_SignalLINR_EOPB_RdyForSleep: accessed-variable=SignalLINR_EOPB_RdyForSleep.SignalLINR_EOPB_RdyForSleep
          mode-access-point mode-group=MdulPwrMod.AppMode_MDGP_ESH_Mode:
            ident MAP_MdulPwrMod_AppMode_MDGP_ESH_Mode
          parameter access CPA_KeCFGR_b_LIN3_Equid: accessed-parameter=KeCFGR_b_LIN3_Equid.KeCFGR_b_LIN3_Equid
          read-local-variables:
            access IRVRA_VeLINR_d_LIN_SlavePrsnt_LIN3: accessed-variable=VeLINR_d_LIN_SlavePrsnt_LIN3
            access IRVRA_VeLINR_d_LIN_SlaveRdyToSleep_LIN3: accessed-variable=VeLINR_d_LIN_SlaveRdyToSleep_LIN3
          sync call SSCP_GetRteMode_GetMODR_b_InPostRunMode: operation=GetRteMode.GetMODR_b_InPostRunMode, timeout=0.01
          written-local-variables:
            access IRVWA_VeLINR_d_LIN_SlaveRdyToSleep_LIN3: accessed-variable=VeLINR_d_LIN_SlaveRdyToSleep_LIN3
        SignalLINR_HTLBV_RdyForSleep: symbol=ApplLinComAb_LIN3_SignalLINR_HTLBV_RdyForSleep  # HTLBV is ready for sleep. Set it's bit in Lin slave ready to sleep.Transmit
          data-receive-point-by-arguments:
            access DRP_SignalLINR_HTLBV_RdyForSleep_SignalLINR_HTLBV_RdyForSleep: accessed-variable=SignalLINR_HTLBV_RdyForSleep.SignalLINR_HTLBV_RdyForSleep
          mode-access-point mode-group=MdulPwrMod.AppMode_MDGP_ESH_Mode:
            ident MAP_MdulPwrMod_AppMode_MDGP_ESH_Mode
          parameter access CPA_KeCFGR_b_LIN3_Equid: accessed-parameter=KeCFGR_b_LIN3_Equid.KeCFGR_b_LIN3_Equid
          read-local-variables:
            access IRVRA_VeLINR_d_LIN_SlavePrsnt_LIN3: accessed-variable=VeLINR_d_LIN_SlavePrsnt_LIN3
            access IRVRA_VeLINR_d_LIN_SlaveRdyToSleep_LIN3: accessed-variable=VeLINR_d_LIN_SlaveRdyToSleep_LIN3
          sync call SSCP_GetRteMode_GetMODR_b_InPostRunMode: operation=GetRteMode.GetMODR_b_InPostRunMode, timeout=0.01
          written-local-variables:
            access IRVWA_VeLINR_d_LIN_SlaveRdyToSleep_LIN3: accessed-variable=VeLINR_d_LIN_SlaveRdyToSleep_LIN3
        SignalLINR_PECP2_RdyForSleep: symbol=ApplLinComAb_LIN3_SignalLINR_PECP2_RdyForSleep  # PECP2 is ready for sleep. Set it's bit in Lin slave ready to sleep.Transmit
          data-receive-point-by-arguments:
            access DRP_SignalLINR_PECP2_RdyForSleep_SignalLINR_PECP2_RdyForSleep: accessed-variable=SignalLINR_PECP2_RdyForSleep.SignalLINR_PECP2_RdyForSleep
          mode-access-point mode-group=MdulPwrMod.AppMode_MDGP_ESH_Mode:
            ident MAP_MdulPwrMod_AppMode_MDGP_ESH_Mode
          parameter access CPA_KeCFGR_b_LIN3_Equid: accessed-parameter=KeCFGR_b_LIN3_Equid.KeCFGR_b_LIN3_Equid
          read-local-variables:
            access IRVRA_VeLINR_d_LIN_SlavePrsnt_LIN3: accessed-variable=VeLINR_d_LIN_SlavePrsnt_LIN3
            access IRVRA_VeLINR_d_LIN_SlaveRdyToSleep_LIN3: accessed-variable=VeLINR_d_LIN_SlaveRdyToSleep_LIN3
          sync call SSCP_GetRteMode_GetMODR_b_InPostRunMode: operation=GetRteMode.GetMODR_b_InPostRunMode, timeout=0.01
          written-local-variables:
            access IRVWA_VeLINR_d_LIN_SlaveRdyToSleep_LIN3: accessed-variable=VeLINR_d_LIN_SlaveRdyToSleep_LIN3
        SignalLINR_SPP2_RdyForSleep: symbol=ApplLinComAb_LIN3_SignalLINR_SPP2_RdyForSleep  # SPP2 is ready for sleep. Set it's bit in Lin slave ready to sleep.Transmit
          data-receive-point-by-arguments:
            access DRP_SignalLINR_SPP2_RdyForSleep_SignalLINR_SPP2_RdyForSleep: accessed-variable=SignalLINR_SPP2_RdyForSleep.SignalLINR_SPP2_RdyForSleep
          mode-access-point mode-group=MdulPwrMod.AppMode_MDGP_ESH_Mode:
            ident MAP_MdulPwrMod_AppMode_MDGP_ESH_Mode
          parameter access CPA_KeCFGR_b_LIN3_Equid: accessed-parameter=KeCFGR_b_LIN3_Equid.KeCFGR_b_LIN3_Equid
          read-local-variables:
            access IRVRA_VeLINR_d_LIN_SlavePrsnt_LIN3: accessed-variable=VeLINR_d_LIN_SlavePrsnt_LIN3
            access IRVRA_VeLINR_d_LIN_SlaveRdyToSleep_LIN3: accessed-variable=VeLINR_d_LIN_SlaveRdyToSleep_LIN3
          sync call SSCP_GetRteMode_GetMODR_b_InPostRunMode: operation=GetRteMode.GetMODR_b_InPostRunMode, timeout=0.01
          written-local-variables:
            access IRVWA_VeLINR_d_LIN_SlaveRdyToSleep_LIN3: accessed-variable=VeLINR_d_LIN_SlaveRdyToSleep_LIN3
        ApplLinComAb_LIN3Inin: symbol=ApplLinComAb_LIN3_ApplLinComAb_LIN3Inin  # CAN SWC initialization runnable
          data-send-points:
            access DSP_VeLINR_b_LIN3_RequestsPostRun_VeSPLR_b_PostRunRqrdSt: accessed-variable=VeLINR_b_LIN3_RequestsPostRun.VeSPLR_b_PostRunRqrdSt
          mode switch point MSP_ApplLinComAbLin3EquidMN_MDGP_MSI_Lin3Equid: mode-group=ApplLinComAbLin3EquidMN.MDGP_MSI_Lin3Equid
          parameter access CPA_KeCFGR_b_LIN3_Equid_KeCFGR_b_LIN3_Equid: accessed-parameter=KeCFGR_b_LIN3_Equid.KeCFGR_b_LIN3_Equid
        LinsmComModNotifyRdyToPwrDwn: symbol=ApplLinComAb_LIN3_LinsmComModNotifyRdyToPwrDwn  # Runs when all slaves are ready for power down. Notifies AppModeIf LIN is ready for power down.
          data-send-points:
            access DSP_VeLINR_b_LIN3_RequestsPostRun_VeSPLR_b_PostRunRqrdSt: accessed-variable=VeLINR_b_LIN3_RequestsPostRun.VeSPLR_b_PostRunRqrdSt
          mode-access-point mode-group=MdulPwrMod.AppMode_MDGP_ESH_Mode:
            ident MAP_BswM_MSI_ESH_Mode_BswM_MDGP_ESH_Mode
        LinsmComModPostrun: symbol=ApplLinComAb_LIN3_LinsmComModPostrun  # Runs when ECU goes to POSTRUN state. If LIN is not running when POSTRUN is active, this will immediately notify AppModeIf to power down. Keeps LIN from hanging the power down sequence.
          data-send-points:
            access DSP_VeLINR_b_LIN3_RequestsPostRun_VeSPLR_b_PostRunRqrdSt: accessed-variable=VeLINR_b_LIN3_RequestsPostRun.VeSPLR_b_PostRunRqrdSt
          mode-access-point mode-group=MdulPwrMod.AppMode_MDGP_ESH_Mode:
            ident MAP_BswM_MSI_ESH_Mode_BswM_MDGP_ESH_Mode
          mode-access-point mode-group=PP_MS_LinSMComMod.MDGP_MSI_LinSMComMod:
            ident MAP_BswM_MSI_MDG_LinsmComMod_BswM_MDGP_MDG_LinsmComMod
          parameter access CPA_KeCFGR_b_LIN3_Equid_KeCFGR_b_LIN3_Equid: accessed-parameter=KeCFGR_b_LIN3_Equid.KeCFGR_b_LIN3_Equid
          read-local-variables:
            access IRVRA_VeLINR_d_LIN_SlavePrsnt_LIN3: accessed-variable=VeLINR_d_LIN_SlavePrsnt_LIN3
            access IRVRA_VeLINR_d_LIN_SysSts_LIN3: accessed-variable=VeLINR_d_LIN_SysSts_LIN3
        LinsmComModSetScheduleTbl: symbol=ApplLinComAb_LIN3_LinsmComModSetScheduleTbl  # Sets LIN schedule table based on slaves present (equipped or learned).
          data-send-points:
            access DSP__VeLINR_d_LIN_SlavePrsntSts_LIN3_VeLINR_d_LIN_SlavePrsntSts_LIN3: accessed-variable=VeLINR_d_LIN_SlavePrsntSts_LIN3.VeLINR_d_LIN_SlavePrsntSts_LIN3
          mode-access-point mode-group=PP_MS_LinSMComMod.MDGP_MSI_LinSMComMod:
            ident MAP_BswM_MSI_MDG_LinsmComMod_BswM_MDGP_MDG_LinsmComMod
          10 x parameter access:
            CPA_KeCFGR_b_AGS_Equid_KeCFGR_b_AGS_Equid: accessed-parameter=KeCFGR_b_AGS_Equid.KeCFGR_b_AGS_Equid
            CPA_KeCFGR_b_CEXV_Equid_KeCFGR_b_CEXV_Equid: accessed-parameter=KeCFGR_b_CEXV_Equid.KeCFGR_b_CEXV_Equid
            CPA_KeCFGR_b_CPIM_Equid_KeCFGR_b_CPIM_Equid: accessed-parameter=KeCFGR_b_CPIM_Equid.KeCFGR_b_CPIM_Equid
            CPA_KeCFGR_b_ECH_Equid_KeCFGR_b_ECH_Equid: accessed-parameter=KeCFGR_b_ECH_Equid.KeCFGR_b_ECH_Equid
            CPA_KeCFGR_b_EOPB_Equid_KeCFGR_b_EOPB_Equid: accessed-parameter=KeCFGR_b_EOPB_Equid.KeCFGR_b_EOPB_Equid
            CPA_KeCFGR_b_HTLBV_Equid_KeCFGR_b_HTLBV_Equid: accessed-parameter=KeCFGR_b_HTLBV_Equid.KeCFGR_b_HTLBV_Equid
            CPA_KeCFGR_b_LIN3_Equid_KeCFGR_b_LIN3_Equid: accessed-parameter=KeCFGR_b_LIN3_Equid.KeCFGR_b_LIN3_Equid
            CPA_KeCFGR_b_PECP2_Equid_KeCFGR_b_PECP2_Equid: accessed-parameter=KeCFGR_b_PECP2_Equid.KeCFGR_b_PECP2_Equid
            CPA_KeCFGR_b_SPP2_Equid_KeCFGR_b_SPP2_Equid: accessed-parameter=KeCFGR_b_SPP2_Equid.KeCFGR_b_SPP2_Equid
            CPA_KeLINR_y_LIN3SwtSchdTbl_KeLINR_y_LIN3SwtSchdTbl: accessed-parameter=KeLINR_y_LIN3SwtSchdTbl.KeLINR_y_LIN3SwtSchdTbl
          read-local-variables:
            access IRVRA_VeLINR_d_LIN_SlavePrsnt_LIN3: accessed-variable=VeLINR_d_LIN_SlavePrsnt_LIN3
            access IRVRA_VeLINR_d_LIN_SysSts_LIN3: accessed-variable=VeLINR_d_LIN_SysSts_LIN3
          written-local-variables:
            access IRVWA_VeLINR_d_LIN_SlavePrsnt_LIN3: accessed-variable=VeLINR_d_LIN_SlavePrsnt_LIN3
            access IRVWA_VeLINR_d_LIN_SysSts_LIN3: accessed-variable=VeLINR_d_LIN_SysSts_LIN3
        COMRXL_PowerPanel2_LED_A_Feedback_PowerPanel2_STAT_Lin3_Received: symbol=ApplLinComAb_LIN3_COMRXL_PowerPanel2_LED_A_Feedback_PowerPanel2_STAT_Lin3_Received  # Received -
          data-receive-point-by-arguments:
            access DRP_Lin3ComRxSignalsSR_COMRXL_PowerPanel2_LED_A_Feedback_PowerPanel2_STAT_Lin3: accessed-variable=Lin3ComRxSignalsSR.COMRXL_PowerPanel2_LED_A_Feedback_PowerPanel2_STAT_Lin3
          data-send-points:
            access DSP_VeLINR_e_PowerPanel2_LED_A_Fdbk_VeLINR_e_PowerPanel2_LED_A_Fdbk: accessed-variable=VeLINR_e_PowerPanel2_LED_A_Fdbk.VeLINR_e_PowerPanel2_LED_A_Fdbk
            access DSP_VeLINR_b_PowerPanel2_LED_A_FdbkTO_VeLINR_b_PowerPanel2_LED_A_FdbkTO: accessed-variable=VeLINR_b_PowerPanel2_LED_A_FdbkTO.VeLINR_b_PowerPanel2_LED_A_FdbkTO
        COMRXL_PowerPanel2_LED_A_Feedback_PowerPanel2_STAT_Lin3_Error: symbol=ApplLinComAb_LIN3_COMRXL_PowerPanel2_LED_A_Feedback_PowerPanel2_STAT_Lin3_Error  # Error -
          data-receive-point-by-arguments:
            access DRP_Lin3ComRxSignalsSR_COMRXL_PowerPanel2_LED_A_Feedback_PowerPanel2_STAT_Lin3: accessed-variable=Lin3ComRxSignalsSR.COMRXL_PowerPanel2_LED_A_Feedback_PowerPanel2_STAT_Lin3
          data-send-points:
            access DSP_VeLINR_e_PowerPanel2_LED_A_Fdbk_VeLINR_e_PowerPanel2_LED_A_Fdbk: accessed-variable=VeLINR_e_PowerPanel2_LED_A_Fdbk.VeLINR_e_PowerPanel2_LED_A_Fdbk
            access DSP_VeLINR_b_PowerPanel2_LED_A_FdbkTO_VeLINR_b_PowerPanel2_LED_A_FdbkTO: accessed-variable=VeLINR_b_PowerPanel2_LED_A_FdbkTO.VeLINR_b_PowerPanel2_LED_A_FdbkTO
          read-local-variables:
            access IRVRA_VeLINR_d_LIN_SlavePrsnt_LIN3: accessed-variable=VeLINR_d_LIN_SlavePrsnt_LIN3
        COMRXL_PowerPanel2_LED_B_Feedback_PowerPanel2_STAT_Lin3_Received: symbol=ApplLinComAb_LIN3_COMRXL_PowerPanel2_LED_B_Feedback_PowerPanel2_STAT_Lin3_Received  # Received -
          data-receive-point-by-arguments:
            access DRP_Lin3ComRxSignalsSR_COMRXL_PowerPanel2_LED_B_Feedback_PowerPanel2_STAT_Lin3: accessed-variable=Lin3ComRxSignalsSR.COMRXL_PowerPanel2_LED_B_Feedback_PowerPanel2_STAT_Lin3
          data-send-points:
            access DSP_VeLINR_e_PowerPanel2_LED_B_Fdbk_VeLINR_e_PowerPanel2_LED_B_Fdbk: accessed-variable=VeLINR_e_PowerPanel2_LED_B_Fdbk.VeLINR_e_PowerPanel2_LED_B_Fdbk
            access DSP_VeLINR_b_PowerPanel2_LED_B_FdbkTO_VeLINR_b_PowerPanel2_LED_B_FdbkTO: accessed-variable=VeLINR_b_PowerPanel2_LED_B_FdbkTO.VeLINR_b_PowerPanel2_LED_B_FdbkTO
        COMRXL_PowerPanel2_LED_B_Feedback_PowerPanel2_STAT_Lin3_Error: symbol=ApplLinComAb_LIN3_COMRXL_PowerPanel2_LED_B_Feedback_PowerPanel2_STAT_Lin3_Error  # Error -
          data-receive-point-by-arguments:
            access DRP_Lin3ComRxSignalsSR_COMRXL_PowerPanel2_LED_B_Feedback_PowerPanel2_STAT_Lin3: accessed-variable=Lin3ComRxSignalsSR.COMRXL_PowerPanel2_LED_B_Feedback_PowerPanel2_STAT_Lin3
          data-send-points:
            access DSP_VeLINR_e_PowerPanel2_LED_B_Fdbk_VeLINR_e_PowerPanel2_LED_B_Fdbk: accessed-variable=VeLINR_e_PowerPanel2_LED_B_Fdbk.VeLINR_e_PowerPanel2_LED_B_Fdbk
            access DSP_VeLINR_b_PowerPanel2_LED_B_FdbkTO_VeLINR_b_PowerPanel2_LED_B_FdbkTO: accessed-variable=VeLINR_b_PowerPanel2_LED_B_FdbkTO.VeLINR_b_PowerPanel2_LED_B_FdbkTO
          read-local-variables:
            access IRVRA_VeLINR_d_LIN_SlavePrsnt_LIN3: accessed-variable=VeLINR_d_LIN_SlavePrsnt_LIN3
        COMRXL_PowerPanel2_LED_A_FailStatus_PowerPanel2_STAT_Lin3_Received: symbol=ApplLinComAb_LIN3_COMRXL_PowerPanel2_LED_A_FailStatus_PowerPanel2_STAT_Lin3_Received  # Received -
          data-receive-point-by-arguments:
            access DRP_Lin3ComRxSignalsSR_COMRXL_PowerPanel2_LED_A_FailStatus_PowerPanel2_STAT_Lin3: accessed-variable=Lin3ComRxSignalsSR.COMRXL_PowerPanel2_LED_A_FailStatus_PowerPanel2_STAT_Lin3
          data-send-points:
            access DSP_VeLINR_e_PowPan2_LED_A_FailStat_VeLINR_e_PowPan2_LED_A_FailStat: accessed-variable=VeLINR_e_PowPan2_LED_A_FailStat.VeLINR_e_PowPan2_LED_A_FailStat
            access DSP_VeLINR_b_PowPan2_LED_A_FailStatTO_VeLINR_b_PowPan2_LED_A_FailStatTO: accessed-variable=VeLINR_b_PowPan2_LED_A_FailStatTO.VeLINR_b_PowPan2_LED_A_FailStatTO
        COMRXL_PowerPanel2_LED_A_FailStatus_PowerPanel2_STAT_Lin3_Error: symbol=ApplLinComAb_LIN3_COMRXL_PowerPanel2_LED_A_FailStatus_PowerPanel2_STAT_Lin3_Error  # Error -
          data-receive-point-by-arguments:
            access DRP_Lin3ComRxSignalsSR_COMRXL_PowerPanel2_LED_A_FailStatus_PowerPanel2_STAT_Lin3: accessed-variable=Lin3ComRxSignalsSR.COMRXL_PowerPanel2_LED_A_FailStatus_PowerPanel2_STAT_Lin3
          data-send-points:
            access DSP_VeLINR_e_PowPan2_LED_A_FailStat_VeLINR_e_PowPan2_LED_A_FailStat: accessed-variable=VeLINR_e_PowPan2_LED_A_FailStat.VeLINR_e_PowPan2_LED_A_FailStat
            access DSP_VeLINR_b_PowPan2_LED_A_FailStatTO_VeLINR_b_PowPan2_LED_A_FailStatTO: accessed-variable=VeLINR_b_PowPan2_LED_A_FailStatTO.VeLINR_b_PowPan2_LED_A_FailStatTO
          read-local-variables:
            access IRVRA_VeLINR_d_LIN_SlavePrsnt_LIN3: accessed-variable=VeLINR_d_LIN_SlavePrsnt_LIN3
        COMRXL_PowerPanel2_LED_B_FailStatus_PowerPanel2_STAT_Lin3_Received: symbol=ApplLinComAb_LIN3_COMRXL_PowerPanel2_LED_B_FailStatus_PowerPanel2_STAT_Lin3_Received  # Received -
          data-receive-point-by-arguments:
            access DRP_Lin3ComRxSignalsSR_COMRXL_PowerPanel2_LED_B_FailStatus_PowerPanel2_STAT_Lin3: accessed-variable=Lin3ComRxSignalsSR.COMRXL_PowerPanel2_LED_B_FailStatus_PowerPanel2_STAT_Lin3
          data-send-points:
            access DSP_VeLINR_e_PowPan2_LED_B_FailStat_VeLINR_e_PowPan2_LED_B_FailStat: accessed-variable=VeLINR_e_PowPan2_LED_B_FailStat.VeLINR_e_PowPan2_LED_B_FailStat
            access DSP_VeLINR_b_PowPan2_LED_B_FailStatTO_VeLINR_b_PowPan2_LED_B_FailStatTO: accessed-variable=VeLINR_b_PowPan2_LED_B_FailStatTO.VeLINR_b_PowPan2_LED_B_FailStatTO
        COMRXL_PowerPanel2_LED_B_FailStatus_PowerPanel2_STAT_Lin3_Error: symbol=ApplLinComAb_LIN3_COMRXL_PowerPanel2_LED_B_FailStatus_PowerPanel2_STAT_Lin3_Error  # Error -
          data-receive-point-by-arguments:
            access DRP_Lin3ComRxSignalsSR_COMRXL_PowerPanel2_LED_B_FailStatus_PowerPanel2_STAT_Lin3: accessed-variable=Lin3ComRxSignalsSR.COMRXL_PowerPanel2_LED_B_FailStatus_PowerPanel2_STAT_Lin3
          data-send-points:
            access DSP_VeLINR_e_PowPan2_LED_B_FailStat_VeLINR_e_PowPan2_LED_B_FailStat: accessed-variable=VeLINR_e_PowPan2_LED_B_FailStat.VeLINR_e_PowPan2_LED_B_FailStat
            access DSP_VeLINR_b_PowPan2_LED_B_FailStatTO_VeLINR_b_PowPan2_LED_B_FailStatTO: accessed-variable=VeLINR_b_PowPan2_LED_B_FailStatTO.VeLINR_b_PowPan2_LED_B_FailStatTO
          read-local-variables:
            access IRVRA_VeLINR_d_LIN_SlavePrsnt_LIN3: accessed-variable=VeLINR_d_LIN_SlavePrsnt_LIN3
        COMRXL_PowerPanel2_LED_A_Color_Feedback_PowerPanel2_STAT_Lin3_Received: symbol=ApplLinComAb_LIN3_COMRXL_PowerPanel2_LED_A_Color_Feedback_PowerPanel2_STAT_Lin3_Received  # Received -
          data-receive-point-by-arguments:
            access DRP_Lin3ComRxSignalsSR_COMRXL_PowerPanel2_LED_A_Color_Feedback_PowerPanel2_STAT_Lin3: accessed-variable=Lin3ComRxSignalsSR.COMRXL_PowerPanel2_LED_A_Color_Feedback_PowerPanel2_STAT_Lin3
          data-send-points:
            access DSP_VeLINR_e_PowPan2_LED_A_Col_Fdbk_VeLINR_e_PowPan2_LED_A_Col_Fdbk: accessed-variable=VeLINR_e_PowPan2_LED_A_Col_Fdbk.VeLINR_e_PowPan2_LED_A_Col_Fdbk
            access DSP_VeLINR_b_PowPan2_LED_A_Col_FdbkTO_VeLINR_b_PowPan2_LED_A_Col_FdbkTO: accessed-variable=VeLINR_b_PowPan2_LED_A_Col_FdbkTO.VeLINR_b_PowPan2_LED_A_Col_FdbkTO
        COMRXL_PowerPanel2_LED_A_Color_Feedback_PowerPanel2_STAT_Lin3_Error: symbol=ApplLinComAb_LIN3_COMRXL_PowerPanel2_LED_A_Color_Feedback_PowerPanel2_STAT_Lin3_Error  # Error -
          data-receive-point-by-arguments:
            access DRP_Lin3ComRxSignalsSR_COMRXL_PowerPanel2_LED_A_Color_Feedback_PowerPanel2_STAT_Lin3: accessed-variable=Lin3ComRxSignalsSR.COMRXL_PowerPanel2_LED_A_Color_Feedback_PowerPanel2_STAT_Lin3
          data-send-points:
            access DSP_VeLINR_e_PowPan2_LED_A_Col_Fdbk_VeLINR_e_PowPan2_LED_A_Col_Fdbk: accessed-variable=VeLINR_e_PowPan2_LED_A_Col_Fdbk.VeLINR_e_PowPan2_LED_A_Col_Fdbk
            access DSP_VeLINR_b_PowPan2_LED_A_Col_FdbkTO_VeLINR_b_PowPan2_LED_A_Col_FdbkTO: accessed-variable=VeLINR_b_PowPan2_LED_A_Col_FdbkTO.VeLINR_b_PowPan2_LED_A_Col_FdbkTO
          read-local-variables:
            access IRVRA_VeLINR_d_LIN_SlavePrsnt_LIN3: accessed-variable=VeLINR_d_LIN_SlavePrsnt_LIN3
        COMRXL_PowerPanel2_LED_B_Color_Feedback_PowerPanel2_STAT_Lin3_Received: symbol=ApplLinComAb_LIN3_COMRXL_PowerPanel2_LED_B_Color_Feedback_PowerPanel2_STAT_Lin3_Received  # Received -
          data-receive-point-by-arguments:
            access DRP_Lin3ComRxSignalsSR_COMRXL_PowerPanel2_LED_B_Color_Feedback_PowerPanel2_STAT_Lin3: accessed-variable=Lin3ComRxSignalsSR.COMRXL_PowerPanel2_LED_B_Color_Feedback_PowerPanel2_STAT_Lin3
          data-send-points:
            access DSP_VeLINR_e_PowPan2_LED_B_Col_Fdbk_VeLINR_e_PowPan2_LED_B_Col_Fdbk: accessed-variable=VeLINR_e_PowPan2_LED_B_Col_Fdbk.VeLINR_e_PowPan2_LED_B_Col_Fdbk
            access DSP_VeLINR_b_PowPan2_LED_B_Col_FdbkTO_VeLINR_b_PowPan2_LED_B_Col_FdbkTO: accessed-variable=VeLINR_b_PowPan2_LED_B_Col_FdbkTO.VeLINR_b_PowPan2_LED_B_Col_FdbkTO
        COMRXL_PowerPanel2_LED_B_Color_Feedback_PowerPanel2_STAT_Lin3_Error: symbol=ApplLinComAb_LIN3_COMRXL_PowerPanel2_LED_B_Color_Feedback_PowerPanel2_STAT_Lin3_Error  # Error -
          data-receive-point-by-arguments:
            access DRP_Lin3ComRxSignalsSR_COMRXL_PowerPanel2_LED_B_Color_Feedback_PowerPanel2_STAT_Lin3: accessed-variable=Lin3ComRxSignalsSR.COMRXL_PowerPanel2_LED_B_Color_Feedback_PowerPanel2_STAT_Lin3
          data-send-points:
            access DSP_VeLINR_e_PowPan2_LED_B_Col_Fdbk_VeLINR_e_PowPan2_LED_B_Col_Fdbk: accessed-variable=VeLINR_e_PowPan2_LED_B_Col_Fdbk.VeLINR_e_PowPan2_LED_B_Col_Fdbk
            access DSP_VeLINR_b_PowPan2_LED_B_Col_FdbkTO_VeLINR_b_PowPan2_LED_B_Col_FdbkTO: accessed-variable=VeLINR_b_PowPan2_LED_B_Col_FdbkTO.VeLINR_b_PowPan2_LED_B_Col_FdbkTO
          read-local-variables:
            access IRVRA_VeLINR_d_LIN_SlavePrsnt_LIN3: accessed-variable=VeLINR_d_LIN_SlavePrsnt_LIN3
        COMRXL_PowerPanel2_LIN_Checksum_Error_PowerPanel2_STAT_Lin3_Received: symbol=ApplLinComAb_LIN3_COMRXL_PowerPanel2_LIN_Checksum_Error_PowerPanel2_STAT_Lin3_Received  # Received -
          data-receive-point-by-arguments:
            access DRP_Lin3ComRxSignalsSR_COMRXL_PowerPanel2_LIN_Checksum_Error_PowerPanel2_STAT_Lin3: accessed-variable=Lin3ComRxSignalsSR.COMRXL_PowerPanel2_LIN_Checksum_Error_PowerPanel2_STAT_Lin3
          data-send-points:
            access DSP_VeLINR_b_PowPan2_LIN_Cksm_Err_VeLINR_b_PowPan2_LIN_Cksm_Err: accessed-variable=VeLINR_b_PowPan2_LIN_Cksm_Err.VeLINR_b_PowPan2_LIN_Cksm_Err
            access DSP_VeLINR_b_PowPan2_LIN_Cksm_ErrTO_VeLINR_b_PowPan2_LIN_Cksm_ErrTO: accessed-variable=VeLINR_b_PowPan2_LIN_Cksm_ErrTO.VeLINR_b_PowPan2_LIN_Cksm_ErrTO
        COMRXL_PowerPanel2_LIN_Checksum_Error_PowerPanel2_STAT_Lin3_Error: symbol=ApplLinComAb_LIN3_COMRXL_PowerPanel2_LIN_Checksum_Error_PowerPanel2_STAT_Lin3_Error  # Error -
          data-receive-point-by-arguments:
            access DRP_Lin3ComRxSignalsSR_COMRXL_PowerPanel2_LIN_Checksum_Error_PowerPanel2_STAT_Lin3: accessed-variable=Lin3ComRxSignalsSR.COMRXL_PowerPanel2_LIN_Checksum_Error_PowerPanel2_STAT_Lin3
          data-send-points:
            access DSP_VeLINR_b_PowPan2_LIN_Cksm_Err_VeLINR_b_PowPan2_LIN_Cksm_Err: accessed-variable=VeLINR_b_PowPan2_LIN_Cksm_Err.VeLINR_b_PowPan2_LIN_Cksm_Err
            access DSP_VeLINR_b_PowPan2_LIN_Cksm_ErrTO_VeLINR_b_PowPan2_LIN_Cksm_ErrTO: accessed-variable=VeLINR_b_PowPan2_LIN_Cksm_ErrTO.VeLINR_b_PowPan2_LIN_Cksm_ErrTO
          read-local-variables:
            access IRVRA_VeLINR_d_LIN_SlavePrsnt_LIN3: accessed-variable=VeLINR_d_LIN_SlavePrsnt_LIN3
        COMRXL_PowerPanel2_LIN_Data_Error_PowerPanel2_STAT_Lin3_Received: symbol=ApplLinComAb_LIN3_COMRXL_PowerPanel2_LIN_Data_Error_PowerPanel2_STAT_Lin3_Received  # Received -
          data-receive-point-by-arguments:
            access DRP_Lin3ComRxSignalsSR_COMRXL_PowerPanel2_LIN_Data_Error_PowerPanel2_STAT_Lin3: accessed-variable=Lin3ComRxSignalsSR.COMRXL_PowerPanel2_LIN_Data_Error_PowerPanel2_STAT_Lin3
          data-send-points:
            access DSP_VeLINR_b_PowPan2_LIN_Data_Err_VeLINR_b_PowPan2_LIN_Data_Err: accessed-variable=VeLINR_b_PowPan2_LIN_Data_Err.VeLINR_b_PowPan2_LIN_Data_Err
            access DSP_VeLINR_b_PowPan2_LIN_Data_ErrTO_VeLINR_b_PowPan2_LIN_Data_ErrTO: accessed-variable=VeLINR_b_PowPan2_LIN_Data_ErrTO.VeLINR_b_PowPan2_LIN_Data_ErrTO
        COMRXL_PowerPanel2_LIN_Data_Error_PowerPanel2_STAT_Lin3_Error: symbol=ApplLinComAb_LIN3_COMRXL_PowerPanel2_LIN_Data_Error_PowerPanel2_STAT_Lin3_Error  # Error -
          data-receive-point-by-arguments:
            access DRP_Lin3ComRxSignalsSR_COMRXL_PowerPanel2_LIN_Data_Error_PowerPanel2_STAT_Lin3: accessed-variable=Lin3ComRxSignalsSR.COMRXL_PowerPanel2_LIN_Data_Error_PowerPanel2_STAT_Lin3
          data-send-points:
            access DSP_VeLINR_b_PowPan2_LIN_Data_Err_VeLINR_b_PowPan2_LIN_Data_Err: accessed-variable=VeLINR_b_PowPan2_LIN_Data_Err.VeLINR_b_PowPan2_LIN_Data_Err
            access DSP_VeLINR_b_PowPan2_LIN_Data_ErrTO_VeLINR_b_PowPan2_LIN_Data_ErrTO: accessed-variable=VeLINR_b_PowPan2_LIN_Data_ErrTO.VeLINR_b_PowPan2_LIN_Data_ErrTO
          read-local-variables:
            access IRVRA_VeLINR_d_LIN_SlavePrsnt_LIN3: accessed-variable=VeLINR_d_LIN_SlavePrsnt_LIN3
        COMRXL_PowerPanel2_LIN_Parity_Error_PowerPanel2_STAT_Lin3_Received: symbol=ApplLinComAb_LIN3_COMRXL_PowerPanel2_LIN_Parity_Error_PowerPanel2_STAT_Lin3_Received  # Received -
          data-receive-point-by-arguments:
            access DRP_Lin3ComRxSignalsSR_COMRXL_PowerPanel2_LIN_Parity_Error_PowerPanel2_STAT_Lin3: accessed-variable=Lin3ComRxSignalsSR.COMRXL_PowerPanel2_LIN_Parity_Error_PowerPanel2_STAT_Lin3
          data-send-points:
            access DSP_VeLINR_b_PowPan2_LIN_Parity_Err_VeLINR_b_PowPan2_LIN_Parity_Err: accessed-variable=VeLINR_b_PowPan2_LIN_Parity_Err.VeLINR_b_PowPan2_LIN_Parity_Err
            access DSP_VeLINR_b_PowPan2_LIN_Parity_ErrTO_VeLINR_b_PowPan2_LIN_Parity_ErrTO: accessed-variable=VeLINR_b_PowPan2_LIN_Parity_ErrTO.VeLINR_b_PowPan2_LIN_Parity_ErrTO
        COMRXL_PowerPanel2_LIN_Parity_Error_PowerPanel2_STAT_Lin3_Error: symbol=ApplLinComAb_LIN3_COMRXL_PowerPanel2_LIN_Parity_Error_PowerPanel2_STAT_Lin3_Error  # Error -
          data-receive-point-by-arguments:
            access DRP_Lin3ComRxSignalsSR_COMRXL_PowerPanel2_LIN_Parity_Error_PowerPanel2_STAT_Lin3: accessed-variable=Lin3ComRxSignalsSR.COMRXL_PowerPanel2_LIN_Parity_Error_PowerPanel2_STAT_Lin3
          data-send-points:
            access DSP_VeLINR_b_PowPan2_LIN_Parity_Err_VeLINR_b_PowPan2_LIN_Parity_Err: accessed-variable=VeLINR_b_PowPan2_LIN_Parity_Err.VeLINR_b_PowPan2_LIN_Parity_Err
            access DSP_VeLINR_b_PowPan2_LIN_Parity_ErrTO_VeLINR_b_PowPan2_LIN_Parity_ErrTO: accessed-variable=VeLINR_b_PowPan2_LIN_Parity_ErrTO.VeLINR_b_PowPan2_LIN_Parity_ErrTO
          read-local-variables:
            access IRVRA_VeLINR_d_LIN_SlavePrsnt_LIN3: accessed-variable=VeLINR_d_LIN_SlavePrsnt_LIN3
        COMRXL_PowerPanel2_Gnd_Fault_Detected_PowerPanel2_STAT_Lin3_Received: symbol=ApplLinComAb_LIN3_COMRXL_PowerPanel2_Gnd_Fault_Detected_PowerPanel2_STAT_Lin3_Received  # Received -
          data-receive-point-by-arguments:
            access DRP_Lin3ComRxSignalsSR_COMRXL_PowerPanel2_Gnd_Fault_Detected_PowerPanel2_STAT_Lin3: accessed-variable=Lin3ComRxSignalsSR.COMRXL_PowerPanel2_Gnd_Fault_Detected_PowerPanel2_STAT_Lin3
          data-send-points:
            access DSP_VeLINR_b_PowPan2_Gnd_Fault_Det_VeLINR_b_PowPan2_Gnd_Fault_Det: accessed-variable=VeLINR_b_PowPan2_Gnd_Fault_Det.VeLINR_b_PowPan2_Gnd_Fault_Det
            access DSP_VeLINR_b_PowPan2_Gnd_Fault_DetTO_VeLINR_b_PowPan2_Gnd_Fault_DetTO: accessed-variable=VeLINR_b_PowPan2_Gnd_Fault_DetTO.VeLINR_b_PowPan2_Gnd_Fault_DetTO
        COMRXL_PowerPanel2_Gnd_Fault_Detected_PowerPanel2_STAT_Lin3_Error: symbol=ApplLinComAb_LIN3_COMRXL_PowerPanel2_Gnd_Fault_Detected_PowerPanel2_STAT_Lin3_Error  # Error -
          data-receive-point-by-arguments:
            access DRP_Lin3ComRxSignalsSR_COMRXL_PowerPanel2_Gnd_Fault_Detected_PowerPanel2_STAT_Lin3: accessed-variable=Lin3ComRxSignalsSR.COMRXL_PowerPanel2_Gnd_Fault_Detected_PowerPanel2_STAT_Lin3
          data-send-points:
            access DSP_VeLINR_b_PowPan2_Gnd_Fault_Det_VeLINR_b_PowPan2_Gnd_Fault_Det: accessed-variable=VeLINR_b_PowPan2_Gnd_Fault_Det.VeLINR_b_PowPan2_Gnd_Fault_Det
            access DSP_VeLINR_b_PowPan2_Gnd_Fault_DetTO_VeLINR_b_PowPan2_Gnd_Fault_DetTO: accessed-variable=VeLINR_b_PowPan2_Gnd_Fault_DetTO.VeLINR_b_PowPan2_Gnd_Fault_DetTO
          read-local-variables:
            access IRVRA_VeLINR_d_LIN_SlavePrsnt_LIN3: accessed-variable=VeLINR_d_LIN_SlavePrsnt_LIN3
        SendLINR_PowPan2_LED_A_Col_Comm: can-be-invoked-concurrently=true, symbol=ApplLinComAb_LIN3_SendLINR_PowPan2_LED_A_Col_Comm  # Transmit
          data-receive-point-by-arguments:
            access DRP_SendLINR_PowPan2_LED_A_Col_Comm_SendLINR_PowPan2_LED_A_Col_Comm: accessed-variable=SendLINR_PowPan2_LED_A_Col_Comm.SendLINR_PowPan2_LED_A_Col_Comm
            access DRP_SendLINR_PowPan2_LED_A_Col_CommVld_SendLINR_PowPan2_LED_A_Col_CommVld: accessed-variable=SendLINR_PowPan2_LED_A_Col_CommVld.SendLINR_PowPan2_LED_A_Col_CommVld
          data-send-points:
            access DSP_Lin3ComTxSignalsSR_COMTXL_PowerPanel2_LED_A_Color_Command_PowerPanel2_REQ_Lin3: accessed-variable=Lin3ComTxSignalsSR.COMTXL_PowerPanel2_LED_A_Color_Command_PowerPanel2_REQ_Lin3
        SendLINR_PowPan2_LED_B_Col_Comm: can-be-invoked-concurrently=true, symbol=ApplLinComAb_LIN3_SendLINR_PowPan2_LED_B_Col_Comm  # Transmit
          data-receive-point-by-arguments:
            access DRP_SendLINR_PowPan2_LED_B_Col_Comm_SendLINR_PowPan2_LED_B_Col_Comm: accessed-variable=SendLINR_PowPan2_LED_B_Col_Comm.SendLINR_PowPan2_LED_B_Col_Comm
            access DRP_SendLINR_PowPan2_LED_B_Col_CommVld_SendLINR_PowPan2_LED_B_Col_CommVld: accessed-variable=SendLINR_PowPan2_LED_B_Col_CommVld.SendLINR_PowPan2_LED_B_Col_CommVld
          data-send-points:
            access DSP_Lin3ComTxSignalsSR_COMTXL_PowerPanel2_LED_B_Color_Command_PowerPanel2_REQ_Lin3: accessed-variable=Lin3ComTxSignalsSR.COMTXL_PowerPanel2_LED_B_Color_Command_PowerPanel2_REQ_Lin3
        COMRXL_PowerPanel2_Current_Draw_Sens1_PowerPanel2_STAT_Lin3_Received: symbol=ApplLinComAb_LIN3_COMRXL_PowerPanel2_Current_Draw_Sens1_PowerPanel2_STAT_Lin3_Received  # Received -
          data-receive-point-by-arguments:
            access DRP_Lin3ComRxSignalsSR_COMRXL_PowerPanel2_Current_Draw_Sens1_PowerPanel2_STAT_Lin3: accessed-variable=Lin3ComRxSignalsSR.COMRXL_PowerPanel2_Current_Draw_Sens1_PowerPanel2_STAT_Lin3
          data-send-points:
            access DSP_VeLINR_d_PwrPanel2CurrDrawSens1_VeLINR_d_PwrPanel2CurrDrawSens1: accessed-variable=VeLINR_d_PwrPanel2CurrDrawSens1.VeLINR_d_PwrPanel2CurrDrawSens1
            access DSP_VeLINR_b_PwrPanel2CurrDrawSens1TO_VeLINR_b_PwrPanel2CurrDrawSens1TO: accessed-variable=VeLINR_b_PwrPanel2CurrDrawSens1TO.VeLINR_b_PwrPanel2CurrDrawSens1TO
        COMRXL_PowerPanel2_Current_Draw_Sens1_PowerPanel2_STAT_Lin3_Error: symbol=ApplLinComAb_LIN3_COMRXL_PowerPanel2_Current_Draw_Sens1_PowerPanel2_STAT_Lin3_Error  # Error -
          data-receive-point-by-arguments:
            access DRP_Lin3ComRxSignalsSR_COMRXL_PowerPanel2_Current_Draw_Sens1_PowerPanel2_STAT_Lin3: accessed-variable=Lin3ComRxSignalsSR.COMRXL_PowerPanel2_Current_Draw_Sens1_PowerPanel2_STAT_Lin3
          data-send-points:
            access DSP_VeLINR_d_PwrPanel2CurrDrawSens1_VeLINR_d_PwrPanel2CurrDrawSens1: accessed-variable=VeLINR_d_PwrPanel2CurrDrawSens1.VeLINR_d_PwrPanel2CurrDrawSens1
            access DSP_VeLINR_b_PwrPanel2CurrDrawSens1TO_VeLINR_b_PwrPanel2CurrDrawSens1TO: accessed-variable=VeLINR_b_PwrPanel2CurrDrawSens1TO.VeLINR_b_PwrPanel2CurrDrawSens1TO
          read-local-variables:
            access IRVRA_VeLINR_d_LIN_SlavePrsnt_LIN3: accessed-variable=VeLINR_d_LIN_SlavePrsnt_LIN3
        COMRXL_PowerPanel2_Current_Draw_Sens2_PowerPanel2_STAT_Lin3_Received: symbol=ApplLinComAb_LIN3_COMRXL_PowerPanel2_Current_Draw_Sens2_PowerPanel2_STAT_Lin3_Received  # Received -
          data-receive-point-by-arguments:
            access DRP_Lin3ComRxSignalsSR_COMRXL_PowerPanel2_Current_Draw_Sens2_PowerPanel2_STAT_Lin3: accessed-variable=Lin3ComRxSignalsSR.COMRXL_PowerPanel2_Current_Draw_Sens2_PowerPanel2_STAT_Lin3
          data-send-points:
            access DSP_VeLINR_d_PwrPanel2CurrDrawSens2_VeLINR_d_PwrPanel2CurrDrawSens2: accessed-variable=VeLINR_d_PwrPanel2CurrDrawSens2.VeLINR_d_PwrPanel2CurrDrawSens2
            access DSP_VeLINR_b_PwrPanel2CurrDrawSens2TO_VeLINR_b_PwrPanel2CurrDrawSens2TO: accessed-variable=VeLINR_b_PwrPanel2CurrDrawSens2TO.VeLINR_b_PwrPanel2CurrDrawSens2TO
        COMRXL_PowerPanel2_Current_Draw_Sens2_PowerPanel2_STAT_Lin3_Error: symbol=ApplLinComAb_LIN3_COMRXL_PowerPanel2_Current_Draw_Sens2_PowerPanel2_STAT_Lin3_Error  # Error -
          data-receive-point-by-arguments:
            access DRP_Lin3ComRxSignalsSR_COMRXL_PowerPanel2_Current_Draw_Sens2_PowerPanel2_STAT_Lin3: accessed-variable=Lin3ComRxSignalsSR.COMRXL_PowerPanel2_Current_Draw_Sens2_PowerPanel2_STAT_Lin3
          data-send-points:
            access DSP_VeLINR_d_PwrPanel2CurrDrawSens2_VeLINR_d_PwrPanel2CurrDrawSens2: accessed-variable=VeLINR_d_PwrPanel2CurrDrawSens2.VeLINR_d_PwrPanel2CurrDrawSens2
            access DSP_VeLINR_b_PwrPanel2CurrDrawSens2TO_VeLINR_b_PwrPanel2CurrDrawSens2TO: accessed-variable=VeLINR_b_PwrPanel2CurrDrawSens2TO.VeLINR_b_PwrPanel2CurrDrawSens2TO
          read-local-variables:
            access IRVRA_VeLINR_d_LIN_SlavePrsnt_LIN3: accessed-variable=VeLINR_d_LIN_SlavePrsnt_LIN3
        COMRXL_PowerPanel2_Fault_PowerPanel2_STAT_Lin3_Received: symbol=ApplLinComAb_LIN3_COMRXL_PowerPanel2_Fault_PowerPanel2_STAT_Lin3_Received  # Received -
          data-receive-point-by-arguments:
            access DRP_Lin3ComRxSignalsSR_COMRXL_PowerPanel2_Fault_PowerPanel2_STAT_Lin3: accessed-variable=Lin3ComRxSignalsSR.COMRXL_PowerPanel2_Fault_PowerPanel2_STAT_Lin3
          data-send-points:
            access DSP_VeLINR_e_PowerPanel2_Fault_VeLINR_e_PowerPanel2_Fault: accessed-variable=VeLINR_e_PowerPanel2_Fault.VeLINR_e_PowerPanel2_Fault
            access DSP_VeLINR_b_PowerPanel2_FaultTO_VeLINR_b_PowerPanel2_FaultTO: accessed-variable=VeLINR_b_PowerPanel2_FaultTO.VeLINR_b_PowerPanel2_FaultTO
        COMRXL_PowerPanel2_Fault_PowerPanel2_STAT_Lin3_Error: symbol=ApplLinComAb_LIN3_COMRXL_PowerPanel2_Fault_PowerPanel2_STAT_Lin3_Error  # Error -
          data-receive-point-by-arguments:
            access DRP_Lin3ComRxSignalsSR_COMRXL_PowerPanel2_Fault_PowerPanel2_STAT_Lin3: accessed-variable=Lin3ComRxSignalsSR.COMRXL_PowerPanel2_Fault_PowerPanel2_STAT_Lin3
          data-send-points:
            access DSP_VeLINR_e_PowerPanel2_Fault_VeLINR_e_PowerPanel2_Fault: accessed-variable=VeLINR_e_PowerPanel2_Fault.VeLINR_e_PowerPanel2_Fault
            access DSP_VeLINR_b_PowerPanel2_FaultTO_VeLINR_b_PowerPanel2_FaultTO: accessed-variable=VeLINR_b_PowerPanel2_FaultTO.VeLINR_b_PowerPanel2_FaultTO
          read-local-variables:
            access IRVRA_VeLINR_d_LIN_SlavePrsnt_LIN3: accessed-variable=VeLINR_d_LIN_SlavePrsnt_LIN3
        COMRXL_PowerPanel2_RatedPower_PowerPanel2_STAT_Lin3_Received: symbol=ApplLinComAb_LIN3_COMRXL_PowerPanel2_RatedPower_PowerPanel2_STAT_Lin3_Received  # Received -
          data-receive-point-by-arguments:
            access DRP_Lin3ComRxSignalsSR_COMRXL_PowerPanel2_RatedPower_PowerPanel2_STAT_Lin3: accessed-variable=Lin3ComRxSignalsSR.COMRXL_PowerPanel2_RatedPower_PowerPanel2_STAT_Lin3
          data-send-points:
            access DSP_VeLINR_y_PowerPanel2_RatedPower_VeLINR_y_PowerPanel2_RatedPower: accessed-variable=VeLINR_y_PowerPanel2_RatedPower.VeLINR_y_PowerPanel2_RatedPower
            access DSP_VeLINR_b_PowerPanel2_RatedPowerTO_VeLINR_b_PowerPanel2_RatedPowerTO: accessed-variable=VeLINR_b_PowerPanel2_RatedPowerTO.VeLINR_b_PowerPanel2_RatedPowerTO
        COMRXL_PowerPanel2_RatedPower_PowerPanel2_STAT_Lin3_Error: symbol=ApplLinComAb_LIN3_COMRXL_PowerPanel2_RatedPower_PowerPanel2_STAT_Lin3_Error  # Error -
          data-receive-point-by-arguments:
            access DRP_Lin3ComRxSignalsSR_COMRXL_PowerPanel2_RatedPower_PowerPanel2_STAT_Lin3: accessed-variable=Lin3ComRxSignalsSR.COMRXL_PowerPanel2_RatedPower_PowerPanel2_STAT_Lin3
          data-send-points:
            access DSP_VeLINR_y_PowerPanel2_RatedPower_VeLINR_y_PowerPanel2_RatedPower: accessed-variable=VeLINR_y_PowerPanel2_RatedPower.VeLINR_y_PowerPanel2_RatedPower
            access DSP_VeLINR_b_PowerPanel2_RatedPowerTO_VeLINR_b_PowerPanel2_RatedPowerTO: accessed-variable=VeLINR_b_PowerPanel2_RatedPowerTO.VeLINR_b_PowerPanel2_RatedPowerTO
          read-local-variables:
            access IRVRA_VeLINR_d_LIN_SlavePrsnt_LIN3: accessed-variable=VeLINR_d_LIN_SlavePrsnt_LIN3
package /STLASWCs/ComSwCpts/ComDataDefinition/ComConstSpec
  180 x constant specification:
    COMRXL_AGS_BoostStat_AGS_ECM_STATUS_Lin3_Init: value-spec=Value:0
    COMRXL_AGS_CalActv_AGS_ECM_STATUS_Lin3_Init: value-spec=Value:0
    COMRXL_AGS_CalStat_AGS_ECM_STATUS_Lin3_Init: value-spec=Value:0
    COMRXL_AGS_CurrPos_AGS_ECM_STATUS_Lin3_Init: value-spec=Value:0
    COMRXL_AGS_ErrLIN_AGS_ECM_STATUS_Lin3_Init: value-spec=Value:0
    COMRXL_AGS_ErrMechBreak_AGS_ECM_STATUS_Lin3_Init: value-spec=Value:0
    COMRXL_AGS_ErrMechStuck_AGS_ECM_STATUS_Lin3_Init: value-spec=Value:0
    COMRXL_AGS_ErrOvrTemp_AGS_ECM_STATUS_Lin3_Init: value-spec=Value:0
    COMRXL_AGS_ErrOvrVolt_AGS_ECM_STATUS_Lin3_Init: value-spec=Value:0
    COMRXL_AGS_ErrUnVolt_AGS_ECM_STATUS_Lin3_Init: value-spec=Value:0
    COMRXL_Ambient_Temp_CPIM_HCP_FEEDBACK_Lin3_Init: value-spec=Value:0
    COMRXL_Below_60V_HVCHLIN18Fr01_Lin3_Init: value-spec=Value:3
    COMRXL_CEXV_Board_Temp_CEXV_STAT_Lin3_Init: value-spec=Value:0
    COMRXL_CEXV_CalRq_CEXV_STAT_Lin3_Init: value-spec=Value:0
    COMRXL_CEXV_CalStat_CEXV_STAT_Lin3_Init: value-spec=Value:0
    COMRXL_CEXV_ERR_CEXV_STAT_Lin3_Init: value-spec=Value:0
    COMRXL_CEXV_PosAct_CEXV_STAT_Lin3_Init: value-spec=Value:0
    COMRXL_CEXV_Refrigerant_Pressure_CEXV_STAT_Lin3_Init: value-spec=Value:16383
    COMRXL_CEXV_Refrigerant_Temp_CEXV_STAT_Lin3_Init: value-spec=Value:0
    COMRXL_CEXV_Sts_CEXV_STAT_Lin3_Init: value-spec=Value:0
    COMRXL_CEXV_SupplyVolt_CEXV_STAT_Lin3_Init: value-spec=Value:0
    COMRXL_CPIM_IND1_FailSts_CPIM_HCP_FEEDBACK_Lin3_Init: value-spec=Value:0
    COMRXL_CPIM_IND1_Fdbk_CPIM_HCP_FEEDBACK_Lin3_Init: value-spec=Value:0
    COMRXL_CPIM_IND2_FailSts_CPIM_HCP_FEEDBACK_Lin3_Init: value-spec=Value:0
    COMRXL_CPIM_IND2_Fdbk_CPIM_HCP_FEEDBACK_Lin3_Init: value-spec=Value:0
    COMRXL_CPIM_IND3_FailSts_CPIM_HCP_FEEDBACK_Lin3_Init: value-spec=Value:0
    COMRXL_CPIM_IND3_Fdbk_CPIM_HCP_FEEDBACK_Lin3_Init: value-spec=Value:0
    COMRXL_CPIM_IND4_FailSts_CPIM_HCP_FEEDBACK_Lin3_Init: value-spec=Value:0
    COMRXL_CPIM_IND4_Fdbk_CPIM_HCP_FEEDBACK_Lin3_Init: value-spec=Value:0
    COMRXL_CPIM_IND5_FailSts_CPIM_HCP_FEEDBACK_Lin3_Init: value-spec=Value:0
    COMRXL_CPIM_IND5_Fdbk_CPIM_HCP_FEEDBACK_Lin3_Init: value-spec=Value:0
    COMRXL_CPIM_IND_Color_Fdbk_CPIM_HCP_FEEDBACK_Lin3_Init: value-spec=Value:0
    COMRXL_CPIM_LIN_Checksum_Error_CPIM_HCP_FEEDBACK_Lin3_Init: value-spec=Value:0
    COMRXL_CPIM_LIN_Data_Error_CPIM_HCP_FEEDBACK_Lin3_Init: value-spec=Value:0
    COMRXL_CPIM_LIN_Parity_Error_CPIM_HCP_FEEDBACK_Lin3_Init: value-spec=Value:0
    COMRXL_CPIM_Over_Temperature_CPIM_HCP_FEEDBACK_Lin3_Init: value-spec=Value:0
    COMRXL_CPIM_Undervoltage_CPIM_HCP_FEEDBACK_Lin3_Init: value-spec=Value:0
    COMRXL_ChrgPortButton_Sts_CPIM_HCP_FEEDBACK_Lin3_Init: value-spec=Value:0
    COMRXL_ChrgPortDoor_Sts_CPIM_HCP_FEEDBACK_Lin3_Init: value-spec=Value:0
    COMRXL_ChrgPortLock_FailSts_CPIM_HCP_FEEDBACK_Lin3_Init: value-spec=Value:0
    COMRXL_ChrgPortLock_Sts_CPIM_HCP_FEEDBACK_Lin3_Init: value-spec=Value:0
    COMRXL_Chrg_Inlet_Temp_CPIM_HCP_FEEDBACK_Lin3_Init: value-spec=Value:0
    COMRXL_ECH_InterlockStat_HVCHLIN18Fr01_Lin3_Init: value-spec=Value:0
    COMRXL_EOPB_CURR_EOPB_STAT_Lin3_Init: value-spec=Value:255
    COMRXL_EOPB_DR_RN_ER_EOPB_STAT_Lin3_Init: value-spec=Value:3
    COMRXL_EOPB_HW_VER_EOPB_VER_Lin3_Init: value-spec=Value:255
    COMRXL_EOPB_LMP_HM_AN_ON_EOPB_STAT_Lin3_Init: value-spec=Value:3
    COMRXL_EOPB_LOW_TMP_STAT_EOPB_STAT_Lin3_Init: value-spec=Value:3
    COMRXL_EOPB_MONTRNG_RPM_EOPB_STAT_Lin3_Init: value-spec=Value:3
    COMRXL_EOPB_OIL_TEMP_EOPB_STAT2_Lin3_Init: value-spec=Value:255
    COMRXL_EOPB_OV_CUR_ER_EOPB_STAT_Lin3_Init: value-spec=Value:3
    COMRXL_EOPB_OV_TMP_ER_EOPB_STAT_Lin3_Init: value-spec=Value:3
    COMRXL_EOPB_POST_RUN_STAT_EOPB_STAT_Lin3_Init: value-spec=Value:7
    COMRXL_EOPB_RPM_ACTL_EOPB_STAT_Lin3_Init: value-spec=Value:255
    COMRXL_EOPB_RPM_TGT_EOPB_STAT_Lin3_Init: value-spec=Value:255
    COMRXL_EOPB_SW_VER_EOPB_VER_Lin3_Init: value-spec=Value:255
    COMRXL_EOPB_Stall_Event_EOPB_STAT_Lin3_Init: value-spec=Value:3
    COMRXL_EOPB_TEMP_EOPB_STAT_Lin3_Init: value-spec=Value:255
    COMRXL_EOPB_VLTG_EOPB_STAT_Lin3_Init: value-spec=Value:255
    COMRXL_EOPB_VLTG_ER_EOPB_STAT_Lin3_Init: value-spec=Value:3
    COMRXL_HTLBV_CalStat_HTLBV_STAT_Lin3_Init: value-spec=Value:0
    COMRXL_HTLBV_ERR_HTLBV_STAT_Lin3_Init: value-spec=Value:0
    COMRXL_HTLBV_MotorVolt_HTLBV_STAT_Lin3_Init: value-spec=Value:0
    COMRXL_HTLBV_PosAct_HTLBV_STAT_Lin3_Init: value-spec=Value:0
    COMRXL_HTLBV_Sts_HTLBV_STAT_Lin3_Init: value-spec=Value:0
    COMRXL_HVH_UnlockCounter_HVCHLIN18Fr01_Lin3_Init: value-spec=Value:0
    COMRXL_HvCooltHVmeas_HVCHLIN18Fr01_Lin3_Init: value-spec=Value:1023
    COMRXL_HvCooltHeatrICns_HVCHLIN18Fr01_Lin3_Init: value-spec=Value:255
    COMRXL_HvCooltHeatrProtnOfSelfTmpHwProtn_HVCHLIN18Fr02_Lin3_Init: value-spec=Value:3
    COMRXL_HvCooltHeatrProtnOfSelfTmpOvrheatg_HVCHLIN18Fr02_Lin3_Init: value-spec=Value:3
    COMRXL_HvCooltHeatrSnsrFltCooltTInSnsrFlt_HVCHLIN18Fr02_Lin3_Init: value-spec=Value:3
    COMRXL_HvCooltHeatrSnsrFltCooltTOutSnsrFlt_HVCHLIN18Fr02_Lin3_Init: value-spec=Value:3
    COMRXL_HvCooltHeatrSnsrFltTInMtrlSnsrFlt_HVCHLIN18Fr02_Lin3_Init: value-spec=Value:3
    COMRXL_HvCooltHeatrSrvRqrdCircForDrvrShoOrOpen_HVCHLIN18Fr02_Lin3_Init: value-spec=Value:3
    COMRXL_HvCooltHeatrSrvRqrdICnsOutOfRng_HVCHLIN18Fr02_Lin3_Init: value-spec=Value:3
    COMRXL_HvCooltHeatrSrvRqrdMemErr_HVCHLIN18Fr02_Lin3_Init: value-spec=Value:3
    COMRXL_HvCooltHeatrSrvRqrdSrvRqrd_HVCHLIN18Fr02_Lin3_Init: value-spec=Value:3
    COMRXL_HvCooltHeatrSts_HVCHLIN18Fr01_Lin3_Init: value-spec=Value:0
    COMRXL_HvCooltHeatrWarnCooltTOutOfRng_HVCHLIN18Fr02_Lin3_Init: value-spec=Value:3
    COMRXL_HvCooltHeatrWarnFltInCom_HVCHLIN18Fr02_Lin3_Init: value-spec=Value:3
    COMRXL_HvCooltHeatrWarnHvOutOfRng_HVCHLIN18Fr02_Lin3_Init: value-spec=Value:3
    COMRXL_HvCooltHeatrWarnULoOutOfRng_HVCHLIN18Fr02_Lin3_Init: value-spec=Value:3
    COMRXL_HvCooltWtrHeatrWtrTInIntk_HVCHLIN18Fr01_Lin3_Init: value-spec=Value:255
    COMRXL_HvHeatrPwrCnsDes_HVCHLIN18Fr01_Lin3_Init: value-spec=Value:1023
    COMRXL_HvHeatrPwrCns_HVCHLIN18Fr01_Lin3_Init: value-spec=Value:1023
    COMRXL_HvWtrHeatrWtrT_HVCHLIN18Fr01_Lin3_Init: value-spec=Value:255
    COMRXL_Icon1_FailSts_CPIM_HCP_FEEDBACK_Lin3_Init: value-spec=Value:0
    COMRXL_Icon1_Sts_CPIM_HCP_FEEDBACK_Lin3_Init: value-spec=Value:0
    COMRXL_Icon2_FailSts_CPIM_HCP_FEEDBACK_Lin3_Init: value-spec=Value:0
    COMRXL_Icon2_Sts_CPIM_HCP_FEEDBACK_Lin3_Init: value-spec=Value:0
    COMRXL_Inlet_Temp1_DC_CPIM_HCP_FEEDBACK2_Lin3_Init: value-spec=Value:0
    COMRXL_Inlet_Temp2_DC_CPIM_HCP_FEEDBACK2_Lin3_Init: value-spec=Value:0
    COMRXL_PECP2_AIR_PRE_ERR_PECP2_STAT_GLOBAL_Lin3_Init: value-spec=Value:3
    COMRXL_PECP2_CURR_PECP2_STAT_GLOBAL_Lin3_Init: value-spec=Value:255
    COMRXL_PECP2_DBLK_ACTV_PECP2_STAT_GLOBAL_Lin3_Init: value-spec=Value:3
    COMRXL_PECP2_DR_RN_ERR_PECP2_STAT_GLOBAL_Lin3_Init: value-spec=Value:3
    COMRXL_PECP2_FL_SAFE_ACTVTD_PECP2_STAT_GLOBAL_Lin3_Init: value-spec=Value:3
    COMRXL_PECP2_LMP_HM_AN_ON_PECP2_STAT_GLOBAL_Lin3_Init: value-spec=Value:3
    COMRXL_PECP2_MONTRNG_RPM_PECP2_STAT_GLOBAL_Lin3_Init: value-spec=Value:3
    COMRXL_PECP2_NODE_ERR_PECP2_STAT_GLOBAL_Lin3_Init: value-spec=Value:3
    COMRXL_PECP2_OVR_CUR_ERR_PECP2_STAT_GLOBAL_Lin3_Init: value-spec=Value:3
    COMRXL_PECP2_OVR_TMP_ERR_PECP2_STAT_GLOBAL_Lin3_Init: value-spec=Value:3
    COMRXL_PECP2_POST_RUN_STAT_PECP2_STAT_GLOBAL_Lin3_Init: value-spec=Value:7
    COMRXL_PECP2_RPM_ACTL_PERCT_PECP2_STAT_GLOBAL_Lin3_Init: value-spec=Value:255
    COMRXL_PECP2_RPM_TGT_PERCT_PECP2_STAT_GLOBAL_Lin3_Init: value-spec=Value:255
    COMRXL_PECP2_SUPPLIER_PECP2_VER_Lin3_Init: value-spec=Value:0
    COMRXL_PECP2_TEMP_PECP2_STAT_GLOBAL_Lin3_Init: value-spec=Value:255
    COMRXL_PECP2_VERSION_PECP2_VER_Lin3_Init: value-spec=Value:255
    COMRXL_PECP2_VLTG_ERR_PECP2_STAT_GLOBAL_Lin3_Init: value-spec=Value:3
    COMRXL_PECP2_VLTG_PECP2_STAT_GLOBAL_Lin3_Init: value-spec=Value:255
    COMRXL_PowerPanel2_AC_Present_Sens1_PowerPanel2_STAT_Lin3_Init: value-spec=Value:0
    COMRXL_PowerPanel2_AC_Present_Sens2_PowerPanel2_STAT_Lin3_Init: value-spec=Value:0
    COMRXL_PowerPanel2_Button_State_PowerPanel2_STAT_Lin3_Init: value-spec=Value:0
    COMRXL_PowerPanel2_Current_Draw_Sens1_PowerPanel2_STAT_Lin3_Init: value-spec=Value:0
    COMRXL_PowerPanel2_Current_Draw_Sens2_PowerPanel2_STAT_Lin3_Init: value-spec=Value:0
    COMRXL_PowerPanel2_Fault_PowerPanel2_STAT_Lin3_Init: value-spec=Value:0
    COMRXL_PowerPanel2_Fault_Reason_PowerPanel2_STAT_Lin3_Init: value-spec=Value:0
    COMRXL_PowerPanel2_Gnd_Fault_Detected_PowerPanel2_STAT_Lin3_Init: value-spec=Value:0
    COMRXL_PowerPanel2_LED_A_Color_Feedback_PowerPanel2_STAT_Lin3_Init: value-spec=Value:0
    COMRXL_PowerPanel2_LED_A_FailStatus_PowerPanel2_STAT_Lin3_Init: value-spec=Value:0
    COMRXL_PowerPanel2_LED_A_Feedback_PowerPanel2_STAT_Lin3_Init: value-spec=Value:0
    COMRXL_PowerPanel2_LED_B_Color_Feedback_PowerPanel2_STAT_Lin3_Init: value-spec=Value:0
    COMRXL_PowerPanel2_LED_B_FailStatus_PowerPanel2_STAT_Lin3_Init: value-spec=Value:0
    COMRXL_PowerPanel2_LED_B_Feedback_PowerPanel2_STAT_Lin3_Init: value-spec=Value:0
    COMRXL_PowerPanel2_LIN_Checksum_Error_PowerPanel2_STAT_Lin3_Init: value-spec=Value:0
    COMRXL_PowerPanel2_LIN_Data_Error_PowerPanel2_STAT_Lin3_Init: value-spec=Value:0
    COMRXL_PowerPanel2_LIN_Parity_Error_PowerPanel2_STAT_Lin3_Init: value-spec=Value:0
    COMRXL_PowerPanel2_Lid_Switch_Sts_120A_PowerPanel2_STAT_Lin3_Init: value-spec=Value:0
    COMRXL_PowerPanel2_Lid_Switch_Sts_120B_PowerPanel2_STAT_Lin3_Init: value-spec=Value:0
    COMRXL_PowerPanel2_Lid_Switch_Sts_240_PowerPanel2_STAT_Lin3_Init: value-spec=Value:0
    COMRXL_PowerPanel2_RatedPower_PowerPanel2_STAT_Lin3_Init: value-spec=Value:0
    COMRXL_ResponseErrorStsCPIM_CPIM_HCP_FEEDBACK_Lin3_Init: value-spec=Value:0
    COMRXL_RsErr_AGS_AGS_ECM_STATUS_Lin3_Init: value-spec=Value:0
    COMRXL_RsErr_CEXV_CEXV_STAT_Lin3_Init: value-spec=Value:0
    COMRXL_RsErr_ECH_HVCHLIN18Fr02_Lin3_Init: value-spec=Value:0
    COMRXL_RsErr_EOPB_EOPB_STAT_Lin3_Init: value-spec=Value:0
    COMRXL_RsErr_HTLBV_HTLBV_STAT_Lin3_Init: value-spec=Value:0
    COMRXL_RsErr_PECP2_PUMP_PECP2_STAT_GLOBAL_Lin3_Init: value-spec=Value:0
    COMRXL_RsErr_SPP2_PowerPanel2_STAT_Lin3_Init: value-spec=Value:0
    COMRXL_S2MRes1Bit_AGS_ECM_STATUS_Lin3_Init: value-spec=Value:0
    COMRXL_S2MResByte1_AGS_ECM_STATUS_Lin3_Init: value-spec=Value:0
    COMRXL_S2MResByte2_AGS_ECM_STATUS_Lin3_Init: value-spec=Value:0
    COMTXL_AGS_BoostRq_ECM_AGS_DEMAND_Lin3_Init: value-spec=0
    COMTXL_AGS_CalRq_ECM_AGS_DEMAND_Lin3_Init: value-spec=0
    COMTXL_AGS_PosRq_ECM_AGS_DEMAND_Lin3_Init: value-spec=0
    COMTXL_Backlight_Cmd_HCP_CPIM_COMMAND_Lin3_Init: value-spec=0
    COMTXL_CEXV_CalCmd_CEXV_REQ_Lin3_Init: value-spec=0
    COMTXL_CEXV_PosRq_CEXV_REQ_Lin3_Init: value-spec=0
    COMTXL_CPIM_Blink_Rate_HCP_CPIM_COMMAND_Lin3_Init: value-spec=0
    COMTXL_CPIM_IND_Color_HCP_CPIM_COMMAND_Lin3_Init: value-spec=0
    COMTXL_CPIM_SET_IND{1..5}_HCP_CPIM_COMMAND_Lin3_Init: value-spec=0
    COMTXL_ChrgPortLock_Cmd_HCP_CPIM_COMMAND_Lin3_Init: value-spec=0
    COMTXL_DAY_LGT_MD_CPIM_HCP_CPIM_COMMAND_Lin3_Init: value-spec=0
    COMTXL_DAY_LGT_MD_PowerPanel2_PowerPanel2_REQ_Lin3_Init: value-spec=0
    COMTXL_EOPB_POST_RUN_COM_EOPB_REQ_Lin3_Init: value-spec=7
    COMTXL_EOPB_RPM_COM_EOPB_REQ_Lin3_Init: value-spec=255
    COMTXL_HTLBV_CalRq_HTLBV_REQ_Lin3_Init: value-spec=0
    COMTXL_HTLBV_PosRq_HTLBV_REQ_Lin3_Init: value-spec=0
    COMTXL_HTLBV_PosSv_HTLBV_REQ_Lin3_Init: value-spec=0
    COMTXL_HVH_OverheatUnlock_CCMLIN18Fr02_Lin3_Init: value-spec=0
    COMTXL_HvCooltHeatrEnad_CCMLIN18Fr02_Lin3_Init: value-spec=0
    COMTXL_HvWtrHeatrPwrCnsAllwd_CCMLIN18Fr02_Lin3_Init: value-spec=255
    COMTXL_HvWtrHeatrWtrTDes_CCMLIN18Fr02_Lin3_Init: value-spec=255
    COMTXL_M2SRes2Bit_ECM_AGS_DEMAND_Lin3_Init: value-spec=0
    COMTXL_M2SResByte{1..3}_ECM_AGS_DEMAND_Lin3_Init: value-spec=0
    COMTXL_PECP2_FL_SAFE_ACTVT_PECP2_REQ_GLOBAL_Lin3_Init: value-spec=3
    COMTXL_PECP2_POST_RUN_REQ_PECP2_REQ_GLOBAL_Lin3_Init: value-spec=7
    COMTXL_PECP2_RPM_REQ_PERCT_PECP2_REQ_GLOBAL_Lin3_Init: value-spec=255
    COMTXL_PowerPanel2_LED_A_Color_Command_PowerPanel2_REQ_Lin3_Init: value-spec=0
    COMTXL_PowerPanel2_LED_A_Command_PowerPanel2_REQ_Lin3_Init: value-spec=0
    COMTXL_PowerPanel2_LED_B_Color_Command_PowerPanel2_REQ_Lin3_Init: value-spec=0
    COMTXL_PowerPanel2_LED_B_Command_PowerPanel2_REQ_Lin3_Init: value-spec=0
    COMTXL_Set_Icon1_cmd_HCP_CPIM_COMMAND_Lin3_Init: value-spec=0
    COMTXL_Set_Icon2_cmd_HCP_CPIM_COMMAND_Lin3_Init: value-spec=0
package /STLASWCs/ComSwCpts/ComDataDefinition/ComImpDataType
  180 x impl type, all with category=TYPE_REFERENCE:
    IDTSAGS_BoostRq_ECM_AGS_DEMAND_Lin3: implementation-data-type=boolean
    IDTSAGS_BoostStat_AGS_ECM_STATUS_Lin3: implementation-data-type=boolean
    IDTSAGS_CalActv_AGS_ECM_STATUS_Lin3: implementation-data-type=boolean
    IDTSAGS_CalRq_ECM_AGS_DEMAND_Lin3: implementation-data-type=boolean
    IDTSAGS_CalStat_AGS_ECM_STATUS_Lin3: implementation-data-type=boolean
    IDTSAGS_CurrPos_AGS_ECM_STATUS_Lin3: implementation-data-type=uint8, invalid-value=Value:15
    IDTSAGS_ErrLIN_AGS_ECM_STATUS_Lin3: implementation-data-type=uint8, invalid-value=Value:3
    IDTSAGS_ErrMechBreak_AGS_ECM_STATUS_Lin3: implementation-data-type=boolean
    IDTSAGS_ErrMechStuck_AGS_ECM_STATUS_Lin3: implementation-data-type=boolean
    IDTSAGS_ErrOvrTemp_AGS_ECM_STATUS_Lin3: implementation-data-type=boolean
    IDTSAGS_ErrOvrVolt_AGS_ECM_STATUS_Lin3: implementation-data-type=boolean
    IDTSAGS_ErrUnVolt_AGS_ECM_STATUS_Lin3: implementation-data-type=boolean
    IDTSAGS_PosRq_ECM_AGS_DEMAND_Lin3: implementation-data-type=uint8, invalid-value=Value:15
    IDTSAmbient_Temp_CPIM_HCP_FEEDBACK_Lin3: implementation-data-type=uint8, invalid-value=Value:255
    IDTSBacklight_Cmd_HCP_CPIM_COMMAND_Lin3: implementation-data-type=boolean
    IDTSBelow_60V_HVCHLIN18Fr01_Lin3: implementation-data-type=uint8, invalid-value=Value:3
    IDTSCEXV_Board_Temp_CEXV_STAT_Lin3: implementation-data-type=uint8, invalid-value=Value:255
    IDTSCEXV_CalCmd_CEXV_REQ_Lin3: implementation-data-type=uint8
    IDTSCEXV_CalRq_CEXV_STAT_Lin3: implementation-data-type=boolean
    IDTSCEXV_CalStat_CEXV_STAT_Lin3: implementation-data-type=uint8, invalid-value=Value:3
    IDTSCEXV_ERR_CEXV_STAT_Lin3: implementation-data-type=uint8, invalid-value=Value:15
    IDTSCEXV_PosAct_CEXV_STAT_Lin3: implementation-data-type=uint16, invalid-value=Value:1023
    IDTSCEXV_PosRq_CEXV_REQ_Lin3: implementation-data-type=uint16, invalid-value=Value:1023
    IDTSCEXV_Refrigerant_Pressure_CEXV_STAT_Lin3: implementation-data-type=uint16, invalid-value=Value:16383
    IDTSCEXV_Refrigerant_Temp_CEXV_STAT_Lin3: implementation-data-type=uint16, invalid-value=Value:2047
    IDTSCEXV_Sts_CEXV_STAT_Lin3: implementation-data-type=uint8, invalid-value=Value:3
    IDTSCEXV_SupplyVolt_CEXV_STAT_Lin3: implementation-data-type=uint8, invalid-value=Value:255
    IDTSCPIM_Blink_Rate_HCP_CPIM_COMMAND_Lin3: implementation-data-type=uint8, invalid-value=Value:7
    IDTSCPIM_IND1_FailSts_CPIM_HCP_FEEDBACK_Lin3: implementation-data-type=uint8
    IDTSCPIM_IND1_Fdbk_CPIM_HCP_FEEDBACK_Lin3: implementation-data-type=uint8, invalid-value=Value:3
    IDTSCPIM_IND2_FailSts_CPIM_HCP_FEEDBACK_Lin3: implementation-data-type=uint8
    IDTSCPIM_IND2_Fdbk_CPIM_HCP_FEEDBACK_Lin3: implementation-data-type=uint8, invalid-value=Value:3
    IDTSCPIM_IND3_FailSts_CPIM_HCP_FEEDBACK_Lin3: implementation-data-type=uint8
    IDTSCPIM_IND3_Fdbk_CPIM_HCP_FEEDBACK_Lin3: implementation-data-type=uint8, invalid-value=Value:3
    IDTSCPIM_IND4_FailSts_CPIM_HCP_FEEDBACK_Lin3: implementation-data-type=uint8
    IDTSCPIM_IND4_Fdbk_CPIM_HCP_FEEDBACK_Lin3: implementation-data-type=uint8, invalid-value=Value:3
    IDTSCPIM_IND5_FailSts_CPIM_HCP_FEEDBACK_Lin3: implementation-data-type=uint8
    IDTSCPIM_IND5_Fdbk_CPIM_HCP_FEEDBACK_Lin3: implementation-data-type=uint8, invalid-value=Value:3
    IDTSCPIM_IND_Color_Fdbk_CPIM_HCP_FEEDBACK_Lin3: implementation-data-type=uint8, invalid-value=Value:7
    IDTSCPIM_IND_Color_HCP_CPIM_COMMAND_Lin3: implementation-data-type=uint8, invalid-value=Value:7
    IDTSCPIM_LIN_Checksum_Error_CPIM_HCP_FEEDBACK_Lin3: implementation-data-type=boolean
    IDTSCPIM_LIN_Data_Error_CPIM_HCP_FEEDBACK_Lin3: implementation-data-type=boolean
    IDTSCPIM_LIN_Parity_Error_CPIM_HCP_FEEDBACK_Lin3: implementation-data-type=boolean
    IDTSCPIM_Over_Temperature_CPIM_HCP_FEEDBACK_Lin3: implementation-data-type=boolean
    IDTSCPIM_SET_IND{1..5}_HCP_CPIM_COMMAND_Lin3: implementation-data-type=uint8, invalid-value=Value:3
    IDTSCPIM_Undervoltage_CPIM_HCP_FEEDBACK_Lin3: implementation-data-type=boolean
    IDTSChrgPortButton_Sts_CPIM_HCP_FEEDBACK_Lin3: implementation-data-type=boolean
    IDTSChrgPortDoor_Sts_CPIM_HCP_FEEDBACK_Lin3: implementation-data-type=uint8, invalid-value=Value:3
    IDTSChrgPortLock_Cmd_HCP_CPIM_COMMAND_Lin3: implementation-data-type=uint8, invalid-value=Value:3
    IDTSChrgPortLock_FailSts_CPIM_HCP_FEEDBACK_Lin3: implementation-data-type=uint8, invalid-value=Value:3
    IDTSChrgPortLock_Sts_CPIM_HCP_FEEDBACK_Lin3: implementation-data-type=boolean
    IDTSChrg_Inlet_Temp_CPIM_HCP_FEEDBACK_Lin3: implementation-data-type=uint8, invalid-value=Value:255
    IDTSDAY_LGT_MD_CPIM_HCP_CPIM_COMMAND_Lin3: implementation-data-type=boolean
    IDTSDAY_LGT_MD_PowerPanel2_PowerPanel2_REQ_Lin3: implementation-data-type=boolean
    IDTSECH_InterlockStat_HVCHLIN18Fr01_Lin3: implementation-data-type=uint8
    IDTSEOPB_CURR_EOPB_STAT_Lin3: implementation-data-type=uint8, invalid-value=Value:255
    IDTSEOPB_DR_RN_ER_EOPB_STAT_Lin3: implementation-data-type=uint8, invalid-value=Value:3
    IDTSEOPB_HW_VER_EOPB_VER_Lin3: implementation-data-type=uint8, invalid-value=Value:255
    IDTSEOPB_LMP_HM_AN_ON_EOPB_STAT_Lin3: implementation-data-type=uint8, invalid-value=Value:3
    IDTSEOPB_LOW_TMP_STAT_EOPB_STAT_Lin3: implementation-data-type=uint8, invalid-value=Value:3
    IDTSEOPB_MONTRNG_RPM_EOPB_STAT_Lin3: implementation-data-type=uint8, invalid-value=Value:3
    IDTSEOPB_OIL_TEMP_EOPB_STAT2_Lin3: implementation-data-type=uint8, invalid-value=Value:255
    IDTSEOPB_OV_CUR_ER_EOPB_STAT_Lin3: implementation-data-type=uint8, invalid-value=Value:3
    IDTSEOPB_OV_TMP_ER_EOPB_STAT_Lin3: implementation-data-type=uint8, invalid-value=Value:3
    IDTSEOPB_POST_RUN_COM_EOPB_REQ_Lin3: implementation-data-type=uint8, invalid-value=Value:7
    IDTSEOPB_POST_RUN_STAT_EOPB_STAT_Lin3: implementation-data-type=uint8, invalid-value=Value:7
    IDTSEOPB_RPM_ACTL_EOPB_STAT_Lin3: implementation-data-type=uint8, invalid-value=Value:255
    IDTSEOPB_RPM_COM_EOPB_REQ_Lin3: implementation-data-type=uint8, invalid-value=Value:255
    IDTSEOPB_RPM_TGT_EOPB_STAT_Lin3: implementation-data-type=uint8, invalid-value=Value:255
    IDTSEOPB_SW_VER_EOPB_VER_Lin3: implementation-data-type=uint8, invalid-value=Value:255
    IDTSEOPB_Stall_Event_EOPB_STAT_Lin3: implementation-data-type=uint8, invalid-value=Value:3
    IDTSEOPB_TEMP_EOPB_STAT_Lin3: implementation-data-type=uint8, invalid-value=Value:255
    IDTSEOPB_VLTG_EOPB_STAT_Lin3: implementation-data-type=uint8, invalid-value=Value:255
    IDTSEOPB_VLTG_ER_EOPB_STAT_Lin3: implementation-data-type=uint8, invalid-value=Value:3
    IDTSHTLBV_CalRq_HTLBV_REQ_Lin3: implementation-data-type=uint8
    IDTSHTLBV_CalStat_HTLBV_STAT_Lin3: implementation-data-type=uint8
    IDTSHTLBV_ERR_HTLBV_STAT_Lin3: implementation-data-type=uint8, invalid-value=Value:128
    IDTSHTLBV_MotorVolt_HTLBV_STAT_Lin3: implementation-data-type=uint8, invalid-value=Value:255
    IDTSHTLBV_PosAct_HTLBV_STAT_Lin3: implementation-data-type=uint8, invalid-value=Value:255
    IDTSHTLBV_PosRq_HTLBV_REQ_Lin3: implementation-data-type=uint8, invalid-value=Value:255
    IDTSHTLBV_PosSv_HTLBV_REQ_Lin3: implementation-data-type=boolean
    IDTSHTLBV_Sts_HTLBV_STAT_Lin3: implementation-data-type=uint8, invalid-value=Value:3
    IDTSHVH_OverheatUnlock_CCMLIN18Fr02_Lin3: implementation-data-type=boolean
    IDTSHVH_UnlockCounter_HVCHLIN18Fr01_Lin3: implementation-data-type=uint8, invalid-value=Value:3
    IDTSHvCooltHVmeas_HVCHLIN18Fr01_Lin3: implementation-data-type=uint16, invalid-value=Value:1023
    IDTSHvCooltHeatrEnad_CCMLIN18Fr02_Lin3: implementation-data-type=boolean
    IDTSHvCooltHeatrICns_HVCHLIN18Fr01_Lin3: implementation-data-type=uint8, invalid-value=Value:255
    IDTSHvCooltHeatrProtnOfSelfTmpHwProtn_HVCHLIN18Fr02_Lin3: implementation-data-type=uint8, invalid-value=Value:3
    IDTSHvCooltHeatrProtnOfSelfTmpOvrheatg_HVCHLIN18Fr02_Lin3: implementation-data-type=uint8, invalid-value=Value:3
    IDTSHvCooltHeatrSnsrFltCooltTInSnsrFlt_HVCHLIN18Fr02_Lin3: implementation-data-type=uint8, invalid-value=Value:3
    IDTSHvCooltHeatrSnsrFltCooltTOutSnsrFlt_HVCHLIN18Fr02_Lin3: implementation-data-type=uint8, invalid-value=Value:3
    IDTSHvCooltHeatrSnsrFltTInMtrlSnsrFlt_HVCHLIN18Fr02_Lin3: implementation-data-type=uint8, invalid-value=Value:3
    IDTSHvCooltHeatrSrvRqrdCircForDrvrShoOrOpen_HVCHLIN18Fr02_Lin3: implementation-data-type=uint8, invalid-value=Value:3
    IDTSHvCooltHeatrSrvRqrdICnsOutOfRng_HVCHLIN18Fr02_Lin3: implementation-data-type=uint8, invalid-value=Value:3
    IDTSHvCooltHeatrSrvRqrdMemErr_HVCHLIN18Fr02_Lin3: implementation-data-type=uint8, invalid-value=Value:3
    IDTSHvCooltHeatrSrvRqrdSrvRqrd_HVCHLIN18Fr02_Lin3: implementation-data-type=uint8, invalid-value=Value:3
    IDTSHvCooltHeatrSts_HVCHLIN18Fr01_Lin3: implementation-data-type=uint8
    IDTSHvCooltHeatrWarnCooltTOutOfRng_HVCHLIN18Fr02_Lin3: implementation-data-type=uint8, invalid-value=Value:3
    IDTSHvCooltHeatrWarnFltInCom_HVCHLIN18Fr02_Lin3: implementation-data-type=uint8, invalid-value=Value:3
    IDTSHvCooltHeatrWarnHvOutOfRng_HVCHLIN18Fr02_Lin3: implementation-data-type=uint8, invalid-value=Value:3
    IDTSHvCooltHeatrWarnULoOutOfRng_HVCHLIN18Fr02_Lin3: implementation-data-type=uint8, invalid-value=Value:3
    IDTSHvCooltWtrHeatrWtrTInIntk_HVCHLIN18Fr01_Lin3: implementation-data-type=uint8, invalid-value=Value:255
    IDTSHvHeatrPwrCnsDes_HVCHLIN18Fr01_Lin3: implementation-data-type=uint16, invalid-value=Value:1023
    IDTSHvHeatrPwrCns_HVCHLIN18Fr01_Lin3: implementation-data-type=uint16, invalid-value=Value:1023
    IDTSHvWtrHeatrPwrCnsAllwd_CCMLIN18Fr02_Lin3: implementation-data-type=uint8, invalid-value=Value:255
    IDTSHvWtrHeatrWtrTDes_CCMLIN18Fr02_Lin3: implementation-data-type=uint8, invalid-value=Value:255
    IDTSHvWtrHeatrWtrT_HVCHLIN18Fr01_Lin3: implementation-data-type=uint8, invalid-value=Value:255
    IDTSIcon1_FailSts_CPIM_HCP_FEEDBACK_Lin3: implementation-data-type=boolean
    IDTSIcon1_Sts_CPIM_HCP_FEEDBACK_Lin3: implementation-data-type=uint8, invalid-value=Value:3
    IDTSIcon2_FailSts_CPIM_HCP_FEEDBACK_Lin3: implementation-data-type=boolean
    IDTSIcon2_Sts_CPIM_HCP_FEEDBACK_Lin3: implementation-data-type=uint8, invalid-value=Value:3
    IDTSInlet_Temp1_DC_CPIM_HCP_FEEDBACK2_Lin3: implementation-data-type=uint8, invalid-value=Value:255
    IDTSInlet_Temp2_DC_CPIM_HCP_FEEDBACK2_Lin3: implementation-data-type=uint8, invalid-value=Value:255
    IDTSM2SRes2Bit_ECM_AGS_DEMAND_Lin3: implementation-data-type=uint8
    IDTSM2SResByte{1..3}_ECM_AGS_DEMAND_Lin3: implementation-data-type=uint8
    IDTSPECP2_AIR_PRE_ERR_PECP2_STAT_GLOBAL_Lin3: implementation-data-type=uint8, invalid-value=Value:3
    IDTSPECP2_CURR_PECP2_STAT_GLOBAL_Lin3: implementation-data-type=uint8, invalid-value=Value:255
    IDTSPECP2_DBLK_ACTV_PECP2_STAT_GLOBAL_Lin3: implementation-data-type=uint8, invalid-value=Value:3
    IDTSPECP2_DR_RN_ERR_PECP2_STAT_GLOBAL_Lin3: implementation-data-type=uint8, invalid-value=Value:3
    IDTSPECP2_FL_SAFE_ACTVTD_PECP2_STAT_GLOBAL_Lin3: implementation-data-type=uint8, invalid-value=Value:3
    IDTSPECP2_FL_SAFE_ACTVT_PECP2_REQ_GLOBAL_Lin3: implementation-data-type=uint8, invalid-value=Value:3
    IDTSPECP2_LMP_HM_AN_ON_PECP2_STAT_GLOBAL_Lin3: implementation-data-type=uint8, invalid-value=Value:3
    IDTSPECP2_MONTRNG_RPM_PECP2_STAT_GLOBAL_Lin3: implementation-data-type=uint8, invalid-value=Value:3
    IDTSPECP2_NODE_ERR_PECP2_STAT_GLOBAL_Lin3: implementation-data-type=uint8, invalid-value=Value:3
    IDTSPECP2_OVR_CUR_ERR_PECP2_STAT_GLOBAL_Lin3: implementation-data-type=uint8, invalid-value=Value:3
    IDTSPECP2_OVR_TMP_ERR_PECP2_STAT_GLOBAL_Lin3: implementation-data-type=uint8, invalid-value=Value:3
    IDTSPECP2_POST_RUN_REQ_PECP2_REQ_GLOBAL_Lin3: implementation-data-type=uint8, invalid-value=Value:7
    IDTSPECP2_POST_RUN_STAT_PECP2_STAT_GLOBAL_Lin3: implementation-data-type=uint8, invalid-value=Value:7
    IDTSPECP2_RPM_ACTL_PERCT_PECP2_STAT_GLOBAL_Lin3: implementation-data-type=uint8, invalid-value=Value:255
    IDTSPECP2_RPM_REQ_PERCT_PECP2_REQ_GLOBAL_Lin3: implementation-data-type=uint8, invalid-value=Value:255
    IDTSPECP2_RPM_TGT_PERCT_PECP2_STAT_GLOBAL_Lin3: implementation-data-type=uint8, invalid-value=Value:255
    IDTSPECP2_SUPPLIER_PECP2_VER_Lin3: implementation-data-type=uint8
    IDTSPECP2_TEMP_PECP2_STAT_GLOBAL_Lin3: implementation-data-type=uint8, invalid-value=Value:255
    IDTSPECP2_VERSION_PECP2_VER_Lin3: implementation-data-type=uint8, invalid-value=Value:255
    IDTSPECP2_VLTG_ERR_PECP2_STAT_GLOBAL_Lin3: implementation-data-type=uint8, invalid-value=Value:3
    IDTSPECP2_VLTG_PECP2_STAT_GLOBAL_Lin3: implementation-data-type=uint8, invalid-value=Value:255
    IDTSPowerPanel2_AC_Present_Sens1_PowerPanel2_STAT_Lin3: implementation-data-type=boolean
    IDTSPowerPanel2_AC_Present_Sens2_PowerPanel2_STAT_Lin3: implementation-data-type=boolean
    IDTSPowerPanel2_Button_State_PowerPanel2_STAT_Lin3: implementation-data-type=boolean
    IDTSPowerPanel2_Current_Draw_Sens1_PowerPanel2_STAT_Lin3: implementation-data-type=uint16, invalid-value=Value:1023
    IDTSPowerPanel2_Current_Draw_Sens2_PowerPanel2_STAT_Lin3: implementation-data-type=uint16, invalid-value=Value:1023
    IDTSPowerPanel2_Fault_PowerPanel2_STAT_Lin3: implementation-data-type=uint8, invalid-value=Value:3
    IDTSPowerPanel2_Fault_Reason_PowerPanel2_STAT_Lin3: implementation-data-type=uint8, invalid-value=Value:15
    IDTSPowerPanel2_Gnd_Fault_Detected_PowerPanel2_STAT_Lin3: implementation-data-type=boolean
    IDTSPowerPanel2_LED_A_Color_Command_PowerPanel2_REQ_Lin3: implementation-data-type=uint8
    IDTSPowerPanel2_LED_A_Color_Feedback_PowerPanel2_STAT_Lin3: implementation-data-type=uint8
    IDTSPowerPanel2_LED_A_Command_PowerPanel2_REQ_Lin3: implementation-data-type=uint8, invalid-value=Value:3
    IDTSPowerPanel2_LED_A_FailStatus_PowerPanel2_STAT_Lin3: implementation-data-type=uint8
    IDTSPowerPanel2_LED_A_Feedback_PowerPanel2_STAT_Lin3: implementation-data-type=uint8, invalid-value=Value:3
    IDTSPowerPanel2_LED_B_Color_Command_PowerPanel2_REQ_Lin3: implementation-data-type=uint8
    IDTSPowerPanel2_LED_B_Color_Feedback_PowerPanel2_STAT_Lin3: implementation-data-type=uint8
    IDTSPowerPanel2_LED_B_Command_PowerPanel2_REQ_Lin3: implementation-data-type=uint8, invalid-value=Value:3
    IDTSPowerPanel2_LED_B_FailStatus_PowerPanel2_STAT_Lin3: implementation-data-type=uint8
    IDTSPowerPanel2_LED_B_Feedback_PowerPanel2_STAT_Lin3: implementation-data-type=uint8, invalid-value=Value:3
    IDTSPowerPanel2_LIN_Checksum_Error_PowerPanel2_STAT_Lin3: implementation-data-type=boolean
    IDTSPowerPanel2_LIN_Data_Error_PowerPanel2_STAT_Lin3: implementation-data-type=boolean
    IDTSPowerPanel2_LIN_Parity_Error_PowerPanel2_STAT_Lin3: implementation-data-type=boolean
    IDTSPowerPanel2_Lid_Switch_Sts_120A_PowerPanel2_STAT_Lin3: implementation-data-type=boolean
    IDTSPowerPanel2_Lid_Switch_Sts_120B_PowerPanel2_STAT_Lin3: implementation-data-type=boolean
    IDTSPowerPanel2_Lid_Switch_Sts_240_PowerPanel2_STAT_Lin3: implementation-data-type=boolean
    IDTSPowerPanel2_RatedPower_PowerPanel2_STAT_Lin3: implementation-data-type=uint8
    IDTSResponseErrorStsCPIM_CPIM_HCP_FEEDBACK_Lin3: implementation-data-type=boolean
    IDTSRsErr_AGS_AGS_ECM_STATUS_Lin3: implementation-data-type=boolean
    IDTSRsErr_CEXV_CEXV_STAT_Lin3: implementation-data-type=boolean
    IDTSRsErr_ECH_HVCHLIN18Fr02_Lin3: implementation-data-type=boolean
    IDTSRsErr_EOPB_EOPB_STAT_Lin3: implementation-data-type=boolean
    IDTSRsErr_HTLBV_HTLBV_STAT_Lin3: implementation-data-type=boolean
    IDTSRsErr_PECP2_PUMP_PECP2_STAT_GLOBAL_Lin3: implementation-data-type=boolean
    IDTSRsErr_SPP2_PowerPanel2_STAT_Lin3: implementation-data-type=boolean
    IDTSS2MRes1Bit_AGS_ECM_STATUS_Lin3: implementation-data-type=boolean
    IDTSS2MResByte1_AGS_ECM_STATUS_Lin3: implementation-data-type=uint8
    IDTSS2MResByte2_AGS_ECM_STATUS_Lin3: implementation-data-type=uint8
    IDTSSet_Icon1_cmd_HCP_CPIM_COMMAND_Lin3: implementation-data-type=uint8, invalid-value=Value:3
    IDTSSet_Icon2_cmd_HCP_CPIM_COMMAND_Lin3: implementation-data-type=uint8, invalid-value=Value:3
package /STLASWCs/ComSwCpts/ComPrivateInterfaces
  sender receiver interface Lin3ComRxSignalsSR
    142 x data, all with category=TYPE_REFERENCE, sw-calibration-access=READ-ONLY:
      COMRXL_AGS_CurrPos_AGS_ECM_STATUS_Lin3: type=IDTSAGS_CurrPos_AGS_ECM_STATUS_Lin3
      COMRXL_AGS_CalStat_AGS_ECM_STATUS_Lin3: type=IDTSAGS_CalStat_AGS_ECM_STATUS_Lin3
      COMRXL_AGS_CalActv_AGS_ECM_STATUS_Lin3: type=IDTSAGS_CalActv_AGS_ECM_STATUS_Lin3
      COMRXL_AGS_ErrUnVolt_AGS_ECM_STATUS_Lin3: type=IDTSAGS_ErrUnVolt_AGS_ECM_STATUS_Lin3
      COMRXL_AGS_ErrOvrVolt_AGS_ECM_STATUS_Lin3: type=IDTSAGS_ErrOvrVolt_AGS_ECM_STATUS_Lin3
      COMRXL_AGS_ErrOvrTemp_AGS_ECM_STATUS_Lin3: type=IDTSAGS_ErrOvrTemp_AGS_ECM_STATUS_Lin3
      COMRXL_AGS_ErrMechStuck_AGS_ECM_STATUS_Lin3: type=IDTSAGS_ErrMechStuck_AGS_ECM_STATUS_Lin3
      COMRXL_AGS_ErrMechBreak_AGS_ECM_STATUS_Lin3: type=IDTSAGS_ErrMechBreak_AGS_ECM_STATUS_Lin3
      COMRXL_AGS_ErrLIN_AGS_ECM_STATUS_Lin3: type=IDTSAGS_ErrLIN_AGS_ECM_STATUS_Lin3
      COMRXL_RsErr_AGS_AGS_ECM_STATUS_Lin3: type=IDTSRsErr_AGS_AGS_ECM_STATUS_Lin3
      COMRXL_AGS_BoostStat_AGS_ECM_STATUS_Lin3: type=IDTSAGS_BoostStat_AGS_ECM_STATUS_Lin3
      COMRXL_S2MRes1Bit_AGS_ECM_STATUS_Lin3: type=IDTSS2MRes1Bit_AGS_ECM_STATUS_Lin3
      COMRXL_S2MResByte1_AGS_ECM_STATUS_Lin3: type=IDTSS2MResByte1_AGS_ECM_STATUS_Lin3
      COMRXL_S2MResByte2_AGS_ECM_STATUS_Lin3: type=IDTSS2MResByte2_AGS_ECM_STATUS_Lin3
      COMRXL_CEXV_PosAct_CEXV_STAT_Lin3: type=IDTSCEXV_PosAct_CEXV_STAT_Lin3
      COMRXL_CEXV_CalStat_CEXV_STAT_Lin3: type=IDTSCEXV_CalStat_CEXV_STAT_Lin3
      COMRXL_CEXV_CalRq_CEXV_STAT_Lin3: type=IDTSCEXV_CalRq_CEXV_STAT_Lin3
      COMRXL_RsErr_CEXV_CEXV_STAT_Lin3: type=IDTSRsErr_CEXV_CEXV_STAT_Lin3
      COMRXL_CEXV_Sts_CEXV_STAT_Lin3: type=IDTSCEXV_Sts_CEXV_STAT_Lin3
      COMRXL_CEXV_ERR_CEXV_STAT_Lin3: type=IDTSCEXV_ERR_CEXV_STAT_Lin3
      COMRXL_CEXV_SupplyVolt_CEXV_STAT_Lin3: type=IDTSCEXV_SupplyVolt_CEXV_STAT_Lin3
      COMRXL_CEXV_Refrigerant_Pressure_CEXV_STAT_Lin3: type=IDTSCEXV_Refrigerant_Pressure_CEXV_STAT_Lin3
      COMRXL_CEXV_Board_Temp_CEXV_STAT_Lin3: type=IDTSCEXV_Board_Temp_CEXV_STAT_Lin3
      COMRXL_CEXV_Refrigerant_Temp_CEXV_STAT_Lin3: type=IDTSCEXV_Refrigerant_Temp_CEXV_STAT_Lin3
      COMRXL_Inlet_Temp1_DC_CPIM_HCP_FEEDBACK2_Lin3: type=IDTSInlet_Temp1_DC_CPIM_HCP_FEEDBACK2_Lin3
      COMRXL_Inlet_Temp2_DC_CPIM_HCP_FEEDBACK2_Lin3: type=IDTSInlet_Temp2_DC_CPIM_HCP_FEEDBACK2_Lin3
      COMRXL_CPIM_IND{1..5}_Fdbk_CPIM_HCP_FEEDBACK_Lin3: type=IDTSCPIM_IND{1..5}_Fdbk_CPIM_HCP_FEEDBACK_Lin3
      COMRXL_CPIM_IND_Color_Fdbk_CPIM_HCP_FEEDBACK_Lin3: type=IDTSCPIM_IND_Color_Fdbk_CPIM_HCP_FEEDBACK_Lin3
      COMRXL_CPIM_IND{1..5}_FailSts_CPIM_HCP_FEEDBACK_Lin3: type=IDTSCPIM_IND{1..5}_FailSts_CPIM_HCP_FEEDBACK_Lin3
      COMRXL_CPIM_Undervoltage_CPIM_HCP_FEEDBACK_Lin3: type=IDTSCPIM_Undervoltage_CPIM_HCP_FEEDBACK_Lin3
      COMRXL_CPIM_Over_Temperature_CPIM_HCP_FEEDBACK_Lin3: type=IDTSCPIM_Over_Temperature_CPIM_HCP_FEEDBACK_Lin3
      COMRXL_CPIM_LIN_Parity_Error_CPIM_HCP_FEEDBACK_Lin3: type=IDTSCPIM_LIN_Parity_Error_CPIM_HCP_FEEDBACK_Lin3
      COMRXL_CPIM_LIN_Checksum_Error_CPIM_HCP_FEEDBACK_Lin3: type=IDTSCPIM_LIN_Checksum_Error_CPIM_HCP_FEEDBACK_Lin3
      COMRXL_CPIM_LIN_Data_Error_CPIM_HCP_FEEDBACK_Lin3: type=IDTSCPIM_LIN_Data_Error_CPIM_HCP_FEEDBACK_Lin3
      COMRXL_ChrgPortLock_Sts_CPIM_HCP_FEEDBACK_Lin3: type=IDTSChrgPortLock_Sts_CPIM_HCP_FEEDBACK_Lin3
      COMRXL_ChrgPortButton_Sts_CPIM_HCP_FEEDBACK_Lin3: type=IDTSChrgPortButton_Sts_CPIM_HCP_FEEDBACK_Lin3
      COMRXL_Ambient_Temp_CPIM_HCP_FEEDBACK_Lin3: type=IDTSAmbient_Temp_CPIM_HCP_FEEDBACK_Lin3
      COMRXL_Chrg_Inlet_Temp_CPIM_HCP_FEEDBACK_Lin3: type=IDTSChrg_Inlet_Temp_CPIM_HCP_FEEDBACK_Lin3
      COMRXL_ResponseErrorStsCPIM_CPIM_HCP_FEEDBACK_Lin3: type=IDTSResponseErrorStsCPIM_CPIM_HCP_FEEDBACK_Lin3
      COMRXL_ChrgPortLock_FailSts_CPIM_HCP_FEEDBACK_Lin3: type=IDTSChrgPortLock_FailSts_CPIM_HCP_FEEDBACK_Lin3
      COMRXL_Icon1_Sts_CPIM_HCP_FEEDBACK_Lin3: type=IDTSIcon1_Sts_CPIM_HCP_FEEDBACK_Lin3
      COMRXL_Icon1_FailSts_CPIM_HCP_FEEDBACK_Lin3: type=IDTSIcon1_FailSts_CPIM_HCP_FEEDBACK_Lin3
      COMRXL_Icon2_Sts_CPIM_HCP_FEEDBACK_Lin3: type=IDTSIcon2_Sts_CPIM_HCP_FEEDBACK_Lin3
      COMRXL_Icon2_FailSts_CPIM_HCP_FEEDBACK_Lin3: type=IDTSIcon2_FailSts_CPIM_HCP_FEEDBACK_Lin3
      COMRXL_ChrgPortDoor_Sts_CPIM_HCP_FEEDBACK_Lin3: type=IDTSChrgPortDoor_Sts_CPIM_HCP_FEEDBACK_Lin3
      COMRXL_HvCooltHeatrSts_HVCHLIN18Fr01_Lin3: type=IDTSHvCooltHeatrSts_HVCHLIN18Fr01_Lin3
      COMRXL_ECH_InterlockStat_HVCHLIN18Fr01_Lin3: type=IDTSECH_InterlockStat_HVCHLIN18Fr01_Lin3
      COMRXL_Below_60V_HVCHLIN18Fr01_Lin3: type=IDTSBelow_60V_HVCHLIN18Fr01_Lin3
      COMRXL_HvCooltWtrHeatrWtrTInIntk_HVCHLIN18Fr01_Lin3: type=IDTSHvCooltWtrHeatrWtrTInIntk_HVCHLIN18Fr01_Lin3
      COMRXL_HvWtrHeatrWtrT_HVCHLIN18Fr01_Lin3: type=IDTSHvWtrHeatrWtrT_HVCHLIN18Fr01_Lin3
      COMRXL_HvCooltHeatrICns_HVCHLIN18Fr01_Lin3: type=IDTSHvCooltHeatrICns_HVCHLIN18Fr01_Lin3
      COMRXL_HvCooltHVmeas_HVCHLIN18Fr01_Lin3: type=IDTSHvCooltHVmeas_HVCHLIN18Fr01_Lin3
      COMRXL_HvHeatrPwrCns_HVCHLIN18Fr01_Lin3: type=IDTSHvHeatrPwrCns_HVCHLIN18Fr01_Lin3
      COMRXL_HvHeatrPwrCnsDes_HVCHLIN18Fr01_Lin3: type=IDTSHvHeatrPwrCnsDes_HVCHLIN18Fr01_Lin3
      COMRXL_HVH_UnlockCounter_HVCHLIN18Fr01_Lin3: type=IDTSHVH_UnlockCounter_HVCHLIN18Fr01_Lin3
      COMRXL_RsErr_ECH_HVCHLIN18Fr02_Lin3: type=IDTSRsErr_ECH_HVCHLIN18Fr02_Lin3
      COMRXL_HvCooltHeatrWarnFltInCom_HVCHLIN18Fr02_Lin3: type=IDTSHvCooltHeatrWarnFltInCom_HVCHLIN18Fr02_Lin3
      COMRXL_HvCooltHeatrWarnHvOutOfRng_HVCHLIN18Fr02_Lin3: type=IDTSHvCooltHeatrWarnHvOutOfRng_HVCHLIN18Fr02_Lin3
      COMRXL_HvCooltHeatrWarnULoOutOfRng_HVCHLIN18Fr02_Lin3: type=IDTSHvCooltHeatrWarnULoOutOfRng_HVCHLIN18Fr02_Lin3
      COMRXL_HvCooltHeatrWarnCooltTOutOfRng_HVCHLIN18Fr02_Lin3: type=IDTSHvCooltHeatrWarnCooltTOutOfRng_HVCHLIN18Fr02_Lin3
      COMRXL_HvCooltHeatrProtnOfSelfTmpHwProtn_HVCHLIN18Fr02_Lin3: type=IDTSHvCooltHeatrProtnOfSelfTmpHwProtn_HVCHLIN18Fr02_Lin3
      COMRXL_HvCooltHeatrProtnOfSelfTmpOvrheatg_HVCHLIN18Fr02_Lin3: type=IDTSHvCooltHeatrProtnOfSelfTmpOvrheatg_HVCHLIN18Fr02_Lin3
      COMRXL_HvCooltHeatrSnsrFltCooltTInSnsrFlt_HVCHLIN18Fr02_Lin3: type=IDTSHvCooltHeatrSnsrFltCooltTInSnsrFlt_HVCHLIN18Fr02_Lin3
      COMRXL_HvCooltHeatrSnsrFltCooltTOutSnsrFlt_HVCHLIN18Fr02_Lin3: type=IDTSHvCooltHeatrSnsrFltCooltTOutSnsrFlt_HVCHLIN18Fr02_Lin3
      COMRXL_HvCooltHeatrSnsrFltTInMtrlSnsrFlt_HVCHLIN18Fr02_Lin3: type=IDTSHvCooltHeatrSnsrFltTInMtrlSnsrFlt_HVCHLIN18Fr02_Lin3
      COMRXL_HvCooltHeatrSrvRqrdCircForDrvrShoOrOpen_HVCHLIN18Fr02_Lin3: type=IDTSHvCooltHeatrSrvRqrdCircForDrvrShoOrOpen_HVCHLIN18Fr02_Lin3
      COMRXL_HvCooltHeatrSrvRqrdICnsOutOfRng_HVCHLIN18Fr02_Lin3: type=IDTSHvCooltHeatrSrvRqrdICnsOutOfRng_HVCHLIN18Fr02_Lin3
      COMRXL_HvCooltHeatrSrvRqrdMemErr_HVCHLIN18Fr02_Lin3: type=IDTSHvCooltHeatrSrvRqrdMemErr_HVCHLIN18Fr02_Lin3
      COMRXL_HvCooltHeatrSrvRqrdSrvRqrd_HVCHLIN18Fr02_Lin3: type=IDTSHvCooltHeatrSrvRqrdSrvRqrd_HVCHLIN18Fr02_Lin3
      COMRXL_EOPB_RPM_TGT_EOPB_STAT_Lin3: type=IDTSEOPB_RPM_TGT_EOPB_STAT_Lin3
      COMRXL_EOPB_RPM_ACTL_EOPB_STAT_Lin3: type=IDTSEOPB_RPM_ACTL_EOPB_STAT_Lin3
      COMRXL_EOPB_VLTG_EOPB_STAT_Lin3: type=IDTSEOPB_VLTG_EOPB_STAT_Lin3
      COMRXL_EOPB_TEMP_EOPB_STAT_Lin3: type=IDTSEOPB_TEMP_EOPB_STAT_Lin3
      COMRXL_EOPB_CURR_EOPB_STAT_Lin3: type=IDTSEOPB_CURR_EOPB_STAT_Lin3
      COMRXL_EOPB_LOW_TMP_STAT_EOPB_STAT_Lin3: type=IDTSEOPB_LOW_TMP_STAT_EOPB_STAT_Lin3
      COMRXL_EOPB_MONTRNG_RPM_EOPB_STAT_Lin3: type=IDTSEOPB_MONTRNG_RPM_EOPB_STAT_Lin3
      COMRXL_EOPB_LMP_HM_AN_ON_EOPB_STAT_Lin3: type=IDTSEOPB_LMP_HM_AN_ON_EOPB_STAT_Lin3
      COMRXL_EOPB_OV_TMP_ER_EOPB_STAT_Lin3: type=IDTSEOPB_OV_TMP_ER_EOPB_STAT_Lin3
      COMRXL_EOPB_OV_CUR_ER_EOPB_STAT_Lin3: type=IDTSEOPB_OV_CUR_ER_EOPB_STAT_Lin3
      COMRXL_EOPB_DR_RN_ER_EOPB_STAT_Lin3: type=IDTSEOPB_DR_RN_ER_EOPB_STAT_Lin3
      COMRXL_EOPB_VLTG_ER_EOPB_STAT_Lin3: type=IDTSEOPB_VLTG_ER_EOPB_STAT_Lin3
      COMRXL_EOPB_Stall_Event_EOPB_STAT_Lin3: type=IDTSEOPB_Stall_Event_EOPB_STAT_Lin3
      COMRXL_EOPB_POST_RUN_STAT_EOPB_STAT_Lin3: type=IDTSEOPB_POST_RUN_STAT_EOPB_STAT_Lin3
      COMRXL_RsErr_EOPB_EOPB_STAT_Lin3: type=IDTSRsErr_EOPB_EOPB_STAT_Lin3
      COMRXL_EOPB_OIL_TEMP_EOPB_STAT2_Lin3: type=IDTSEOPB_OIL_TEMP_EOPB_STAT2_Lin3
      COMRXL_EOPB_HW_VER_EOPB_VER_Lin3: type=IDTSEOPB_HW_VER_EOPB_VER_Lin3
      COMRXL_EOPB_SW_VER_EOPB_VER_Lin3: type=IDTSEOPB_SW_VER_EOPB_VER_Lin3
      COMRXL_HTLBV_PosAct_HTLBV_STAT_Lin3: type=IDTSHTLBV_PosAct_HTLBV_STAT_Lin3
      COMRXL_HTLBV_ERR_HTLBV_STAT_Lin3: type=IDTSHTLBV_ERR_HTLBV_STAT_Lin3
      COMRXL_HTLBV_MotorVolt_HTLBV_STAT_Lin3: type=IDTSHTLBV_MotorVolt_HTLBV_STAT_Lin3
      COMRXL_HTLBV_Sts_HTLBV_STAT_Lin3: type=IDTSHTLBV_Sts_HTLBV_STAT_Lin3
      COMRXL_RsErr_HTLBV_HTLBV_STAT_Lin3: type=IDTSRsErr_HTLBV_HTLBV_STAT_Lin3
      COMRXL_HTLBV_CalStat_HTLBV_STAT_Lin3: type=IDTSHTLBV_CalStat_HTLBV_STAT_Lin3
      COMRXL_PECP2_RPM_TGT_PERCT_PECP2_STAT_GLOBAL_Lin3: type=IDTSPECP2_RPM_TGT_PERCT_PECP2_STAT_GLOBAL_Lin3
      COMRXL_PECP2_RPM_ACTL_PERCT_PECP2_STAT_GLOBAL_Lin3: type=IDTSPECP2_RPM_ACTL_PERCT_PECP2_STAT_GLOBAL_Lin3
      COMRXL_PECP2_VLTG_PECP2_STAT_GLOBAL_Lin3: type=IDTSPECP2_VLTG_PECP2_STAT_GLOBAL_Lin3
      COMRXL_PECP2_TEMP_PECP2_STAT_GLOBAL_Lin3: type=IDTSPECP2_TEMP_PECP2_STAT_GLOBAL_Lin3
      COMRXL_PECP2_CURR_PECP2_STAT_GLOBAL_Lin3: type=IDTSPECP2_CURR_PECP2_STAT_GLOBAL_Lin3
      COMRXL_PECP2_FL_SAFE_ACTVTD_PECP2_STAT_GLOBAL_Lin3: type=IDTSPECP2_FL_SAFE_ACTVTD_PECP2_STAT_GLOBAL_Lin3
      COMRXL_PECP2_LMP_HM_AN_ON_PECP2_STAT_GLOBAL_Lin3: type=IDTSPECP2_LMP_HM_AN_ON_PECP2_STAT_GLOBAL_Lin3
      COMRXL_PECP2_AIR_PRE_ERR_PECP2_STAT_GLOBAL_Lin3: type=IDTSPECP2_AIR_PRE_ERR_PECP2_STAT_GLOBAL_Lin3
      COMRXL_PECP2_OVR_TMP_ERR_PECP2_STAT_GLOBAL_Lin3: type=IDTSPECP2_OVR_TMP_ERR_PECP2_STAT_GLOBAL_Lin3
      COMRXL_PECP2_OVR_CUR_ERR_PECP2_STAT_GLOBAL_Lin3: type=IDTSPECP2_OVR_CUR_ERR_PECP2_STAT_GLOBAL_Lin3
      COMRXL_PECP2_DR_RN_ERR_PECP2_STAT_GLOBAL_Lin3: type=IDTSPECP2_DR_RN_ERR_PECP2_STAT_GLOBAL_Lin3
      COMRXL_PECP2_VLTG_ERR_PECP2_STAT_GLOBAL_Lin3: type=IDTSPECP2_VLTG_ERR_PECP2_STAT_GLOBAL_Lin3
      COMRXL_PECP2_DBLK_ACTV_PECP2_STAT_GLOBAL_Lin3: type=IDTSPECP2_DBLK_ACTV_PECP2_STAT_GLOBAL_Lin3
      COMRXL_PECP2_MONTRNG_RPM_PECP2_STAT_GLOBAL_Lin3: type=IDTSPECP2_MONTRNG_RPM_PECP2_STAT_GLOBAL_Lin3
      COMRXL_PECP2_NODE_ERR_PECP2_STAT_GLOBAL_Lin3: type=IDTSPECP2_NODE_ERR_PECP2_STAT_GLOBAL_Lin3
      COMRXL_PECP2_POST_RUN_STAT_PECP2_STAT_GLOBAL_Lin3: type=IDTSPECP2_POST_RUN_STAT_PECP2_STAT_GLOBAL_Lin3
      COMRXL_RsErr_PECP2_PUMP_PECP2_STAT_GLOBAL_Lin3: type=IDTSRsErr_PECP2_PUMP_PECP2_STAT_GLOBAL_Lin3
      COMRXL_PECP2_VERSION_PECP2_VER_Lin3: type=IDTSPECP2_VERSION_PECP2_VER_Lin3
      COMRXL_PECP2_SUPPLIER_PECP2_VER_Lin3: type=IDTSPECP2_SUPPLIER_PECP2_VER_Lin3
      COMRXL_PowerPanel2_Button_State_PowerPanel2_STAT_Lin3: type=IDTSPowerPanel2_Button_State_PowerPanel2_STAT_Lin3
      COMRXL_PowerPanel2_Lid_Switch_Sts_120A_PowerPanel2_STAT_Lin3: type=IDTSPowerPanel2_Lid_Switch_Sts_120A_PowerPanel2_STAT_Lin3
      COMRXL_PowerPanel2_Lid_Switch_Sts_120B_PowerPanel2_STAT_Lin3: type=IDTSPowerPanel2_Lid_Switch_Sts_120B_PowerPanel2_STAT_Lin3
      COMRXL_PowerPanel2_Lid_Switch_Sts_240_PowerPanel2_STAT_Lin3: type=IDTSPowerPanel2_Lid_Switch_Sts_240_PowerPanel2_STAT_Lin3
      COMRXL_PowerPanel2_AC_Present_Sens1_PowerPanel2_STAT_Lin3: type=IDTSPowerPanel2_AC_Present_Sens1_PowerPanel2_STAT_Lin3
      COMRXL_PowerPanel2_AC_Present_Sens2_PowerPanel2_STAT_Lin3: type=IDTSPowerPanel2_AC_Present_Sens2_PowerPanel2_STAT_Lin3
      COMRXL_PowerPanel2_Fault_Reason_PowerPanel2_STAT_Lin3: type=IDTSPowerPanel2_Fault_Reason_PowerPanel2_STAT_Lin3
      COMRXL_RsErr_SPP2_PowerPanel2_STAT_Lin3: type=IDTSRsErr_SPP2_PowerPanel2_STAT_Lin3
      COMRXL_PowerPanel2_LED_A_Feedback_PowerPanel2_STAT_Lin3: type=IDTSPowerPanel2_LED_A_Feedback_PowerPanel2_STAT_Lin3
      COMRXL_PowerPanel2_LED_B_Feedback_PowerPanel2_STAT_Lin3: type=IDTSPowerPanel2_LED_B_Feedback_PowerPanel2_STAT_Lin3
      COMRXL_PowerPanel2_LED_A_FailStatus_PowerPanel2_STAT_Lin3: type=IDTSPowerPanel2_LED_A_FailStatus_PowerPanel2_STAT_Lin3
      COMRXL_PowerPanel2_LED_B_FailStatus_PowerPanel2_STAT_Lin3: type=IDTSPowerPanel2_LED_B_FailStatus_PowerPanel2_STAT_Lin3
      COMRXL_PowerPanel2_LED_A_Color_Feedback_PowerPanel2_STAT_Lin3: type=IDTSPowerPanel2_LED_A_Color_Feedback_PowerPanel2_STAT_Lin3
      COMRXL_PowerPanel2_LED_B_Color_Feedback_PowerPanel2_STAT_Lin3: type=IDTSPowerPanel2_LED_B_Color_Feedback_PowerPanel2_STAT_Lin3
      COMRXL_PowerPanel2_LIN_Checksum_Error_PowerPanel2_STAT_Lin3: type=IDTSPowerPanel2_LIN_Checksum_Error_PowerPanel2_STAT_Lin3
      COMRXL_PowerPanel2_LIN_Data_Error_PowerPanel2_STAT_Lin3: type=IDTSPowerPanel2_LIN_Data_Error_PowerPanel2_STAT_Lin3
      COMRXL_PowerPanel2_LIN_Parity_Error_PowerPanel2_STAT_Lin3: type=IDTSPowerPanel2_LIN_Parity_Error_PowerPanel2_STAT_Lin3
      COMRXL_PowerPanel2_Gnd_Fault_Detected_PowerPanel2_STAT_Lin3: type=IDTSPowerPanel2_Gnd_Fault_Detected_PowerPanel2_STAT_Lin3
      COMRXL_PowerPanel2_Current_Draw_Sens1_PowerPanel2_STAT_Lin3: type=IDTSPowerPanel2_Current_Draw_Sens1_PowerPanel2_STAT_Lin3
      COMRXL_PowerPanel2_Current_Draw_Sens2_PowerPanel2_STAT_Lin3: type=IDTSPowerPanel2_Current_Draw_Sens2_PowerPanel2_STAT_Lin3
      COMRXL_PowerPanel2_Fault_PowerPanel2_STAT_Lin3: type=IDTSPowerPanel2_Fault_PowerPanel2_STAT_Lin3
      COMRXL_PowerPanel2_RatedPower_PowerPanel2_STAT_Lin3: type=IDTSPowerPanel2_RatedPower_PowerPanel2_STAT_Lin3
    invalidation-policys:
      data-element=COMRXL_AGS_CurrPos_AGS_ECM_STATUS_Lin3, handle-invalid=KEEP
      data-element=COMRXL_AGS_CalStat_AGS_ECM_STATUS_Lin3, handle-invalid=DONT-INVALIDATE
      data-element=COMRXL_AGS_CalActv_AGS_ECM_STATUS_Lin3, handle-invalid=DONT-INVALIDATE
      data-element=COMRXL_AGS_ErrUnVolt_AGS_ECM_STATUS_Lin3, handle-invalid=DONT-INVALIDATE
      data-element=COMRXL_AGS_ErrOvrVolt_AGS_ECM_STATUS_Lin3, handle-invalid=DONT-INVALIDATE
      data-element=COMRXL_AGS_ErrOvrTemp_AGS_ECM_STATUS_Lin3, handle-invalid=DONT-INVALIDATE
      data-element=COMRXL_AGS_ErrMechStuck_AGS_ECM_STATUS_Lin3, handle-invalid=DONT-INVALIDATE
      data-element=COMRXL_AGS_ErrMechBreak_AGS_ECM_STATUS_Lin3, handle-invalid=DONT-INVALIDATE
      data-element=COMRXL_AGS_ErrLIN_AGS_ECM_STATUS_Lin3, handle-invalid=KEEP
      data-element=COMRXL_RsErr_AGS_AGS_ECM_STATUS_Lin3, handle-invalid=DONT-INVALIDATE
      data-element=COMRXL_AGS_BoostStat_AGS_ECM_STATUS_Lin3, handle-invalid=DONT-INVALIDATE
      data-element=COMRXL_S2MRes1Bit_AGS_ECM_STATUS_Lin3, handle-invalid=DONT-INVALIDATE
      data-element=COMRXL_S2MResByte1_AGS_ECM_STATUS_Lin3, handle-invalid=DONT-INVALIDATE
      data-element=COMRXL_S2MResByte2_AGS_ECM_STATUS_Lin3, handle-invalid=DONT-INVALIDATE
      data-element=COMRXL_CEXV_PosAct_CEXV_STAT_Lin3, handle-invalid=KEEP
      data-element=COMRXL_CEXV_CalStat_CEXV_STAT_Lin3, handle-invalid=KEEP
      data-element=COMRXL_CEXV_CalRq_CEXV_STAT_Lin3, handle-invalid=DONT-INVALIDATE
      data-element=COMRXL_RsErr_CEXV_CEXV_STAT_Lin3, handle-invalid=DONT-INVALIDATE
      data-element=COMRXL_CEXV_Sts_CEXV_STAT_Lin3, handle-invalid=KEEP
      data-element=COMRXL_CEXV_ERR_CEXV_STAT_Lin3, handle-invalid=KEEP
      data-element=COMRXL_CEXV_SupplyVolt_CEXV_STAT_Lin3, handle-invalid=KEEP
      data-element=COMRXL_CEXV_Refrigerant_Pressure_CEXV_STAT_Lin3, handle-invalid=KEEP
      data-element=COMRXL_CEXV_Board_Temp_CEXV_STAT_Lin3, handle-invalid=KEEP
      data-element=COMRXL_CEXV_Refrigerant_Temp_CEXV_STAT_Lin3, handle-invalid=KEEP
      data-element=COMRXL_Inlet_Temp1_DC_CPIM_HCP_FEEDBACK2_Lin3, handle-invalid=KEEP
      data-element=COMRXL_Inlet_Temp2_DC_CPIM_HCP_FEEDBACK2_Lin3, handle-invalid=KEEP
      data-element=COMRXL_CPIM_IND{1..5}_Fdbk_CPIM_HCP_FEEDBACK_Lin3, handle-invalid=KEEP
      data-element=COMRXL_CPIM_IND_Color_Fdbk_CPIM_HCP_FEEDBACK_Lin3, handle-invalid=KEEP
      data-element=COMRXL_CPIM_IND{1..5}_FailSts_CPIM_HCP_FEEDBACK_Lin3, handle-invalid=DONT-INVALIDATE
      data-element=COMRXL_CPIM_Undervoltage_CPIM_HCP_FEEDBACK_Lin3, handle-invalid=DONT-INVALIDATE
      data-element=COMRXL_CPIM_Over_Temperature_CPIM_HCP_FEEDBACK_Lin3, handle-invalid=DONT-INVALIDATE
      data-element=COMRXL_CPIM_LIN_Parity_Error_CPIM_HCP_FEEDBACK_Lin3, handle-invalid=DONT-INVALIDATE
      data-element=COMRXL_CPIM_LIN_Checksum_Error_CPIM_HCP_FEEDBACK_Lin3, handle-invalid=DONT-INVALIDATE
      data-element=COMRXL_CPIM_LIN_Data_Error_CPIM_HCP_FEEDBACK_Lin3, handle-invalid=DONT-INVALIDATE
      data-element=COMRXL_ChrgPortLock_Sts_CPIM_HCP_FEEDBACK_Lin3, handle-invalid=DONT-INVALIDATE
      data-element=COMRXL_ChrgPortButton_Sts_CPIM_HCP_FEEDBACK_Lin3, handle-invalid=DONT-INVALIDATE
      data-element=COMRXL_Ambient_Temp_CPIM_HCP_FEEDBACK_Lin3, handle-invalid=KEEP
      data-element=COMRXL_Chrg_Inlet_Temp_CPIM_HCP_FEEDBACK_Lin3, handle-invalid=KEEP
      data-element=COMRXL_ResponseErrorStsCPIM_CPIM_HCP_FEEDBACK_Lin3, handle-invalid=DONT-INVALIDATE
      data-element=COMRXL_ChrgPortLock_FailSts_CPIM_HCP_FEEDBACK_Lin3, handle-invalid=KEEP
      data-element=COMRXL_Icon1_Sts_CPIM_HCP_FEEDBACK_Lin3, handle-invalid=KEEP
      data-element=COMRXL_Icon1_FailSts_CPIM_HCP_FEEDBACK_Lin3, handle-invalid=DONT-INVALIDATE
      data-element=COMRXL_Icon2_Sts_CPIM_HCP_FEEDBACK_Lin3, handle-invalid=KEEP
      data-element=COMRXL_Icon2_FailSts_CPIM_HCP_FEEDBACK_Lin3, handle-invalid=DONT-INVALIDATE
      data-element=COMRXL_ChrgPortDoor_Sts_CPIM_HCP_FEEDBACK_Lin3, handle-invalid=KEEP
      data-element=COMRXL_HvCooltHeatrSts_HVCHLIN18Fr01_Lin3, handle-invalid=DONT-INVALIDATE
      data-element=COMRXL_ECH_InterlockStat_HVCHLIN18Fr01_Lin3, handle-invalid=DONT-INVALIDATE
      data-element=COMRXL_Below_60V_HVCHLIN18Fr01_Lin3, handle-invalid=KEEP
      data-element=COMRXL_HvCooltWtrHeatrWtrTInIntk_HVCHLIN18Fr01_Lin3, handle-invalid=KEEP
      data-element=COMRXL_HvWtrHeatrWtrT_HVCHLIN18Fr01_Lin3, handle-invalid=KEEP
      data-element=COMRXL_HvCooltHeatrICns_HVCHLIN18Fr01_Lin3, handle-invalid=KEEP
      data-element=COMRXL_HvCooltHVmeas_HVCHLIN18Fr01_Lin3, handle-invalid=KEEP
      data-element=COMRXL_HvHeatrPwrCns_HVCHLIN18Fr01_Lin3, handle-invalid=KEEP
      data-element=COMRXL_HvHeatrPwrCnsDes_HVCHLIN18Fr01_Lin3, handle-invalid=KEEP
      data-element=COMRXL_HVH_UnlockCounter_HVCHLIN18Fr01_Lin3, handle-invalid=KEEP
      data-element=COMRXL_RsErr_ECH_HVCHLIN18Fr02_Lin3, handle-invalid=DONT-INVALIDATE
      data-element=COMRXL_HvCooltHeatrWarnFltInCom_HVCHLIN18Fr02_Lin3, handle-invalid=KEEP
      data-element=COMRXL_HvCooltHeatrWarnHvOutOfRng_HVCHLIN18Fr02_Lin3, handle-invalid=KEEP
      data-element=COMRXL_HvCooltHeatrWarnULoOutOfRng_HVCHLIN18Fr02_Lin3, handle-invalid=KEEP
      data-element=COMRXL_HvCooltHeatrWarnCooltTOutOfRng_HVCHLIN18Fr02_Lin3, handle-invalid=KEEP
      data-element=COMRXL_HvCooltHeatrProtnOfSelfTmpHwProtn_HVCHLIN18Fr02_Lin3, handle-invalid=KEEP
      data-element=COMRXL_HvCooltHeatrProtnOfSelfTmpOvrheatg_HVCHLIN18Fr02_Lin3, handle-invalid=KEEP
      data-element=COMRXL_HvCooltHeatrSnsrFltCooltTInSnsrFlt_HVCHLIN18Fr02_Lin3, handle-invalid=KEEP
      data-element=COMRXL_HvCooltHeatrSnsrFltCooltTOutSnsrFlt_HVCHLIN18Fr02_Lin3, handle-invalid=KEEP
      data-element=COMRXL_HvCooltHeatrSnsrFltTInMtrlSnsrFlt_HVCHLIN18Fr02_Lin3, handle-invalid=KEEP
      data-element=COMRXL_HvCooltHeatrSrvRqrdCircForDrvrShoOrOpen_HVCHLIN18Fr02_Lin3, handle-invalid=KEEP
      data-element=COMRXL_HvCooltHeatrSrvRqrdICnsOutOfRng_HVCHLIN18Fr02_Lin3, handle-invalid=KEEP
      data-element=COMRXL_HvCooltHeatrSrvRqrdMemErr_HVCHLIN18Fr02_Lin3, handle-invalid=KEEP
      data-element=COMRXL_HvCooltHeatrSrvRqrdSrvRqrd_HVCHLIN18Fr02_Lin3, handle-invalid=KEEP
      data-element=COMRXL_EOPB_RPM_TGT_EOPB_STAT_Lin3, handle-invalid=KEEP
      data-element=COMRXL_EOPB_RPM_ACTL_EOPB_STAT_Lin3, handle-invalid=KEEP
      data-element=COMRXL_EOPB_VLTG_EOPB_STAT_Lin3, handle-invalid=KEEP
      data-element=COMRXL_EOPB_TEMP_EOPB_STAT_Lin3, handle-invalid=KEEP
      data-element=COMRXL_EOPB_CURR_EOPB_STAT_Lin3, handle-invalid=KEEP
      data-element=COMRXL_EOPB_LOW_TMP_STAT_EOPB_STAT_Lin3, handle-invalid=KEEP
      data-element=COMRXL_EOPB_MONTRNG_RPM_EOPB_STAT_Lin3, handle-invalid=KEEP
      data-element=COMRXL_EOPB_LMP_HM_AN_ON_EOPB_STAT_Lin3, handle-invalid=KEEP
      data-element=COMRXL_EOPB_OV_TMP_ER_EOPB_STAT_Lin3, handle-invalid=KEEP
      data-element=COMRXL_EOPB_OV_CUR_ER_EOPB_STAT_Lin3, handle-invalid=KEEP
      data-element=COMRXL_EOPB_DR_RN_ER_EOPB_STAT_Lin3, handle-invalid=KEEP
      data-element=COMRXL_EOPB_VLTG_ER_EOPB_STAT_Lin3, handle-invalid=KEEP
      data-element=COMRXL_EOPB_Stall_Event_EOPB_STAT_Lin3, handle-invalid=KEEP
      data-element=COMRXL_EOPB_POST_RUN_STAT_EOPB_STAT_Lin3, handle-invalid=KEEP
      data-element=COMRXL_RsErr_EOPB_EOPB_STAT_Lin3, handle-invalid=DONT-INVALIDATE
      data-element=COMRXL_EOPB_OIL_TEMP_EOPB_STAT2_Lin3, handle-invalid=KEEP
      data-element=COMRXL_EOPB_HW_VER_EOPB_VER_Lin3, handle-invalid=KEEP
      data-element=COMRXL_EOPB_SW_VER_EOPB_VER_Lin3, handle-invalid=KEEP
      data-element=COMRXL_HTLBV_PosAct_HTLBV_STAT_Lin3, handle-invalid=KEEP
      data-element=COMRXL_HTLBV_ERR_HTLBV_STAT_Lin3, handle-invalid=KEEP
      data-element=COMRXL_HTLBV_MotorVolt_HTLBV_STAT_Lin3, handle-invalid=KEEP
      data-element=COMRXL_HTLBV_Sts_HTLBV_STAT_Lin3, handle-invalid=KEEP
      data-element=COMRXL_RsErr_HTLBV_HTLBV_STAT_Lin3, handle-invalid=DONT-INVALIDATE
      data-element=COMRXL_HTLBV_CalStat_HTLBV_STAT_Lin3, handle-invalid=DONT-INVALIDATE
      data-element=COMRXL_PECP2_RPM_TGT_PERCT_PECP2_STAT_GLOBAL_Lin3, handle-invalid=KEEP
      data-element=COMRXL_PECP2_RPM_ACTL_PERCT_PECP2_STAT_GLOBAL_Lin3, handle-invalid=KEEP
      data-element=COMRXL_PECP2_VLTG_PECP2_STAT_GLOBAL_Lin3, handle-invalid=KEEP
      data-element=COMRXL_PECP2_TEMP_PECP2_STAT_GLOBAL_Lin3, handle-invalid=KEEP
      data-element=COMRXL_PECP2_CURR_PECP2_STAT_GLOBAL_Lin3, handle-invalid=KEEP
      data-element=COMRXL_PECP2_FL_SAFE_ACTVTD_PECP2_STAT_GLOBAL_Lin3, handle-invalid=KEEP
      data-element=COMRXL_PECP2_LMP_HM_AN_ON_PECP2_STAT_GLOBAL_Lin3, handle-invalid=KEEP
      data-element=COMRXL_PECP2_AIR_PRE_ERR_PECP2_STAT_GLOBAL_Lin3, handle-invalid=KEEP
      data-element=COMRXL_PECP2_OVR_TMP_ERR_PECP2_STAT_GLOBAL_Lin3, handle-invalid=KEEP
      data-element=COMRXL_PECP2_OVR_CUR_ERR_PECP2_STAT_GLOBAL_Lin3, handle-invalid=KEEP
      data-element=COMRXL_PECP2_DR_RN_ERR_PECP2_STAT_GLOBAL_Lin3, handle-invalid=KEEP
      data-element=COMRXL_PECP2_VLTG_ERR_PECP2_STAT_GLOBAL_Lin3, handle-invalid=KEEP
      data-element=COMRXL_PECP2_DBLK_ACTV_PECP2_STAT_GLOBAL_Lin3, handle-invalid=KEEP
      data-element=COMRXL_PECP2_MONTRNG_RPM_PECP2_STAT_GLOBAL_Lin3, handle-invalid=KEEP
      data-element=COMRXL_PECP2_NODE_ERR_PECP2_STAT_GLOBAL_Lin3, handle-invalid=KEEP
      data-element=COMRXL_PECP2_POST_RUN_STAT_PECP2_STAT_GLOBAL_Lin3, handle-invalid=KEEP
      data-element=COMRXL_RsErr_PECP2_PUMP_PECP2_STAT_GLOBAL_Lin3, handle-invalid=DONT-INVALIDATE
      data-element=COMRXL_PECP2_VERSION_PECP2_VER_Lin3, handle-invalid=KEEP
      data-element=COMRXL_PECP2_SUPPLIER_PECP2_VER_Lin3, handle-invalid=DONT-INVALIDATE
      data-element=COMRXL_PowerPanel2_Button_State_PowerPanel2_STAT_Lin3, handle-invalid=DONT-INVALIDATE
      data-element=COMRXL_PowerPanel2_Lid_Switch_Sts_120A_PowerPanel2_STAT_Lin3, handle-invalid=DONT-INVALIDATE
      data-element=COMRXL_PowerPanel2_Lid_Switch_Sts_120B_PowerPanel2_STAT_Lin3, handle-invalid=DONT-INVALIDATE
      data-element=COMRXL_PowerPanel2_Lid_Switch_Sts_240_PowerPanel2_STAT_Lin3, handle-invalid=DONT-INVALIDATE
      data-element=COMRXL_PowerPanel2_AC_Present_Sens1_PowerPanel2_STAT_Lin3, handle-invalid=DONT-INVALIDATE
      data-element=COMRXL_PowerPanel2_AC_Present_Sens2_PowerPanel2_STAT_Lin3, handle-invalid=DONT-INVALIDATE
      data-element=COMRXL_PowerPanel2_Fault_Reason_PowerPanel2_STAT_Lin3, handle-invalid=KEEP
      data-element=COMRXL_RsErr_SPP2_PowerPanel2_STAT_Lin3, handle-invalid=DONT-INVALIDATE
      data-element=COMRXL_PowerPanel2_LED_A_Feedback_PowerPanel2_STAT_Lin3, handle-invalid=KEEP
      data-element=COMRXL_PowerPanel2_LED_B_Feedback_PowerPanel2_STAT_Lin3, handle-invalid=KEEP
      data-element=COMRXL_PowerPanel2_LED_A_FailStatus_PowerPanel2_STAT_Lin3, handle-invalid=DONT-INVALIDATE
      data-element=COMRXL_PowerPanel2_LED_B_FailStatus_PowerPanel2_STAT_Lin3, handle-invalid=DONT-INVALIDATE
      data-element=COMRXL_PowerPanel2_LED_A_Color_Feedback_PowerPanel2_STAT_Lin3, handle-invalid=DONT-INVALIDATE
      data-element=COMRXL_PowerPanel2_LED_B_Color_Feedback_PowerPanel2_STAT_Lin3, handle-invalid=DONT-INVALIDATE
      data-element=COMRXL_PowerPanel2_LIN_Checksum_Error_PowerPanel2_STAT_Lin3, handle-invalid=DONT-INVALIDATE
      data-element=COMRXL_PowerPanel2_LIN_Data_Error_PowerPanel2_STAT_Lin3, handle-invalid=DONT-INVALIDATE
      data-element=COMRXL_PowerPanel2_LIN_Parity_Error_PowerPanel2_STAT_Lin3, handle-invalid=DONT-INVALIDATE
      data-element=COMRXL_PowerPanel2_Gnd_Fault_Detected_PowerPanel2_STAT_Lin3, handle-invalid=DONT-INVALIDATE
      data-element=COMRXL_PowerPanel2_Current_Draw_Sens1_PowerPanel2_STAT_Lin3, handle-invalid=KEEP
      data-element=COMRXL_PowerPanel2_Current_Draw_Sens2_PowerPanel2_STAT_Lin3, handle-invalid=KEEP
      data-element=COMRXL_PowerPanel2_Fault_PowerPanel2_STAT_Lin3, handle-invalid=KEEP
      data-element=COMRXL_PowerPanel2_RatedPower_PowerPanel2_STAT_Lin3, handle-invalid=DONT-INVALIDATE
  sender receiver interface Lin3ComTxSignalsSR
    38 x data, all with category=TYPE_REFERENCE, sw-calibration-access=READ-ONLY:
      COMTXL_AGS_PosRq_ECM_AGS_DEMAND_Lin3: type=IDTSAGS_PosRq_ECM_AGS_DEMAND_Lin3, init-value=COMTXL_AGS_PosRq_ECM_AGS_DEMAND_Lin3Value:0  # Raw signal data to be transmitted over the LIN bus for the Signal AGS_PosRq
      COMTXL_AGS_CalRq_ECM_AGS_DEMAND_Lin3: type=IDTSAGS_CalRq_ECM_AGS_DEMAND_Lin3, init-value=COMTXL_AGS_CalRq_ECM_AGS_DEMAND_Lin3Value:0  # Raw signal data to be transmitted over the LIN bus for the Signal AGS_CalRq
      COMTXL_AGS_BoostRq_ECM_AGS_DEMAND_Lin3: type=IDTSAGS_BoostRq_ECM_AGS_DEMAND_Lin3, init-value=COMTXL_AGS_BoostRq_ECM_AGS_DEMAND_Lin3Value:0  # Raw signal data to be transmitted over the LIN bus for the Signal AGS_BoostRq
      COMTXL_M2SRes2Bit_ECM_AGS_DEMAND_Lin3: type=IDTSM2SRes2Bit_ECM_AGS_DEMAND_Lin3, init-value=COMTXL_M2SRes2Bit_ECM_AGS_DEMAND_Lin3Value:0  # Raw signal data to be transmitted over the LIN bus for the Signal M2SRes2Bit
      COMTXL_M2SResByte{1..3}_ECM_AGS_DEMAND_Lin3: type=IDTSM2SResByte{1..3}_ECM_AGS_DEMAND_Lin3, init-value=COMTXL_M2SResByte{1..3}_ECM_AGS_DEMAND_Lin3Value:0  # Raw signal data to be transmitted over the LIN bus for the Signal M2SResByte{1..3}
      COMTXL_CEXV_PosRq_CEXV_REQ_Lin3: type=IDTSCEXV_PosRq_CEXV_REQ_Lin3, init-value=COMTXL_CEXV_PosRq_CEXV_REQ_Lin3Value:0  # Raw signal data to be transmitted over the LIN bus for the Signal CEXV_PosRq
      COMTXL_CEXV_CalCmd_CEXV_REQ_Lin3: type=IDTSCEXV_CalCmd_CEXV_REQ_Lin3, init-value=COMTXL_CEXV_CalCmd_CEXV_REQ_Lin3Value:0  # Raw signal data to be transmitted over the LIN bus for the Signal CEXV_CalCmd
      COMTXL_CPIM_SET_IND{1..5}_HCP_CPIM_COMMAND_Lin3: type=IDTSCPIM_SET_IND{1..5}_HCP_CPIM_COMMAND_Lin3, init-value=COMTXL_CPIM_SET_IND{1..5}_HCP_CPIM_COMMAND_Lin3Value:0  # Raw signal data to be transmitted over the LIN bus for the Signal CPIM_SET_IND{1..5}
      COMTXL_CPIM_Blink_Rate_HCP_CPIM_COMMAND_Lin3: type=IDTSCPIM_Blink_Rate_HCP_CPIM_COMMAND_Lin3, init-value=COMTXL_CPIM_Blink_Rate_HCP_CPIM_COMMAND_Lin3Value:0  # Raw signal data to be transmitted over the LIN bus for the Signal CPIM_Blink_Rate
      COMTXL_CPIM_IND_Color_HCP_CPIM_COMMAND_Lin3: type=IDTSCPIM_IND_Color_HCP_CPIM_COMMAND_Lin3, init-value=COMTXL_CPIM_IND_Color_HCP_CPIM_COMMAND_Lin3Value:0  # Raw signal data to be transmitted over the LIN bus for the Signal CPIM_IND_Color
      COMTXL_ChrgPortLock_Cmd_HCP_CPIM_COMMAND_Lin3: type=IDTSChrgPortLock_Cmd_HCP_CPIM_COMMAND_Lin3, init-value=COMTXL_ChrgPortLock_Cmd_HCP_CPIM_COMMAND_Lin3Value:0  # Raw signal data to be transmitted over the LIN bus for the Signal ChrgPortLock_Cmd
      COMTXL_Set_Icon1_cmd_HCP_CPIM_COMMAND_Lin3: type=IDTSSet_Icon1_cmd_HCP_CPIM_COMMAND_Lin3, init-value=COMTXL_Set_Icon1_cmd_HCP_CPIM_COMMAND_Lin3Value:0  # Raw signal data to be transmitted over the LIN bus for the Signal Set_Icon1_cmd
      COMTXL_Set_Icon2_cmd_HCP_CPIM_COMMAND_Lin3: type=IDTSSet_Icon2_cmd_HCP_CPIM_COMMAND_Lin3, init-value=COMTXL_Set_Icon2_cmd_HCP_CPIM_COMMAND_Lin3Value:0  # Raw signal data to be transmitted over the LIN bus for the Signal Set_Icon2_cmd
      COMTXL_DAY_LGT_MD_CPIM_HCP_CPIM_COMMAND_Lin3: type=IDTSDAY_LGT_MD_CPIM_HCP_CPIM_COMMAND_Lin3, init-value=COMTXL_DAY_LGT_MD_CPIM_HCP_CPIM_COMMAND_Lin3Value:0  # Raw signal data to be transmitted over the LIN bus for the Signal DAY_LGT_MD_CPIM
      COMTXL_Backlight_Cmd_HCP_CPIM_COMMAND_Lin3: type=IDTSBacklight_Cmd_HCP_CPIM_COMMAND_Lin3, init-value=COMTXL_Backlight_Cmd_HCP_CPIM_COMMAND_Lin3Value:0  # Raw signal data to be transmitted over the LIN bus for the Signal Backlight_Cmd
      COMTXL_HvWtrHeatrPwrCnsAllwd_CCMLIN18Fr02_Lin3: type=IDTSHvWtrHeatrPwrCnsAllwd_CCMLIN18Fr02_Lin3, init-value=COMTXL_HvWtrHeatrPwrCnsAllwd_CCMLIN18Fr02_Lin3Value:255  # Raw signal data to be transmitted over the LIN bus for the Signal HvWtrHeatrPwrCnsAllwd
      COMTXL_HvWtrHeatrWtrTDes_CCMLIN18Fr02_Lin3: type=IDTSHvWtrHeatrWtrTDes_CCMLIN18Fr02_Lin3, init-value=COMTXL_HvWtrHeatrWtrTDes_CCMLIN18Fr02_Lin3Value:255  # Raw signal data to be transmitted over the LIN bus for the Signal HvWtrHeatrWtrTDes
      COMTXL_HvCooltHeatrEnad_CCMLIN18Fr02_Lin3: type=IDTSHvCooltHeatrEnad_CCMLIN18Fr02_Lin3, init-value=COMTXL_HvCooltHeatrEnad_CCMLIN18Fr02_Lin3Value:0  # Raw signal data to be transmitted over the LIN bus for the Signal HvCooltHeatrEnad
      COMTXL_HVH_OverheatUnlock_CCMLIN18Fr02_Lin3: type=IDTSHVH_OverheatUnlock_CCMLIN18Fr02_Lin3, init-value=COMTXL_HVH_OverheatUnlock_CCMLIN18Fr02_Lin3Value:0  # Raw signal data to be transmitted over the LIN bus for the Signal HVH_OverheatUnlock
      COMTXL_EOPB_RPM_COM_EOPB_REQ_Lin3: type=IDTSEOPB_RPM_COM_EOPB_REQ_Lin3, init-value=COMTXL_EOPB_RPM_COM_EOPB_REQ_Lin3Value:255  # Raw signal data to be transmitted over the LIN bus for the Signal EOPB_RPM_COM
      COMTXL_EOPB_POST_RUN_COM_EOPB_REQ_Lin3: type=IDTSEOPB_POST_RUN_COM_EOPB_REQ_Lin3, init-value=COMTXL_EOPB_POST_RUN_COM_EOPB_REQ_Lin3Value:7  # Raw signal data to be transmitted over the LIN bus for the Signal EOPB_POST_RUN_COM
      COMTXL_HTLBV_PosRq_HTLBV_REQ_Lin3: type=IDTSHTLBV_PosRq_HTLBV_REQ_Lin3, init-value=COMTXL_HTLBV_PosRq_HTLBV_REQ_Lin3Value:0  # Raw signal data to be transmitted over the LIN bus for the Signal HTLBV_PosRq
      COMTXL_HTLBV_PosSv_HTLBV_REQ_Lin3: type=IDTSHTLBV_PosSv_HTLBV_REQ_Lin3, init-value=COMTXL_HTLBV_PosSv_HTLBV_REQ_Lin3Value:0  # Raw signal data to be transmitted over the LIN bus for the Signal HTLBV_PosSv
      COMTXL_HTLBV_CalRq_HTLBV_REQ_Lin3: type=IDTSHTLBV_CalRq_HTLBV_REQ_Lin3, init-value=COMTXL_HTLBV_CalRq_HTLBV_REQ_Lin3Value:0  # Raw signal data to be transmitted over the LIN bus for the Signal HTLBV_CalRq
      COMTXL_PECP2_RPM_REQ_PERCT_PECP2_REQ_GLOBAL_Lin3: type=IDTSPECP2_RPM_REQ_PERCT_PECP2_REQ_GLOBAL_Lin3, init-value=COMTXL_PECP2_RPM_REQ_PERCT_PECP2_REQ_GLOBAL_Lin3Value:255  # Raw signal data to be transmitted over the LIN bus for the Signal PECP2_RPM_REQ_PERCT
      COMTXL_PECP2_POST_RUN_REQ_PECP2_REQ_GLOBAL_Lin3: type=IDTSPECP2_POST_RUN_REQ_PECP2_REQ_GLOBAL_Lin3, init-value=COMTXL_PECP2_POST_RUN_REQ_PECP2_REQ_GLOBAL_Lin3Value:7  # Raw signal data to be transmitted over the LIN bus for the Signal PECP2_POST_RUN_REQ
      COMTXL_PECP2_FL_SAFE_ACTVT_PECP2_REQ_GLOBAL_Lin3: type=IDTSPECP2_FL_SAFE_ACTVT_PECP2_REQ_GLOBAL_Lin3, init-value=COMTXL_PECP2_FL_SAFE_ACTVT_PECP2_REQ_GLOBAL_Lin3Value:3  # Raw signal data to be transmitted over the LIN bus for the Signal PECP2_FL_SAFE_ACTVT
      COMTXL_PowerPanel2_LED_A_Command_PowerPanel2_REQ_Lin3: type=IDTSPowerPanel2_LED_A_Command_PowerPanel2_REQ_Lin3, init-value=COMTXL_PowerPanel2_LED_A_Command_PowerPanel2_REQ_Lin3Value:0  # Raw signal data to be transmitted over the LIN bus for the Signal PowerPanel2_LED_A_Command
      COMTXL_PowerPanel2_LED_B_Command_PowerPanel2_REQ_Lin3: type=IDTSPowerPanel2_LED_B_Command_PowerPanel2_REQ_Lin3, init-value=COMTXL_PowerPanel2_LED_B_Command_PowerPanel2_REQ_Lin3Value:0  # Raw signal data to be transmitted over the LIN bus for the Signal PowerPanel2_LED_B_Command
      COMTXL_DAY_LGT_MD_PowerPanel2_PowerPanel2_REQ_Lin3: type=IDTSDAY_LGT_MD_PowerPanel2_PowerPanel2_REQ_Lin3, init-value=COMTXL_DAY_LGT_MD_PowerPanel2_PowerPanel2_REQ_Lin3Value:0  # Raw signal data to be transmitted over the LIN bus for the Signal DAY_LGT_MD_PowerPanel2
      COMTXL_PowerPanel2_LED_A_Color_Command_PowerPanel2_REQ_Lin3: type=IDTSPowerPanel2_LED_A_Color_Command_PowerPanel2_REQ_Lin3, init-value=COMTXL_PowerPanel2_LED_A_Color_Command_PowerPanel2_REQ_Lin3Value:0  # Raw signal data to be transmitted over the LIN bus for the Signal PowerPanel2_LED_A_Color_Command
      COMTXL_PowerPanel2_LED_B_Color_Command_PowerPanel2_REQ_Lin3: type=IDTSPowerPanel2_LED_B_Color_Command_PowerPanel2_REQ_Lin3, init-value=COMTXL_PowerPanel2_LED_B_Color_Command_PowerPanel2_REQ_Lin3Value:0  # Raw signal data to be transmitted over the LIN bus for the Signal PowerPanel2_LED_B_Color_Command
    invalidation-policys:
      data-element=COMTXL_AGS_PosRq_ECM_AGS_DEMAND_Lin3, handle-invalid=KEEP
      data-element=COMTXL_AGS_CalRq_ECM_AGS_DEMAND_Lin3, handle-invalid=DONT-INVALIDATE
      data-element=COMTXL_AGS_BoostRq_ECM_AGS_DEMAND_Lin3, handle-invalid=DONT-INVALIDATE
      data-element=COMTXL_M2SRes2Bit_ECM_AGS_DEMAND_Lin3, handle-invalid=DONT-INVALIDATE
      data-element=COMTXL_M2SResByte{1..3}_ECM_AGS_DEMAND_Lin3, handle-invalid=DONT-INVALIDATE
      data-element=COMTXL_CEXV_PosRq_CEXV_REQ_Lin3, handle-invalid=KEEP
      data-element=COMTXL_CEXV_CalCmd_CEXV_REQ_Lin3, handle-invalid=DONT-INVALIDATE
      data-element=COMTXL_CPIM_SET_IND{1..5}_HCP_CPIM_COMMAND_Lin3, handle-invalid=KEEP
      data-element=COMTXL_CPIM_Blink_Rate_HCP_CPIM_COMMAND_Lin3, handle-invalid=KEEP
      data-element=COMTXL_CPIM_IND_Color_HCP_CPIM_COMMAND_Lin3, handle-invalid=KEEP
      data-element=COMTXL_ChrgPortLock_Cmd_HCP_CPIM_COMMAND_Lin3, handle-invalid=KEEP
      data-element=COMTXL_Set_Icon1_cmd_HCP_CPIM_COMMAND_Lin3, handle-invalid=KEEP
      data-element=COMTXL_Set_Icon2_cmd_HCP_CPIM_COMMAND_Lin3, handle-invalid=KEEP
      data-element=COMTXL_DAY_LGT_MD_CPIM_HCP_CPIM_COMMAND_Lin3, handle-invalid=DONT-INVALIDATE
      data-element=COMTXL_Backlight_Cmd_HCP_CPIM_COMMAND_Lin3, handle-invalid=DONT-INVALIDATE
      data-element=COMTXL_HvWtrHeatrPwrCnsAllwd_CCMLIN18Fr02_Lin3, handle-invalid=KEEP
      data-element=COMTXL_HvWtrHeatrWtrTDes_CCMLIN18Fr02_Lin3, handle-invalid=KEEP
      data-element=COMTXL_HvCooltHeatrEnad_CCMLIN18Fr02_Lin3, handle-invalid=DONT-INVALIDATE
      data-element=COMTXL_HVH_OverheatUnlock_CCMLIN18Fr02_Lin3, handle-invalid=DONT-INVALIDATE
      data-element=COMTXL_EOPB_RPM_COM_EOPB_REQ_Lin3, handle-invalid=KEEP
      data-element=COMTXL_EOPB_POST_RUN_COM_EOPB_REQ_Lin3, handle-invalid=KEEP
      data-element=COMTXL_HTLBV_PosRq_HTLBV_REQ_Lin3, handle-invalid=KEEP
      data-element=COMTXL_HTLBV_PosSv_HTLBV_REQ_Lin3, handle-invalid=DONT-INVALIDATE
      data-element=COMTXL_HTLBV_CalRq_HTLBV_REQ_Lin3, handle-invalid=DONT-INVALIDATE
      data-element=COMTXL_PECP2_RPM_REQ_PERCT_PECP2_REQ_GLOBAL_Lin3, handle-invalid=KEEP
      data-element=COMTXL_PECP2_POST_RUN_REQ_PECP2_REQ_GLOBAL_Lin3, handle-invalid=KEEP
      data-element=COMTXL_PECP2_FL_SAFE_ACTVT_PECP2_REQ_GLOBAL_Lin3, handle-invalid=KEEP
      data-element=COMTXL_PowerPanel2_LED_A_Command_PowerPanel2_REQ_Lin3, handle-invalid=KEEP
      data-element=COMTXL_PowerPanel2_LED_B_Command_PowerPanel2_REQ_Lin3, handle-invalid=KEEP
      data-element=COMTXL_DAY_LGT_MD_PowerPanel2_PowerPanel2_REQ_Lin3, handle-invalid=DONT-INVALIDATE
      data-element=COMTXL_PowerPanel2_LED_A_Color_Command_PowerPanel2_REQ_Lin3, handle-invalid=DONT-INVALIDATE
      data-element=COMTXL_PowerPanel2_LED_B_Color_Command_PowerPanel2_REQ_Lin3, handle-invalid=DONT-INVALIDATE
