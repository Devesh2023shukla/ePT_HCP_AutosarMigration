[part 2 of 3: package /STLASWCs]
AUTOSAR XML (schema 4-3-0)
package /STLASWCs  (continued)
  complex device driver sw component type ApplLinComAb_LIN3  (continued)
    behavior IBApplLinComAb_LIN3: data-type-mapping=[MG_LinEquid_Mapping, ADTtoIDTMapping, BswMMappingSet], handle-termination-and-restart=NO-SUPPORT  (continued)
      data receive error event DEECOMRXL_PowerPanel2_LED_A_Feedback_PowerPanel2_STAT_Lin3: start-on-event=COMRXL_PowerPanel2_LED_A_Feedback_PowerPanel2_STAT_Lin3_Error, data=Lin3ComRxSignalsSR.COMRXL_PowerPanel2_LED_A_Feedback_PowerPanel2_STAT_Lin3
      data received event DRECOMRXL_PowerPanel2_LED_B_Feedback_PowerPanel2_STAT_Lin3: start-on-event=COMRXL_PowerPanel2_LED_B_Feedback_PowerPanel2_STAT_Lin3_Received, data=Lin3ComRxSignalsSR.COMRXL_PowerPanel2_LED_B_Feedback_PowerPanel2_STAT_Lin3
      data receive error event DEECOMRXL_PowerPanel2_LED_B_Feedback_PowerPanel2_STAT_Lin3: start-on-event=COMRXL_PowerPanel2_LED_B_Feedback_PowerPanel2_STAT_Lin3_Error, data=Lin3ComRxSignalsSR.COMRXL_PowerPanel2_LED_B_Feedback_PowerPanel2_STAT_Lin3
      data received event DRECOMRXL_PowerPanel2_LED_A_FailStatus_PowerPanel2_STAT_Lin3: start-on-event=COMRXL_PowerPanel2_LED_A_FailStatus_PowerPanel2_STAT_Lin3_Received, data=Lin3ComRxSignalsSR.COMRXL_PowerPanel2_LED_A_FailStatus_PowerPanel2_STAT_Lin3
      data receive error event DEECOMRXL_PowerPanel2_LED_A_FailStatus_PowerPanel2_STAT_Lin3: start-on-event=COMRXL_PowerPanel2_LED_A_FailStatus_PowerPanel2_STAT_Lin3_Error, data=Lin3ComRxSignalsSR.COMRXL_PowerPanel2_LED_A_FailStatus_PowerPanel2_STAT_Lin3
      data received event DRECOMRXL_PowerPanel2_LED_B_FailStatus_PowerPanel2_STAT_Lin3: start-on-event=COMRXL_PowerPanel2_LED_B_FailStatus_PowerPanel2_STAT_Lin3_Received, data=Lin3ComRxSignalsSR.COMRXL_PowerPanel2_LED_B_FailStatus_PowerPanel2_STAT_Lin3
      data receive error event DEECOMRXL_PowerPanel2_LED_B_FailStatus_PowerPanel2_STAT_Lin3: start-on-event=COMRXL_PowerPanel2_LED_B_FailStatus_PowerPanel2_STAT_Lin3_Error, data=Lin3ComRxSignalsSR.COMRXL_PowerPanel2_LED_B_FailStatus_PowerPanel2_STAT_Lin3
      data received event DRECOMRXL_PowerPanel2_LED_A_Color_Feedback_PowerPanel2_STAT_Lin3: start-on-event=COMRXL_PowerPanel2_LED_A_Color_Feedback_PowerPanel2_STAT_Lin3_Received, data=Lin3ComRxSignalsSR.COMRXL_PowerPanel2_LED_A_Color_Feedback_PowerPanel2_STAT_Lin3
      data receive error event DEECOMRXL_PowerPanel2_LED_A_Color_Feedback_PowerPanel2_STAT_Lin3: start-on-event=COMRXL_PowerPanel2_LED_A_Color_Feedback_PowerPanel2_STAT_Lin3_Error, data=Lin3ComRxSignalsSR.COMRXL_PowerPanel2_LED_A_Color_Feedback_PowerPanel2_STAT_Lin3
      data received event DRECOMRXL_PowerPanel2_LED_B_Color_Feedback_PowerPanel2_STAT_Lin3: start-on-event=COMRXL_PowerPanel2_LED_B_Color_Feedback_PowerPanel2_STAT_Lin3_Received, data=Lin3ComRxSignalsSR.COMRXL_PowerPanel2_LED_B_Color_Feedback_PowerPanel2_STAT_Lin3
      data receive error event DEECOMRXL_PowerPanel2_LED_B_Color_Feedback_PowerPanel2_STAT_Lin3: start-on-event=COMRXL_PowerPanel2_LED_B_Color_Feedback_PowerPanel2_STAT_Lin3_Error, data=Lin3ComRxSignalsSR.COMRXL_PowerPanel2_LED_B_Color_Feedback_PowerPanel2_STAT_Lin3
      data received event DRECOMRXL_PowerPanel2_LIN_Checksum_Error_PowerPanel2_STAT_Lin3: start-on-event=COMRXL_PowerPanel2_LIN_Checksum_Error_PowerPanel2_STAT_Lin3_Received, data=Lin3ComRxSignalsSR.COMRXL_PowerPanel2_LIN_Checksum_Error_PowerPanel2_STAT_Lin3
      data receive error event DEECOMRXL_PowerPanel2_LIN_Checksum_Error_PowerPanel2_STAT_Lin3: start-on-event=COMRXL_PowerPanel2_LIN_Checksum_Error_PowerPanel2_STAT_Lin3_Error, data=Lin3ComRxSignalsSR.COMRXL_PowerPanel2_LIN_Checksum_Error_PowerPanel2_STAT_Lin3
      data received event DRECOMRXL_PowerPanel2_LIN_Data_Error_PowerPanel2_STAT_Lin3: start-on-event=COMRXL_PowerPanel2_LIN_Data_Error_PowerPanel2_STAT_Lin3_Received, data=Lin3ComRxSignalsSR.COMRXL_PowerPanel2_LIN_Data_Error_PowerPanel2_STAT_Lin3
      data receive error event DEECOMRXL_PowerPanel2_LIN_Data_Error_PowerPanel2_STAT_Lin3: start-on-event=COMRXL_PowerPanel2_LIN_Data_Error_PowerPanel2_STAT_Lin3_Error, data=Lin3ComRxSignalsSR.COMRXL_PowerPanel2_LIN_Data_Error_PowerPanel2_STAT_Lin3
      data received event DRECOMRXL_PowerPanel2_LIN_Parity_Error_PowerPanel2_STAT_Lin3: start-on-event=COMRXL_PowerPanel2_LIN_Parity_Error_PowerPanel2_STAT_Lin3_Received, data=Lin3ComRxSignalsSR.COMRXL_PowerPanel2_LIN_Parity_Error_PowerPanel2_STAT_Lin3
      data receive error event DEECOMRXL_PowerPanel2_LIN_Parity_Error_PowerPanel2_STAT_Lin3: start-on-event=COMRXL_PowerPanel2_LIN_Parity_Error_PowerPanel2_STAT_Lin3_Error, data=Lin3ComRxSignalsSR.COMRXL_PowerPanel2_LIN_Parity_Error_PowerPanel2_STAT_Lin3
      data received event DRECOMRXL_PowerPanel2_Gnd_Fault_Detected_PowerPanel2_STAT_Lin3: start-on-event=COMRXL_PowerPanel2_Gnd_Fault_Detected_PowerPanel2_STAT_Lin3_Received, data=Lin3ComRxSignalsSR.COMRXL_PowerPanel2_Gnd_Fault_Detected_PowerPanel2_STAT_Lin3
      data receive error event DEECOMRXL_PowerPanel2_Gnd_Fault_Detected_PowerPanel2_STAT_Lin3: start-on-event=COMRXL_PowerPanel2_Gnd_Fault_Detected_PowerPanel2_STAT_Lin3_Error, data=Lin3ComRxSignalsSR.COMRXL_PowerPanel2_Gnd_Fault_Detected_PowerPanel2_STAT_Lin3
      data received event DRESendLINR_PowPan2_LED_A_Col_Comm: start-on-event=SendLINR_PowPan2_LED_A_Col_Comm, data=SendLINR_PowPan2_LED_A_Col_Comm.SendLINR_PowPan2_LED_A_Col_Comm
      data received event DRESendLINR_PowPan2_LED_B_Col_Comm: start-on-event=SendLINR_PowPan2_LED_B_Col_Comm, data=SendLINR_PowPan2_LED_B_Col_Comm.SendLINR_PowPan2_LED_B_Col_Comm
      data received event DRECOMRXL_PowerPanel2_Current_Draw_Sens1_PowerPanel2_STAT_Lin3: start-on-event=COMRXL_PowerPanel2_Current_Draw_Sens1_PowerPanel2_STAT_Lin3_Received, data=Lin3ComRxSignalsSR.COMRXL_PowerPanel2_Current_Draw_Sens1_PowerPanel2_STAT_Lin3
      data receive error event DEECOMRXL_PowerPanel2_Current_Draw_Sens1_PowerPanel2_STAT_Lin3: start-on-event=COMRXL_PowerPanel2_Current_Draw_Sens1_PowerPanel2_STAT_Lin3_Error, data=Lin3ComRxSignalsSR.COMRXL_PowerPanel2_Current_Draw_Sens1_PowerPanel2_STAT_Lin3
      data received event DRECOMRXL_PowerPanel2_Current_Draw_Sens2_PowerPanel2_STAT_Lin3: start-on-event=COMRXL_PowerPanel2_Current_Draw_Sens2_PowerPanel2_STAT_Lin3_Received, data=Lin3ComRxSignalsSR.COMRXL_PowerPanel2_Current_Draw_Sens2_PowerPanel2_STAT_Lin3
      data receive error event DEECOMRXL_PowerPanel2_Current_Draw_Sens2_PowerPanel2_STAT_Lin3: start-on-event=COMRXL_PowerPanel2_Current_Draw_Sens2_PowerPanel2_STAT_Lin3_Error, data=Lin3ComRxSignalsSR.COMRXL_PowerPanel2_Current_Draw_Sens2_PowerPanel2_STAT_Lin3
      data received event DRECOMRXL_PowerPanel2_Fault_PowerPanel2_STAT_Lin3: start-on-event=COMRXL_PowerPanel2_Fault_PowerPanel2_STAT_Lin3_Received, data=Lin3ComRxSignalsSR.COMRXL_PowerPanel2_Fault_PowerPanel2_STAT_Lin3
      data receive error event DEECOMRXL_PowerPanel2_Fault_PowerPanel2_STAT_Lin3: start-on-event=COMRXL_PowerPanel2_Fault_PowerPanel2_STAT_Lin3_Error, data=Lin3ComRxSignalsSR.COMRXL_PowerPanel2_Fault_PowerPanel2_STAT_Lin3
      data received event DRECOMRXL_PowerPanel2_RatedPower_PowerPanel2_STAT_Lin3: start-on-event=COMRXL_PowerPanel2_RatedPower_PowerPanel2_STAT_Lin3_Received, data=Lin3ComRxSignalsSR.COMRXL_PowerPanel2_RatedPower_PowerPanel2_STAT_Lin3
      data receive error event DEECOMRXL_PowerPanel2_RatedPower_PowerPanel2_STAT_Lin3: start-on-event=COMRXL_PowerPanel2_RatedPower_PowerPanel2_STAT_Lin3_Error, data=Lin3ComRxSignalsSR.COMRXL_PowerPanel2_RatedPower_PowerPanel2_STAT_Lin3
      explicit-inter-runnable-variables:
        data VeLINR_d_LIN_SlavePrsnt_LIN3: type=uint16, init-value=Value:0  # Each bit inidicates whether a LIN slave is present (equipped or learned). 0 = not present, 1 = present.
        data VeLINR_d_LIN_SlaveRdyToSleep_LIN3: type=uint16, init-value=Value:0  # Each bit indicates whether a LIN slave is ready to sleep. 0 = not ready, 1 = ready
        data VeLINR_d_LIN_SysSts_LIN3: type=uint16, init-value=Value:0  # Bits which indicate LIN system status.
      334 x runnable:
        COMRXL_AGS_CurrPos_AGS_ECM_STATUS_Lin3_Received: symbol=ApplLinComAb_LIN3_COMRXL_AGS_CurrPos_AGS_ECM_STATUS_Lin3_Received  # Received -
          data-receive-point-by-arguments:
            access DRP_Lin3ComRxSignalsSR_COMRXL_AGS_CurrPos_AGS_ECM_STATUS_Lin3: accessed-variable=Lin3ComRxSignalsSR.COMRXL_AGS_CurrPos_AGS_ECM_STATUS_Lin3
          data-send-points:
            access DSP_VeLINR_e_AGS_CurrPos_VeLINR_e_AGS_CurrPos: accessed-variable=VeLINR_e_AGS_CurrPos.VeLINR_e_AGS_CurrPos
            access DSP_VeLINR_b_AGS_CurrPosTO_VeLINR_b_AGS_CurrPosTO: accessed-variable=VeLINR_b_AGS_CurrPosTO.VeLINR_b_AGS_CurrPosTO
        COMRXL_AGS_CurrPos_AGS_ECM_STATUS_Lin3_Error: symbol=ApplLinComAb_LIN3_COMRXL_AGS_CurrPos_AGS_ECM_STATUS_Lin3_Error  # Error -
          data-receive-point-by-arguments:
            access DRP_Lin3ComRxSignalsSR_COMRXL_AGS_CurrPos_AGS_ECM_STATUS_Lin3: accessed-variable=Lin3ComRxSignalsSR.COMRXL_AGS_CurrPos_AGS_ECM_STATUS_Lin3
          data-send-points:
            access DSP_VeLINR_e_AGS_CurrPos_VeLINR_e_AGS_CurrPos: accessed-variable=VeLINR_e_AGS_CurrPos.VeLINR_e_AGS_CurrPos
            access DSP_VeLINR_b_AGS_CurrPosTO_VeLINR_b_AGS_CurrPosTO: accessed-variable=VeLINR_b_AGS_CurrPosTO.VeLINR_b_AGS_CurrPosTO
          read-local-variables:
            access IRVRA_VeLINR_d_LIN_SlavePrsnt_LIN3: accessed-variable=VeLINR_d_LIN_SlavePrsnt_LIN3
        COMRXL_AGS_CalStat_AGS_ECM_STATUS_Lin3_Received: symbol=ApplLinComAb_LIN3_COMRXL_AGS_CalStat_AGS_ECM_STATUS_Lin3_Received  # Received -
          data-receive-point-by-arguments:
            access DRP_Lin3ComRxSignalsSR_COMRXL_AGS_CalStat_AGS_ECM_STATUS_Lin3: accessed-variable=Lin3ComRxSignalsSR.COMRXL_AGS_CalStat_AGS_ECM_STATUS_Lin3
          data-send-points:
            access DSP_VeLINR_b_AGS_CalStat_VeLINR_b_AGS_CalStat: accessed-variable=VeLINR_b_AGS_CalStat.VeLINR_b_AGS_CalStat
            access DSP_VeLINR_b_AGS_CalStatTO_VeLINR_b_AGS_CalStatTO: accessed-variable=VeLINR_b_AGS_CalStatTO.VeLINR_b_AGS_CalStatTO
        COMRXL_AGS_CalStat_AGS_ECM_STATUS_Lin3_Error: symbol=ApplLinComAb_LIN3_COMRXL_AGS_CalStat_AGS_ECM_STATUS_Lin3_Error  # Error -
          data-receive-point-by-arguments:
            access DRP_Lin3ComRxSignalsSR_COMRXL_AGS_CalStat_AGS_ECM_STATUS_Lin3: accessed-variable=Lin3ComRxSignalsSR.COMRXL_AGS_CalStat_AGS_ECM_STATUS_Lin3
          data-send-points:
            access DSP_VeLINR_b_AGS_CalStat_VeLINR_b_AGS_CalStat: accessed-variable=VeLINR_b_AGS_CalStat.VeLINR_b_AGS_CalStat
            access DSP_VeLINR_b_AGS_CalStatTO_VeLINR_b_AGS_CalStatTO: accessed-variable=VeLINR_b_AGS_CalStatTO.VeLINR_b_AGS_CalStatTO
          read-local-variables:
            access IRVRA_VeLINR_d_LIN_SlavePrsnt_LIN3: accessed-variable=VeLINR_d_LIN_SlavePrsnt_LIN3
        COMRXL_AGS_CalActv_AGS_ECM_STATUS_Lin3_Received: symbol=ApplLinComAb_LIN3_COMRXL_AGS_CalActv_AGS_ECM_STATUS_Lin3_Received  # Received -
          data-receive-point-by-arguments:
            access DRP_Lin3ComRxSignalsSR_COMRXL_AGS_CalActv_AGS_ECM_STATUS_Lin3: accessed-variable=Lin3ComRxSignalsSR.COMRXL_AGS_CalActv_AGS_ECM_STATUS_Lin3
          data-send-points:
            access DSP_VeLINR_b_AGS_CalActv_VeLINR_b_AGS_CalActv: accessed-variable=VeLINR_b_AGS_CalActv.VeLINR_b_AGS_CalActv
            access DSP_VeLINR_b_AGS_CalActvTO_VeLINR_b_AGS_CalActvTO: accessed-variable=VeLINR_b_AGS_CalActvTO.VeLINR_b_AGS_CalActvTO
        COMRXL_AGS_CalActv_AGS_ECM_STATUS_Lin3_Error: symbol=ApplLinComAb_LIN3_COMRXL_AGS_CalActv_AGS_ECM_STATUS_Lin3_Error  # Error -
          data-receive-point-by-arguments:
            access DRP_Lin3ComRxSignalsSR_COMRXL_AGS_CalActv_AGS_ECM_STATUS_Lin3: accessed-variable=Lin3ComRxSignalsSR.COMRXL_AGS_CalActv_AGS_ECM_STATUS_Lin3
          data-send-points:
            access DSP_VeLINR_b_AGS_CalActv_VeLINR_b_AGS_CalActv: accessed-variable=VeLINR_b_AGS_CalActv.VeLINR_b_AGS_CalActv
            access DSP_VeLINR_b_AGS_CalActvTO_VeLINR_b_AGS_CalActvTO: accessed-variable=VeLINR_b_AGS_CalActvTO.VeLINR_b_AGS_CalActvTO
          read-local-variables:
            access IRVRA_VeLINR_d_LIN_SlavePrsnt_LIN3: accessed-variable=VeLINR_d_LIN_SlavePrsnt_LIN3
        COMRXL_AGS_ErrUnVolt_AGS_ECM_STATUS_Lin3_Received: symbol=ApplLinComAb_LIN3_COMRXL_AGS_ErrUnVolt_AGS_ECM_STATUS_Lin3_Received  # Received -
          data-receive-point-by-arguments:
            access DRP_Lin3ComRxSignalsSR_COMRXL_AGS_ErrUnVolt_AGS_ECM_STATUS_Lin3: accessed-variable=Lin3ComRxSignalsSR.COMRXL_AGS_ErrUnVolt_AGS_ECM_STATUS_Lin3
          data-send-points:
            access DSP_VeLINR_b_AGS_ErrUnVolt_VeLINR_b_AGS_ErrUnVolt: accessed-variable=VeLINR_b_AGS_ErrUnVolt.VeLINR_b_AGS_ErrUnVolt
            access DSP_VeLINR_b_AGS_ErrUnVoltTO_VeLINR_b_AGS_ErrUnVoltTO: accessed-variable=VeLINR_b_AGS_ErrUnVoltTO.VeLINR_b_AGS_ErrUnVoltTO
        COMRXL_AGS_ErrUnVolt_AGS_ECM_STATUS_Lin3_Error: symbol=ApplLinComAb_LIN3_COMRXL_AGS_ErrUnVolt_AGS_ECM_STATUS_Lin3_Error  # Error -
          data-receive-point-by-arguments:
            access DRP_Lin3ComRxSignalsSR_COMRXL_AGS_ErrUnVolt_AGS_ECM_STATUS_Lin3: accessed-variable=Lin3ComRxSignalsSR.COMRXL_AGS_ErrUnVolt_AGS_ECM_STATUS_Lin3
          data-send-points:
            access DSP_VeLINR_b_AGS_ErrUnVolt_VeLINR_b_AGS_ErrUnVolt: accessed-variable=VeLINR_b_AGS_ErrUnVolt.VeLINR_b_AGS_ErrUnVolt
            access DSP_VeLINR_b_AGS_ErrUnVoltTO_VeLINR_b_AGS_ErrUnVoltTO: accessed-variable=VeLINR_b_AGS_ErrUnVoltTO.VeLINR_b_AGS_ErrUnVoltTO
          read-local-variables:
            access IRVRA_VeLINR_d_LIN_SlavePrsnt_LIN3: accessed-variable=VeLINR_d_LIN_SlavePrsnt_LIN3
        COMRXL_AGS_ErrOvrVolt_AGS_ECM_STATUS_Lin3_Received: symbol=ApplLinComAb_LIN3_COMRXL_AGS_ErrOvrVolt_AGS_ECM_STATUS_Lin3_Received  # Received -
          data-receive-point-by-arguments:
            access DRP_Lin3ComRxSignalsSR_COMRXL_AGS_ErrOvrVolt_AGS_ECM_STATUS_Lin3: accessed-variable=Lin3ComRxSignalsSR.COMRXL_AGS_ErrOvrVolt_AGS_ECM_STATUS_Lin3
          data-send-points:
            access DSP_VeLINR_b_AGS_ErrOvrVolt_VeLINR_b_AGS_ErrOvrVolt: accessed-variable=VeLINR_b_AGS_ErrOvrVolt.VeLINR_b_AGS_ErrOvrVolt
            access DSP_VeLINR_b_AGS_ErrOvrVoltTO_VeLINR_b_AGS_ErrOvrVoltTO: accessed-variable=VeLINR_b_AGS_ErrOvrVoltTO.VeLINR_b_AGS_ErrOvrVoltTO
        COMRXL_AGS_ErrOvrVolt_AGS_ECM_STATUS_Lin3_Error: symbol=ApplLinComAb_LIN3_COMRXL_AGS_ErrOvrVolt_AGS_ECM_STATUS_Lin3_Error  # Error -
          data-receive-point-by-arguments:
            access DRP_Lin3ComRxSignalsSR_COMRXL_AGS_ErrOvrVolt_AGS_ECM_STATUS_Lin3: accessed-variable=Lin3ComRxSignalsSR.COMRXL_AGS_ErrOvrVolt_AGS_ECM_STATUS_Lin3
          data-send-points:
            access DSP_VeLINR_b_AGS_ErrOvrVolt_VeLINR_b_AGS_ErrOvrVolt: accessed-variable=VeLINR_b_AGS_ErrOvrVolt.VeLINR_b_AGS_ErrOvrVolt
            access DSP_VeLINR_b_AGS_ErrOvrVoltTO_VeLINR_b_AGS_ErrOvrVoltTO: accessed-variable=VeLINR_b_AGS_ErrOvrVoltTO.VeLINR_b_AGS_ErrOvrVoltTO
          read-local-variables:
            access IRVRA_VeLINR_d_LIN_SlavePrsnt_LIN3: accessed-variable=VeLINR_d_LIN_SlavePrsnt_LIN3
        COMRXL_AGS_ErrOvrTemp_AGS_ECM_STATUS_Lin3_Received: symbol=ApplLinComAb_LIN3_COMRXL_AGS_ErrOvrTemp_AGS_ECM_STATUS_Lin3_Received  # Received -
          data-receive-point-by-arguments:
            access DRP_Lin3ComRxSignalsSR_COMRXL_AGS_ErrOvrTemp_AGS_ECM_STATUS_Lin3: accessed-variable=Lin3ComRxSignalsSR.COMRXL_AGS_ErrOvrTemp_AGS_ECM_STATUS_Lin3
          data-send-points:
            access DSP_VeLINR_b_AGS_ErrOvrTemp_VeLINR_b_AGS_ErrOvrTemp: accessed-variable=VeLINR_b_AGS_ErrOvrTemp.VeLINR_b_AGS_ErrOvrTemp
            access DSP_VeLINR_b_AGS_ErrOvrTempTO_VeLINR_b_AGS_ErrOvrTempTO: accessed-variable=VeLINR_b_AGS_ErrOvrTempTO.VeLINR_b_AGS_ErrOvrTempTO
        COMRXL_AGS_ErrOvrTemp_AGS_ECM_STATUS_Lin3_Error: symbol=ApplLinComAb_LIN3_COMRXL_AGS_ErrOvrTemp_AGS_ECM_STATUS_Lin3_Error  # Error -
          data-receive-point-by-arguments:
            access DRP_Lin3ComRxSignalsSR_COMRXL_AGS_ErrOvrTemp_AGS_ECM_STATUS_Lin3: accessed-variable=Lin3ComRxSignalsSR.COMRXL_AGS_ErrOvrTemp_AGS_ECM_STATUS_Lin3
          data-send-points:
            access DSP_VeLINR_b_AGS_ErrOvrTemp_VeLINR_b_AGS_ErrOvrTemp: accessed-variable=VeLINR_b_AGS_ErrOvrTemp.VeLINR_b_AGS_ErrOvrTemp
            access DSP_VeLINR_b_AGS_ErrOvrTempTO_VeLINR_b_AGS_ErrOvrTempTO: accessed-variable=VeLINR_b_AGS_ErrOvrTempTO.VeLINR_b_AGS_ErrOvrTempTO
          read-local-variables:
            access IRVRA_VeLINR_d_LIN_SlavePrsnt_LIN3: accessed-variable=VeLINR_d_LIN_SlavePrsnt_LIN3
        COMRXL_AGS_ErrMechStuck_AGS_ECM_STATUS_Lin3_Received: symbol=ApplLinComAb_LIN3_COMRXL_AGS_ErrMechStuck_AGS_ECM_STATUS_Lin3_Received  # Received -
          data-receive-point-by-arguments:
            access DRP_Lin3ComRxSignalsSR_COMRXL_AGS_ErrMechStuck_AGS_ECM_STATUS_Lin3: accessed-variable=Lin3ComRxSignalsSR.COMRXL_AGS_ErrMechStuck_AGS_ECM_STATUS_Lin3
          data-send-points:
            access DSP_VeLINR_b_AGS_ErrMechStuck_VeLINR_b_AGS_ErrMechStuck: accessed-variable=VeLINR_b_AGS_ErrMechStuck.VeLINR_b_AGS_ErrMechStuck
            access DSP_VeLINR_b_AGS_ErrMechStuckTO_VeLINR_b_AGS_ErrMechStuckTO: accessed-variable=VeLINR_b_AGS_ErrMechStuckTO.VeLINR_b_AGS_ErrMechStuckTO
        COMRXL_AGS_ErrMechStuck_AGS_ECM_STATUS_Lin3_Error: symbol=ApplLinComAb_LIN3_COMRXL_AGS_ErrMechStuck_AGS_ECM_STATUS_Lin3_Error  # Error -
          data-receive-point-by-arguments:
            access DRP_Lin3ComRxSignalsSR_COMRXL_AGS_ErrMechStuck_AGS_ECM_STATUS_Lin3: accessed-variable=Lin3ComRxSignalsSR.COMRXL_AGS_ErrMechStuck_AGS_ECM_STATUS_Lin3
          data-send-points:
            access DSP_VeLINR_b_AGS_ErrMechStuck_VeLINR_b_AGS_ErrMechStuck: accessed-variable=VeLINR_b_AGS_ErrMechStuck.VeLINR_b_AGS_ErrMechStuck
            access DSP_VeLINR_b_AGS_ErrMechStuckTO_VeLINR_b_AGS_ErrMechStuckTO: accessed-variable=VeLINR_b_AGS_ErrMechStuckTO.VeLINR_b_AGS_ErrMechStuckTO
          read-local-variables:
            access IRVRA_VeLINR_d_LIN_SlavePrsnt_LIN3: accessed-variable=VeLINR_d_LIN_SlavePrsnt_LIN3
        COMRXL_AGS_ErrMechBreak_AGS_ECM_STATUS_Lin3_Received: symbol=ApplLinComAb_LIN3_COMRXL_AGS_ErrMechBreak_AGS_ECM_STATUS_Lin3_Received  # Received -
          data-receive-point-by-arguments:
            access DRP_Lin3ComRxSignalsSR_COMRXL_AGS_ErrMechBreak_AGS_ECM_STATUS_Lin3: accessed-variable=Lin3ComRxSignalsSR.COMRXL_AGS_ErrMechBreak_AGS_ECM_STATUS_Lin3
          data-send-points:
            access DSP_VeLINR_b_AGS_ErrMechBreak_VeLINR_b_AGS_ErrMechBreak: accessed-variable=VeLINR_b_AGS_ErrMechBreak.VeLINR_b_AGS_ErrMechBreak
            access DSP_VeLINR_b_AGS_ErrMechBreakTO_VeLINR_b_AGS_ErrMechBreakTO: accessed-variable=VeLINR_b_AGS_ErrMechBreakTO.VeLINR_b_AGS_ErrMechBreakTO
        COMRXL_AGS_ErrMechBreak_AGS_ECM_STATUS_Lin3_Error: symbol=ApplLinComAb_LIN3_COMRXL_AGS_ErrMechBreak_AGS_ECM_STATUS_Lin3_Error  # Error -
          data-receive-point-by-arguments:
            access DRP_Lin3ComRxSignalsSR_COMRXL_AGS_ErrMechBreak_AGS_ECM_STATUS_Lin3: accessed-variable=Lin3ComRxSignalsSR.COMRXL_AGS_ErrMechBreak_AGS_ECM_STATUS_Lin3
          data-send-points:
            access DSP_VeLINR_b_AGS_ErrMechBreak_VeLINR_b_AGS_ErrMechBreak: accessed-variable=VeLINR_b_AGS_ErrMechBreak.VeLINR_b_AGS_ErrMechBreak
            access DSP_VeLINR_b_AGS_ErrMechBreakTO_VeLINR_b_AGS_ErrMechBreakTO: accessed-variable=VeLINR_b_AGS_ErrMechBreakTO.VeLINR_b_AGS_ErrMechBreakTO
          read-local-variables:
            access IRVRA_VeLINR_d_LIN_SlavePrsnt_LIN3: accessed-variable=VeLINR_d_LIN_SlavePrsnt_LIN3
        COMRXL_AGS_ErrLIN_AGS_ECM_STATUS_Lin3_Received: symbol=ApplLinComAb_LIN3_COMRXL_AGS_ErrLIN_AGS_ECM_STATUS_Lin3_Received  # Received -
          data-receive-point-by-arguments:
            access DRP_Lin3ComRxSignalsSR_COMRXL_AGS_ErrLIN_AGS_ECM_STATUS_Lin3: accessed-variable=Lin3ComRxSignalsSR.COMRXL_AGS_ErrLIN_AGS_ECM_STATUS_Lin3
          data-send-points:
            access DSP_VeLINR_e_AGS_ErrLIN_VeLINR_e_AGS_ErrLIN: accessed-variable=VeLINR_e_AGS_ErrLIN.VeLINR_e_AGS_ErrLIN
            access DSP_VeLINR_b_AGS_ErrLIN_TO_VeLINR_b_AGS_ErrLIN_TO: accessed-variable=VeLINR_b_AGS_ErrLIN_TO.VeLINR_b_AGS_ErrLIN_TO
        COMRXL_AGS_ErrLIN_AGS_ECM_STATUS_Lin3_Error: symbol=ApplLinComAb_LIN3_COMRXL_AGS_ErrLIN_AGS_ECM_STATUS_Lin3_Error  # Error -
          data-receive-point-by-arguments:
            access DRP_Lin3ComRxSignalsSR_COMRXL_AGS_ErrLIN_AGS_ECM_STATUS_Lin3: accessed-variable=Lin3ComRxSignalsSR.COMRXL_AGS_ErrLIN_AGS_ECM_STATUS_Lin3
          data-send-points:
            access DSP_VeLINR_e_AGS_ErrLIN_VeLINR_e_AGS_ErrLIN: accessed-variable=VeLINR_e_AGS_ErrLIN.VeLINR_e_AGS_ErrLIN
            access DSP_VeLINR_b_AGS_ErrLIN_TO_VeLINR_b_AGS_ErrLIN_TO: accessed-variable=VeLINR_b_AGS_ErrLIN_TO.VeLINR_b_AGS_ErrLIN_TO
          read-local-variables:
            access IRVRA_VeLINR_d_LIN_SlavePrsnt_LIN3: accessed-variable=VeLINR_d_LIN_SlavePrsnt_LIN3
        COMRXL_RsErr_AGS_AGS_ECM_STATUS_Lin3_Received: symbol=ApplLinComAb_LIN3_COMRXL_RsErr_AGS_AGS_ECM_STATUS_Lin3_Received  # Received -
          data-receive-point-by-arguments:
            access DRP_Lin3ComRxSignalsSR_COMRXL_RsErr_AGS_AGS_ECM_STATUS_Lin3: accessed-variable=Lin3ComRxSignalsSR.COMRXL_RsErr_AGS_AGS_ECM_STATUS_Lin3
          data-send-points:
            access DSP_VeLINR_b_RsErr_AGS_VeLINR_b_RsErr_AGS: accessed-variable=VeLINR_b_RsErr_AGS.VeLINR_b_RsErr_AGS
            access DSP_VeLINR_b_RsErr_AGS_TO_VeLINR_b_RsErr_AGS_TO: accessed-variable=VeLINR_b_RsErr_AGS_TO.VeLINR_b_RsErr_AGS_TO
        COMRXL_RsErr_AGS_AGS_ECM_STATUS_Lin3_Error: symbol=ApplLinComAb_LIN3_COMRXL_RsErr_AGS_AGS_ECM_STATUS_Lin3_Error  # Error -
          data-receive-point-by-arguments:
            access DRP_Lin3ComRxSignalsSR_COMRXL_RsErr_AGS_AGS_ECM_STATUS_Lin3: accessed-variable=Lin3ComRxSignalsSR.COMRXL_RsErr_AGS_AGS_ECM_STATUS_Lin3
          data-send-points:
            access DSP_VeLINR_b_RsErr_AGS_VeLINR_b_RsErr_AGS: accessed-variable=VeLINR_b_RsErr_AGS.VeLINR_b_RsErr_AGS
            access DSP_VeLINR_b_RsErr_AGS_TO_VeLINR_b_RsErr_AGS_TO: accessed-variable=VeLINR_b_RsErr_AGS_TO.VeLINR_b_RsErr_AGS_TO
          read-local-variables:
            access IRVRA_VeLINR_d_LIN_SlavePrsnt_LIN3: accessed-variable=VeLINR_d_LIN_SlavePrsnt_LIN3
        COMRXL_AGS_BoostStat_AGS_ECM_STATUS_Lin3_Received: symbol=ApplLinComAb_LIN3_COMRXL_AGS_BoostStat_AGS_ECM_STATUS_Lin3_Received  # Received -
          data-receive-point-by-arguments:
            access DRP_Lin3ComRxSignalsSR_COMRXL_AGS_BoostStat_AGS_ECM_STATUS_Lin3: accessed-variable=Lin3ComRxSignalsSR.COMRXL_AGS_BoostStat_AGS_ECM_STATUS_Lin3
          data-send-points:
            access DSP_VeLINR_b_AGS_BoostStat_VeLINR_b_AGS_BoostStat: accessed-variable=VeLINR_b_AGS_BoostStat.VeLINR_b_AGS_BoostStat
            access DSP_VeLINR_b_AGS_BoostStatTO_VeLINR_b_AGS_BoostStatTO: accessed-variable=VeLINR_b_AGS_BoostStatTO.VeLINR_b_AGS_BoostStatTO
        COMRXL_AGS_BoostStat_AGS_ECM_STATUS_Lin3_Error: symbol=ApplLinComAb_LIN3_COMRXL_AGS_BoostStat_AGS_ECM_STATUS_Lin3_Error  # Error -
          data-receive-point-by-arguments:
            access DRP_Lin3ComRxSignalsSR_COMRXL_AGS_BoostStat_AGS_ECM_STATUS_Lin3: accessed-variable=Lin3ComRxSignalsSR.COMRXL_AGS_BoostStat_AGS_ECM_STATUS_Lin3
          data-send-points:
            access DSP_VeLINR_b_AGS_BoostStat_VeLINR_b_AGS_BoostStat: accessed-variable=VeLINR_b_AGS_BoostStat.VeLINR_b_AGS_BoostStat
            access DSP_VeLINR_b_AGS_BoostStatTO_VeLINR_b_AGS_BoostStatTO: accessed-variable=VeLINR_b_AGS_BoostStatTO.VeLINR_b_AGS_BoostStatTO
          read-local-variables:
            access IRVRA_VeLINR_d_LIN_SlavePrsnt_LIN3: accessed-variable=VeLINR_d_LIN_SlavePrsnt_LIN3
        COMRXL_S2MRes1Bit_AGS_ECM_STATUS_Lin3_Received: symbol=ApplLinComAb_LIN3_COMRXL_S2MRes1Bit_AGS_ECM_STATUS_Lin3_Received  # Received -
          data-receive-point-by-arguments:
            access DRP_Lin3ComRxSignalsSR_COMRXL_S2MRes1Bit_AGS_ECM_STATUS_Lin3: accessed-variable=Lin3ComRxSignalsSR.COMRXL_S2MRes1Bit_AGS_ECM_STATUS_Lin3
          data-send-points:
            access DSP_VeLINR_b_S2MRes1Bit_VeLINR_b_S2MRes1Bit: accessed-variable=VeLINR_b_S2MRes1Bit.VeLINR_b_S2MRes1Bit
            access DSP_VeLINR_b_S2MRes1BitTO_VeLINR_b_S2MRes1BitTO: accessed-variable=VeLINR_b_S2MRes1BitTO.VeLINR_b_S2MRes1BitTO
        COMRXL_S2MRes1Bit_AGS_ECM_STATUS_Lin3_Error: symbol=ApplLinComAb_LIN3_COMRXL_S2MRes1Bit_AGS_ECM_STATUS_Lin3_Error  # Error -
          data-receive-point-by-arguments:
            access DRP_Lin3ComRxSignalsSR_COMRXL_S2MRes1Bit_AGS_ECM_STATUS_Lin3: accessed-variable=Lin3ComRxSignalsSR.COMRXL_S2MRes1Bit_AGS_ECM_STATUS_Lin3
          data-send-points:
            access DSP_VeLINR_b_S2MRes1Bit_VeLINR_b_S2MRes1Bit: accessed-variable=VeLINR_b_S2MRes1Bit.VeLINR_b_S2MRes1Bit
            access DSP_VeLINR_b_S2MRes1BitTO_VeLINR_b_S2MRes1BitTO: accessed-variable=VeLINR_b_S2MRes1BitTO.VeLINR_b_S2MRes1BitTO
          read-local-variables:
            access IRVRA_VeLINR_d_LIN_SlavePrsnt_LIN3: accessed-variable=VeLINR_d_LIN_SlavePrsnt_LIN3
        COMRXL_S2MResByte1_AGS_ECM_STATUS_Lin3_Received: symbol=ApplLinComAb_LIN3_COMRXL_S2MResByte1_AGS_ECM_STATUS_Lin3_Received  # Received -
          data-receive-point-by-arguments:
            access DRP_Lin3ComRxSignalsSR_COMRXL_S2MResByte1_AGS_ECM_STATUS_Lin3: accessed-variable=Lin3ComRxSignalsSR.COMRXL_S2MResByte1_AGS_ECM_STATUS_Lin3
          data-send-points:
            access DSP_VeLINR_e_S2MResByte1_VeLINR_e_S2MResByte1: accessed-variable=VeLINR_e_S2MResByte1.VeLINR_e_S2MResByte1
            access DSP_VeLINR_b_S2MResByte1TO_VeLINR_b_S2MResByte1TO: accessed-variable=VeLINR_b_S2MResByte1TO.VeLINR_b_S2MResByte1TO
        COMRXL_S2MResByte1_AGS_ECM_STATUS_Lin3_Error: symbol=ApplLinComAb_LIN3_COMRXL_S2MResByte1_AGS_ECM_STATUS_Lin3_Error  # Error -
          data-receive-point-by-arguments:
            access DRP_Lin3ComRxSignalsSR_COMRXL_S2MResByte1_AGS_ECM_STATUS_Lin3: accessed-variable=Lin3ComRxSignalsSR.COMRXL_S2MResByte1_AGS_ECM_STATUS_Lin3
          data-send-points:
            access DSP_VeLINR_e_S2MResByte1_VeLINR_e_S2MResByte1: accessed-variable=VeLINR_e_S2MResByte1.VeLINR_e_S2MResByte1
            access DSP_VeLINR_b_S2MResByte1TO_VeLINR_b_S2MResByte1TO: accessed-variable=VeLINR_b_S2MResByte1TO.VeLINR_b_S2MResByte1TO
          read-local-variables:
            access IRVRA_VeLINR_d_LIN_SlavePrsnt_LIN3: accessed-variable=VeLINR_d_LIN_SlavePrsnt_LIN3
        COMRXL_S2MResByte2_AGS_ECM_STATUS_Lin3_Received: symbol=ApplLinComAb_LIN3_COMRXL_S2MResByte2_AGS_ECM_STATUS_Lin3_Received  # Received -
          data-receive-point-by-arguments:
            access DRP_Lin3ComRxSignalsSR_COMRXL_S2MResByte2_AGS_ECM_STATUS_Lin3: accessed-variable=Lin3ComRxSignalsSR.COMRXL_S2MResByte2_AGS_ECM_STATUS_Lin3
          data-send-points:
            access DSP_VeLINR_e_S2MResByte2_VeLINR_e_S2MResByte2: accessed-variable=VeLINR_e_S2MResByte2.VeLINR_e_S2MResByte2
            access DSP_VeLINR_b_S2MResByte2TO_VeLINR_b_S2MResByte2TO: accessed-variable=VeLINR_b_S2MResByte2TO.VeLINR_b_S2MResByte2TO
        COMRXL_S2MResByte2_AGS_ECM_STATUS_Lin3_Error: symbol=ApplLinComAb_LIN3_COMRXL_S2MResByte2_AGS_ECM_STATUS_Lin3_Error  # Error -
          data-receive-point-by-arguments:
            access DRP_Lin3ComRxSignalsSR_COMRXL_S2MResByte2_AGS_ECM_STATUS_Lin3: accessed-variable=Lin3ComRxSignalsSR.COMRXL_S2MResByte2_AGS_ECM_STATUS_Lin3
          data-send-points:
            access DSP_VeLINR_e_S2MResByte2_VeLINR_e_S2MResByte2: accessed-variable=VeLINR_e_S2MResByte2.VeLINR_e_S2MResByte2
            access DSP_VeLINR_b_S2MResByte2TO_VeLINR_b_S2MResByte2TO: accessed-variable=VeLINR_b_S2MResByte2TO.VeLINR_b_S2MResByte2TO
          read-local-variables:
            access IRVRA_VeLINR_d_LIN_SlavePrsnt_LIN3: accessed-variable=VeLINR_d_LIN_SlavePrsnt_LIN3
        COMRXL_CEXV_PosAct_CEXV_STAT_Lin3_Received: symbol=ApplLinComAb_LIN3_COMRXL_CEXV_PosAct_CEXV_STAT_Lin3_Received  # Received -
          data-receive-point-by-arguments:
            access DRP_Lin3ComRxSignalsSR_COMRXL_CEXV_PosAct_CEXV_STAT_Lin3: accessed-variable=Lin3ComRxSignalsSR.COMRXL_CEXV_PosAct_CEXV_STAT_Lin3
          data-send-points:
            access DSP_VeLINR_Pct_CEXV_PosAct_VeLINR_Pct_CEXV_PosAct: accessed-variable=VeLINR_Pct_CEXV_PosAct.VeLINR_Pct_CEXV_PosAct
            access DSP_VeLINR_b_CEXV_PosActTO_VeLINR_b_CEXV_PosActTO: accessed-variable=VeLINR_b_CEXV_PosActTO.VeLINR_b_CEXV_PosActTO
        COMRXL_CEXV_PosAct_CEXV_STAT_Lin3_Error: symbol=ApplLinComAb_LIN3_COMRXL_CEXV_PosAct_CEXV_STAT_Lin3_Error  # Error -
          data-receive-point-by-arguments:
            access DRP_Lin3ComRxSignalsSR_COMRXL_CEXV_PosAct_CEXV_STAT_Lin3: accessed-variable=Lin3ComRxSignalsSR.COMRXL_CEXV_PosAct_CEXV_STAT_Lin3
          data-send-points:
            access DSP_VeLINR_Pct_CEXV_PosAct_VeLINR_Pct_CEXV_PosAct: accessed-variable=VeLINR_Pct_CEXV_PosAct.VeLINR_Pct_CEXV_PosAct
            access DSP_VeLINR_b_CEXV_PosActTO_VeLINR_b_CEXV_PosActTO: accessed-variable=VeLINR_b_CEXV_PosActTO.VeLINR_b_CEXV_PosActTO
          read-local-variables:
            access IRVRA_VeLINR_d_LIN_SlavePrsnt_LIN3: accessed-variable=VeLINR_d_LIN_SlavePrsnt_LIN3
        COMRXL_CEXV_CalStat_CEXV_STAT_Lin3_Received: symbol=ApplLinComAb_LIN3_COMRXL_CEXV_CalStat_CEXV_STAT_Lin3_Received  # Received -
          data-receive-point-by-arguments:
            access DRP_Lin3ComRxSignalsSR_COMRXL_CEXV_CalStat_CEXV_STAT_Lin3: accessed-variable=Lin3ComRxSignalsSR.COMRXL_CEXV_CalStat_CEXV_STAT_Lin3
          data-send-points:
            access DSP_VeLINR_e_CEXV_CalStat_VeLINR_e_CEXV_CalStat: accessed-variable=VeLINR_e_CEXV_CalStat.VeLINR_e_CEXV_CalStat
            access DSP_VeLINR_b_CEXV_CalStatTO_VeLINR_b_CEXV_CalStatTO: accessed-variable=VeLINR_b_CEXV_CalStatTO.VeLINR_b_CEXV_CalStatTO
        COMRXL_CEXV_CalStat_CEXV_STAT_Lin3_Error: symbol=ApplLinComAb_LIN3_COMRXL_CEXV_CalStat_CEXV_STAT_Lin3_Error  # Error -
          data-receive-point-by-arguments:
            access DRP_Lin3ComRxSignalsSR_COMRXL_CEXV_CalStat_CEXV_STAT_Lin3: accessed-variable=Lin3ComRxSignalsSR.COMRXL_CEXV_CalStat_CEXV_STAT_Lin3
          data-send-points:
            access DSP_VeLINR_e_CEXV_CalStat_VeLINR_e_CEXV_CalStat: accessed-variable=VeLINR_e_CEXV_CalStat.VeLINR_e_CEXV_CalStat
            access DSP_VeLINR_b_CEXV_CalStatTO_VeLINR_b_CEXV_CalStatTO: accessed-variable=VeLINR_b_CEXV_CalStatTO.VeLINR_b_CEXV_CalStatTO
          read-local-variables:
            access IRVRA_VeLINR_d_LIN_SlavePrsnt_LIN3: accessed-variable=VeLINR_d_LIN_SlavePrsnt_LIN3
        COMRXL_CEXV_CalRq_CEXV_STAT_Lin3_Received: symbol=ApplLinComAb_LIN3_COMRXL_CEXV_CalRq_CEXV_STAT_Lin3_Received  # Received -
          data-receive-point-by-arguments:
            access DRP_Lin3ComRxSignalsSR_COMRXL_CEXV_CalRq_CEXV_STAT_Lin3: accessed-variable=Lin3ComRxSignalsSR.COMRXL_CEXV_CalRq_CEXV_STAT_Lin3
          data-send-points:
            access DSP_VeLINR_b_CEXV_CalRq_VeLINR_b_CEXV_CalRq: accessed-variable=VeLINR_b_CEXV_CalRq.VeLINR_b_CEXV_CalRq
            access DSP_VeLINR_b_CEXV_CalRqTO_VeLINR_b_CEXV_CalRqTO: accessed-variable=VeLINR_b_CEXV_CalRqTO.VeLINR_b_CEXV_CalRqTO
        COMRXL_CEXV_CalRq_CEXV_STAT_Lin3_Error: symbol=ApplLinComAb_LIN3_COMRXL_CEXV_CalRq_CEXV_STAT_Lin3_Error  # Error -
          data-receive-point-by-arguments:
            access DRP_Lin3ComRxSignalsSR_COMRXL_CEXV_CalRq_CEXV_STAT_Lin3: accessed-variable=Lin3ComRxSignalsSR.COMRXL_CEXV_CalRq_CEXV_STAT_Lin3
          data-send-points:
            access DSP_VeLINR_b_CEXV_CalRq_VeLINR_b_CEXV_CalRq: accessed-variable=VeLINR_b_CEXV_CalRq.VeLINR_b_CEXV_CalRq
            access DSP_VeLINR_b_CEXV_CalRqTO_VeLINR_b_CEXV_CalRqTO: accessed-variable=VeLINR_b_CEXV_CalRqTO.VeLINR_b_CEXV_CalRqTO
          read-local-variables:
            access IRVRA_VeLINR_d_LIN_SlavePrsnt_LIN3: accessed-variable=VeLINR_d_LIN_SlavePrsnt_LIN3
        COMRXL_RsErr_CEXV_CEXV_STAT_Lin3_Received: symbol=ApplLinComAb_LIN3_COMRXL_RsErr_CEXV_CEXV_STAT_Lin3_Received  # Received -
          data-receive-point-by-arguments:
            access DRP_Lin3ComRxSignalsSR_COMRXL_RsErr_CEXV_CEXV_STAT_Lin3: accessed-variable=Lin3ComRxSignalsSR.COMRXL_RsErr_CEXV_CEXV_STAT_Lin3
          data-send-points:
            access DSP_VeLINR_b_RsErr_CEXV_VeLINR_b_RsErr_CEXV: accessed-variable=VeLINR_b_RsErr_CEXV.VeLINR_b_RsErr_CEXV
            access DSP_VeLINR_b_RsErr_CEXV_TO_VeLINR_b_RsErr_CEXV_TO: accessed-variable=VeLINR_b_RsErr_CEXV_TO.VeLINR_b_RsErr_CEXV_TO
        COMRXL_RsErr_CEXV_CEXV_STAT_Lin3_Error: symbol=ApplLinComAb_LIN3_COMRXL_RsErr_CEXV_CEXV_STAT_Lin3_Error  # Error -
          data-receive-point-by-arguments:
            access DRP_Lin3ComRxSignalsSR_COMRXL_RsErr_CEXV_CEXV_STAT_Lin3: accessed-variable=Lin3ComRxSignalsSR.COMRXL_RsErr_CEXV_CEXV_STAT_Lin3
          data-send-points:
            access DSP_VeLINR_b_RsErr_CEXV_VeLINR_b_RsErr_CEXV: accessed-variable=VeLINR_b_RsErr_CEXV.VeLINR_b_RsErr_CEXV
            access DSP_VeLINR_b_RsErr_CEXV_TO_VeLINR_b_RsErr_CEXV_TO: accessed-variable=VeLINR_b_RsErr_CEXV_TO.VeLINR_b_RsErr_CEXV_TO
          read-local-variables:
            access IRVRA_VeLINR_d_LIN_SlavePrsnt_LIN3: accessed-variable=VeLINR_d_LIN_SlavePrsnt_LIN3
        COMRXL_CEXV_Sts_CEXV_STAT_Lin3_Received: symbol=ApplLinComAb_LIN3_COMRXL_CEXV_Sts_CEXV_STAT_Lin3_Received  # Received -
          data-receive-point-by-arguments:
            access DRP_Lin3ComRxSignalsSR_COMRXL_CEXV_Sts_CEXV_STAT_Lin3: accessed-variable=Lin3ComRxSignalsSR.COMRXL_CEXV_Sts_CEXV_STAT_Lin3
          data-send-points:
            access DSP_VeLINR_e_CEXV_Sts_VeLINR_e_CEXV_Sts: accessed-variable=VeLINR_e_CEXV_Sts.VeLINR_e_CEXV_Sts
            access DSP_VeLINR_b_CEXV_StsTO_VeLINR_b_CEXV_StsTO: accessed-variable=VeLINR_b_CEXV_StsTO.VeLINR_b_CEXV_StsTO
        COMRXL_CEXV_Sts_CEXV_STAT_Lin3_Error: symbol=ApplLinComAb_LIN3_COMRXL_CEXV_Sts_CEXV_STAT_Lin3_Error  # Error -
          data-receive-point-by-arguments:
            access DRP_Lin3ComRxSignalsSR_COMRXL_CEXV_Sts_CEXV_STAT_Lin3: accessed-variable=Lin3ComRxSignalsSR.COMRXL_CEXV_Sts_CEXV_STAT_Lin3
          data-send-points:
            access DSP_VeLINR_e_CEXV_Sts_VeLINR_e_CEXV_Sts: accessed-variable=VeLINR_e_CEXV_Sts.VeLINR_e_CEXV_Sts
            access DSP_VeLINR_b_CEXV_StsTO_VeLINR_b_CEXV_StsTO: accessed-variable=VeLINR_b_CEXV_StsTO.VeLINR_b_CEXV_StsTO
          read-local-variables:
            access IRVRA_VeLINR_d_LIN_SlavePrsnt_LIN3: accessed-variable=VeLINR_d_LIN_SlavePrsnt_LIN3
        COMRXL_CEXV_ERR_CEXV_STAT_Lin3_Received: symbol=ApplLinComAb_LIN3_COMRXL_CEXV_ERR_CEXV_STAT_Lin3_Received  # Received -
          data-receive-point-by-arguments:
            access DRP_Lin3ComRxSignalsSR_COMRXL_CEXV_ERR_CEXV_STAT_Lin3: accessed-variable=Lin3ComRxSignalsSR.COMRXL_CEXV_ERR_CEXV_STAT_Lin3
          data-send-points:
            access DSP_VeLINR_e_CEXV_ERR_VeLINR_e_CEXV_ERR: accessed-variable=VeLINR_e_CEXV_ERR.VeLINR_e_CEXV_ERR
            access DSP_VeLINR_b_CEXV_ERR_TO_VeLINR_b_CEXV_ERR_TO: accessed-variable=VeLINR_b_CEXV_ERR_TO.VeLINR_b_CEXV_ERR_TO
        COMRXL_CEXV_ERR_CEXV_STAT_Lin3_Error: symbol=ApplLinComAb_LIN3_COMRXL_CEXV_ERR_CEXV_STAT_Lin3_Error  # Error -
          data-receive-point-by-arguments:
            access DRP_Lin3ComRxSignalsSR_COMRXL_CEXV_ERR_CEXV_STAT_Lin3: accessed-variable=Lin3ComRxSignalsSR.COMRXL_CEXV_ERR_CEXV_STAT_Lin3
          data-send-points:
            access DSP_VeLINR_e_CEXV_ERR_VeLINR_e_CEXV_ERR: accessed-variable=VeLINR_e_CEXV_ERR.VeLINR_e_CEXV_ERR
            access DSP_VeLINR_b_CEXV_ERR_TO_VeLINR_b_CEXV_ERR_TO: accessed-variable=VeLINR_b_CEXV_ERR_TO.VeLINR_b_CEXV_ERR_TO
          read-local-variables:
            access IRVRA_VeLINR_d_LIN_SlavePrsnt_LIN3: accessed-variable=VeLINR_d_LIN_SlavePrsnt_LIN3
        COMRXL_CEXV_SupplyVolt_CEXV_STAT_Lin3_Received: symbol=ApplLinComAb_LIN3_COMRXL_CEXV_SupplyVolt_CEXV_STAT_Lin3_Received  # Received -
          data-receive-point-by-arguments:
            access DRP_Lin3ComRxSignalsSR_COMRXL_CEXV_SupplyVolt_CEXV_STAT_Lin3: accessed-variable=Lin3ComRxSignalsSR.COMRXL_CEXV_SupplyVolt_CEXV_STAT_Lin3
          data-send-points:
            access DSP_VeLINR_U_CEXV_SupplyVolt_VeLINR_U_CEXV_SupplyVolt: accessed-variable=VeLINR_U_CEXV_SupplyVolt.VeLINR_U_CEXV_SupplyVolt
            access DSP_VeLINR_b_CEXV_SupplyVoltTO_VeLINR_b_CEXV_SupplyVoltTO: accessed-variable=VeLINR_b_CEXV_SupplyVoltTO.VeLINR_b_CEXV_SupplyVoltTO
        COMRXL_CEXV_SupplyVolt_CEXV_STAT_Lin3_Error: symbol=ApplLinComAb_LIN3_COMRXL_CEXV_SupplyVolt_CEXV_STAT_Lin3_Error  # Error -
          data-receive-point-by-arguments:
            access DRP_Lin3ComRxSignalsSR_COMRXL_CEXV_SupplyVolt_CEXV_STAT_Lin3: accessed-variable=Lin3ComRxSignalsSR.COMRXL_CEXV_SupplyVolt_CEXV_STAT_Lin3
          data-send-points:
            access DSP_VeLINR_U_CEXV_SupplyVolt_VeLINR_U_CEXV_SupplyVolt: accessed-variable=VeLINR_U_CEXV_SupplyVolt.VeLINR_U_CEXV_SupplyVolt
            access DSP_VeLINR_b_CEXV_SupplyVoltTO_VeLINR_b_CEXV_SupplyVoltTO: accessed-variable=VeLINR_b_CEXV_SupplyVoltTO.VeLINR_b_CEXV_SupplyVoltTO
          read-local-variables:
            access IRVRA_VeLINR_d_LIN_SlavePrsnt_LIN3: accessed-variable=VeLINR_d_LIN_SlavePrsnt_LIN3
        COMRXL_CEXV_Refrigerant_Pressure_CEXV_STAT_Lin3_Received: symbol=ApplLinComAb_LIN3_COMRXL_CEXV_Refrigerant_Pressure_CEXV_STAT_Lin3_Received  # Received -
          data-receive-point-by-arguments:
            access DRP_Lin3ComRxSignalsSR_COMRXL_CEXV_Refrigerant_Pressure_CEXV_STAT_Lin3: accessed-variable=Lin3ComRxSignalsSR.COMRXL_CEXV_Refrigerant_Pressure_CEXV_STAT_Lin3
          data-send-points:
            access DSP_VeLINR_e_CEXV_Refrigerant_Press_VeLINR_e_CEXV_Refrigerant_Press: accessed-variable=VeLINR_e_CEXV_Refrigerant_Press.VeLINR_e_CEXV_Refrigerant_Press
            access DSP_VeLINR_b_CEXV_Refrigerant_PressTO_VeLINR_b_CEXV_Refrigerant_PressTO: accessed-variable=VeLINR_b_CEXV_Refrigerant_PressTO.VeLINR_b_CEXV_Refrigerant_PressTO
        COMRXL_CEXV_Refrigerant_Pressure_CEXV_STAT_Lin3_Error: symbol=ApplLinComAb_LIN3_COMRXL_CEXV_Refrigerant_Pressure_CEXV_STAT_Lin3_Error  # Error -
          data-receive-point-by-arguments:
            access DRP_Lin3ComRxSignalsSR_COMRXL_CEXV_Refrigerant_Pressure_CEXV_STAT_Lin3: accessed-variable=Lin3ComRxSignalsSR.COMRXL_CEXV_Refrigerant_Pressure_CEXV_STAT_Lin3
          data-send-points:
            access DSP_VeLINR_e_CEXV_Refrigerant_Press_VeLINR_e_CEXV_Refrigerant_Press: accessed-variable=VeLINR_e_CEXV_Refrigerant_Press.VeLINR_e_CEXV_Refrigerant_Press
            access DSP_VeLINR_b_CEXV_Refrigerant_PressTO_VeLINR_b_CEXV_Refrigerant_PressTO: accessed-variable=VeLINR_b_CEXV_Refrigerant_PressTO.VeLINR_b_CEXV_Refrigerant_PressTO
          read-local-variables:
            access IRVRA_VeLINR_d_LIN_SlavePrsnt_LIN3: accessed-variable=VeLINR_d_LIN_SlavePrsnt_LIN3
        COMRXL_CEXV_Board_Temp_CEXV_STAT_Lin3_Received: symbol=ApplLinComAb_LIN3_COMRXL_CEXV_Board_Temp_CEXV_STAT_Lin3_Received  # Received -
          data-receive-point-by-arguments:
            access DRP_Lin3ComRxSignalsSR_COMRXL_CEXV_Board_Temp_CEXV_STAT_Lin3: accessed-variable=Lin3ComRxSignalsSR.COMRXL_CEXV_Board_Temp_CEXV_STAT_Lin3
          data-send-points:
            access DSP_VeLINR_T_CEXV_Board_Temp_VeLINR_T_CEXV_Board_Temp: accessed-variable=VeLINR_T_CEXV_Board_Temp.VeLINR_T_CEXV_Board_Temp
            access DSP_VeLINR_b_CEXV_Board_TempTO_VeLINR_b_CEXV_Board_TempTO: accessed-variable=VeLINR_b_CEXV_Board_TempTO.VeLINR_b_CEXV_Board_TempTO
        COMRXL_CEXV_Board_Temp_CEXV_STAT_Lin3_Error: symbol=ApplLinComAb_LIN3_COMRXL_CEXV_Board_Temp_CEXV_STAT_Lin3_Error  # Error -
          data-receive-point-by-arguments:
            access DRP_Lin3ComRxSignalsSR_COMRXL_CEXV_Board_Temp_CEXV_STAT_Lin3: accessed-variable=Lin3ComRxSignalsSR.COMRXL_CEXV_Board_Temp_CEXV_STAT_Lin3
          data-send-points:
            access DSP_VeLINR_T_CEXV_Board_Temp_VeLINR_T_CEXV_Board_Temp: accessed-variable=VeLINR_T_CEXV_Board_Temp.VeLINR_T_CEXV_Board_Temp
            access DSP_VeLINR_b_CEXV_Board_TempTO_VeLINR_b_CEXV_Board_TempTO: accessed-variable=VeLINR_b_CEXV_Board_TempTO.VeLINR_b_CEXV_Board_TempTO
          read-local-variables:
            access IRVRA_VeLINR_d_LIN_SlavePrsnt_LIN3: accessed-variable=VeLINR_d_LIN_SlavePrsnt_LIN3
        COMRXL_CEXV_Refrigerant_Temp_CEXV_STAT_Lin3_Received: symbol=ApplLinComAb_LIN3_COMRXL_CEXV_Refrigerant_Temp_CEXV_STAT_Lin3_Received  # Received -
          data-receive-point-by-arguments:
            access DRP_Lin3ComRxSignalsSR_COMRXL_CEXV_Refrigerant_Temp_CEXV_STAT_Lin3: accessed-variable=Lin3ComRxSignalsSR.COMRXL_CEXV_Refrigerant_Temp_CEXV_STAT_Lin3
          data-send-points:
            access DSP_VeLINR_e_CEXV_Refrigerant_Temp_VeLINR_e_CEXV_Refrigerant_Temp: accessed-variable=VeLINR_e_CEXV_Refrigerant_Temp.VeLINR_e_CEXV_Refrigerant_Temp
            access DSP_VeLINR_b_CEXV_Refrigerant_TempTO_VeLINR_b_CEXV_Refrigerant_TempTO: accessed-variable=VeLINR_b_CEXV_Refrigerant_TempTO.VeLINR_b_CEXV_Refrigerant_TempTO
        COMRXL_CEXV_Refrigerant_Temp_CEXV_STAT_Lin3_Error: symbol=ApplLinComAb_LIN3_COMRXL_CEXV_Refrigerant_Temp_CEXV_STAT_Lin3_Error  # Error -
          data-receive-point-by-arguments:
            access DRP_Lin3ComRxSignalsSR_COMRXL_CEXV_Refrigerant_Temp_CEXV_STAT_Lin3: accessed-variable=Lin3ComRxSignalsSR.COMRXL_CEXV_Refrigerant_Temp_CEXV_STAT_Lin3
          data-send-points:
            access DSP_VeLINR_e_CEXV_Refrigerant_Temp_VeLINR_e_CEXV_Refrigerant_Temp: accessed-variable=VeLINR_e_CEXV_Refrigerant_Temp.VeLINR_e_CEXV_Refrigerant_Temp
            access DSP_VeLINR_b_CEXV_Refrigerant_TempTO_VeLINR_b_CEXV_Refrigerant_TempTO: accessed-variable=VeLINR_b_CEXV_Refrigerant_TempTO.VeLINR_b_CEXV_Refrigerant_TempTO
          read-local-variables:
            access IRVRA_VeLINR_d_LIN_SlavePrsnt_LIN3: accessed-variable=VeLINR_d_LIN_SlavePrsnt_LIN3
        COMRXL_Inlet_Temp1_DC_CPIM_HCP_FEEDBACK2_Lin3_Received: symbol=ApplLinComAb_LIN3_COMRXL_Inlet_Temp1_DC_CPIM_HCP_FEEDBACK2_Lin3_Received  # Received -
          data-receive-point-by-arguments:
            access DRP_Lin3ComRxSignalsSR_COMRXL_Inlet_Temp1_DC_CPIM_HCP_FEEDBACK2_Lin3: accessed-variable=Lin3ComRxSignalsSR.COMRXL_Inlet_Temp1_DC_CPIM_HCP_FEEDBACK2_Lin3
          data-send-points:
            access DSP_VeLINR_e_Inlet_Temp1_DC_VeLINR_e_Inlet_Temp1_DC: accessed-variable=VeLINR_e_Inlet_Temp1_DC.VeLINR_e_Inlet_Temp1_DC
            access DSP_VeLINR_b_Inlet_Temp1_DC_TO_VeLINR_b_Inlet_Temp1_DC_TO: accessed-variable=VeLINR_b_Inlet_Temp1_DC_TO.VeLINR_b_Inlet_Temp1_DC_TO
        COMRXL_Inlet_Temp1_DC_CPIM_HCP_FEEDBACK2_Lin3_Error: symbol=ApplLinComAb_LIN3_COMRXL_Inlet_Temp1_DC_CPIM_HCP_FEEDBACK2_Lin3_Error  # Error -
          data-receive-point-by-arguments:
            access DRP_Lin3ComRxSignalsSR_COMRXL_Inlet_Temp1_DC_CPIM_HCP_FEEDBACK2_Lin3: accessed-variable=Lin3ComRxSignalsSR.COMRXL_Inlet_Temp1_DC_CPIM_HCP_FEEDBACK2_Lin3
          data-send-points:
            access DSP_VeLINR_e_Inlet_Temp1_DC_VeLINR_e_Inlet_Temp1_DC: accessed-variable=VeLINR_e_Inlet_Temp1_DC.VeLINR_e_Inlet_Temp1_DC
            access DSP_VeLINR_b_Inlet_Temp1_DC_TO_VeLINR_b_Inlet_Temp1_DC_TO: accessed-variable=VeLINR_b_Inlet_Temp1_DC_TO.VeLINR_b_Inlet_Temp1_DC_TO
          read-local-variables:
            access IRVRA_VeLINR_d_LIN_SlavePrsnt_LIN3: accessed-variable=VeLINR_d_LIN_SlavePrsnt_LIN3
        COMRXL_Inlet_Temp2_DC_CPIM_HCP_FEEDBACK2_Lin3_Received: symbol=ApplLinComAb_LIN3_COMRXL_Inlet_Temp2_DC_CPIM_HCP_FEEDBACK2_Lin3_Received  # Received -
          data-receive-point-by-arguments:
            access DRP_Lin3ComRxSignalsSR_COMRXL_Inlet_Temp2_DC_CPIM_HCP_FEEDBACK2_Lin3: accessed-variable=Lin3ComRxSignalsSR.COMRXL_Inlet_Temp2_DC_CPIM_HCP_FEEDBACK2_Lin3
          data-send-points:
            access DSP_VeLINR_e_Inlet_Temp2_DC_VeLINR_e_Inlet_Temp2_DC: accessed-variable=VeLINR_e_Inlet_Temp2_DC.VeLINR_e_Inlet_Temp2_DC
            access DSP_VeLINR_b_Inlet_Temp2_DC_TO_VeLINR_b_Inlet_Temp2_DC_TO: accessed-variable=VeLINR_b_Inlet_Temp2_DC_TO.VeLINR_b_Inlet_Temp2_DC_TO
        COMRXL_Inlet_Temp2_DC_CPIM_HCP_FEEDBACK2_Lin3_Error: symbol=ApplLinComAb_LIN3_COMRXL_Inlet_Temp2_DC_CPIM_HCP_FEEDBACK2_Lin3_Error  # Error -
          data-receive-point-by-arguments:
            access DRP_Lin3ComRxSignalsSR_COMRXL_Inlet_Temp2_DC_CPIM_HCP_FEEDBACK2_Lin3: accessed-variable=Lin3ComRxSignalsSR.COMRXL_Inlet_Temp2_DC_CPIM_HCP_FEEDBACK2_Lin3
          data-send-points:
            access DSP_VeLINR_e_Inlet_Temp2_DC_VeLINR_e_Inlet_Temp2_DC: accessed-variable=VeLINR_e_Inlet_Temp2_DC.VeLINR_e_Inlet_Temp2_DC
            access DSP_VeLINR_b_Inlet_Temp2_DC_TO_VeLINR_b_Inlet_Temp2_DC_TO: accessed-variable=VeLINR_b_Inlet_Temp2_DC_TO.VeLINR_b_Inlet_Temp2_DC_TO
          read-local-variables:
            access IRVRA_VeLINR_d_LIN_SlavePrsnt_LIN3: accessed-variable=VeLINR_d_LIN_SlavePrsnt_LIN3
        COMRXL_CPIM_IND1_Fdbk_CPIM_HCP_FEEDBACK_Lin3_Received: symbol=ApplLinComAb_LIN3_COMRXL_CPIM_IND1_Fdbk_CPIM_HCP_FEEDBACK_Lin3_Received  # Received -
          data-receive-point-by-arguments:
            access DRP_Lin3ComRxSignalsSR_COMRXL_CPIM_IND1_Fdbk_CPIM_HCP_FEEDBACK_Lin3: accessed-variable=Lin3ComRxSignalsSR.COMRXL_CPIM_IND1_Fdbk_CPIM_HCP_FEEDBACK_Lin3
          data-send-points:
            access DSP_VeLINR_e_CPIM_IND1_Fdbk_VeLINR_e_CPIM_IND1_Fdbk: accessed-variable=VeLINR_e_CPIM_IND1_Fdbk.VeLINR_e_CPIM_IND1_Fdbk
            access DSP_VeLINR_b_CPIM_IND1_FdbkTO_VeLINR_b_CPIM_IND1_FdbkTO: accessed-variable=VeLINR_b_CPIM_IND1_FdbkTO.VeLINR_b_CPIM_IND1_FdbkTO
        COMRXL_CPIM_IND1_Fdbk_CPIM_HCP_FEEDBACK_Lin3_Error: symbol=ApplLinComAb_LIN3_COMRXL_CPIM_IND1_Fdbk_CPIM_HCP_FEEDBACK_Lin3_Error  # Error -
          data-receive-point-by-arguments:
            access DRP_Lin3ComRxSignalsSR_COMRXL_CPIM_IND1_Fdbk_CPIM_HCP_FEEDBACK_Lin3: accessed-variable=Lin3ComRxSignalsSR.COMRXL_CPIM_IND1_Fdbk_CPIM_HCP_FEEDBACK_Lin3
          data-send-points:
            access DSP_VeLINR_e_CPIM_IND1_Fdbk_VeLINR_e_CPIM_IND1_Fdbk: accessed-variable=VeLINR_e_CPIM_IND1_Fdbk.VeLINR_e_CPIM_IND1_Fdbk
            access DSP_VeLINR_b_CPIM_IND1_FdbkTO_VeLINR_b_CPIM_IND1_FdbkTO: accessed-variable=VeLINR_b_CPIM_IND1_FdbkTO.VeLINR_b_CPIM_IND1_FdbkTO
          read-local-variables:
            access IRVRA_VeLINR_d_LIN_SlavePrsnt_LIN3: accessed-variable=VeLINR_d_LIN_SlavePrsnt_LIN3
        COMRXL_CPIM_IND2_Fdbk_CPIM_HCP_FEEDBACK_Lin3_Received: symbol=ApplLinComAb_LIN3_COMRXL_CPIM_IND2_Fdbk_CPIM_HCP_FEEDBACK_Lin3_Received  # Received -
          data-receive-point-by-arguments:
            access DRP_Lin3ComRxSignalsSR_COMRXL_CPIM_IND2_Fdbk_CPIM_HCP_FEEDBACK_Lin3: accessed-variable=Lin3ComRxSignalsSR.COMRXL_CPIM_IND2_Fdbk_CPIM_HCP_FEEDBACK_Lin3
          data-send-points:
            access DSP_VeLINR_e_CPIM_IND2_Fdbk_VeLINR_e_CPIM_IND2_Fdbk: accessed-variable=VeLINR_e_CPIM_IND2_Fdbk.VeLINR_e_CPIM_IND2_Fdbk
            access DSP_VeLINR_b_CPIM_IND2_FdbkTO_VeLINR_b_CPIM_IND2_FdbkTO: accessed-variable=VeLINR_b_CPIM_IND2_FdbkTO.VeLINR_b_CPIM_IND2_FdbkTO
        COMRXL_CPIM_IND2_Fdbk_CPIM_HCP_FEEDBACK_Lin3_Error: symbol=ApplLinComAb_LIN3_COMRXL_CPIM_IND2_Fdbk_CPIM_HCP_FEEDBACK_Lin3_Error  # Error -
          data-receive-point-by-arguments:
            access DRP_Lin3ComRxSignalsSR_COMRXL_CPIM_IND2_Fdbk_CPIM_HCP_FEEDBACK_Lin3: accessed-variable=Lin3ComRxSignalsSR.COMRXL_CPIM_IND2_Fdbk_CPIM_HCP_FEEDBACK_Lin3
          data-send-points:
            access DSP_VeLINR_e_CPIM_IND2_Fdbk_VeLINR_e_CPIM_IND2_Fdbk: accessed-variable=VeLINR_e_CPIM_IND2_Fdbk.VeLINR_e_CPIM_IND2_Fdbk
            access DSP_VeLINR_b_CPIM_IND2_FdbkTO_VeLINR_b_CPIM_IND2_FdbkTO: accessed-variable=VeLINR_b_CPIM_IND2_FdbkTO.VeLINR_b_CPIM_IND2_FdbkTO
          read-local-variables:
            access IRVRA_VeLINR_d_LIN_SlavePrsnt_LIN3: accessed-variable=VeLINR_d_LIN_SlavePrsnt_LIN3
        COMRXL_CPIM_IND3_Fdbk_CPIM_HCP_FEEDBACK_Lin3_Received: symbol=ApplLinComAb_LIN3_COMRXL_CPIM_IND3_Fdbk_CPIM_HCP_FEEDBACK_Lin3_Received  # Received -
          data-receive-point-by-arguments:
            access DRP_Lin3ComRxSignalsSR_COMRXL_CPIM_IND3_Fdbk_CPIM_HCP_FEEDBACK_Lin3: accessed-variable=Lin3ComRxSignalsSR.COMRXL_CPIM_IND3_Fdbk_CPIM_HCP_FEEDBACK_Lin3
          data-send-points:
            access DSP_VeLINR_e_CPIM_IND3_Fdbk_VeLINR_e_CPIM_IND3_Fdbk: accessed-variable=VeLINR_e_CPIM_IND3_Fdbk.VeLINR_e_CPIM_IND3_Fdbk
            access DSP_VeLINR_b_CPIM_IND3_FdbkTO_VeLINR_b_CPIM_IND3_FdbkTO: accessed-variable=VeLINR_b_CPIM_IND3_FdbkTO.VeLINR_b_CPIM_IND3_FdbkTO
        COMRXL_CPIM_IND3_Fdbk_CPIM_HCP_FEEDBACK_Lin3_Error: symbol=ApplLinComAb_LIN3_COMRXL_CPIM_IND3_Fdbk_CPIM_HCP_FEEDBACK_Lin3_Error  # Error -
          data-receive-point-by-arguments:
            access DRP_Lin3ComRxSignalsSR_COMRXL_CPIM_IND3_Fdbk_CPIM_HCP_FEEDBACK_Lin3: accessed-variable=Lin3ComRxSignalsSR.COMRXL_CPIM_IND3_Fdbk_CPIM_HCP_FEEDBACK_Lin3
          data-send-points:
            access DSP_VeLINR_e_CPIM_IND3_Fdbk_VeLINR_e_CPIM_IND3_Fdbk: accessed-variable=VeLINR_e_CPIM_IND3_Fdbk.VeLINR_e_CPIM_IND3_Fdbk
            access DSP_VeLINR_b_CPIM_IND3_FdbkTO_VeLINR_b_CPIM_IND3_FdbkTO: accessed-variable=VeLINR_b_CPIM_IND3_FdbkTO.VeLINR_b_CPIM_IND3_FdbkTO
          read-local-variables:
            access IRVRA_VeLINR_d_LIN_SlavePrsnt_LIN3: accessed-variable=VeLINR_d_LIN_SlavePrsnt_LIN3
        COMRXL_CPIM_IND4_Fdbk_CPIM_HCP_FEEDBACK_Lin3_Received: symbol=ApplLinComAb_LIN3_COMRXL_CPIM_IND4_Fdbk_CPIM_HCP_FEEDBACK_Lin3_Received  # Received -
          data-receive-point-by-arguments:
            access DRP_Lin3ComRxSignalsSR_COMRXL_CPIM_IND4_Fdbk_CPIM_HCP_FEEDBACK_Lin3: accessed-variable=Lin3ComRxSignalsSR.COMRXL_CPIM_IND4_Fdbk_CPIM_HCP_FEEDBACK_Lin3
          data-send-points:
            access DSP_VeLINR_e_CPIM_IND4_Fdbk_VeLINR_e_CPIM_IND4_Fdbk: accessed-variable=VeLINR_e_CPIM_IND4_Fdbk.VeLINR_e_CPIM_IND4_Fdbk
            access DSP_VeLINR_b_CPIM_IND4_FdbkTO_VeLINR_b_CPIM_IND4_FdbkTO: accessed-variable=VeLINR_b_CPIM_IND4_FdbkTO.VeLINR_b_CPIM_IND4_FdbkTO
        COMRXL_CPIM_IND4_Fdbk_CPIM_HCP_FEEDBACK_Lin3_Error: symbol=ApplLinComAb_LIN3_COMRXL_CPIM_IND4_Fdbk_CPIM_HCP_FEEDBACK_Lin3_Error  # Error -
          data-receive-point-by-arguments:
            access DRP_Lin3ComRxSignalsSR_COMRXL_CPIM_IND4_Fdbk_CPIM_HCP_FEEDBACK_Lin3: accessed-variable=Lin3ComRxSignalsSR.COMRXL_CPIM_IND4_Fdbk_CPIM_HCP_FEEDBACK_Lin3
          data-send-points:
            access DSP_VeLINR_e_CPIM_IND4_Fdbk_VeLINR_e_CPIM_IND4_Fdbk: accessed-variable=VeLINR_e_CPIM_IND4_Fdbk.VeLINR_e_CPIM_IND4_Fdbk
            access DSP_VeLINR_b_CPIM_IND4_FdbkTO_VeLINR_b_CPIM_IND4_FdbkTO: accessed-variable=VeLINR_b_CPIM_IND4_FdbkTO.VeLINR_b_CPIM_IND4_FdbkTO
          read-local-variables:
            access IRVRA_VeLINR_d_LIN_SlavePrsnt_LIN3: accessed-variable=VeLINR_d_LIN_SlavePrsnt_LIN3
        COMRXL_CPIM_IND5_Fdbk_CPIM_HCP_FEEDBACK_Lin3_Received: symbol=ApplLinComAb_LIN3_COMRXL_CPIM_IND5_Fdbk_CPIM_HCP_FEEDBACK_Lin3_Received  # Received -
          data-receive-point-by-arguments:
            access DRP_Lin3ComRxSignalsSR_COMRXL_CPIM_IND5_Fdbk_CPIM_HCP_FEEDBACK_Lin3: accessed-variable=Lin3ComRxSignalsSR.COMRXL_CPIM_IND5_Fdbk_CPIM_HCP_FEEDBACK_Lin3
          data-send-points:
            access DSP_VeLINR_e_CPIM_IND5_Fdbk_VeLINR_e_CPIM_IND5_Fdbk: accessed-variable=VeLINR_e_CPIM_IND5_Fdbk.VeLINR_e_CPIM_IND5_Fdbk
            access DSP_VeLINR_b_CPIM_IND5_FdbkTO_VeLINR_b_CPIM_IND5_FdbkTO: accessed-variable=VeLINR_b_CPIM_IND5_FdbkTO.VeLINR_b_CPIM_IND5_FdbkTO
        COMRXL_CPIM_IND5_Fdbk_CPIM_HCP_FEEDBACK_Lin3_Error: symbol=ApplLinComAb_LIN3_COMRXL_CPIM_IND5_Fdbk_CPIM_HCP_FEEDBACK_Lin3_Error  # Error -
          data-receive-point-by-arguments:
            access DRP_Lin3ComRxSignalsSR_COMRXL_CPIM_IND5_Fdbk_CPIM_HCP_FEEDBACK_Lin3: accessed-variable=Lin3ComRxSignalsSR.COMRXL_CPIM_IND5_Fdbk_CPIM_HCP_FEEDBACK_Lin3
          data-send-points:
            access DSP_VeLINR_e_CPIM_IND5_Fdbk_VeLINR_e_CPIM_IND5_Fdbk: accessed-variable=VeLINR_e_CPIM_IND5_Fdbk.VeLINR_e_CPIM_IND5_Fdbk
            access DSP_VeLINR_b_CPIM_IND5_FdbkTO_VeLINR_b_CPIM_IND5_FdbkTO: accessed-variable=VeLINR_b_CPIM_IND5_FdbkTO.VeLINR_b_CPIM_IND5_FdbkTO
          read-local-variables:
            access IRVRA_VeLINR_d_LIN_SlavePrsnt_LIN3: accessed-variable=VeLINR_d_LIN_SlavePrsnt_LIN3
        COMRXL_CPIM_IND_Color_Fdbk_CPIM_HCP_FEEDBACK_Lin3_Received: symbol=ApplLinComAb_LIN3_COMRXL_CPIM_IND_Color_Fdbk_CPIM_HCP_FEEDBACK_Lin3_Received  # Received -
          data-receive-point-by-arguments:
            access DRP_Lin3ComRxSignalsSR_COMRXL_CPIM_IND_Color_Fdbk_CPIM_HCP_FEEDBACK_Lin3: accessed-variable=Lin3ComRxSignalsSR.COMRXL_CPIM_IND_Color_Fdbk_CPIM_HCP_FEEDBACK_Lin3
          data-send-points:
            access DSP_VeLINR_e_CPIM_IND_Color_Fdbk_VeLINR_e_CPIM_IND_Color_Fdbk: accessed-variable=VeLINR_e_CPIM_IND_Color_Fdbk.VeLINR_e_CPIM_IND_Color_Fdbk
            access DSP_VeLINR_b_CPIM_IND_Color_FdbkTO_VeLINR_b_CPIM_IND_Color_FdbkTO: accessed-variable=VeLINR_b_CPIM_IND_Color_FdbkTO.VeLINR_b_CPIM_IND_Color_FdbkTO
        COMRXL_CPIM_IND_Color_Fdbk_CPIM_HCP_FEEDBACK_Lin3_Error: symbol=ApplLinComAb_LIN3_COMRXL_CPIM_IND_Color_Fdbk_CPIM_HCP_FEEDBACK_Lin3_Error  # Error -
          data-receive-point-by-arguments:
            access DRP_Lin3ComRxSignalsSR_COMRXL_CPIM_IND_Color_Fdbk_CPIM_HCP_FEEDBACK_Lin3: accessed-variable=Lin3ComRxSignalsSR.COMRXL_CPIM_IND_Color_Fdbk_CPIM_HCP_FEEDBACK_Lin3
          data-send-points:
            access DSP_VeLINR_e_CPIM_IND_Color_Fdbk_VeLINR_e_CPIM_IND_Color_Fdbk: accessed-variable=VeLINR_e_CPIM_IND_Color_Fdbk.VeLINR_e_CPIM_IND_Color_Fdbk
            access DSP_VeLINR_b_CPIM_IND_Color_FdbkTO_VeLINR_b_CPIM_IND_Color_FdbkTO: accessed-variable=VeLINR_b_CPIM_IND_Color_FdbkTO.VeLINR_b_CPIM_IND_Color_FdbkTO
          read-local-variables:
            access IRVRA_VeLINR_d_LIN_SlavePrsnt_LIN3: accessed-variable=VeLINR_d_LIN_SlavePrsnt_LIN3
        COMRXL_CPIM_IND1_FailSts_CPIM_HCP_FEEDBACK_Lin3_Received: symbol=ApplLinComAb_LIN3_COMRXL_CPIM_IND1_FailSts_CPIM_HCP_FEEDBACK_Lin3_Received  # Received -
          data-receive-point-by-arguments:
            access DRP_Lin3ComRxSignalsSR_COMRXL_CPIM_IND1_FailSts_CPIM_HCP_FEEDBACK_Lin3: accessed-variable=Lin3ComRxSignalsSR.COMRXL_CPIM_IND1_FailSts_CPIM_HCP_FEEDBACK_Lin3
          data-send-points:
            access DSP_VeLINR_e_CPIM_IND1_FailSts_VeLINR_e_CPIM_IND1_FailSts: accessed-variable=VeLINR_e_CPIM_IND1_FailSts.VeLINR_e_CPIM_IND1_FailSts
            access DSP_VeLINR_b_CPIM_IND1_FailStsTO_VeLINR_b_CPIM_IND1_FailStsTO: accessed-variable=VeLINR_b_CPIM_IND1_FailStsTO.VeLINR_b_CPIM_IND1_FailStsTO
        COMRXL_CPIM_IND1_FailSts_CPIM_HCP_FEEDBACK_Lin3_Error: symbol=ApplLinComAb_LIN3_COMRXL_CPIM_IND1_FailSts_CPIM_HCP_FEEDBACK_Lin3_Error  # Error -
          data-receive-point-by-arguments:
            access DRP_Lin3ComRxSignalsSR_COMRXL_CPIM_IND1_FailSts_CPIM_HCP_FEEDBACK_Lin3: accessed-variable=Lin3ComRxSignalsSR.COMRXL_CPIM_IND1_FailSts_CPIM_HCP_FEEDBACK_Lin3
          data-send-points:
            access DSP_VeLINR_e_CPIM_IND1_FailSts_VeLINR_e_CPIM_IND1_FailSts: accessed-variable=VeLINR_e_CPIM_IND1_FailSts.VeLINR_e_CPIM_IND1_FailSts
            access DSP_VeLINR_b_CPIM_IND1_FailStsTO_VeLINR_b_CPIM_IND1_FailStsTO: accessed-variable=VeLINR_b_CPIM_IND1_FailStsTO.VeLINR_b_CPIM_IND1_FailStsTO
          read-local-variables:
            access IRVRA_VeLINR_d_LIN_SlavePrsnt_LIN3: accessed-variable=VeLINR_d_LIN_SlavePrsnt_LIN3
        COMRXL_CPIM_IND2_FailSts_CPIM_HCP_FEEDBACK_Lin3_Received: symbol=ApplLinComAb_LIN3_COMRXL_CPIM_IND2_FailSts_CPIM_HCP_FEEDBACK_Lin3_Received  # Received -
          data-receive-point-by-arguments:
            access DRP_Lin3ComRxSignalsSR_COMRXL_CPIM_IND2_FailSts_CPIM_HCP_FEEDBACK_Lin3: accessed-variable=Lin3ComRxSignalsSR.COMRXL_CPIM_IND2_FailSts_CPIM_HCP_FEEDBACK_Lin3
          data-send-points:
            access DSP_VeLINR_e_CPIM_IND2_FailSts_VeLINR_e_CPIM_IND2_FailSts: accessed-variable=VeLINR_e_CPIM_IND2_FailSts.VeLINR_e_CPIM_IND2_FailSts
            access DSP_VeLINR_b_CPIM_IND2_FailStsTO_VeLINR_b_CPIM_IND2_FailStsTO: accessed-variable=VeLINR_b_CPIM_IND2_FailStsTO.VeLINR_b_CPIM_IND2_FailStsTO
        COMRXL_CPIM_IND2_FailSts_CPIM_HCP_FEEDBACK_Lin3_Error: symbol=ApplLinComAb_LIN3_COMRXL_CPIM_IND2_FailSts_CPIM_HCP_FEEDBACK_Lin3_Error  # Error -
          data-receive-point-by-arguments:
            access DRP_Lin3ComRxSignalsSR_COMRXL_CPIM_IND2_FailSts_CPIM_HCP_FEEDBACK_Lin3: accessed-variable=Lin3ComRxSignalsSR.COMRXL_CPIM_IND2_FailSts_CPIM_HCP_FEEDBACK_Lin3
          data-send-points:
            access DSP_VeLINR_e_CPIM_IND2_FailSts_VeLINR_e_CPIM_IND2_FailSts: accessed-variable=VeLINR_e_CPIM_IND2_FailSts.VeLINR_e_CPIM_IND2_FailSts
            access DSP_VeLINR_b_CPIM_IND2_FailStsTO_VeLINR_b_CPIM_IND2_FailStsTO: accessed-variable=VeLINR_b_CPIM_IND2_FailStsTO.VeLINR_b_CPIM_IND2_FailStsTO
          read-local-variables:
            access IRVRA_VeLINR_d_LIN_SlavePrsnt_LIN3: accessed-variable=VeLINR_d_LIN_SlavePrsnt_LIN3
        COMRXL_CPIM_IND3_FailSts_CPIM_HCP_FEEDBACK_Lin3_Received: symbol=ApplLinComAb_LIN3_COMRXL_CPIM_IND3_FailSts_CPIM_HCP_FEEDBACK_Lin3_Received  # Received -
          data-receive-point-by-arguments:
            access DRP_Lin3ComRxSignalsSR_COMRXL_CPIM_IND3_FailSts_CPIM_HCP_FEEDBACK_Lin3: accessed-variable=Lin3ComRxSignalsSR.COMRXL_CPIM_IND3_FailSts_CPIM_HCP_FEEDBACK_Lin3
          data-send-points:
            access DSP_VeLINR_e_CPIM_IND3_FailSts_VeLINR_e_CPIM_IND3_FailSts: accessed-variable=VeLINR_e_CPIM_IND3_FailSts.VeLINR_e_CPIM_IND3_FailSts
            access DSP_VeLINR_b_CPIM_IND3_FailStsTO_VeLINR_b_CPIM_IND3_FailStsTO: accessed-variable=VeLINR_b_CPIM_IND3_FailStsTO.VeLINR_b_CPIM_IND3_FailStsTO
        COMRXL_CPIM_IND3_FailSts_CPIM_HCP_FEEDBACK_Lin3_Error: symbol=ApplLinComAb_LIN3_COMRXL_CPIM_IND3_FailSts_CPIM_HCP_FEEDBACK_Lin3_Error  # Error -
          data-receive-point-by-arguments:
            access DRP_Lin3ComRxSignalsSR_COMRXL_CPIM_IND3_FailSts_CPIM_HCP_FEEDBACK_Lin3: accessed-variable=Lin3ComRxSignalsSR.COMRXL_CPIM_IND3_FailSts_CPIM_HCP_FEEDBACK_Lin3
          data-send-points:
            access DSP_VeLINR_e_CPIM_IND3_FailSts_VeLINR_e_CPIM_IND3_FailSts: accessed-variable=VeLINR_e_CPIM_IND3_FailSts.VeLINR_e_CPIM_IND3_FailSts
            access DSP_VeLINR_b_CPIM_IND3_FailStsTO_VeLINR_b_CPIM_IND3_FailStsTO: accessed-variable=VeLINR_b_CPIM_IND3_FailStsTO.VeLINR_b_CPIM_IND3_FailStsTO
          read-local-variables:
            access IRVRA_VeLINR_d_LIN_SlavePrsnt_LIN3: accessed-variable=VeLINR_d_LIN_SlavePrsnt_LIN3
        COMRXL_CPIM_IND4_FailSts_CPIM_HCP_FEEDBACK_Lin3_Received: symbol=ApplLinComAb_LIN3_COMRXL_CPIM_IND4_FailSts_CPIM_HCP_FEEDBACK_Lin3_Received  # Received -
          data-receive-point-by-arguments:
            access DRP_Lin3ComRxSignalsSR_COMRXL_CPIM_IND4_FailSts_CPIM_HCP_FEEDBACK_Lin3: accessed-variable=Lin3ComRxSignalsSR.COMRXL_CPIM_IND4_FailSts_CPIM_HCP_FEEDBACK_Lin3
          data-send-points:
            access DSP_VeLINR_e_CPIM_IND4_FailSts_VeLINR_e_CPIM_IND4_FailSts: accessed-variable=VeLINR_e_CPIM_IND4_FailSts.VeLINR_e_CPIM_IND4_FailSts
            access DSP_VeLINR_b_CPIM_IND4_FailStsTO_VeLINR_b_CPIM_IND4_FailStsTO: accessed-variable=VeLINR_b_CPIM_IND4_FailStsTO.VeLINR_b_CPIM_IND4_FailStsTO
        COMRXL_CPIM_IND4_FailSts_CPIM_HCP_FEEDBACK_Lin3_Error: symbol=ApplLinComAb_LIN3_COMRXL_CPIM_IND4_FailSts_CPIM_HCP_FEEDBACK_Lin3_Error  # Error -
          data-receive-point-by-arguments:
            access DRP_Lin3ComRxSignalsSR_COMRXL_CPIM_IND4_FailSts_CPIM_HCP_FEEDBACK_Lin3: accessed-variable=Lin3ComRxSignalsSR.COMRXL_CPIM_IND4_FailSts_CPIM_HCP_FEEDBACK_Lin3
          data-send-points:
            access DSP_VeLINR_e_CPIM_IND4_FailSts_VeLINR_e_CPIM_IND4_FailSts: accessed-variable=VeLINR_e_CPIM_IND4_FailSts.VeLINR_e_CPIM_IND4_FailSts
            access DSP_VeLINR_b_CPIM_IND4_FailStsTO_VeLINR_b_CPIM_IND4_FailStsTO: accessed-variable=VeLINR_b_CPIM_IND4_FailStsTO.VeLINR_b_CPIM_IND4_FailStsTO
          read-local-variables:
            access IRVRA_VeLINR_d_LIN_SlavePrsnt_LIN3: accessed-variable=VeLINR_d_LIN_SlavePrsnt_LIN3
        COMRXL_CPIM_IND5_FailSts_CPIM_HCP_FEEDBACK_Lin3_Received: symbol=ApplLinComAb_LIN3_COMRXL_CPIM_IND5_FailSts_CPIM_HCP_FEEDBACK_Lin3_Received  # Received -
          data-receive-point-by-arguments:
            access DRP_Lin3ComRxSignalsSR_COMRXL_CPIM_IND5_FailSts_CPIM_HCP_FEEDBACK_Lin3: accessed-variable=Lin3ComRxSignalsSR.COMRXL_CPIM_IND5_FailSts_CPIM_HCP_FEEDBACK_Lin3
          data-send-points:
            access DSP_VeLINR_e_CPIM_IND5_FailSts_VeLINR_e_CPIM_IND5_FailSts: accessed-variable=VeLINR_e_CPIM_IND5_FailSts.VeLINR_e_CPIM_IND5_FailSts
            access DSP_VeLINR_b_CPIM_IND5_FailStsTO_VeLINR_b_CPIM_IND5_FailStsTO: accessed-variable=VeLINR_b_CPIM_IND5_FailStsTO.VeLINR_b_CPIM_IND5_FailStsTO
        COMRXL_CPIM_IND5_FailSts_CPIM_HCP_FEEDBACK_Lin3_Error: symbol=ApplLinComAb_LIN3_COMRXL_CPIM_IND5_FailSts_CPIM_HCP_FEEDBACK_Lin3_Error  # Error -
          data-receive-point-by-arguments:
            access DRP_Lin3ComRxSignalsSR_COMRXL_CPIM_IND5_FailSts_CPIM_HCP_FEEDBACK_Lin3: accessed-variable=Lin3ComRxSignalsSR.COMRXL_CPIM_IND5_FailSts_CPIM_HCP_FEEDBACK_Lin3
          data-send-points:
            access DSP_VeLINR_e_CPIM_IND5_FailSts_VeLINR_e_CPIM_IND5_FailSts: accessed-variable=VeLINR_e_CPIM_IND5_FailSts.VeLINR_e_CPIM_IND5_FailSts
            access DSP_VeLINR_b_CPIM_IND5_FailStsTO_VeLINR_b_CPIM_IND5_FailStsTO: accessed-variable=VeLINR_b_CPIM_IND5_FailStsTO.VeLINR_b_CPIM_IND5_FailStsTO
          read-local-variables:
            access IRVRA_VeLINR_d_LIN_SlavePrsnt_LIN3: accessed-variable=VeLINR_d_LIN_SlavePrsnt_LIN3
        COMRXL_CPIM_Undervoltage_CPIM_HCP_FEEDBACK_Lin3_Received: symbol=ApplLinComAb_LIN3_COMRXL_CPIM_Undervoltage_CPIM_HCP_FEEDBACK_Lin3_Received  # Received -
          data-receive-point-by-arguments:
            access DRP_Lin3ComRxSignalsSR_COMRXL_CPIM_Undervoltage_CPIM_HCP_FEEDBACK_Lin3: accessed-variable=Lin3ComRxSignalsSR.COMRXL_CPIM_Undervoltage_CPIM_HCP_FEEDBACK_Lin3
          data-send-points:
            access DSP_VeLINR_b_CPIM_Undervoltage_VeLINR_b_CPIM_Undervoltage: accessed-variable=VeLINR_b_CPIM_Undervoltage.VeLINR_b_CPIM_Undervoltage
            access DSP_VeLINR_b_CPIM_UndervoltageTO_VeLINR_b_CPIM_UndervoltageTO: accessed-variable=VeLINR_b_CPIM_UndervoltageTO.VeLINR_b_CPIM_UndervoltageTO
        COMRXL_CPIM_Undervoltage_CPIM_HCP_FEEDBACK_Lin3_Error: symbol=ApplLinComAb_LIN3_COMRXL_CPIM_Undervoltage_CPIM_HCP_FEEDBACK_Lin3_Error  # Error -
          data-receive-point-by-arguments:
            access DRP_Lin3ComRxSignalsSR_COMRXL_CPIM_Undervoltage_CPIM_HCP_FEEDBACK_Lin3: accessed-variable=Lin3ComRxSignalsSR.COMRXL_CPIM_Undervoltage_CPIM_HCP_FEEDBACK_Lin3
          data-send-points:
            access DSP_VeLINR_b_CPIM_Undervoltage_VeLINR_b_CPIM_Undervoltage: accessed-variable=VeLINR_b_CPIM_Undervoltage.VeLINR_b_CPIM_Undervoltage
            access DSP_VeLINR_b_CPIM_UndervoltageTO_VeLINR_b_CPIM_UndervoltageTO: accessed-variable=VeLINR_b_CPIM_UndervoltageTO.VeLINR_b_CPIM_UndervoltageTO
          read-local-variables:
            access IRVRA_VeLINR_d_LIN_SlavePrsnt_LIN3: accessed-variable=VeLINR_d_LIN_SlavePrsnt_LIN3
        COMRXL_CPIM_Over_Temperature_CPIM_HCP_FEEDBACK_Lin3_Received: symbol=ApplLinComAb_LIN3_COMRXL_CPIM_Over_Temperature_CPIM_HCP_FEEDBACK_Lin3_Received  # Received -
          data-receive-point-by-arguments:
            access DRP_Lin3ComRxSignalsSR_COMRXL_CPIM_Over_Temperature_CPIM_HCP_FEEDBACK_Lin3: accessed-variable=Lin3ComRxSignalsSR.COMRXL_CPIM_Over_Temperature_CPIM_HCP_FEEDBACK_Lin3
          data-send-points:
            access DSP_VeLINR_b_CPIM_Over_Temperature_VeLINR_b_CPIM_Over_Temperature: accessed-variable=VeLINR_b_CPIM_Over_Temperature.VeLINR_b_CPIM_Over_Temperature
            access DSP_VeLINR_b_CPIM_Over_TemperatureTO_VeLINR_b_CPIM_Over_TemperatureTO: accessed-variable=VeLINR_b_CPIM_Over_TemperatureTO.VeLINR_b_CPIM_Over_TemperatureTO
        COMRXL_CPIM_Over_Temperature_CPIM_HCP_FEEDBACK_Lin3_Error: symbol=ApplLinComAb_LIN3_COMRXL_CPIM_Over_Temperature_CPIM_HCP_FEEDBACK_Lin3_Error  # Error -
          data-receive-point-by-arguments:
            access DRP_Lin3ComRxSignalsSR_COMRXL_CPIM_Over_Temperature_CPIM_HCP_FEEDBACK_Lin3: accessed-variable=Lin3ComRxSignalsSR.COMRXL_CPIM_Over_Temperature_CPIM_HCP_FEEDBACK_Lin3
          data-send-points:
            access DSP_VeLINR_b_CPIM_Over_Temperature_VeLINR_b_CPIM_Over_Temperature: accessed-variable=VeLINR_b_CPIM_Over_Temperature.VeLINR_b_CPIM_Over_Temperature
            access DSP_VeLINR_b_CPIM_Over_TemperatureTO_VeLINR_b_CPIM_Over_TemperatureTO: accessed-variable=VeLINR_b_CPIM_Over_TemperatureTO.VeLINR_b_CPIM_Over_TemperatureTO
          read-local-variables:
            access IRVRA_VeLINR_d_LIN_SlavePrsnt_LIN3: accessed-variable=VeLINR_d_LIN_SlavePrsnt_LIN3
        COMRXL_CPIM_LIN_Parity_Error_CPIM_HCP_FEEDBACK_Lin3_Received: symbol=ApplLinComAb_LIN3_COMRXL_CPIM_LIN_Parity_Error_CPIM_HCP_FEEDBACK_Lin3_Received  # Received -
          data-receive-point-by-arguments:
            access DRP_Lin3ComRxSignalsSR_COMRXL_CPIM_LIN_Parity_Error_CPIM_HCP_FEEDBACK_Lin3: accessed-variable=Lin3ComRxSignalsSR.COMRXL_CPIM_LIN_Parity_Error_CPIM_HCP_FEEDBACK_Lin3
          data-send-points:
            access DSP_VeLINR_b_CPIM_LIN_Parity_Error_VeLINR_b_CPIM_LIN_Parity_Error: accessed-variable=VeLINR_b_CPIM_LIN_Parity_Error.VeLINR_b_CPIM_LIN_Parity_Error
            access DSP_VeLINR_b_CPIM_LIN_Parity_ErrorTO_VeLINR_b_CPIM_LIN_Parity_ErrorTO: accessed-variable=VeLINR_b_CPIM_LIN_Parity_ErrorTO.VeLINR_b_CPIM_LIN_Parity_ErrorTO
        COMRXL_CPIM_LIN_Parity_Error_CPIM_HCP_FEEDBACK_Lin3_Error: symbol=ApplLinComAb_LIN3_COMRXL_CPIM_LIN_Parity_Error_CPIM_HCP_FEEDBACK_Lin3_Error  # Error -
          data-receive-point-by-arguments:
            access DRP_Lin3ComRxSignalsSR_COMRXL_CPIM_LIN_Parity_Error_CPIM_HCP_FEEDBACK_Lin3: accessed-variable=Lin3ComRxSignalsSR.COMRXL_CPIM_LIN_Parity_Error_CPIM_HCP_FEEDBACK_Lin3
          data-send-points:
            access DSP_VeLINR_b_CPIM_LIN_Parity_Error_VeLINR_b_CPIM_LIN_Parity_Error: accessed-variable=VeLINR_b_CPIM_LIN_Parity_Error.VeLINR_b_CPIM_LIN_Parity_Error
            access DSP_VeLINR_b_CPIM_LIN_Parity_ErrorTO_VeLINR_b_CPIM_LIN_Parity_ErrorTO: accessed-variable=VeLINR_b_CPIM_LIN_Parity_ErrorTO.VeLINR_b_CPIM_LIN_Parity_ErrorTO
          read-local-variables:
            access IRVRA_VeLINR_d_LIN_SlavePrsnt_LIN3: accessed-variable=VeLINR_d_LIN_SlavePrsnt_LIN3
        COMRXL_CPIM_LIN_Checksum_Error_CPIM_HCP_FEEDBACK_Lin3_Received: symbol=ApplLinComAb_LIN3_COMRXL_CPIM_LIN_Checksum_Error_CPIM_HCP_FEEDBACK_Lin3_Received  # Received -
          data-receive-point-by-arguments:
            access DRP_Lin3ComRxSignalsSR_COMRXL_CPIM_LIN_Checksum_Error_CPIM_HCP_FEEDBACK_Lin3: accessed-variable=Lin3ComRxSignalsSR.COMRXL_CPIM_LIN_Checksum_Error_CPIM_HCP_FEEDBACK_Lin3
          data-send-points:
            access DSP_VeLINR_b_CPIM_LIN_ChecksumError_VeLINR_b_CPIM_LIN_ChecksumError: accessed-variable=VeLINR_b_CPIM_LIN_ChecksumError.VeLINR_b_CPIM_LIN_ChecksumError
            access DSP_VeLINR_b_CPIM_LIN_ChecksumErrorTO_VeLINR_b_CPIM_LIN_ChecksumErrorTO: accessed-variable=VeLINR_b_CPIM_LIN_ChecksumErrorTO.VeLINR_b_CPIM_LIN_ChecksumErrorTO
        COMRXL_CPIM_LIN_Checksum_Error_CPIM_HCP_FEEDBACK_Lin3_Error: symbol=ApplLinComAb_LIN3_COMRXL_CPIM_LIN_Checksum_Error_CPIM_HCP_FEEDBACK_Lin3_Error  # Error -
          data-receive-point-by-arguments:
            access DRP_Lin3ComRxSignalsSR_COMRXL_CPIM_LIN_Checksum_Error_CPIM_HCP_FEEDBACK_Lin3: accessed-variable=Lin3ComRxSignalsSR.COMRXL_CPIM_LIN_Checksum_Error_CPIM_HCP_FEEDBACK_Lin3
          data-send-points:
            access DSP_VeLINR_b_CPIM_LIN_ChecksumError_VeLINR_b_CPIM_LIN_ChecksumError: accessed-variable=VeLINR_b_CPIM_LIN_ChecksumError.VeLINR_b_CPIM_LIN_ChecksumError
            access DSP_VeLINR_b_CPIM_LIN_ChecksumErrorTO_VeLINR_b_CPIM_LIN_ChecksumErrorTO: accessed-variable=VeLINR_b_CPIM_LIN_ChecksumErrorTO.VeLINR_b_CPIM_LIN_ChecksumErrorTO
          read-local-variables:
            access IRVRA_VeLINR_d_LIN_SlavePrsnt_LIN3: accessed-variable=VeLINR_d_LIN_SlavePrsnt_LIN3
        COMRXL_CPIM_LIN_Data_Error_CPIM_HCP_FEEDBACK_Lin3_Received: symbol=ApplLinComAb_LIN3_COMRXL_CPIM_LIN_Data_Error_CPIM_HCP_FEEDBACK_Lin3_Received  # Received -
          data-receive-point-by-arguments:
            access DRP_Lin3ComRxSignalsSR_COMRXL_CPIM_LIN_Data_Error_CPIM_HCP_FEEDBACK_Lin3: accessed-variable=Lin3ComRxSignalsSR.COMRXL_CPIM_LIN_Data_Error_CPIM_HCP_FEEDBACK_Lin3
          data-send-points:
            access DSP_VeLINR_b_CPIM_LIN_Data_Error_VeLINR_b_CPIM_LIN_Data_Error: accessed-variable=VeLINR_b_CPIM_LIN_Data_Error.VeLINR_b_CPIM_LIN_Data_Error
            access DSP_VeLINR_b_CPIM_LIN_Data_ErrorTO_VeLINR_b_CPIM_LIN_Data_ErrorTO: accessed-variable=VeLINR_b_CPIM_LIN_Data_ErrorTO.VeLINR_b_CPIM_LIN_Data_ErrorTO
        COMRXL_CPIM_LIN_Data_Error_CPIM_HCP_FEEDBACK_Lin3_Error: symbol=ApplLinComAb_LIN3_COMRXL_CPIM_LIN_Data_Error_CPIM_HCP_FEEDBACK_Lin3_Error  # Error -
          data-receive-point-by-arguments:
            access DRP_Lin3ComRxSignalsSR_COMRXL_CPIM_LIN_Data_Error_CPIM_HCP_FEEDBACK_Lin3: accessed-variable=Lin3ComRxSignalsSR.COMRXL_CPIM_LIN_Data_Error_CPIM_HCP_FEEDBACK_Lin3
          data-send-points:
            access DSP_VeLINR_b_CPIM_LIN_Data_Error_VeLINR_b_CPIM_LIN_Data_Error: accessed-variable=VeLINR_b_CPIM_LIN_Data_Error.VeLINR_b_CPIM_LIN_Data_Error
            access DSP_VeLINR_b_CPIM_LIN_Data_ErrorTO_VeLINR_b_CPIM_LIN_Data_ErrorTO: accessed-variable=VeLINR_b_CPIM_LIN_Data_ErrorTO.VeLINR_b_CPIM_LIN_Data_ErrorTO
          read-local-variables:
            access IRVRA_VeLINR_d_LIN_SlavePrsnt_LIN3: accessed-variable=VeLINR_d_LIN_SlavePrsnt_LIN3
        COMRXL_ChrgPortLock_Sts_CPIM_HCP_FEEDBACK_Lin3_Received: symbol=ApplLinComAb_LIN3_COMRXL_ChrgPortLock_Sts_CPIM_HCP_FEEDBACK_Lin3_Received  # Received -
          data-receive-point-by-arguments:
            access DRP_Lin3ComRxSignalsSR_COMRXL_ChrgPortLock_Sts_CPIM_HCP_FEEDBACK_Lin3: accessed-variable=Lin3ComRxSignalsSR.COMRXL_ChrgPortLock_Sts_CPIM_HCP_FEEDBACK_Lin3
          data-send-points:
            access DSP_VeLINR_b_ChrgPortLock_Sts_VeLINR_b_ChrgPortLock_Sts: accessed-variable=VeLINR_b_ChrgPortLock_Sts.VeLINR_b_ChrgPortLock_Sts
            access DSP_VeLINR_b_ChrgPortLock_StsTO_VeLINR_b_ChrgPortLock_StsTO: accessed-variable=VeLINR_b_ChrgPortLock_StsTO.VeLINR_b_ChrgPortLock_StsTO
        COMRXL_ChrgPortLock_Sts_CPIM_HCP_FEEDBACK_Lin3_Error: symbol=ApplLinComAb_LIN3_COMRXL_ChrgPortLock_Sts_CPIM_HCP_FEEDBACK_Lin3_Error  # Error -
          data-receive-point-by-arguments:
            access DRP_Lin3ComRxSignalsSR_COMRXL_ChrgPortLock_Sts_CPIM_HCP_FEEDBACK_Lin3: accessed-variable=Lin3ComRxSignalsSR.COMRXL_ChrgPortLock_Sts_CPIM_HCP_FEEDBACK_Lin3
          data-send-points:
            access DSP_VeLINR_b_ChrgPortLock_Sts_VeLINR_b_ChrgPortLock_Sts: accessed-variable=VeLINR_b_ChrgPortLock_Sts.VeLINR_b_ChrgPortLock_Sts
            access DSP_VeLINR_b_ChrgPortLock_StsTO_VeLINR_b_ChrgPortLock_StsTO: accessed-variable=VeLINR_b_ChrgPortLock_StsTO.VeLINR_b_ChrgPortLock_StsTO
          read-local-variables:
            access IRVRA_VeLINR_d_LIN_SlavePrsnt_LIN3: accessed-variable=VeLINR_d_LIN_SlavePrsnt_LIN3
        COMRXL_ChrgPortButton_Sts_CPIM_HCP_FEEDBACK_Lin3_Received: symbol=ApplLinComAb_LIN3_COMRXL_ChrgPortButton_Sts_CPIM_HCP_FEEDBACK_Lin3_Received  # Received -
          data-receive-point-by-arguments:
            access DRP_Lin3ComRxSignalsSR_COMRXL_ChrgPortButton_Sts_CPIM_HCP_FEEDBACK_Lin3: accessed-variable=Lin3ComRxSignalsSR.COMRXL_ChrgPortButton_Sts_CPIM_HCP_FEEDBACK_Lin3
          data-send-points:
            access DSP_VeLINR_b_ChrgPortButton_Sts_VeLINR_b_ChrgPortButton_Sts: accessed-variable=VeLINR_b_ChrgPortButton_Sts.VeLINR_b_ChrgPortButton_Sts
            access DSP_VeLINR_b_ChrgPortButton_StsTO_VeLINR_b_ChrgPortButton_StsTO: accessed-variable=VeLINR_b_ChrgPortButton_StsTO.VeLINR_b_ChrgPortButton_StsTO
        COMRXL_ChrgPortButton_Sts_CPIM_HCP_FEEDBACK_Lin3_Error: symbol=ApplLinComAb_LIN3_COMRXL_ChrgPortButton_Sts_CPIM_HCP_FEEDBACK_Lin3_Error  # Error -
          data-receive-point-by-arguments:
            access DRP_Lin3ComRxSignalsSR_COMRXL_ChrgPortButton_Sts_CPIM_HCP_FEEDBACK_Lin3: accessed-variable=Lin3ComRxSignalsSR.COMRXL_ChrgPortButton_Sts_CPIM_HCP_FEEDBACK_Lin3
          data-send-points:
            access DSP_VeLINR_b_ChrgPortButton_Sts_VeLINR_b_ChrgPortButton_Sts: accessed-variable=VeLINR_b_ChrgPortButton_Sts.VeLINR_b_ChrgPortButton_Sts
            access DSP_VeLINR_b_ChrgPortButton_StsTO_VeLINR_b_ChrgPortButton_StsTO: accessed-variable=VeLINR_b_ChrgPortButton_StsTO.VeLINR_b_ChrgPortButton_StsTO
          read-local-variables:
            access IRVRA_VeLINR_d_LIN_SlavePrsnt_LIN3: accessed-variable=VeLINR_d_LIN_SlavePrsnt_LIN3
        COMRXL_Ambient_Temp_CPIM_HCP_FEEDBACK_Lin3_Received: symbol=ApplLinComAb_LIN3_COMRXL_Ambient_Temp_CPIM_HCP_FEEDBACK_Lin3_Received  # Received -
          data-receive-point-by-arguments:
            access DRP_Lin3ComRxSignalsSR_COMRXL_Ambient_Temp_CPIM_HCP_FEEDBACK_Lin3: accessed-variable=Lin3ComRxSignalsSR.COMRXL_Ambient_Temp_CPIM_HCP_FEEDBACK_Lin3
          data-send-points:
            access DSP_VeLINR_e_Ambient_Temp_VeLINR_e_Ambient_Temp: accessed-variable=VeLINR_e_Ambient_Temp.VeLINR_e_Ambient_Temp
            access DSP_VeLINR_b_Ambient_TempTO_VeLINR_b_Ambient_TempTO: accessed-variable=VeLINR_b_Ambient_TempTO.VeLINR_b_Ambient_TempTO
        COMRXL_Ambient_Temp_CPIM_HCP_FEEDBACK_Lin3_Error: symbol=ApplLinComAb_LIN3_COMRXL_Ambient_Temp_CPIM_HCP_FEEDBACK_Lin3_Error  # Error -
          data-receive-point-by-arguments:
            access DRP_Lin3ComRxSignalsSR_COMRXL_Ambient_Temp_CPIM_HCP_FEEDBACK_Lin3: accessed-variable=Lin3ComRxSignalsSR.COMRXL_Ambient_Temp_CPIM_HCP_FEEDBACK_Lin3
          data-send-points:
            access DSP_VeLINR_e_Ambient_Temp_VeLINR_e_Ambient_Temp: accessed-variable=VeLINR_e_Ambient_Temp.VeLINR_e_Ambient_Temp
            access DSP_VeLINR_b_Ambient_TempTO_VeLINR_b_Ambient_TempTO: accessed-variable=VeLINR_b_Ambient_TempTO.VeLINR_b_Ambient_TempTO
          read-local-variables:
            access IRVRA_VeLINR_d_LIN_SlavePrsnt_LIN3: accessed-variable=VeLINR_d_LIN_SlavePrsnt_LIN3
        COMRXL_Chrg_Inlet_Temp_CPIM_HCP_FEEDBACK_Lin3_Received: symbol=ApplLinComAb_LIN3_COMRXL_Chrg_Inlet_Temp_CPIM_HCP_FEEDBACK_Lin3_Received  # Received -
          data-receive-point-by-arguments:
            access DRP_Lin3ComRxSignalsSR_COMRXL_Chrg_Inlet_Temp_CPIM_HCP_FEEDBACK_Lin3: accessed-variable=Lin3ComRxSignalsSR.COMRXL_Chrg_Inlet_Temp_CPIM_HCP_FEEDBACK_Lin3
          data-send-points:
            access DSP_VeLINR_e_Chrg_Inlet_Temp_VeLINR_e_Chrg_Inlet_Temp: accessed-variable=VeLINR_e_Chrg_Inlet_Temp.VeLINR_e_Chrg_Inlet_Temp
            access DSP_VeLINR_b_Chrg_Inlet_TempTO_VeLINR_b_Chrg_Inlet_TempTO: accessed-variable=VeLINR_b_Chrg_Inlet_TempTO.VeLINR_b_Chrg_Inlet_TempTO
        COMRXL_Chrg_Inlet_Temp_CPIM_HCP_FEEDBACK_Lin3_Error: symbol=ApplLinComAb_LIN3_COMRXL_Chrg_Inlet_Temp_CPIM_HCP_FEEDBACK_Lin3_Error  # Error -
          data-receive-point-by-arguments:
            access DRP_Lin3ComRxSignalsSR_COMRXL_Chrg_Inlet_Temp_CPIM_HCP_FEEDBACK_Lin3: accessed-variable=Lin3ComRxSignalsSR.COMRXL_Chrg_Inlet_Temp_CPIM_HCP_FEEDBACK_Lin3
          data-send-points:
            access DSP_VeLINR_e_Chrg_Inlet_Temp_VeLINR_e_Chrg_Inlet_Temp: accessed-variable=VeLINR_e_Chrg_Inlet_Temp.VeLINR_e_Chrg_Inlet_Temp
            access DSP_VeLINR_b_Chrg_Inlet_TempTO_VeLINR_b_Chrg_Inlet_TempTO: accessed-variable=VeLINR_b_Chrg_Inlet_TempTO.VeLINR_b_Chrg_Inlet_TempTO
          read-local-variables:
            access IRVRA_VeLINR_d_LIN_SlavePrsnt_LIN3: accessed-variable=VeLINR_d_LIN_SlavePrsnt_LIN3
        COMRXL_ResponseErrorStsCPIM_CPIM_HCP_FEEDBACK_Lin3_Received: symbol=ApplLinComAb_LIN3_COMRXL_ResponseErrorStsCPIM_CPIM_HCP_FEEDBACK_Lin3_Received  # Received -
          data-receive-point-by-arguments:
            access DRP_Lin3ComRxSignalsSR_COMRXL_ResponseErrorStsCPIM_CPIM_HCP_FEEDBACK_Lin3: accessed-variable=Lin3ComRxSignalsSR.COMRXL_ResponseErrorStsCPIM_CPIM_HCP_FEEDBACK_Lin3
          data-send-points:
            access DSP_VeLINR_b_ResponseErrorStsCPIM_VeLINR_b_ResponseErrorStsCPIM: accessed-variable=VeLINR_b_ResponseErrorStsCPIM.VeLINR_b_ResponseErrorStsCPIM
            access DSP_VeLINR_b_ResponseErrorStsCPIM_TO_VeLINR_b_ResponseErrorStsCPIM_TO: accessed-variable=VeLINR_b_ResponseErrorStsCPIM_TO.VeLINR_b_ResponseErrorStsCPIM_TO
        COMRXL_ResponseErrorStsCPIM_CPIM_HCP_FEEDBACK_Lin3_Error: symbol=ApplLinComAb_LIN3_COMRXL_ResponseErrorStsCPIM_CPIM_HCP_FEEDBACK_Lin3_Error  # Error -
          data-receive-point-by-arguments:
            access DRP_Lin3ComRxSignalsSR_COMRXL_ResponseErrorStsCPIM_CPIM_HCP_FEEDBACK_Lin3: accessed-variable=Lin3ComRxSignalsSR.COMRXL_ResponseErrorStsCPIM_CPIM_HCP_FEEDBACK_Lin3
          data-send-points:
            access DSP_VeLINR_b_ResponseErrorStsCPIM_VeLINR_b_ResponseErrorStsCPIM: accessed-variable=VeLINR_b_ResponseErrorStsCPIM.VeLINR_b_ResponseErrorStsCPIM
            access DSP_VeLINR_b_ResponseErrorStsCPIM_TO_VeLINR_b_ResponseErrorStsCPIM_TO: accessed-variable=VeLINR_b_ResponseErrorStsCPIM_TO.VeLINR_b_ResponseErrorStsCPIM_TO
          read-local-variables:
            access IRVRA_VeLINR_d_LIN_SlavePrsnt_LIN3: accessed-variable=VeLINR_d_LIN_SlavePrsnt_LIN3
        COMRXL_ChrgPortLock_FailSts_CPIM_HCP_FEEDBACK_Lin3_Received: symbol=ApplLinComAb_LIN3_COMRXL_ChrgPortLock_FailSts_CPIM_HCP_FEEDBACK_Lin3_Received  # Received -
          data-receive-point-by-arguments:
            access DRP_Lin3ComRxSignalsSR_COMRXL_ChrgPortLock_FailSts_CPIM_HCP_FEEDBACK_Lin3: accessed-variable=Lin3ComRxSignalsSR.COMRXL_ChrgPortLock_FailSts_CPIM_HCP_FEEDBACK_Lin3
          data-send-points:
            access DSP_VeLINR_e_ChrgPortLock_FailSts_VeLINR_e_ChrgPortLock_FailSts: accessed-variable=VeLINR_e_ChrgPortLock_FailSts.VeLINR_e_ChrgPortLock_FailSts
            access DSP_VeLINR_b_ChrgPortLock_FailStsTO_VeLINR_b_ChrgPortLock_FailStsTO: accessed-variable=VeLINR_b_ChrgPortLock_FailStsTO.VeLINR_b_ChrgPortLock_FailStsTO
        COMRXL_ChrgPortLock_FailSts_CPIM_HCP_FEEDBACK_Lin3_Error: symbol=ApplLinComAb_LIN3_COMRXL_ChrgPortLock_FailSts_CPIM_HCP_FEEDBACK_Lin3_Error  # Error -
          data-receive-point-by-arguments:
            access DRP_Lin3ComRxSignalsSR_COMRXL_ChrgPortLock_FailSts_CPIM_HCP_FEEDBACK_Lin3: accessed-variable=Lin3ComRxSignalsSR.COMRXL_ChrgPortLock_FailSts_CPIM_HCP_FEEDBACK_Lin3
          data-send-points:
            access DSP_VeLINR_e_ChrgPortLock_FailSts_VeLINR_e_ChrgPortLock_FailSts: accessed-variable=VeLINR_e_ChrgPortLock_FailSts.VeLINR_e_ChrgPortLock_FailSts
            access DSP_VeLINR_b_ChrgPortLock_FailStsTO_VeLINR_b_ChrgPortLock_FailStsTO: accessed-variable=VeLINR_b_ChrgPortLock_FailStsTO.VeLINR_b_ChrgPortLock_FailStsTO
          read-local-variables:
            access IRVRA_VeLINR_d_LIN_SlavePrsnt_LIN3: accessed-variable=VeLINR_d_LIN_SlavePrsnt_LIN3
        COMRXL_Icon1_Sts_CPIM_HCP_FEEDBACK_Lin3_Received: symbol=ApplLinComAb_LIN3_COMRXL_Icon1_Sts_CPIM_HCP_FEEDBACK_Lin3_Received  # Received -
          data-receive-point-by-arguments:
            access DRP_Lin3ComRxSignalsSR_COMRXL_Icon1_Sts_CPIM_HCP_FEEDBACK_Lin3: accessed-variable=Lin3ComRxSignalsSR.COMRXL_Icon1_Sts_CPIM_HCP_FEEDBACK_Lin3
          data-send-points:
            access DSP_VeLINR_e_Icon1_Sts_VeLINR_e_Icon1_Sts: accessed-variable=VeLINR_e_Icon1_Sts.VeLINR_e_Icon1_Sts
            access DSP_VeLINR_b_Icon1_StsTO_VeLINR_b_Icon1_StsTO: accessed-variable=VeLINR_b_Icon1_StsTO.VeLINR_b_Icon1_StsTO
        COMRXL_Icon1_Sts_CPIM_HCP_FEEDBACK_Lin3_Error: symbol=ApplLinComAb_LIN3_COMRXL_Icon1_Sts_CPIM_HCP_FEEDBACK_Lin3_Error  # Error -
          data-receive-point-by-arguments:
            access DRP_Lin3ComRxSignalsSR_COMRXL_Icon1_Sts_CPIM_HCP_FEEDBACK_Lin3: accessed-variable=Lin3ComRxSignalsSR.COMRXL_Icon1_Sts_CPIM_HCP_FEEDBACK_Lin3
          data-send-points:
            access DSP_VeLINR_e_Icon1_Sts_VeLINR_e_Icon1_Sts: accessed-variable=VeLINR_e_Icon1_Sts.VeLINR_e_Icon1_Sts
            access DSP_VeLINR_b_Icon1_StsTO_VeLINR_b_Icon1_StsTO: accessed-variable=VeLINR_b_Icon1_StsTO.VeLINR_b_Icon1_StsTO
          read-local-variables:
            access IRVRA_VeLINR_d_LIN_SlavePrsnt_LIN3: accessed-variable=VeLINR_d_LIN_SlavePrsnt_LIN3
        COMRXL_Icon1_FailSts_CPIM_HCP_FEEDBACK_Lin3_Received: symbol=ApplLinComAb_LIN3_COMRXL_Icon1_FailSts_CPIM_HCP_FEEDBACK_Lin3_Received  # Received -
          data-receive-point-by-arguments:
            access DRP_Lin3ComRxSignalsSR_COMRXL_Icon1_FailSts_CPIM_HCP_FEEDBACK_Lin3: accessed-variable=Lin3ComRxSignalsSR.COMRXL_Icon1_FailSts_CPIM_HCP_FEEDBACK_Lin3
          data-send-points:
            access DSP_VeLINR_b_Icon1_FailSts_VeLINR_b_Icon1_FailSts: accessed-variable=VeLINR_b_Icon1_FailSts.VeLINR_b_Icon1_FailSts
            access DSP_VeLINR_b_Icon1_FailStsTO_VeLINR_b_Icon1_FailStsTO: accessed-variable=VeLINR_b_Icon1_FailStsTO.VeLINR_b_Icon1_FailStsTO
        COMRXL_Icon1_FailSts_CPIM_HCP_FEEDBACK_Lin3_Error: symbol=ApplLinComAb_LIN3_COMRXL_Icon1_FailSts_CPIM_HCP_FEEDBACK_Lin3_Error  # Error -
          data-receive-point-by-arguments:
            access DRP_Lin3ComRxSignalsSR_COMRXL_Icon1_FailSts_CPIM_HCP_FEEDBACK_Lin3: accessed-variable=Lin3ComRxSignalsSR.COMRXL_Icon1_FailSts_CPIM_HCP_FEEDBACK_Lin3
          data-send-points:
            access DSP_VeLINR_b_Icon1_FailSts_VeLINR_b_Icon1_FailSts: accessed-variable=VeLINR_b_Icon1_FailSts.VeLINR_b_Icon1_FailSts
            access DSP_VeLINR_b_Icon1_FailStsTO_VeLINR_b_Icon1_FailStsTO: accessed-variable=VeLINR_b_Icon1_FailStsTO.VeLINR_b_Icon1_FailStsTO
          read-local-variables:
            access IRVRA_VeLINR_d_LIN_SlavePrsnt_LIN3: accessed-variable=VeLINR_d_LIN_SlavePrsnt_LIN3
        COMRXL_Icon2_Sts_CPIM_HCP_FEEDBACK_Lin3_Received: symbol=ApplLinComAb_LIN3_COMRXL_Icon2_Sts_CPIM_HCP_FEEDBACK_Lin3_Received  # Received -
          data-receive-point-by-arguments:
            access DRP_Lin3ComRxSignalsSR_COMRXL_Icon2_Sts_CPIM_HCP_FEEDBACK_Lin3: accessed-variable=Lin3ComRxSignalsSR.COMRXL_Icon2_Sts_CPIM_HCP_FEEDBACK_Lin3
          data-send-points:
            access DSP_VeLINR_e_Icon2_Sts_VeLINR_e_Icon2_Sts: accessed-variable=VeLINR_e_Icon2_Sts.VeLINR_e_Icon2_Sts
            access DSP_VeLINR_b_Icon2_StsTO_VeLINR_b_Icon2_StsTO: accessed-variable=VeLINR_b_Icon2_StsTO.VeLINR_b_Icon2_StsTO
        COMRXL_Icon2_Sts_CPIM_HCP_FEEDBACK_Lin3_Error: symbol=ApplLinComAb_LIN3_COMRXL_Icon2_Sts_CPIM_HCP_FEEDBACK_Lin3_Error  # Error -
          data-receive-point-by-arguments:
            access DRP_Lin3ComRxSignalsSR_COMRXL_Icon2_Sts_CPIM_HCP_FEEDBACK_Lin3: accessed-variable=Lin3ComRxSignalsSR.COMRXL_Icon2_Sts_CPIM_HCP_FEEDBACK_Lin3
          data-send-points:
            access DSP_VeLINR_e_Icon2_Sts_VeLINR_e_Icon2_Sts: accessed-variable=VeLINR_e_Icon2_Sts.VeLINR_e_Icon2_Sts
            access DSP_VeLINR_b_Icon2_StsTO_VeLINR_b_Icon2_StsTO: accessed-variable=VeLINR_b_Icon2_StsTO.VeLINR_b_Icon2_StsTO
          read-local-variables:
            access IRVRA_VeLINR_d_LIN_SlavePrsnt_LIN3: accessed-variable=VeLINR_d_LIN_SlavePrsnt_LIN3
        COMRXL_Icon2_FailSts_CPIM_HCP_FEEDBACK_Lin3_Received: symbol=ApplLinComAb_LIN3_COMRXL_Icon2_FailSts_CPIM_HCP_FEEDBACK_Lin3_Received  # Received -
          data-receive-point-by-arguments:
            access DRP_Lin3ComRxSignalsSR_COMRXL_Icon2_FailSts_CPIM_HCP_FEEDBACK_Lin3: accessed-variable=Lin3ComRxSignalsSR.COMRXL_Icon2_FailSts_CPIM_HCP_FEEDBACK_Lin3
          data-send-points:
            access DSP_VeLINR_b_Icon2_FailSts_VeLINR_b_Icon2_FailSts: accessed-variable=VeLINR_b_Icon2_FailSts.VeLINR_b_Icon2_FailSts
            access DSP_VeLINR_b_Icon2_FailStsTO_VeLINR_b_Icon2_FailStsTO: accessed-variable=VeLINR_b_Icon2_FailStsTO.VeLINR_b_Icon2_FailStsTO
        COMRXL_Icon2_FailSts_CPIM_HCP_FEEDBACK_Lin3_Error: symbol=ApplLinComAb_LIN3_COMRXL_Icon2_FailSts_CPIM_HCP_FEEDBACK_Lin3_Error  # Error -
          data-receive-point-by-arguments:
            access DRP_Lin3ComRxSignalsSR_COMRXL_Icon2_FailSts_CPIM_HCP_FEEDBACK_Lin3: accessed-variable=Lin3ComRxSignalsSR.COMRXL_Icon2_FailSts_CPIM_HCP_FEEDBACK_Lin3
          data-send-points:
            access DSP_VeLINR_b_Icon2_FailSts_VeLINR_b_Icon2_FailSts: accessed-variable=VeLINR_b_Icon2_FailSts.VeLINR_b_Icon2_FailSts
            access DSP_VeLINR_b_Icon2_FailStsTO_VeLINR_b_Icon2_FailStsTO: accessed-variable=VeLINR_b_Icon2_FailStsTO.VeLINR_b_Icon2_FailStsTO
          read-local-variables:
            access IRVRA_VeLINR_d_LIN_SlavePrsnt_LIN3: accessed-variable=VeLINR_d_LIN_SlavePrsnt_LIN3
        COMRXL_ChrgPortDoor_Sts_CPIM_HCP_FEEDBACK_Lin3_Received: symbol=ApplLinComAb_LIN3_COMRXL_ChrgPortDoor_Sts_CPIM_HCP_FEEDBACK_Lin3_Received  # Received -
          data-receive-point-by-arguments:
            access DRP_Lin3ComRxSignalsSR_COMRXL_ChrgPortDoor_Sts_CPIM_HCP_FEEDBACK_Lin3: accessed-variable=Lin3ComRxSignalsSR.COMRXL_ChrgPortDoor_Sts_CPIM_HCP_FEEDBACK_Lin3
          data-send-points:
            access DSP_VeLINR_e_ChrgPortDoor_Sts_VeLINR_e_ChrgPortDoor_Sts: accessed-variable=VeLINR_e_ChrgPortDoor_Sts.VeLINR_e_ChrgPortDoor_Sts
            access DSP_VeLINR_b_ChrgPortDoor_StsTO_VeLINR_b_ChrgPortDoor_StsTO: accessed-variable=VeLINR_b_ChrgPortDoor_StsTO.VeLINR_b_ChrgPortDoor_StsTO
        COMRXL_ChrgPortDoor_Sts_CPIM_HCP_FEEDBACK_Lin3_Error: symbol=ApplLinComAb_LIN3_COMRXL_ChrgPortDoor_Sts_CPIM_HCP_FEEDBACK_Lin3_Error  # Error -
          data-receive-point-by-arguments:
            access DRP_Lin3ComRxSignalsSR_COMRXL_ChrgPortDoor_Sts_CPIM_HCP_FEEDBACK_Lin3: accessed-variable=Lin3ComRxSignalsSR.COMRXL_ChrgPortDoor_Sts_CPIM_HCP_FEEDBACK_Lin3
          data-send-points:
            access DSP_VeLINR_e_ChrgPortDoor_Sts_VeLINR_e_ChrgPortDoor_Sts: accessed-variable=VeLINR_e_ChrgPortDoor_Sts.VeLINR_e_ChrgPortDoor_Sts
            access DSP_VeLINR_b_ChrgPortDoor_StsTO_VeLINR_b_ChrgPortDoor_StsTO: accessed-variable=VeLINR_b_ChrgPortDoor_StsTO.VeLINR_b_ChrgPortDoor_StsTO
          read-local-variables:
            access IRVRA_VeLINR_d_LIN_SlavePrsnt_LIN3: accessed-variable=VeLINR_d_LIN_SlavePrsnt_LIN3
        COMRXL_HvCooltHeatrSts_HVCHLIN18Fr01_Lin3_Received: symbol=ApplLinComAb_LIN3_COMRXL_HvCooltHeatrSts_HVCHLIN18Fr01_Lin3_Received  # Received -
          data-receive-point-by-arguments:
            access DRP_Lin3ComRxSignalsSR_COMRXL_HvCooltHeatrSts_HVCHLIN18Fr01_Lin3: accessed-variable=Lin3ComRxSignalsSR.COMRXL_HvCooltHeatrSts_HVCHLIN18Fr01_Lin3
          data-send-points:
            access DSP_VeLINR_e_HvCooltHeatrSts_VeLINR_e_HvCooltHeatrSts: accessed-variable=VeLINR_e_HvCooltHeatrSts.VeLINR_e_HvCooltHeatrSts
            access DSP_VeLINR_b_HvCooltHeatrStsTO_VeLINR_b_HvCooltHeatrStsTO: accessed-variable=VeLINR_b_HvCooltHeatrStsTO.VeLINR_b_HvCooltHeatrStsTO
        COMRXL_HvCooltHeatrSts_HVCHLIN18Fr01_Lin3_Error: symbol=ApplLinComAb_LIN3_COMRXL_HvCooltHeatrSts_HVCHLIN18Fr01_Lin3_Error  # Error -
          data-receive-point-by-arguments:
            access DRP_Lin3ComRxSignalsSR_COMRXL_HvCooltHeatrSts_HVCHLIN18Fr01_Lin3: accessed-variable=Lin3ComRxSignalsSR.COMRXL_HvCooltHeatrSts_HVCHLIN18Fr01_Lin3
          data-send-points:
            access DSP_VeLINR_e_HvCooltHeatrSts_VeLINR_e_HvCooltHeatrSts: accessed-variable=VeLINR_e_HvCooltHeatrSts.VeLINR_e_HvCooltHeatrSts
            access DSP_VeLINR_b_HvCooltHeatrStsTO_VeLINR_b_HvCooltHeatrStsTO: accessed-variable=VeLINR_b_HvCooltHeatrStsTO.VeLINR_b_HvCooltHeatrStsTO
          read-local-variables:
            access IRVRA_VeLINR_d_LIN_SlavePrsnt_LIN3: accessed-variable=VeLINR_d_LIN_SlavePrsnt_LIN3
        COMRXL_ECH_InterlockStat_HVCHLIN18Fr01_Lin3_Received: symbol=ApplLinComAb_LIN3_COMRXL_ECH_InterlockStat_HVCHLIN18Fr01_Lin3_Received  # Received -
          data-receive-point-by-arguments:
            access DRP_Lin3ComRxSignalsSR_COMRXL_ECH_InterlockStat_HVCHLIN18Fr01_Lin3: accessed-variable=Lin3ComRxSignalsSR.COMRXL_ECH_InterlockStat_HVCHLIN18Fr01_Lin3
          data-send-points:
            access DSP_VeLINR_e_ECH_InterlockStat_VeLINR_e_ECH_InterlockStat: accessed-variable=VeLINR_e_ECH_InterlockStat.VeLINR_e_ECH_InterlockStat
            access DSP_VeLINR_b_ECH_InterlockStatTO_VeLINR_b_ECH_InterlockStatTO: accessed-variable=VeLINR_b_ECH_InterlockStatTO.VeLINR_b_ECH_InterlockStatTO
        COMRXL_ECH_InterlockStat_HVCHLIN18Fr01_Lin3_Error: symbol=ApplLinComAb_LIN3_COMRXL_ECH_InterlockStat_HVCHLIN18Fr01_Lin3_Error  # Error -
          data-receive-point-by-arguments:
            access DRP_Lin3ComRxSignalsSR_COMRXL_ECH_InterlockStat_HVCHLIN18Fr01_Lin3: accessed-variable=Lin3ComRxSignalsSR.COMRXL_ECH_InterlockStat_HVCHLIN18Fr01_Lin3
          data-send-points:
            access DSP_VeLINR_e_ECH_InterlockStat_VeLINR_e_ECH_InterlockStat: accessed-variable=VeLINR_e_ECH_InterlockStat.VeLINR_e_ECH_InterlockStat
            access DSP_VeLINR_b_ECH_InterlockStatTO_VeLINR_b_ECH_InterlockStatTO: accessed-variable=VeLINR_b_ECH_InterlockStatTO.VeLINR_b_ECH_InterlockStatTO
          read-local-variables:
            access IRVRA_VeLINR_d_LIN_SlavePrsnt_LIN3: accessed-variable=VeLINR_d_LIN_SlavePrsnt_LIN3
        COMRXL_Below_60V_HVCHLIN18Fr01_Lin3_Received: symbol=ApplLinComAb_LIN3_COMRXL_Below_60V_HVCHLIN18Fr01_Lin3_Received  # Received -
          data-receive-point-by-arguments:
            access DRP_Lin3ComRxSignalsSR_COMRXL_Below_60V_HVCHLIN18Fr01_Lin3: accessed-variable=Lin3ComRxSignalsSR.COMRXL_Below_60V_HVCHLIN18Fr01_Lin3
          data-send-points:
            access DSP_VeLINR_e_Below_60V_VeLINR_e_Below_60V: accessed-variable=VeLINR_e_Below_60V.VeLINR_e_Below_60V
            access DSP_VeLINR_b_Below_60V_TO_VeLINR_b_Below_60V_TO: accessed-variable=VeLINR_b_Below_60V_TO.VeLINR_b_Below_60V_TO
        COMRXL_Below_60V_HVCHLIN18Fr01_Lin3_Error: symbol=ApplLinComAb_LIN3_COMRXL_Below_60V_HVCHLIN18Fr01_Lin3_Error  # Error -
          data-receive-point-by-arguments:
            access DRP_Lin3ComRxSignalsSR_COMRXL_Below_60V_HVCHLIN18Fr01_Lin3: accessed-variable=Lin3ComRxSignalsSR.COMRXL_Below_60V_HVCHLIN18Fr01_Lin3
          data-send-points:
            access DSP_VeLINR_e_Below_60V_VeLINR_e_Below_60V: accessed-variable=VeLINR_e_Below_60V.VeLINR_e_Below_60V
            access DSP_VeLINR_b_Below_60V_TO_VeLINR_b_Below_60V_TO: accessed-variable=VeLINR_b_Below_60V_TO.VeLINR_b_Below_60V_TO
          read-local-variables:
            access IRVRA_VeLINR_d_LIN_SlavePrsnt_LIN3: accessed-variable=VeLINR_d_LIN_SlavePrsnt_LIN3
        COMRXL_HvCooltWtrHeatrWtrTInIntk_HVCHLIN18Fr01_Lin3_Received: symbol=ApplLinComAb_LIN3_COMRXL_HvCooltWtrHeatrWtrTInIntk_HVCHLIN18Fr01_Lin3_Received  # Received -
          data-receive-point-by-arguments:
            access DRP_Lin3ComRxSignalsSR_COMRXL_HvCooltWtrHeatrWtrTInIntk_HVCHLIN18Fr01_Lin3: accessed-variable=Lin3ComRxSignalsSR.COMRXL_HvCooltWtrHeatrWtrTInIntk_HVCHLIN18Fr01_Lin3
          data-send-points:
            access DSP_VeLINR_T_HvCltWtrHtrWtrTInIntk_VeLINR_T_HvCltWtrHtrWtrTInIntk: accessed-variable=VeLINR_T_HvCltWtrHtrWtrTInIntk.VeLINR_T_HvCltWtrHtrWtrTInIntk
            access DSP_VeLINR_b_HvCltWtrHtrWtrTInIntkTO_VeLINR_b_HvCltWtrHtrWtrTInIntkTO: accessed-variable=VeLINR_b_HvCltWtrHtrWtrTInIntkTO.VeLINR_b_HvCltWtrHtrWtrTInIntkTO
        COMRXL_HvCooltWtrHeatrWtrTInIntk_HVCHLIN18Fr01_Lin3_Error: symbol=ApplLinComAb_LIN3_COMRXL_HvCooltWtrHeatrWtrTInIntk_HVCHLIN18Fr01_Lin3_Error  # Error -
          data-receive-point-by-arguments:
            access DRP_Lin3ComRxSignalsSR_COMRXL_HvCooltWtrHeatrWtrTInIntk_HVCHLIN18Fr01_Lin3: accessed-variable=Lin3ComRxSignalsSR.COMRXL_HvCooltWtrHeatrWtrTInIntk_HVCHLIN18Fr01_Lin3
          data-send-points:
            access DSP_VeLINR_T_HvCltWtrHtrWtrTInIntk_VeLINR_T_HvCltWtrHtrWtrTInIntk: accessed-variable=VeLINR_T_HvCltWtrHtrWtrTInIntk.VeLINR_T_HvCltWtrHtrWtrTInIntk
            access DSP_VeLINR_b_HvCltWtrHtrWtrTInIntkTO_VeLINR_b_HvCltWtrHtrWtrTInIntkTO: accessed-variable=VeLINR_b_HvCltWtrHtrWtrTInIntkTO.VeLINR_b_HvCltWtrHtrWtrTInIntkTO
          read-local-variables:
            access IRVRA_VeLINR_d_LIN_SlavePrsnt_LIN3: accessed-variable=VeLINR_d_LIN_SlavePrsnt_LIN3
        COMRXL_HvWtrHeatrWtrT_HVCHLIN18Fr01_Lin3_Received: symbol=ApplLinComAb_LIN3_COMRXL_HvWtrHeatrWtrT_HVCHLIN18Fr01_Lin3_Received  # Received -
          data-receive-point-by-arguments:
            access DRP_Lin3ComRxSignalsSR_COMRXL_HvWtrHeatrWtrT_HVCHLIN18Fr01_Lin3: accessed-variable=Lin3ComRxSignalsSR.COMRXL_HvWtrHeatrWtrT_HVCHLIN18Fr01_Lin3
          data-send-points:
            access DSP_VeLINR_T_HvWtrHeatrWtrT_VeLINR_T_HvWtrHeatrWtrT: accessed-variable=VeLINR_T_HvWtrHeatrWtrT.VeLINR_T_HvWtrHeatrWtrT
            access DSP_VeLINR_b_HvWtrHeatrWtrT_TO_VeLINR_b_HvWtrHeatrWtrT_TO: accessed-variable=VeLINR_b_HvWtrHeatrWtrT_TO.VeLINR_b_HvWtrHeatrWtrT_TO
        COMRXL_HvWtrHeatrWtrT_HVCHLIN18Fr01_Lin3_Error: symbol=ApplLinComAb_LIN3_COMRXL_HvWtrHeatrWtrT_HVCHLIN18Fr01_Lin3_Error  # Error -
          data-receive-point-by-arguments:
            access DRP_Lin3ComRxSignalsSR_COMRXL_HvWtrHeatrWtrT_HVCHLIN18Fr01_Lin3: accessed-variable=Lin3ComRxSignalsSR.COMRXL_HvWtrHeatrWtrT_HVCHLIN18Fr01_Lin3
          data-send-points:
            access DSP_VeLINR_T_HvWtrHeatrWtrT_VeLINR_T_HvWtrHeatrWtrT: accessed-variable=VeLINR_T_HvWtrHeatrWtrT.VeLINR_T_HvWtrHeatrWtrT
            access DSP_VeLINR_b_HvWtrHeatrWtrT_TO_VeLINR_b_HvWtrHeatrWtrT_TO: accessed-variable=VeLINR_b_HvWtrHeatrWtrT_TO.VeLINR_b_HvWtrHeatrWtrT_TO
          read-local-variables:
            access IRVRA_VeLINR_d_LIN_SlavePrsnt_LIN3: accessed-variable=VeLINR_d_LIN_SlavePrsnt_LIN3
        COMRXL_HvCooltHeatrICns_HVCHLIN18Fr01_Lin3_Received: symbol=ApplLinComAb_LIN3_COMRXL_HvCooltHeatrICns_HVCHLIN18Fr01_Lin3_Received  # Received -
          data-receive-point-by-arguments:
            access DRP_Lin3ComRxSignalsSR_COMRXL_HvCooltHeatrICns_HVCHLIN18Fr01_Lin3: accessed-variable=Lin3ComRxSignalsSR.COMRXL_HvCooltHeatrICns_HVCHLIN18Fr01_Lin3
          data-send-points:
            access DSP_VeLINR_I_HvCooltHeatrICns_VeLINR_I_HvCooltHeatrICns: accessed-variable=VeLINR_I_HvCooltHeatrICns.VeLINR_I_HvCooltHeatrICns
            access DSP_VeLINR_b_HvCooltHeatrICnsTO_VeLINR_b_HvCooltHeatrICnsTO: accessed-variable=VeLINR_b_HvCooltHeatrICnsTO.VeLINR_b_HvCooltHeatrICnsTO
        COMRXL_HvCooltHeatrICns_HVCHLIN18Fr01_Lin3_Error: symbol=ApplLinComAb_LIN3_COMRXL_HvCooltHeatrICns_HVCHLIN18Fr01_Lin3_Error  # Error -
          data-receive-point-by-arguments:
            access DRP_Lin3ComRxSignalsSR_COMRXL_HvCooltHeatrICns_HVCHLIN18Fr01_Lin3: accessed-variable=Lin3ComRxSignalsSR.COMRXL_HvCooltHeatrICns_HVCHLIN18Fr01_Lin3
          data-send-points:
            access DSP_VeLINR_I_HvCooltHeatrICns_VeLINR_I_HvCooltHeatrICns: accessed-variable=VeLINR_I_HvCooltHeatrICns.VeLINR_I_HvCooltHeatrICns
            access DSP_VeLINR_b_HvCooltHeatrICnsTO_VeLINR_b_HvCooltHeatrICnsTO: accessed-variable=VeLINR_b_HvCooltHeatrICnsTO.VeLINR_b_HvCooltHeatrICnsTO
          read-local-variables:
            access IRVRA_VeLINR_d_LIN_SlavePrsnt_LIN3: accessed-variable=VeLINR_d_LIN_SlavePrsnt_LIN3
        COMRXL_HvCooltHVmeas_HVCHLIN18Fr01_Lin3_Received: symbol=ApplLinComAb_LIN3_COMRXL_HvCooltHVmeas_HVCHLIN18Fr01_Lin3_Received  # Received -
          data-receive-point-by-arguments:
            access DRP_Lin3ComRxSignalsSR_COMRXL_HvCooltHVmeas_HVCHLIN18Fr01_Lin3: accessed-variable=Lin3ComRxSignalsSR.COMRXL_HvCooltHVmeas_HVCHLIN18Fr01_Lin3
          data-send-points:
            access DSP_VeLINR_U_HvCooltHVmeas_VeLINR_U_HvCooltHVmeas: accessed-variable=VeLINR_U_HvCooltHVmeas.VeLINR_U_HvCooltHVmeas
            access DSP_VeLINR_b_HvCooltHVmeasTO_VeLINR_b_HvCooltHVmeasTO: accessed-variable=VeLINR_b_HvCooltHVmeasTO.VeLINR_b_HvCooltHVmeasTO
        COMRXL_HvCooltHVmeas_HVCHLIN18Fr01_Lin3_Error: symbol=ApplLinComAb_LIN3_COMRXL_HvCooltHVmeas_HVCHLIN18Fr01_Lin3_Error  # Error -
          data-receive-point-by-arguments:
            access DRP_Lin3ComRxSignalsSR_COMRXL_HvCooltHVmeas_HVCHLIN18Fr01_Lin3: accessed-variable=Lin3ComRxSignalsSR.COMRXL_HvCooltHVmeas_HVCHLIN18Fr01_Lin3
          data-send-points:
            access DSP_VeLINR_U_HvCooltHVmeas_VeLINR_U_HvCooltHVmeas: accessed-variable=VeLINR_U_HvCooltHVmeas.VeLINR_U_HvCooltHVmeas
            access DSP_VeLINR_b_HvCooltHVmeasTO_VeLINR_b_HvCooltHVmeasTO: accessed-variable=VeLINR_b_HvCooltHVmeasTO.VeLINR_b_HvCooltHVmeasTO
          read-local-variables:
            access IRVRA_VeLINR_d_LIN_SlavePrsnt_LIN3: accessed-variable=VeLINR_d_LIN_SlavePrsnt_LIN3
        COMRXL_HvHeatrPwrCns_HVCHLIN18Fr01_Lin3_Received: symbol=ApplLinComAb_LIN3_COMRXL_HvHeatrPwrCns_HVCHLIN18Fr01_Lin3_Received  # Received -
          data-receive-point-by-arguments:
            access DRP_Lin3ComRxSignalsSR_COMRXL_HvHeatrPwrCns_HVCHLIN18Fr01_Lin3: accessed-variable=Lin3ComRxSignalsSR.COMRXL_HvHeatrPwrCns_HVCHLIN18Fr01_Lin3
          data-send-points:
            access DSP_VeLINR_P_HvHeatrPwrCns_VeLINR_P_HvHeatrPwrCns: accessed-variable=VeLINR_P_HvHeatrPwrCns.VeLINR_P_HvHeatrPwrCns
            access DSP_VeLINR_b_HvHeatrPwrCnsTO_VeLINR_b_HvHeatrPwrCnsTO: accessed-variable=VeLINR_b_HvHeatrPwrCnsTO.VeLINR_b_HvHeatrPwrCnsTO
        COMRXL_HvHeatrPwrCns_HVCHLIN18Fr01_Lin3_Error: symbol=ApplLinComAb_LIN3_COMRXL_HvHeatrPwrCns_HVCHLIN18Fr01_Lin3_Error  # Error -
          data-receive-point-by-arguments:
            access DRP_Lin3ComRxSignalsSR_COMRXL_HvHeatrPwrCns_HVCHLIN18Fr01_Lin3: accessed-variable=Lin3ComRxSignalsSR.COMRXL_HvHeatrPwrCns_HVCHLIN18Fr01_Lin3
          data-send-points:
            access DSP_VeLINR_P_HvHeatrPwrCns_VeLINR_P_HvHeatrPwrCns: accessed-variable=VeLINR_P_HvHeatrPwrCns.VeLINR_P_HvHeatrPwrCns
            access DSP_VeLINR_b_HvHeatrPwrCnsTO_VeLINR_b_HvHeatrPwrCnsTO: accessed-variable=VeLINR_b_HvHeatrPwrCnsTO.VeLINR_b_HvHeatrPwrCnsTO
          read-local-variables:
            access IRVRA_VeLINR_d_LIN_SlavePrsnt_LIN3: accessed-variable=VeLINR_d_LIN_SlavePrsnt_LIN3
        COMRXL_HvHeatrPwrCnsDes_HVCHLIN18Fr01_Lin3_Received: symbol=ApplLinComAb_LIN3_COMRXL_HvHeatrPwrCnsDes_HVCHLIN18Fr01_Lin3_Received  # Received -
          data-receive-point-by-arguments:
            access DRP_Lin3ComRxSignalsSR_COMRXL_HvHeatrPwrCnsDes_HVCHLIN18Fr01_Lin3: accessed-variable=Lin3ComRxSignalsSR.COMRXL_HvHeatrPwrCnsDes_HVCHLIN18Fr01_Lin3
          data-send-points:
            access DSP_VeLINR_P_HvHeatrPwrCnsDes_VeLINR_P_HvHeatrPwrCnsDes: accessed-variable=VeLINR_P_HvHeatrPwrCnsDes.VeLINR_P_HvHeatrPwrCnsDes
            access DSP_VeLINR_b_HvHeatrPwrCnsDesTO_VeLINR_b_HvHeatrPwrCnsDesTO: accessed-variable=VeLINR_b_HvHeatrPwrCnsDesTO.VeLINR_b_HvHeatrPwrCnsDesTO
        COMRXL_HvHeatrPwrCnsDes_HVCHLIN18Fr01_Lin3_Error: symbol=ApplLinComAb_LIN3_COMRXL_HvHeatrPwrCnsDes_HVCHLIN18Fr01_Lin3_Error  # Error -
          data-receive-point-by-arguments:
            access DRP_Lin3ComRxSignalsSR_COMRXL_HvHeatrPwrCnsDes_HVCHLIN18Fr01_Lin3: accessed-variable=Lin3ComRxSignalsSR.COMRXL_HvHeatrPwrCnsDes_HVCHLIN18Fr01_Lin3
          data-send-points:
            access DSP_VeLINR_P_HvHeatrPwrCnsDes_VeLINR_P_HvHeatrPwrCnsDes: accessed-variable=VeLINR_P_HvHeatrPwrCnsDes.VeLINR_P_HvHeatrPwrCnsDes
            access DSP_VeLINR_b_HvHeatrPwrCnsDesTO_VeLINR_b_HvHeatrPwrCnsDesTO: accessed-variable=VeLINR_b_HvHeatrPwrCnsDesTO.VeLINR_b_HvHeatrPwrCnsDesTO
          read-local-variables:
            access IRVRA_VeLINR_d_LIN_SlavePrsnt_LIN3: accessed-variable=VeLINR_d_LIN_SlavePrsnt_LIN3
        COMRXL_HVH_UnlockCounter_HVCHLIN18Fr01_Lin3_Received: symbol=ApplLinComAb_LIN3_COMRXL_HVH_UnlockCounter_HVCHLIN18Fr01_Lin3_Received  # Received -
          data-receive-point-by-arguments:
            access DRP_Lin3ComRxSignalsSR_COMRXL_HVH_UnlockCounter_HVCHLIN18Fr01_Lin3: accessed-variable=Lin3ComRxSignalsSR.COMRXL_HVH_UnlockCounter_HVCHLIN18Fr01_Lin3
          data-send-points:
            access DSP_VeLINR_e_HVH_UnlockCounter_VeLINR_e_HVH_UnlockCounter: accessed-variable=VeLINR_e_HVH_UnlockCounter.VeLINR_e_HVH_UnlockCounter
            access DSP_VeLINR_b_HVH_UnlockCounterTO_VeLINR_b_HVH_UnlockCounterTO: accessed-variable=VeLINR_b_HVH_UnlockCounterTO.VeLINR_b_HVH_UnlockCounterTO
        COMRXL_HVH_UnlockCounter_HVCHLIN18Fr01_Lin3_Error: symbol=ApplLinComAb_LIN3_COMRXL_HVH_UnlockCounter_HVCHLIN18Fr01_Lin3_Error  # Error -
          data-receive-point-by-arguments:
            access DRP_Lin3ComRxSignalsSR_COMRXL_HVH_UnlockCounter_HVCHLIN18Fr01_Lin3: accessed-variable=Lin3ComRxSignalsSR.COMRXL_HVH_UnlockCounter_HVCHLIN18Fr01_Lin3
          data-send-points:
            access DSP_VeLINR_e_HVH_UnlockCounter_VeLINR_e_HVH_UnlockCounter: accessed-variable=VeLINR_e_HVH_UnlockCounter.VeLINR_e_HVH_UnlockCounter
            access DSP_VeLINR_b_HVH_UnlockCounterTO_VeLINR_b_HVH_UnlockCounterTO: accessed-variable=VeLINR_b_HVH_UnlockCounterTO.VeLINR_b_HVH_UnlockCounterTO
          read-local-variables:
            access IRVRA_VeLINR_d_LIN_SlavePrsnt_LIN3: accessed-variable=VeLINR_d_LIN_SlavePrsnt_LIN3
        COMRXL_RsErr_ECH_HVCHLIN18Fr02_Lin3_Received: symbol=ApplLinComAb_LIN3_COMRXL_RsErr_ECH_HVCHLIN18Fr02_Lin3_Received  # Received -
          data-receive-point-by-arguments:
            access DRP_Lin3ComRxSignalsSR_COMRXL_RsErr_ECH_HVCHLIN18Fr02_Lin3: accessed-variable=Lin3ComRxSignalsSR.COMRXL_RsErr_ECH_HVCHLIN18Fr02_Lin3
          data-send-points:
            access DSP_VeLINR_b_RsErr_ECH_VeLINR_b_RsErr_ECH: accessed-variable=VeLINR_b_RsErr_ECH.VeLINR_b_RsErr_ECH
            access DSP_VeLINR_b_RsErr_ECH_TO_VeLINR_b_RsErr_ECH_TO: accessed-variable=VeLINR_b_RsErr_ECH_TO.VeLINR_b_RsErr_ECH_TO
        COMRXL_RsErr_ECH_HVCHLIN18Fr02_Lin3_Error: symbol=ApplLinComAb_LIN3_COMRXL_RsErr_ECH_HVCHLIN18Fr02_Lin3_Error  # Error -
          data-receive-point-by-arguments:
            access DRP_Lin3ComRxSignalsSR_COMRXL_RsErr_ECH_HVCHLIN18Fr02_Lin3: accessed-variable=Lin3ComRxSignalsSR.COMRXL_RsErr_ECH_HVCHLIN18Fr02_Lin3
          data-send-points:
            access DSP_VeLINR_b_RsErr_ECH_VeLINR_b_RsErr_ECH: accessed-variable=VeLINR_b_RsErr_ECH.VeLINR_b_RsErr_ECH
            access DSP_VeLINR_b_RsErr_ECH_TO_VeLINR_b_RsErr_ECH_TO: accessed-variable=VeLINR_b_RsErr_ECH_TO.VeLINR_b_RsErr_ECH_TO
          read-local-variables:
            access IRVRA_VeLINR_d_LIN_SlavePrsnt_LIN3: accessed-variable=VeLINR_d_LIN_SlavePrsnt_LIN3
        COMRXL_HvCooltHeatrWarnFltInCom_HVCHLIN18Fr02_Lin3_Received: symbol=ApplLinComAb_LIN3_COMRXL_HvCooltHeatrWarnFltInCom_HVCHLIN18Fr02_Lin3_Received  # Received -
          data-receive-point-by-arguments:
            access DRP_Lin3ComRxSignalsSR_COMRXL_HvCooltHeatrWarnFltInCom_HVCHLIN18Fr02_Lin3: accessed-variable=Lin3ComRxSignalsSR.COMRXL_HvCooltHeatrWarnFltInCom_HVCHLIN18Fr02_Lin3
          data-send-points:
            access DSP_VeLINR_e_HvCltHtrWrnFltInCom_VeLINR_e_HvCltHtrWrnFltInCom: accessed-variable=VeLINR_e_HvCltHtrWrnFltInCom.VeLINR_e_HvCltHtrWrnFltInCom
            access DSP_VeLINR_b_HvCltHtrWrnFltInComTO_VeLINR_b_HvCltHtrWrnFltInComTO: accessed-variable=VeLINR_b_HvCltHtrWrnFltInComTO.VeLINR_b_HvCltHtrWrnFltInComTO
        COMRXL_HvCooltHeatrWarnFltInCom_HVCHLIN18Fr02_Lin3_Error: symbol=ApplLinComAb_LIN3_COMRXL_HvCooltHeatrWarnFltInCom_HVCHLIN18Fr02_Lin3_Error  # Error -
          data-receive-point-by-arguments:
            access DRP_Lin3ComRxSignalsSR_COMRXL_HvCooltHeatrWarnFltInCom_HVCHLIN18Fr02_Lin3: accessed-variable=Lin3ComRxSignalsSR.COMRXL_HvCooltHeatrWarnFltInCom_HVCHLIN18Fr02_Lin3
          data-send-points:
            access DSP_VeLINR_e_HvCltHtrWrnFltInCom_VeLINR_e_HvCltHtrWrnFltInCom: accessed-variable=VeLINR_e_HvCltHtrWrnFltInCom.VeLINR_e_HvCltHtrWrnFltInCom
            access DSP_VeLINR_b_HvCltHtrWrnFltInComTO_VeLINR_b_HvCltHtrWrnFltInComTO: accessed-variable=VeLINR_b_HvCltHtrWrnFltInComTO.VeLINR_b_HvCltHtrWrnFltInComTO
          read-local-variables:
            access IRVRA_VeLINR_d_LIN_SlavePrsnt_LIN3: accessed-variable=VeLINR_d_LIN_SlavePrsnt_LIN3
        COMRXL_HvCooltHeatrWarnHvOutOfRng_HVCHLIN18Fr02_Lin3_Received: symbol=ApplLinComAb_LIN3_COMRXL_HvCooltHeatrWarnHvOutOfRng_HVCHLIN18Fr02_Lin3_Received  # Received -
          data-receive-point-by-arguments:
            access DRP_Lin3ComRxSignalsSR_COMRXL_HvCooltHeatrWarnHvOutOfRng_HVCHLIN18Fr02_Lin3: accessed-variable=Lin3ComRxSignalsSR.COMRXL_HvCooltHeatrWarnHvOutOfRng_HVCHLIN18Fr02_Lin3
          data-send-points:
            access DSP_VeLINR_e_HvCltHtrWrnHvOtOfRng_VeLINR_e_HvCltHtrWrnHvOtOfRng: accessed-variable=VeLINR_e_HvCltHtrWrnHvOtOfRng.VeLINR_e_HvCltHtrWrnHvOtOfRng
            access DSP_VeLINR_b_HvCltHtrWrnHvOtOfRngTO_VeLINR_b_HvCltHtrWrnHvOtOfRngTO: accessed-variable=VeLINR_b_HvCltHtrWrnHvOtOfRngTO.VeLINR_b_HvCltHtrWrnHvOtOfRngTO
        COMRXL_HvCooltHeatrWarnHvOutOfRng_HVCHLIN18Fr02_Lin3_Error: symbol=ApplLinComAb_LIN3_COMRXL_HvCooltHeatrWarnHvOutOfRng_HVCHLIN18Fr02_Lin3_Error  # Error -
          data-receive-point-by-arguments:
            access DRP_Lin3ComRxSignalsSR_COMRXL_HvCooltHeatrWarnHvOutOfRng_HVCHLIN18Fr02_Lin3: accessed-variable=Lin3ComRxSignalsSR.COMRXL_HvCooltHeatrWarnHvOutOfRng_HVCHLIN18Fr02_Lin3
          data-send-points:
            access DSP_VeLINR_e_HvCltHtrWrnHvOtOfRng_VeLINR_e_HvCltHtrWrnHvOtOfRng: accessed-variable=VeLINR_e_HvCltHtrWrnHvOtOfRng.VeLINR_e_HvCltHtrWrnHvOtOfRng
            access DSP_VeLINR_b_HvCltHtrWrnHvOtOfRngTO_VeLINR_b_HvCltHtrWrnHvOtOfRngTO: accessed-variable=VeLINR_b_HvCltHtrWrnHvOtOfRngTO.VeLINR_b_HvCltHtrWrnHvOtOfRngTO
          read-local-variables:
            access IRVRA_VeLINR_d_LIN_SlavePrsnt_LIN3: accessed-variable=VeLINR_d_LIN_SlavePrsnt_LIN3
        COMRXL_HvCooltHeatrWarnULoOutOfRng_HVCHLIN18Fr02_Lin3_Received: symbol=ApplLinComAb_LIN3_COMRXL_HvCooltHeatrWarnULoOutOfRng_HVCHLIN18Fr02_Lin3_Received  # Received -
          data-receive-point-by-arguments:
            access DRP_Lin3ComRxSignalsSR_COMRXL_HvCooltHeatrWarnULoOutOfRng_HVCHLIN18Fr02_Lin3: accessed-variable=Lin3ComRxSignalsSR.COMRXL_HvCooltHeatrWarnULoOutOfRng_HVCHLIN18Fr02_Lin3
          data-send-points:
            access DSP_VeLINR_e_HvCltHtrWrnULoOtOfRng_VeLINR_e_HvCltHtrWrnULoOtOfRng: accessed-variable=VeLINR_e_HvCltHtrWrnULoOtOfRng.VeLINR_e_HvCltHtrWrnULoOtOfRng
            access DSP_VeLINR_b_HvCltHtrWrnULoOtOfRngTO_VeLINR_b_HvCltHtrWrnULoOtOfRngTO: accessed-variable=VeLINR_b_HvCltHtrWrnULoOtOfRngTO.VeLINR_b_HvCltHtrWrnULoOtOfRngTO
        COMRXL_HvCooltHeatrWarnULoOutOfRng_HVCHLIN18Fr02_Lin3_Error: symbol=ApplLinComAb_LIN3_COMRXL_HvCooltHeatrWarnULoOutOfRng_HVCHLIN18Fr02_Lin3_Error  # Error -
          data-receive-point-by-arguments:
            access DRP_Lin3ComRxSignalsSR_COMRXL_HvCooltHeatrWarnULoOutOfRng_HVCHLIN18Fr02_Lin3: accessed-variable=Lin3ComRxSignalsSR.COMRXL_HvCooltHeatrWarnULoOutOfRng_HVCHLIN18Fr02_Lin3
          data-send-points:
            access DSP_VeLINR_e_HvCltHtrWrnULoOtOfRng_VeLINR_e_HvCltHtrWrnULoOtOfRng: accessed-variable=VeLINR_e_HvCltHtrWrnULoOtOfRng.VeLINR_e_HvCltHtrWrnULoOtOfRng
            access DSP_VeLINR_b_HvCltHtrWrnULoOtOfRngTO_VeLINR_b_HvCltHtrWrnULoOtOfRngTO: accessed-variable=VeLINR_b_HvCltHtrWrnULoOtOfRngTO.VeLINR_b_HvCltHtrWrnULoOtOfRngTO
          read-local-variables:
            access IRVRA_VeLINR_d_LIN_SlavePrsnt_LIN3: accessed-variable=VeLINR_d_LIN_SlavePrsnt_LIN3
        COMRXL_HvCooltHeatrWarnCooltTOutOfRng_HVCHLIN18Fr02_Lin3_Received: symbol=ApplLinComAb_LIN3_COMRXL_HvCooltHeatrWarnCooltTOutOfRng_HVCHLIN18Fr02_Lin3_Received  # Received -
          data-receive-point-by-arguments:
            access DRP_Lin3ComRxSignalsSR_COMRXL_HvCooltHeatrWarnCooltTOutOfRng_HVCHLIN18Fr02_Lin3: accessed-variable=Lin3ComRxSignalsSR.COMRXL_HvCooltHeatrWarnCooltTOutOfRng_HVCHLIN18Fr02_Lin3
          data-send-points:
            access DSP_VeLINR_e_HvCltHtrWrnCltTOtOfRng_VeLINR_e_HvCltHtrWrnCltTOtOfRng: accessed-variable=VeLINR_e_HvCltHtrWrnCltTOtOfRng.VeLINR_e_HvCltHtrWrnCltTOtOfRng
            access DSP_VeLINR_b_HvCltHtrWrnCltTOtOfRngTO_VeLINR_b_HvCltHtrWrnCltTOtOfRngTO: accessed-variable=VeLINR_b_HvCltHtrWrnCltTOtOfRngTO.VeLINR_b_HvCltHtrWrnCltTOtOfRngTO
        COMRXL_HvCooltHeatrWarnCooltTOutOfRng_HVCHLIN18Fr02_Lin3_Error: symbol=ApplLinComAb_LIN3_COMRXL_HvCooltHeatrWarnCooltTOutOfRng_HVCHLIN18Fr02_Lin3_Error  # Error -
          data-receive-point-by-arguments:
            access DRP_Lin3ComRxSignalsSR_COMRXL_HvCooltHeatrWarnCooltTOutOfRng_HVCHLIN18Fr02_Lin3: accessed-variable=Lin3ComRxSignalsSR.COMRXL_HvCooltHeatrWarnCooltTOutOfRng_HVCHLIN18Fr02_Lin3
          data-send-points:
            access DSP_VeLINR_e_HvCltHtrWrnCltTOtOfRng_VeLINR_e_HvCltHtrWrnCltTOtOfRng: accessed-variable=VeLINR_e_HvCltHtrWrnCltTOtOfRng.VeLINR_e_HvCltHtrWrnCltTOtOfRng
            access DSP_VeLINR_b_HvCltHtrWrnCltTOtOfRngTO_VeLINR_b_HvCltHtrWrnCltTOtOfRngTO: accessed-variable=VeLINR_b_HvCltHtrWrnCltTOtOfRngTO.VeLINR_b_HvCltHtrWrnCltTOtOfRngTO
          read-local-variables:
            access IRVRA_VeLINR_d_LIN_SlavePrsnt_LIN3: accessed-variable=VeLINR_d_LIN_SlavePrsnt_LIN3
        COMRXL_HvCooltHeatrProtnOfSelfTmpHwProtn_HVCHLIN18Fr02_Lin3_Received: symbol=ApplLinComAb_LIN3_COMRXL_HvCooltHeatrProtnOfSelfTmpHwProtn_HVCHLIN18Fr02_Lin3_Received  # Received -
          data-receive-point-by-arguments:
            access DRP_Lin3ComRxSignalsSR_COMRXL_HvCooltHeatrProtnOfSelfTmpHwProtn_HVCHLIN18Fr02_Lin3: accessed-variable=Lin3ComRxSignalsSR.COMRXL_HvCooltHeatrProtnOfSelfTmpHwProtn_HVCHLIN18Fr02_Lin3
          data-send-points:
            access DSP_VeLINR_e_HvCltHrPrtnSfTmpHwPrtn_VeLINR_e_HvCltHrPrtnSfTmpHwPrtn: accessed-variable=VeLINR_e_HvCltHrPrtnSfTmpHwPrtn.VeLINR_e_HvCltHrPrtnSfTmpHwPrtn
            access DSP_VeLINR_b_HvCltHrPrtnSfTmpHwPrtnTO_VeLINR_b_HvCltHrPrtnSfTmpHwPrtnTO: accessed-variable=VeLINR_b_HvCltHrPrtnSfTmpHwPrtnTO.VeLINR_b_HvCltHrPrtnSfTmpHwPrtnTO
        COMRXL_HvCooltHeatrProtnOfSelfTmpHwProtn_HVCHLIN18Fr02_Lin3_Error: symbol=ApplLinComAb_LIN3_COMRXL_HvCooltHeatrProtnOfSelfTmpHwProtn_HVCHLIN18Fr02_Lin3_Error  # Error -
          data-receive-point-by-arguments:
            access DRP_Lin3ComRxSignalsSR_COMRXL_HvCooltHeatrProtnOfSelfTmpHwProtn_HVCHLIN18Fr02_Lin3: accessed-variable=Lin3ComRxSignalsSR.COMRXL_HvCooltHeatrProtnOfSelfTmpHwProtn_HVCHLIN18Fr02_Lin3
          data-send-points:
            access DSP_VeLINR_e_HvCltHrPrtnSfTmpHwPrtn_VeLINR_e_HvCltHrPrtnSfTmpHwPrtn: accessed-variable=VeLINR_e_HvCltHrPrtnSfTmpHwPrtn.VeLINR_e_HvCltHrPrtnSfTmpHwPrtn
            access DSP_VeLINR_b_HvCltHrPrtnSfTmpHwPrtnTO_VeLINR_b_HvCltHrPrtnSfTmpHwPrtnTO: accessed-variable=VeLINR_b_HvCltHrPrtnSfTmpHwPrtnTO.VeLINR_b_HvCltHrPrtnSfTmpHwPrtnTO
          read-local-variables:
            access IRVRA_VeLINR_d_LIN_SlavePrsnt_LIN3: accessed-variable=VeLINR_d_LIN_SlavePrsnt_LIN3
        COMRXL_HvCooltHeatrProtnOfSelfTmpOvrheatg_HVCHLIN18Fr02_Lin3_Received: symbol=ApplLinComAb_LIN3_COMRXL_HvCooltHeatrProtnOfSelfTmpOvrheatg_HVCHLIN18Fr02_Lin3_Received  # Received -
          data-receive-point-by-arguments:
            access DRP_Lin3ComRxSignalsSR_COMRXL_HvCooltHeatrProtnOfSelfTmpOvrheatg_HVCHLIN18Fr02_Lin3: accessed-variable=Lin3ComRxSignalsSR.COMRXL_HvCooltHeatrProtnOfSelfTmpOvrheatg_HVCHLIN18Fr02_Lin3
          data-send-points:
            access DSP_VeLINR_e_HvCltHrPrtnSfTmpOvrhtg_VeLINR_e_HvCltHrPrtnSfTmpOvrhtg: accessed-variable=VeLINR_e_HvCltHrPrtnSfTmpOvrhtg.VeLINR_e_HvCltHrPrtnSfTmpOvrhtg
            access DSP_VeLINR_b_HvCltHrPrtnSfTmpOvrhtgTO_VeLINR_b_HvCltHrPrtnSfTmpOvrhtgTO: accessed-variable=VeLINR_b_HvCltHrPrtnSfTmpOvrhtgTO.VeLINR_b_HvCltHrPrtnSfTmpOvrhtgTO
        COMRXL_HvCooltHeatrProtnOfSelfTmpOvrheatg_HVCHLIN18Fr02_Lin3_Error: symbol=ApplLinComAb_LIN3_COMRXL_HvCooltHeatrProtnOfSelfTmpOvrheatg_HVCHLIN18Fr02_Lin3_Error  # Error -
          data-receive-point-by-arguments:
            access DRP_Lin3ComRxSignalsSR_COMRXL_HvCooltHeatrProtnOfSelfTmpOvrheatg_HVCHLIN18Fr02_Lin3: accessed-variable=Lin3ComRxSignalsSR.COMRXL_HvCooltHeatrProtnOfSelfTmpOvrheatg_HVCHLIN18Fr02_Lin3
          data-send-points:
            access DSP_VeLINR_e_HvCltHrPrtnSfTmpOvrhtg_VeLINR_e_HvCltHrPrtnSfTmpOvrhtg: accessed-variable=VeLINR_e_HvCltHrPrtnSfTmpOvrhtg.VeLINR_e_HvCltHrPrtnSfTmpOvrhtg
            access DSP_VeLINR_b_HvCltHrPrtnSfTmpOvrhtgTO_VeLINR_b_HvCltHrPrtnSfTmpOvrhtgTO: accessed-variable=VeLINR_b_HvCltHrPrtnSfTmpOvrhtgTO.VeLINR_b_HvCltHrPrtnSfTmpOvrhtgTO
          read-local-variables:
            access IRVRA_VeLINR_d_LIN_SlavePrsnt_LIN3: accessed-variable=VeLINR_d_LIN_SlavePrsnt_LIN3
        COMRXL_HvCooltHeatrSnsrFltCooltTInSnsrFlt_HVCHLIN18Fr02_Lin3_Received: symbol=ApplLinComAb_LIN3_COMRXL_HvCooltHeatrSnsrFltCooltTInSnsrFlt_HVCHLIN18Fr02_Lin3_Received  # Received -
          data-receive-point-by-arguments:
            access DRP_Lin3ComRxSignalsSR_COMRXL_HvCooltHeatrSnsrFltCooltTInSnsrFlt_HVCHLIN18Fr02_Lin3: accessed-variable=Lin3ComRxSignalsSR.COMRXL_HvCooltHeatrSnsrFltCooltTInSnsrFlt_HVCHLIN18Fr02_Lin3
          data-send-points:
            access DSP_VeLINR_e_HClHrSrFtClTInSnFlt_VeLINR_e_HClHrSrFtClTInSnFlt: accessed-variable=VeLINR_e_HClHrSrFtClTInSnFlt.VeLINR_e_HClHrSrFtClTInSnFlt
            access DSP_VeLINR_b_HClHrSrFtClTInSnFltTO_VeLINR_b_HClHrSrFtClTInSnFltTO: accessed-variable=VeLINR_b_HClHrSrFtClTInSnFltTO.VeLINR_b_HClHrSrFtClTInSnFltTO
        COMRXL_HvCooltHeatrSnsrFltCooltTInSnsrFlt_HVCHLIN18Fr02_Lin3_Error: symbol=ApplLinComAb_LIN3_COMRXL_HvCooltHeatrSnsrFltCooltTInSnsrFlt_HVCHLIN18Fr02_Lin3_Error  # Error -
          data-receive-point-by-arguments:
            access DRP_Lin3ComRxSignalsSR_COMRXL_HvCooltHeatrSnsrFltCooltTInSnsrFlt_HVCHLIN18Fr02_Lin3: accessed-variable=Lin3ComRxSignalsSR.COMRXL_HvCooltHeatrSnsrFltCooltTInSnsrFlt_HVCHLIN18Fr02_Lin3
          data-send-points:
            access DSP_VeLINR_e_HClHrSrFtClTInSnFlt_VeLINR_e_HClHrSrFtClTInSnFlt: accessed-variable=VeLINR_e_HClHrSrFtClTInSnFlt.VeLINR_e_HClHrSrFtClTInSnFlt
            access DSP_VeLINR_b_HClHrSrFtClTInSnFltTO_VeLINR_b_HClHrSrFtClTInSnFltTO: accessed-variable=VeLINR_b_HClHrSrFtClTInSnFltTO.VeLINR_b_HClHrSrFtClTInSnFltTO
          read-local-variables:
            access IRVRA_VeLINR_d_LIN_SlavePrsnt_LIN3: accessed-variable=VeLINR_d_LIN_SlavePrsnt_LIN3
        COMRXL_HvCooltHeatrSnsrFltCooltTOutSnsrFlt_HVCHLIN18Fr02_Lin3_Received: symbol=ApplLinComAb_LIN3_COMRXL_HvCooltHeatrSnsrFltCooltTOutSnsrFlt_HVCHLIN18Fr02_Lin3_Received  # Received -
          data-receive-point-by-arguments:
            access DRP_Lin3ComRxSignalsSR_COMRXL_HvCooltHeatrSnsrFltCooltTOutSnsrFlt_HVCHLIN18Fr02_Lin3: accessed-variable=Lin3ComRxSignalsSR.COMRXL_HvCooltHeatrSnsrFltCooltTOutSnsrFlt_HVCHLIN18Fr02_Lin3
          data-send-points:
            access DSP_VeLINR_e_HClHrSrFtClTOtSnFlt_VeLINR_e_HClHrSrFtClTOtSnFlt: accessed-variable=VeLINR_e_HClHrSrFtClTOtSnFlt.VeLINR_e_HClHrSrFtClTOtSnFlt
            access DSP_VeLINR_b_HClHrSrFtClTOtSnFltTO_VeLINR_b_HClHrSrFtClTOtSnFltTO: accessed-variable=VeLINR_b_HClHrSrFtClTOtSnFltTO.VeLINR_b_HClHrSrFtClTOtSnFltTO
        COMRXL_HvCooltHeatrSnsrFltCooltTOutSnsrFlt_HVCHLIN18Fr02_Lin3_Error: symbol=ApplLinComAb_LIN3_COMRXL_HvCooltHeatrSnsrFltCooltTOutSnsrFlt_HVCHLIN18Fr02_Lin3_Error  # Error -
          data-receive-point-by-arguments:
            access DRP_Lin3ComRxSignalsSR_COMRXL_HvCooltHeatrSnsrFltCooltTOutSnsrFlt_HVCHLIN18Fr02_Lin3: accessed-variable=Lin3ComRxSignalsSR.COMRXL_HvCooltHeatrSnsrFltCooltTOutSnsrFlt_HVCHLIN18Fr02_Lin3
          data-send-points:
            access DSP_VeLINR_e_HClHrSrFtClTOtSnFlt_VeLINR_e_HClHrSrFtClTOtSnFlt: accessed-variable=VeLINR_e_HClHrSrFtClTOtSnFlt.VeLINR_e_HClHrSrFtClTOtSnFlt
            access DSP_VeLINR_b_HClHrSrFtClTOtSnFltTO_VeLINR_b_HClHrSrFtClTOtSnFltTO: accessed-variable=VeLINR_b_HClHrSrFtClTOtSnFltTO.VeLINR_b_HClHrSrFtClTOtSnFltTO
          read-local-variables:
            access IRVRA_VeLINR_d_LIN_SlavePrsnt_LIN3: accessed-variable=VeLINR_d_LIN_SlavePrsnt_LIN3
        COMRXL_HvCooltHeatrSnsrFltTInMtrlSnsrFlt_HVCHLIN18Fr02_Lin3_Received: symbol=ApplLinComAb_LIN3_COMRXL_HvCooltHeatrSnsrFltTInMtrlSnsrFlt_HVCHLIN18Fr02_Lin3_Received  # Received -
          data-receive-point-by-arguments:
            access DRP_Lin3ComRxSignalsSR_COMRXL_HvCooltHeatrSnsrFltTInMtrlSnsrFlt_HVCHLIN18Fr02_Lin3: accessed-variable=Lin3ComRxSignalsSR.COMRXL_HvCooltHeatrSnsrFltTInMtrlSnsrFlt_HVCHLIN18Fr02_Lin3
          data-send-points:
            access DSP_VeLINR_e_HClHrSrFtTInMtrlSnFlt_VeLINR_e_HClHrSrFtTInMtrlSnFlt: accessed-variable=VeLINR_e_HClHrSrFtTInMtrlSnFlt.VeLINR_e_HClHrSrFtTInMtrlSnFlt
            access DSP_VeLINR_b_HClHrSrFtTInMtrlSnFltTO_VeLINR_b_HClHrSrFtTInMtrlSnFltTO: accessed-variable=VeLINR_b_HClHrSrFtTInMtrlSnFltTO.VeLINR_b_HClHrSrFtTInMtrlSnFltTO
        COMRXL_HvCooltHeatrSnsrFltTInMtrlSnsrFlt_HVCHLIN18Fr02_Lin3_Error: symbol=ApplLinComAb_LIN3_COMRXL_HvCooltHeatrSnsrFltTInMtrlSnsrFlt_HVCHLIN18Fr02_Lin3_Error  # Error -
          data-receive-point-by-arguments:
            access DRP_Lin3ComRxSignalsSR_COMRXL_HvCooltHeatrSnsrFltTInMtrlSnsrFlt_HVCHLIN18Fr02_Lin3: accessed-variable=Lin3ComRxSignalsSR.COMRXL_HvCooltHeatrSnsrFltTInMtrlSnsrFlt_HVCHLIN18Fr02_Lin3
          data-send-points:
            access DSP_VeLINR_e_HClHrSrFtTInMtrlSnFlt_VeLINR_e_HClHrSrFtTInMtrlSnFlt: accessed-variable=VeLINR_e_HClHrSrFtTInMtrlSnFlt.VeLINR_e_HClHrSrFtTInMtrlSnFlt
            access DSP_VeLINR_b_HClHrSrFtTInMtrlSnFltTO_VeLINR_b_HClHrSrFtTInMtrlSnFltTO: accessed-variable=VeLINR_b_HClHrSrFtTInMtrlSnFltTO.VeLINR_b_HClHrSrFtTInMtrlSnFltTO
          read-local-variables:
            access IRVRA_VeLINR_d_LIN_SlavePrsnt_LIN3: accessed-variable=VeLINR_d_LIN_SlavePrsnt_LIN3
        COMRXL_HvCooltHeatrSrvRqrdCircForDrvrShoOrOpen_HVCHLIN18Fr02_Lin3_Received: symbol=ApplLinComAb_LIN3_COMRXL_HvCooltHeatrSrvRqrdCircForDrvrShoOrOpen_HVCHLIN18Fr02_Lin3_Received  # Received -
          data-receive-point-by-arguments:
            access DRP_Lin3ComRxSignalsSR_COMRXL_HvCooltHeatrSrvRqrdCircForDrvrShoOrOpen_HVCHLIN18Fr02_Lin3: accessed-variable=Lin3ComRxSignalsSR.COMRXL_HvCooltHeatrSrvRqrdCircForDrvrShoOrOpen_HVCHLIN18Fr02_Lin3
          data-send-points:
            access DSP_VeLINR_e_HClHrSrRqCrFrDrShOrOp_VeLINR_e_HClHrSrRqCrFrDrShOrOp: accessed-variable=VeLINR_e_HClHrSrRqCrFrDrShOrOp.VeLINR_e_HClHrSrRqCrFrDrShOrOp
            access DSP_VeLINR_b_HClHrSrRqCrFrDrShOrOpTO_VeLINR_b_HClHrSrRqCrFrDrShOrOpTO: accessed-variable=VeLINR_b_HClHrSrRqCrFrDrShOrOpTO.VeLINR_b_HClHrSrRqCrFrDrShOrOpTO
        COMRXL_HvCooltHeatrSrvRqrdCircForDrvrShoOrOpen_HVCHLIN18Fr02_Lin3_Error: symbol=ApplLinComAb_LIN3_COMRXL_HvCooltHeatrSrvRqrdCircForDrvrShoOrOpen_HVCHLIN18Fr02_Lin3_Error  # Error -
          data-receive-point-by-arguments:
            access DRP_Lin3ComRxSignalsSR_COMRXL_HvCooltHeatrSrvRqrdCircForDrvrShoOrOpen_HVCHLIN18Fr02_Lin3: accessed-variable=Lin3ComRxSignalsSR.COMRXL_HvCooltHeatrSrvRqrdCircForDrvrShoOrOpen_HVCHLIN18Fr02_Lin3
          data-send-points:
            access DSP_VeLINR_e_HClHrSrRqCrFrDrShOrOp_VeLINR_e_HClHrSrRqCrFrDrShOrOp: accessed-variable=VeLINR_e_HClHrSrRqCrFrDrShOrOp.VeLINR_e_HClHrSrRqCrFrDrShOrOp
            access DSP_VeLINR_b_HClHrSrRqCrFrDrShOrOpTO_VeLINR_b_HClHrSrRqCrFrDrShOrOpTO: accessed-variable=VeLINR_b_HClHrSrRqCrFrDrShOrOpTO.VeLINR_b_HClHrSrRqCrFrDrShOrOpTO
          read-local-variables:
            access IRVRA_VeLINR_d_LIN_SlavePrsnt_LIN3: accessed-variable=VeLINR_d_LIN_SlavePrsnt_LIN3
        COMRXL_HvCooltHeatrSrvRqrdICnsOutOfRng_HVCHLIN18Fr02_Lin3_Received: symbol=ApplLinComAb_LIN3_COMRXL_HvCooltHeatrSrvRqrdICnsOutOfRng_HVCHLIN18Fr02_Lin3_Received  # Received -
          data-receive-point-by-arguments:
            access DRP_Lin3ComRxSignalsSR_COMRXL_HvCooltHeatrSrvRqrdICnsOutOfRng_HVCHLIN18Fr02_Lin3: accessed-variable=Lin3ComRxSignalsSR.COMRXL_HvCooltHeatrSrvRqrdICnsOutOfRng_HVCHLIN18Fr02_Lin3
          data-send-points:
            access DSP_VeLINR_e_HClHrSrRqICnsOtOfRng_VeLINR_e_HClHrSrRqICnsOtOfRng: accessed-variable=VeLINR_e_HClHrSrRqICnsOtOfRng.VeLINR_e_HClHrSrRqICnsOtOfRng
            access DSP_VeLINR_b_HClHrSrRqICnsOtOfRngTO_VeLINR_b_HClHrSrRqICnsOtOfRngTO: accessed-variable=VeLINR_b_HClHrSrRqICnsOtOfRngTO.VeLINR_b_HClHrSrRqICnsOtOfRngTO
        COMRXL_HvCooltHeatrSrvRqrdICnsOutOfRng_HVCHLIN18Fr02_Lin3_Error: symbol=ApplLinComAb_LIN3_COMRXL_HvCooltHeatrSrvRqrdICnsOutOfRng_HVCHLIN18Fr02_Lin3_Error  # Error -
          data-receive-point-by-arguments:
            access DRP_Lin3ComRxSignalsSR_COMRXL_HvCooltHeatrSrvRqrdICnsOutOfRng_HVCHLIN18Fr02_Lin3: accessed-variable=Lin3ComRxSignalsSR.COMRXL_HvCooltHeatrSrvRqrdICnsOutOfRng_HVCHLIN18Fr02_Lin3
          data-send-points:
            access DSP_VeLINR_e_HClHrSrRqICnsOtOfRng_VeLINR_e_HClHrSrRqICnsOtOfRng: accessed-variable=VeLINR_e_HClHrSrRqICnsOtOfRng.VeLINR_e_HClHrSrRqICnsOtOfRng
            access DSP_VeLINR_b_HClHrSrRqICnsOtOfRngTO_VeLINR_b_HClHrSrRqICnsOtOfRngTO: accessed-variable=VeLINR_b_HClHrSrRqICnsOtOfRngTO.VeLINR_b_HClHrSrRqICnsOtOfRngTO
          read-local-variables:
            access IRVRA_VeLINR_d_LIN_SlavePrsnt_LIN3: accessed-variable=VeLINR_d_LIN_SlavePrsnt_LIN3
        COMRXL_HvCooltHeatrSrvRqrdMemErr_HVCHLIN18Fr02_Lin3_Received: symbol=ApplLinComAb_LIN3_COMRXL_HvCooltHeatrSrvRqrdMemErr_HVCHLIN18Fr02_Lin3_Received  # Received -
          data-receive-point-by-arguments:
            access DRP_Lin3ComRxSignalsSR_COMRXL_HvCooltHeatrSrvRqrdMemErr_HVCHLIN18Fr02_Lin3: accessed-variable=Lin3ComRxSignalsSR.COMRXL_HvCooltHeatrSrvRqrdMemErr_HVCHLIN18Fr02_Lin3
          data-send-points:
            access DSP_VeLINR_e_HClHrSrRqMemErr_VeLINR_e_HClHrSrRqMemErr: accessed-variable=VeLINR_e_HClHrSrRqMemErr.VeLINR_e_HClHrSrRqMemErr
            access DSP_VeLINR_b_HClHrSrRqMemErrTO_VeLINR_b_HClHrSrRqMemErrTO: accessed-variable=VeLINR_b_HClHrSrRqMemErrTO.VeLINR_b_HClHrSrRqMemErrTO
        COMRXL_HvCooltHeatrSrvRqrdMemErr_HVCHLIN18Fr02_Lin3_Error: symbol=ApplLinComAb_LIN3_COMRXL_HvCooltHeatrSrvRqrdMemErr_HVCHLIN18Fr02_Lin3_Error  # Error -
          data-receive-point-by-arguments:
            access DRP_Lin3ComRxSignalsSR_COMRXL_HvCooltHeatrSrvRqrdMemErr_HVCHLIN18Fr02_Lin3: accessed-variable=Lin3ComRxSignalsSR.COMRXL_HvCooltHeatrSrvRqrdMemErr_HVCHLIN18Fr02_Lin3
          data-send-points:
            access DSP_VeLINR_e_HClHrSrRqMemErr_VeLINR_e_HClHrSrRqMemErr: accessed-variable=VeLINR_e_HClHrSrRqMemErr.VeLINR_e_HClHrSrRqMemErr
            access DSP_VeLINR_b_HClHrSrRqMemErrTO_VeLINR_b_HClHrSrRqMemErrTO: accessed-variable=VeLINR_b_HClHrSrRqMemErrTO.VeLINR_b_HClHrSrRqMemErrTO
          read-local-variables:
            access IRVRA_VeLINR_d_LIN_SlavePrsnt_LIN3: accessed-variable=VeLINR_d_LIN_SlavePrsnt_LIN3
        COMRXL_HvCooltHeatrSrvRqrdSrvRqrd_HVCHLIN18Fr02_Lin3_Received: symbol=ApplLinComAb_LIN3_COMRXL_HvCooltHeatrSrvRqrdSrvRqrd_HVCHLIN18Fr02_Lin3_Received  # Received -
          data-receive-point-by-arguments:
            access DRP_Lin3ComRxSignalsSR_COMRXL_HvCooltHeatrSrvRqrdSrvRqrd_HVCHLIN18Fr02_Lin3: accessed-variable=Lin3ComRxSignalsSR.COMRXL_HvCooltHeatrSrvRqrdSrvRqrd_HVCHLIN18Fr02_Lin3
          data-send-points:
            access DSP_VeLINR_e_HClHrSrRqSrvRq_VeLINR_e_HClHrSrRqSrvRq: accessed-variable=VeLINR_e_HClHrSrRqSrvRq.VeLINR_e_HClHrSrRqSrvRq
            access DSP_VeLINR_b_HClHrSrRqSrvRqTO_VeLINR_b_HClHrSrRqSrvRqTO: accessed-variable=VeLINR_b_HClHrSrRqSrvRqTO.VeLINR_b_HClHrSrRqSrvRqTO
        COMRXL_HvCooltHeatrSrvRqrdSrvRqrd_HVCHLIN18Fr02_Lin3_Error: symbol=ApplLinComAb_LIN3_COMRXL_HvCooltHeatrSrvRqrdSrvRqrd_HVCHLIN18Fr02_Lin3_Error  # Error -
          data-receive-point-by-arguments:
            access DRP_Lin3ComRxSignalsSR_COMRXL_HvCooltHeatrSrvRqrdSrvRqrd_HVCHLIN18Fr02_Lin3: accessed-variable=Lin3ComRxSignalsSR.COMRXL_HvCooltHeatrSrvRqrdSrvRqrd_HVCHLIN18Fr02_Lin3
          data-send-points:
            access DSP_VeLINR_e_HClHrSrRqSrvRq_VeLINR_e_HClHrSrRqSrvRq: accessed-variable=VeLINR_e_HClHrSrRqSrvRq.VeLINR_e_HClHrSrRqSrvRq
            access DSP_VeLINR_b_HClHrSrRqSrvRqTO_VeLINR_b_HClHrSrRqSrvRqTO: accessed-variable=VeLINR_b_HClHrSrRqSrvRqTO.VeLINR_b_HClHrSrRqSrvRqTO
          read-local-variables:
            access IRVRA_VeLINR_d_LIN_SlavePrsnt_LIN3: accessed-variable=VeLINR_d_LIN_SlavePrsnt_LIN3
        COMRXL_EOPB_RPM_TGT_EOPB_STAT_Lin3_Received: symbol=ApplLinComAb_LIN3_COMRXL_EOPB_RPM_TGT_EOPB_STAT_Lin3_Received  # Received -
          data-receive-point-by-arguments:
            access DRP_Lin3ComRxSignalsSR_COMRXL_EOPB_RPM_TGT_EOPB_STAT_Lin3: accessed-variable=Lin3ComRxSignalsSR.COMRXL_EOPB_RPM_TGT_EOPB_STAT_Lin3
          data-send-points:
            access DSP_VeLINR_e_EOPB_RPM_TGT_VeLINR_e_EOPB_RPM_TGT: accessed-variable=VeLINR_e_EOPB_RPM_TGT.VeLINR_e_EOPB_RPM_TGT
            access DSP_VeLINR_b_EOPB_RPM_TGT_TO_VeLINR_b_EOPB_RPM_TGT_TO: accessed-variable=VeLINR_b_EOPB_RPM_TGT_TO.VeLINR_b_EOPB_RPM_TGT_TO
        COMRXL_EOPB_RPM_TGT_EOPB_STAT_Lin3_Error: symbol=ApplLinComAb_LIN3_COMRXL_EOPB_RPM_TGT_EOPB_STAT_Lin3_Error  # Error -
          data-receive-point-by-arguments:
            access DRP_Lin3ComRxSignalsSR_COMRXL_EOPB_RPM_TGT_EOPB_STAT_Lin3: accessed-variable=Lin3ComRxSignalsSR.COMRXL_EOPB_RPM_TGT_EOPB_STAT_Lin3
          data-send-points:
            access DSP_VeLINR_e_EOPB_RPM_TGT_VeLINR_e_EOPB_RPM_TGT: accessed-variable=VeLINR_e_EOPB_RPM_TGT.VeLINR_e_EOPB_RPM_TGT
            access DSP_VeLINR_b_EOPB_RPM_TGT_TO_VeLINR_b_EOPB_RPM_TGT_TO: accessed-variable=VeLINR_b_EOPB_RPM_TGT_TO.VeLINR_b_EOPB_RPM_TGT_TO
          read-local-variables:
            access IRVRA_VeLINR_d_LIN_SlavePrsnt_LIN3: accessed-variable=VeLINR_d_LIN_SlavePrsnt_LIN3
        COMRXL_EOPB_RPM_ACTL_EOPB_STAT_Lin3_Received: symbol=ApplLinComAb_LIN3_COMRXL_EOPB_RPM_ACTL_EOPB_STAT_Lin3_Received  # Received -
          data-receive-point-by-arguments:
            access DRP_Lin3ComRxSignalsSR_COMRXL_EOPB_RPM_ACTL_EOPB_STAT_Lin3: accessed-variable=Lin3ComRxSignalsSR.COMRXL_EOPB_RPM_ACTL_EOPB_STAT_Lin3
          data-send-points:
            access DSP_VeLINR_e_EOPB_RPM_ACTL_VeLINR_e_EOPB_RPM_ACTL: accessed-variable=VeLINR_e_EOPB_RPM_ACTL.VeLINR_e_EOPB_RPM_ACTL
            access DSP_VeLINR_b_EOPB_RPM_ACTL_TO_VeLINR_b_EOPB_RPM_ACTL_TO: accessed-variable=VeLINR_b_EOPB_RPM_ACTL_TO.VeLINR_b_EOPB_RPM_ACTL_TO
        COMRXL_EOPB_RPM_ACTL_EOPB_STAT_Lin3_Error: symbol=ApplLinComAb_LIN3_COMRXL_EOPB_RPM_ACTL_EOPB_STAT_Lin3_Error  # Error -
          data-receive-point-by-arguments:
            access DRP_Lin3ComRxSignalsSR_COMRXL_EOPB_RPM_ACTL_EOPB_STAT_Lin3: accessed-variable=Lin3ComRxSignalsSR.COMRXL_EOPB_RPM_ACTL_EOPB_STAT_Lin3
          data-send-points:
            access DSP_VeLINR_e_EOPB_RPM_ACTL_VeLINR_e_EOPB_RPM_ACTL: accessed-variable=VeLINR_e_EOPB_RPM_ACTL.VeLINR_e_EOPB_RPM_ACTL
            access DSP_VeLINR_b_EOPB_RPM_ACTL_TO_VeLINR_b_EOPB_RPM_ACTL_TO: accessed-variable=VeLINR_b_EOPB_RPM_ACTL_TO.VeLINR_b_EOPB_RPM_ACTL_TO
          read-local-variables:
            access IRVRA_VeLINR_d_LIN_SlavePrsnt_LIN3: accessed-variable=VeLINR_d_LIN_SlavePrsnt_LIN3
        COMRXL_EOPB_VLTG_EOPB_STAT_Lin3_Received: symbol=ApplLinComAb_LIN3_COMRXL_EOPB_VLTG_EOPB_STAT_Lin3_Received  # Received -
          data-receive-point-by-arguments:
            access DRP_Lin3ComRxSignalsSR_COMRXL_EOPB_VLTG_EOPB_STAT_Lin3: accessed-variable=Lin3ComRxSignalsSR.COMRXL_EOPB_VLTG_EOPB_STAT_Lin3
          data-send-points:
            access DSP_VeLINR_U_EOPB_VLTG_VeLINR_U_EOPB_VLTG: accessed-variable=VeLINR_U_EOPB_VLTG.VeLINR_U_EOPB_VLTG
            access DSP_VeLINR_b_EOPB_VLTG_TO_VeLINR_b_EOPB_VLTG_TO: accessed-variable=VeLINR_b_EOPB_VLTG_TO.VeLINR_b_EOPB_VLTG_TO
        COMRXL_EOPB_VLTG_EOPB_STAT_Lin3_Error: symbol=ApplLinComAb_LIN3_COMRXL_EOPB_VLTG_EOPB_STAT_Lin3_Error  # Error -
          data-receive-point-by-arguments:
            access DRP_Lin3ComRxSignalsSR_COMRXL_EOPB_VLTG_EOPB_STAT_Lin3: accessed-variable=Lin3ComRxSignalsSR.COMRXL_EOPB_VLTG_EOPB_STAT_Lin3
          data-send-points:
            access DSP_VeLINR_U_EOPB_VLTG_VeLINR_U_EOPB_VLTG: accessed-variable=VeLINR_U_EOPB_VLTG.VeLINR_U_EOPB_VLTG
            access DSP_VeLINR_b_EOPB_VLTG_TO_VeLINR_b_EOPB_VLTG_TO: accessed-variable=VeLINR_b_EOPB_VLTG_TO.VeLINR_b_EOPB_VLTG_TO
          read-local-variables:
            access IRVRA_VeLINR_d_LIN_SlavePrsnt_LIN3: accessed-variable=VeLINR_d_LIN_SlavePrsnt_LIN3
        COMRXL_EOPB_TEMP_EOPB_STAT_Lin3_Received: symbol=ApplLinComAb_LIN3_COMRXL_EOPB_TEMP_EOPB_STAT_Lin3_Received  # Received -
          data-receive-point-by-arguments:
            access DRP_Lin3ComRxSignalsSR_COMRXL_EOPB_TEMP_EOPB_STAT_Lin3: accessed-variable=Lin3ComRxSignalsSR.COMRXL_EOPB_TEMP_EOPB_STAT_Lin3
          data-send-points:
            access DSP_VeLINR_T_EOPB_TEMP_VeLINR_T_EOPB_TEMP: accessed-variable=VeLINR_T_EOPB_TEMP.VeLINR_T_EOPB_TEMP
            access DSP_VeLINR_b_EOPB_TEMP_TO_VeLINR_b_EOPB_TEMP_TO: accessed-variable=VeLINR_b_EOPB_TEMP_TO.VeLINR_b_EOPB_TEMP_TO
        COMRXL_EOPB_TEMP_EOPB_STAT_Lin3_Error: symbol=ApplLinComAb_LIN3_COMRXL_EOPB_TEMP_EOPB_STAT_Lin3_Error  # Error -
          data-receive-point-by-arguments:
            access DRP_Lin3ComRxSignalsSR_COMRXL_EOPB_TEMP_EOPB_STAT_Lin3: accessed-variable=Lin3ComRxSignalsSR.COMRXL_EOPB_TEMP_EOPB_STAT_Lin3
          data-send-points:
            access DSP_VeLINR_T_EOPB_TEMP_VeLINR_T_EOPB_TEMP: accessed-variable=VeLINR_T_EOPB_TEMP.VeLINR_T_EOPB_TEMP
            access DSP_VeLINR_b_EOPB_TEMP_TO_VeLINR_b_EOPB_TEMP_TO: accessed-variable=VeLINR_b_EOPB_TEMP_TO.VeLINR_b_EOPB_TEMP_TO
          read-local-variables:
            access IRVRA_VeLINR_d_LIN_SlavePrsnt_LIN3: accessed-variable=VeLINR_d_LIN_SlavePrsnt_LIN3
        COMRXL_EOPB_CURR_EOPB_STAT_Lin3_Received: symbol=ApplLinComAb_LIN3_COMRXL_EOPB_CURR_EOPB_STAT_Lin3_Received  # Received -
          data-receive-point-by-arguments:
            access DRP_Lin3ComRxSignalsSR_COMRXL_EOPB_CURR_EOPB_STAT_Lin3: accessed-variable=Lin3ComRxSignalsSR.COMRXL_EOPB_CURR_EOPB_STAT_Lin3
          data-send-points:
            access DSP_VeLINR_I_EOPB_CURR_VeLINR_I_EOPB_CURR: accessed-variable=VeLINR_I_EOPB_CURR.VeLINR_I_EOPB_CURR
            access DSP_VeLINR_b_EOPB_CURR_TO_VeLINR_b_EOPB_CURR_TO: accessed-variable=VeLINR_b_EOPB_CURR_TO.VeLINR_b_EOPB_CURR_TO
        COMRXL_EOPB_CURR_EOPB_STAT_Lin3_Error: symbol=ApplLinComAb_LIN3_COMRXL_EOPB_CURR_EOPB_STAT_Lin3_Error  # Error -
          data-receive-point-by-arguments:
            access DRP_Lin3ComRxSignalsSR_COMRXL_EOPB_CURR_EOPB_STAT_Lin3: accessed-variable=Lin3ComRxSignalsSR.COMRXL_EOPB_CURR_EOPB_STAT_Lin3
          data-send-points:
            access DSP_VeLINR_I_EOPB_CURR_VeLINR_I_EOPB_CURR: accessed-variable=VeLINR_I_EOPB_CURR.VeLINR_I_EOPB_CURR
            access DSP_VeLINR_b_EOPB_CURR_TO_VeLINR_b_EOPB_CURR_TO: accessed-variable=VeLINR_b_EOPB_CURR_TO.VeLINR_b_EOPB_CURR_TO
          read-local-variables:
            access IRVRA_VeLINR_d_LIN_SlavePrsnt_LIN3: accessed-variable=VeLINR_d_LIN_SlavePrsnt_LIN3
        COMRXL_EOPB_LOW_TMP_STAT_EOPB_STAT_Lin3_Received: symbol=ApplLinComAb_LIN3_COMRXL_EOPB_LOW_TMP_STAT_EOPB_STAT_Lin3_Received  # Received -
          data-receive-point-by-arguments:
            access DRP_Lin3ComRxSignalsSR_COMRXL_EOPB_LOW_TMP_STAT_EOPB_STAT_Lin3: accessed-variable=Lin3ComRxSignalsSR.COMRXL_EOPB_LOW_TMP_STAT_EOPB_STAT_Lin3
          data-send-points:
            access DSP_VeLINR_e_EOPB_LOW_TMP_STAT_VeLINR_e_EOPB_LOW_TMP_STAT: accessed-variable=VeLINR_e_EOPB_LOW_TMP_STAT.VeLINR_e_EOPB_LOW_TMP_STAT
            access DSP_VeLINR_b_EOPB_LOW_TMP_STAT_TO_VeLINR_b_EOPB_LOW_TMP_STAT_TO: accessed-variable=VeLINR_b_EOPB_LOW_TMP_STAT_TO.VeLINR_b_EOPB_LOW_TMP_STAT_TO
        COMRXL_EOPB_LOW_TMP_STAT_EOPB_STAT_Lin3_Error: symbol=ApplLinComAb_LIN3_COMRXL_EOPB_LOW_TMP_STAT_EOPB_STAT_Lin3_Error  # Error -
          data-receive-point-by-arguments:
            access DRP_Lin3ComRxSignalsSR_COMRXL_EOPB_LOW_TMP_STAT_EOPB_STAT_Lin3: accessed-variable=Lin3ComRxSignalsSR.COMRXL_EOPB_LOW_TMP_STAT_EOPB_STAT_Lin3
          data-send-points:
            access DSP_VeLINR_e_EOPB_LOW_TMP_STAT_VeLINR_e_EOPB_LOW_TMP_STAT: accessed-variable=VeLINR_e_EOPB_LOW_TMP_STAT.VeLINR_e_EOPB_LOW_TMP_STAT
            access DSP_VeLINR_b_EOPB_LOW_TMP_STAT_TO_VeLINR_b_EOPB_LOW_TMP_STAT_TO: accessed-variable=VeLINR_b_EOPB_LOW_TMP_STAT_TO.VeLINR_b_EOPB_LOW_TMP_STAT_TO
          read-local-variables:
            access IRVRA_VeLINR_d_LIN_SlavePrsnt_LIN3: accessed-variable=VeLINR_d_LIN_SlavePrsnt_LIN3
        COMRXL_EOPB_MONTRNG_RPM_EOPB_STAT_Lin3_Received: symbol=ApplLinComAb_LIN3_COMRXL_EOPB_MONTRNG_RPM_EOPB_STAT_Lin3_Received  # Received -
          data-receive-point-by-arguments:
            access DRP_Lin3ComRxSignalsSR_COMRXL_EOPB_MONTRNG_RPM_EOPB_STAT_Lin3: accessed-variable=Lin3ComRxSignalsSR.COMRXL_EOPB_MONTRNG_RPM_EOPB_STAT_Lin3
          data-send-points:
            access DSP_VeLINR_e_EOPB_MONTRNG_RPM_VeLINR_e_EOPB_MONTRNG_RPM: accessed-variable=VeLINR_e_EOPB_MONTRNG_RPM.VeLINR_e_EOPB_MONTRNG_RPM
            access DSP_VeLINR_b_EOPB_MONTRNG_RPM_TO_VeLINR_b_EOPB_MONTRNG_RPM_TO: accessed-variable=VeLINR_b_EOPB_MONTRNG_RPM_TO.VeLINR_b_EOPB_MONTRNG_RPM_TO
        COMRXL_EOPB_MONTRNG_RPM_EOPB_STAT_Lin3_Error: symbol=ApplLinComAb_LIN3_COMRXL_EOPB_MONTRNG_RPM_EOPB_STAT_Lin3_Error  # Error -
          data-receive-point-by-arguments:
            access DRP_Lin3ComRxSignalsSR_COMRXL_EOPB_MONTRNG_RPM_EOPB_STAT_Lin3: accessed-variable=Lin3ComRxSignalsSR.COMRXL_EOPB_MONTRNG_RPM_EOPB_STAT_Lin3
          data-send-points:
            access DSP_VeLINR_e_EOPB_MONTRNG_RPM_VeLINR_e_EOPB_MONTRNG_RPM: accessed-variable=VeLINR_e_EOPB_MONTRNG_RPM.VeLINR_e_EOPB_MONTRNG_RPM
            access DSP_VeLINR_b_EOPB_MONTRNG_RPM_TO_VeLINR_b_EOPB_MONTRNG_RPM_TO: accessed-variable=VeLINR_b_EOPB_MONTRNG_RPM_TO.VeLINR_b_EOPB_MONTRNG_RPM_TO
          read-local-variables:
            access IRVRA_VeLINR_d_LIN_SlavePrsnt_LIN3: accessed-variable=VeLINR_d_LIN_SlavePrsnt_LIN3
        COMRXL_EOPB_LMP_HM_AN_ON_EOPB_STAT_Lin3_Received: symbol=ApplLinComAb_LIN3_COMRXL_EOPB_LMP_HM_AN_ON_EOPB_STAT_Lin3_Received  # Received -
          data-receive-point-by-arguments:
            access DRP_Lin3ComRxSignalsSR_COMRXL_EOPB_LMP_HM_AN_ON_EOPB_STAT_Lin3: accessed-variable=Lin3ComRxSignalsSR.COMRXL_EOPB_LMP_HM_AN_ON_EOPB_STAT_Lin3
          data-send-points:
            access DSP_VeLINR_e_EOPB_LMP_HM_AN_ON_VeLINR_e_EOPB_LMP_HM_AN_ON: accessed-variable=VeLINR_e_EOPB_LMP_HM_AN_ON.VeLINR_e_EOPB_LMP_HM_AN_ON
            access DSP_VeLINR_b_EOPB_LMP_HM_AN_ON_TO_VeLINR_b_EOPB_LMP_HM_AN_ON_TO: accessed-variable=VeLINR_b_EOPB_LMP_HM_AN_ON_TO.VeLINR_b_EOPB_LMP_HM_AN_ON_TO
        COMRXL_EOPB_LMP_HM_AN_ON_EOPB_STAT_Lin3_Error: symbol=ApplLinComAb_LIN3_COMRXL_EOPB_LMP_HM_AN_ON_EOPB_STAT_Lin3_Error  # Error -
          data-receive-point-by-arguments:
            access DRP_Lin3ComRxSignalsSR_COMRXL_EOPB_LMP_HM_AN_ON_EOPB_STAT_Lin3: accessed-variable=Lin3ComRxSignalsSR.COMRXL_EOPB_LMP_HM_AN_ON_EOPB_STAT_Lin3
          data-send-points:
            access DSP_VeLINR_e_EOPB_LMP_HM_AN_ON_VeLINR_e_EOPB_LMP_HM_AN_ON: accessed-variable=VeLINR_e_EOPB_LMP_HM_AN_ON.VeLINR_e_EOPB_LMP_HM_AN_ON
            access DSP_VeLINR_b_EOPB_LMP_HM_AN_ON_TO_VeLINR_b_EOPB_LMP_HM_AN_ON_TO: accessed-variable=VeLINR_b_EOPB_LMP_HM_AN_ON_TO.VeLINR_b_EOPB_LMP_HM_AN_ON_TO
          read-local-variables:
            access IRVRA_VeLINR_d_LIN_SlavePrsnt_LIN3: accessed-variable=VeLINR_d_LIN_SlavePrsnt_LIN3
        COMRXL_EOPB_OV_TMP_ER_EOPB_STAT_Lin3_Received: symbol=ApplLinComAb_LIN3_COMRXL_EOPB_OV_TMP_ER_EOPB_STAT_Lin3_Received  # Received -
          data-receive-point-by-arguments:
            access DRP_Lin3ComRxSignalsSR_COMRXL_EOPB_OV_TMP_ER_EOPB_STAT_Lin3: accessed-variable=Lin3ComRxSignalsSR.COMRXL_EOPB_OV_TMP_ER_EOPB_STAT_Lin3
          data-send-points:
            access DSP_VeLINR_e_EOPB_OV_TMP_ER_VeLINR_e_EOPB_OV_TMP_ER: accessed-variable=VeLINR_e_EOPB_OV_TMP_ER.VeLINR_e_EOPB_OV_TMP_ER
            access DSP_VeLINR_b_EOPB_OV_TMP_ER_TO_VeLINR_b_EOPB_OV_TMP_ER_TO: accessed-variable=VeLINR_b_EOPB_OV_TMP_ER_TO.VeLINR_b_EOPB_OV_TMP_ER_TO
        COMRXL_EOPB_OV_TMP_ER_EOPB_STAT_Lin3_Error: symbol=ApplLinComAb_LIN3_COMRXL_EOPB_OV_TMP_ER_EOPB_STAT_Lin3_Error  # Error -
          data-receive-point-by-arguments:
            access DRP_Lin3ComRxSignalsSR_COMRXL_EOPB_OV_TMP_ER_EOPB_STAT_Lin3: accessed-variable=Lin3ComRxSignalsSR.COMRXL_EOPB_OV_TMP_ER_EOPB_STAT_Lin3
          data-send-points:
            access DSP_VeLINR_e_EOPB_OV_TMP_ER_VeLINR_e_EOPB_OV_TMP_ER: accessed-variable=VeLINR_e_EOPB_OV_TMP_ER.VeLINR_e_EOPB_OV_TMP_ER
            access DSP_VeLINR_b_EOPB_OV_TMP_ER_TO_VeLINR_b_EOPB_OV_TMP_ER_TO: accessed-variable=VeLINR_b_EOPB_OV_TMP_ER_TO.VeLINR_b_EOPB_OV_TMP_ER_TO
          read-local-variables:
            access IRVRA_VeLINR_d_LIN_SlavePrsnt_LIN3: accessed-variable=VeLINR_d_LIN_SlavePrsnt_LIN3
        COMRXL_EOPB_OV_CUR_ER_EOPB_STAT_Lin3_Received: symbol=ApplLinComAb_LIN3_COMRXL_EOPB_OV_CUR_ER_EOPB_STAT_Lin3_Received  # Received -
          data-receive-point-by-arguments:
            access DRP_Lin3ComRxSignalsSR_COMRXL_EOPB_OV_CUR_ER_EOPB_STAT_Lin3: accessed-variable=Lin3ComRxSignalsSR.COMRXL_EOPB_OV_CUR_ER_EOPB_STAT_Lin3
          data-send-points:
            access DSP_VeLINR_e_EOPB_OV_CUR_ER_VeLINR_e_EOPB_OV_CUR_ER: accessed-variable=VeLINR_e_EOPB_OV_CUR_ER.VeLINR_e_EOPB_OV_CUR_ER
            access DSP_VeLINR_b_EOPB_OV_CUR_ER_TO_VeLINR_b_EOPB_OV_CUR_ER_TO: accessed-variable=VeLINR_b_EOPB_OV_CUR_ER_TO.VeLINR_b_EOPB_OV_CUR_ER_TO
        COMRXL_EOPB_OV_CUR_ER_EOPB_STAT_Lin3_Error: symbol=ApplLinComAb_LIN3_COMRXL_EOPB_OV_CUR_ER_EOPB_STAT_Lin3_Error  # Error -
          data-receive-point-by-arguments:
            access DRP_Lin3ComRxSignalsSR_COMRXL_EOPB_OV_CUR_ER_EOPB_STAT_Lin3: accessed-variable=Lin3ComRxSignalsSR.COMRXL_EOPB_OV_CUR_ER_EOPB_STAT_Lin3
          data-send-points:
            access DSP_VeLINR_e_EOPB_OV_CUR_ER_VeLINR_e_EOPB_OV_CUR_ER: accessed-variable=VeLINR_e_EOPB_OV_CUR_ER.VeLINR_e_EOPB_OV_CUR_ER
            access DSP_VeLINR_b_EOPB_OV_CUR_ER_TO_VeLINR_b_EOPB_OV_CUR_ER_TO: accessed-variable=VeLINR_b_EOPB_OV_CUR_ER_TO.VeLINR_b_EOPB_OV_CUR_ER_TO
          read-local-variables:
            access IRVRA_VeLINR_d_LIN_SlavePrsnt_LIN3: accessed-variable=VeLINR_d_LIN_SlavePrsnt_LIN3
        COMRXL_EOPB_DR_RN_ER_EOPB_STAT_Lin3_Received: symbol=ApplLinComAb_LIN3_COMRXL_EOPB_DR_RN_ER_EOPB_STAT_Lin3_Received  # Received -
          data-receive-point-by-arguments:
            access DRP_Lin3ComRxSignalsSR_COMRXL_EOPB_DR_RN_ER_EOPB_STAT_Lin3: accessed-variable=Lin3ComRxSignalsSR.COMRXL_EOPB_DR_RN_ER_EOPB_STAT_Lin3
          data-send-points:
            access DSP_VeLINR_e_EOPB_DR_RN_ER_VeLINR_e_EOPB_DR_RN_ER: accessed-variable=VeLINR_e_EOPB_DR_RN_ER.VeLINR_e_EOPB_DR_RN_ER
            access DSP_VeLINR_b_EOPB_DR_RN_ER_TO_VeLINR_b_EOPB_DR_RN_ER_TO: accessed-variable=VeLINR_b_EOPB_DR_RN_ER_TO.VeLINR_b_EOPB_DR_RN_ER_TO
        COMRXL_EOPB_DR_RN_ER_EOPB_STAT_Lin3_Error: symbol=ApplLinComAb_LIN3_COMRXL_EOPB_DR_RN_ER_EOPB_STAT_Lin3_Error  # Error -
          data-receive-point-by-arguments:
            access DRP_Lin3ComRxSignalsSR_COMRXL_EOPB_DR_RN_ER_EOPB_STAT_Lin3: accessed-variable=Lin3ComRxSignalsSR.COMRXL_EOPB_DR_RN_ER_EOPB_STAT_Lin3
          data-send-points:
            access DSP_VeLINR_e_EOPB_DR_RN_ER_VeLINR_e_EOPB_DR_RN_ER: accessed-variable=VeLINR_e_EOPB_DR_RN_ER.VeLINR_e_EOPB_DR_RN_ER
            access DSP_VeLINR_b_EOPB_DR_RN_ER_TO_VeLINR_b_EOPB_DR_RN_ER_TO: accessed-variable=VeLINR_b_EOPB_DR_RN_ER_TO.VeLINR_b_EOPB_DR_RN_ER_TO
          read-local-variables:
            access IRVRA_VeLINR_d_LIN_SlavePrsnt_LIN3: accessed-variable=VeLINR_d_LIN_SlavePrsnt_LIN3
        COMRXL_EOPB_VLTG_ER_EOPB_STAT_Lin3_Received: symbol=ApplLinComAb_LIN3_COMRXL_EOPB_VLTG_ER_EOPB_STAT_Lin3_Received  # Received -
          data-receive-point-by-arguments:
            access DRP_Lin3ComRxSignalsSR_COMRXL_EOPB_VLTG_ER_EOPB_STAT_Lin3: accessed-variable=Lin3ComRxSignalsSR.COMRXL_EOPB_VLTG_ER_EOPB_STAT_Lin3
          data-send-points:
            access DSP_VeLINR_e_EOPB_VLTG_ER_VeLINR_e_EOPB_VLTG_ER: accessed-variable=VeLINR_e_EOPB_VLTG_ER.VeLINR_e_EOPB_VLTG_ER
            access DSP_VeLINR_b_EOPB_VLTG_ER_TO_VeLINR_b_EOPB_VLTG_ER_TO: accessed-variable=VeLINR_b_EOPB_VLTG_ER_TO.VeLINR_b_EOPB_VLTG_ER_TO
        COMRXL_EOPB_VLTG_ER_EOPB_STAT_Lin3_Error: symbol=ApplLinComAb_LIN3_COMRXL_EOPB_VLTG_ER_EOPB_STAT_Lin3_Error  # Error -
          data-receive-point-by-arguments:
            access DRP_Lin3ComRxSignalsSR_COMRXL_EOPB_VLTG_ER_EOPB_STAT_Lin3: accessed-variable=Lin3ComRxSignalsSR.COMRXL_EOPB_VLTG_ER_EOPB_STAT_Lin3
          data-send-points:
            access DSP_VeLINR_e_EOPB_VLTG_ER_VeLINR_e_EOPB_VLTG_ER: accessed-variable=VeLINR_e_EOPB_VLTG_ER.VeLINR_e_EOPB_VLTG_ER
            access DSP_VeLINR_b_EOPB_VLTG_ER_TO_VeLINR_b_EOPB_VLTG_ER_TO: accessed-variable=VeLINR_b_EOPB_VLTG_ER_TO.VeLINR_b_EOPB_VLTG_ER_TO
          read-local-variables:
            access IRVRA_VeLINR_d_LIN_SlavePrsnt_LIN3: accessed-variable=VeLINR_d_LIN_SlavePrsnt_LIN3
        COMRXL_EOPB_Stall_Event_EOPB_STAT_Lin3_Received: symbol=ApplLinComAb_LIN3_COMRXL_EOPB_Stall_Event_EOPB_STAT_Lin3_Received  # Received -
          data-receive-point-by-arguments:
            access DRP_Lin3ComRxSignalsSR_COMRXL_EOPB_Stall_Event_EOPB_STAT_Lin3: accessed-variable=Lin3ComRxSignalsSR.COMRXL_EOPB_Stall_Event_EOPB_STAT_Lin3
          data-send-points:
            access DSP_VeLINR_e_EOPB_Stall_Event_VeLINR_e_EOPB_Stall_Event: accessed-variable=VeLINR_e_EOPB_Stall_Event.VeLINR_e_EOPB_Stall_Event
            access DSP_VeLINR_b_EOPB_Stall_EventTO_VeLINR_b_EOPB_Stall_EventTO: accessed-variable=VeLINR_b_EOPB_Stall_EventTO.VeLINR_b_EOPB_Stall_EventTO
        COMRXL_EOPB_Stall_Event_EOPB_STAT_Lin3_Error: symbol=ApplLinComAb_LIN3_COMRXL_EOPB_Stall_Event_EOPB_STAT_Lin3_Error  # Error -
          data-receive-point-by-arguments:
            access DRP_Lin3ComRxSignalsSR_COMRXL_EOPB_Stall_Event_EOPB_STAT_Lin3: accessed-variable=Lin3ComRxSignalsSR.COMRXL_EOPB_Stall_Event_EOPB_STAT_Lin3
          data-send-points:
            access DSP_VeLINR_e_EOPB_Stall_Event_VeLINR_e_EOPB_Stall_Event: accessed-variable=VeLINR_e_EOPB_Stall_Event.VeLINR_e_EOPB_Stall_Event
            access DSP_VeLINR_b_EOPB_Stall_EventTO_VeLINR_b_EOPB_Stall_EventTO: accessed-variable=VeLINR_b_EOPB_Stall_EventTO.VeLINR_b_EOPB_Stall_EventTO
          read-local-variables:
            access IRVRA_VeLINR_d_LIN_SlavePrsnt_LIN3: accessed-variable=VeLINR_d_LIN_SlavePrsnt_LIN3
        COMRXL_EOPB_POST_RUN_STAT_EOPB_STAT_Lin3_Received: symbol=ApplLinComAb_LIN3_COMRXL_EOPB_POST_RUN_STAT_EOPB_STAT_Lin3_Received  # Received -
          data-receive-point-by-arguments:
            access DRP_Lin3ComRxSignalsSR_COMRXL_EOPB_POST_RUN_STAT_EOPB_STAT_Lin3: accessed-variable=Lin3ComRxSignalsSR.COMRXL_EOPB_POST_RUN_STAT_EOPB_STAT_Lin3
          data-send-points:
            access DSP_VeLINR_e_EOPB_POST_RUN_STAT_VeLINR_e_EOPB_POST_RUN_STAT: accessed-variable=VeLINR_e_EOPB_POST_RUN_STAT.VeLINR_e_EOPB_POST_RUN_STAT
            access DSP_VeLINR_b_EOPB_POST_RUN_STAT_TO_VeLINR_b_EOPB_POST_RUN_STAT_TO: accessed-variable=VeLINR_b_EOPB_POST_RUN_STAT_TO.VeLINR_b_EOPB_POST_RUN_STAT_TO
        COMRXL_EOPB_POST_RUN_STAT_EOPB_STAT_Lin3_Error: symbol=ApplLinComAb_LIN3_COMRXL_EOPB_POST_RUN_STAT_EOPB_STAT_Lin3_Error  # Error -
          data-receive-point-by-arguments:
            access DRP_Lin3ComRxSignalsSR_COMRXL_EOPB_POST_RUN_STAT_EOPB_STAT_Lin3: accessed-variable=Lin3ComRxSignalsSR.COMRXL_EOPB_POST_RUN_STAT_EOPB_STAT_Lin3
          data-send-points:
            access DSP_VeLINR_e_EOPB_POST_RUN_STAT_VeLINR_e_EOPB_POST_RUN_STAT: accessed-variable=VeLINR_e_EOPB_POST_RUN_STAT.VeLINR_e_EOPB_POST_RUN_STAT
            access DSP_VeLINR_b_EOPB_POST_RUN_STAT_TO_VeLINR_b_EOPB_POST_RUN_STAT_TO: accessed-variable=VeLINR_b_EOPB_POST_RUN_STAT_TO.VeLINR_b_EOPB_POST_RUN_STAT_TO
          read-local-variables:
            access IRVRA_VeLINR_d_LIN_SlavePrsnt_LIN3: accessed-variable=VeLINR_d_LIN_SlavePrsnt_LIN3
        COMRXL_RsErr_EOPB_EOPB_STAT_Lin3_Received: symbol=ApplLinComAb_LIN3_COMRXL_RsErr_EOPB_EOPB_STAT_Lin3_Received  # Received -
          data-receive-point-by-arguments:
            access DRP_Lin3ComRxSignalsSR_COMRXL_RsErr_EOPB_EOPB_STAT_Lin3: accessed-variable=Lin3ComRxSignalsSR.COMRXL_RsErr_EOPB_EOPB_STAT_Lin3
          data-send-points:
            access DSP_VeLINR_b_RsErr_EOPB_VeLINR_b_RsErr_EOPB: accessed-variable=VeLINR_b_RsErr_EOPB.VeLINR_b_RsErr_EOPB
            access DSP_VeLINR_b_RsErr_EOPB_TO_VeLINR_b_RsErr_EOPB_TO: accessed-variable=VeLINR_b_RsErr_EOPB_TO.VeLINR_b_RsErr_EOPB_TO
        COMRXL_RsErr_EOPB_EOPB_STAT_Lin3_Error: symbol=ApplLinComAb_LIN3_COMRXL_RsErr_EOPB_EOPB_STAT_Lin3_Error  # Error -
          data-receive-point-by-arguments:
            access DRP_Lin3ComRxSignalsSR_COMRXL_RsErr_EOPB_EOPB_STAT_Lin3: accessed-variable=Lin3ComRxSignalsSR.COMRXL_RsErr_EOPB_EOPB_STAT_Lin3
          data-send-points:
            access DSP_VeLINR_b_RsErr_EOPB_VeLINR_b_RsErr_EOPB: accessed-variable=VeLINR_b_RsErr_EOPB.VeLINR_b_RsErr_EOPB
            access DSP_VeLINR_b_RsErr_EOPB_TO_VeLINR_b_RsErr_EOPB_TO: accessed-variable=VeLINR_b_RsErr_EOPB_TO.VeLINR_b_RsErr_EOPB_TO
          read-local-variables:
            access IRVRA_VeLINR_d_LIN_SlavePrsnt_LIN3: accessed-variable=VeLINR_d_LIN_SlavePrsnt_LIN3
        COMRXL_EOPB_OIL_TEMP_EOPB_STAT2_Lin3_Received: symbol=ApplLinComAb_LIN3_COMRXL_EOPB_OIL_TEMP_EOPB_STAT2_Lin3_Received  # Received -
          data-receive-point-by-arguments:
            access DRP_Lin3ComRxSignalsSR_COMRXL_EOPB_OIL_TEMP_EOPB_STAT2_Lin3: accessed-variable=Lin3ComRxSignalsSR.COMRXL_EOPB_OIL_TEMP_EOPB_STAT2_Lin3
          data-send-points:
            access DSP_VeLINR_T_EOPB_OIL_TEMP_VeLINR_T_EOPB_OIL_TEMP: accessed-variable=VeLINR_T_EOPB_OIL_TEMP.VeLINR_T_EOPB_OIL_TEMP
            access DSP_VeLINR_b_EOPB_OIL_TEMP_TO_VeLINR_b_EOPB_OIL_TEMP_TO: accessed-variable=VeLINR_b_EOPB_OIL_TEMP_TO.VeLINR_b_EOPB_OIL_TEMP_TO
        COMRXL_EOPB_OIL_TEMP_EOPB_STAT2_Lin3_Error: symbol=ApplLinComAb_LIN3_COMRXL_EOPB_OIL_TEMP_EOPB_STAT2_Lin3_Error  # Error -
          data-receive-point-by-arguments:
            access DRP_Lin3ComRxSignalsSR_COMRXL_EOPB_OIL_TEMP_EOPB_STAT2_Lin3: accessed-variable=Lin3ComRxSignalsSR.COMRXL_EOPB_OIL_TEMP_EOPB_STAT2_Lin3
          data-send-points:
            access DSP_VeLINR_T_EOPB_OIL_TEMP_VeLINR_T_EOPB_OIL_TEMP: accessed-variable=VeLINR_T_EOPB_OIL_TEMP.VeLINR_T_EOPB_OIL_TEMP
            access DSP_VeLINR_b_EOPB_OIL_TEMP_TO_VeLINR_b_EOPB_OIL_TEMP_TO: accessed-variable=VeLINR_b_EOPB_OIL_TEMP_TO.VeLINR_b_EOPB_OIL_TEMP_TO
          read-local-variables:
            access IRVRA_VeLINR_d_LIN_SlavePrsnt_LIN3: accessed-variable=VeLINR_d_LIN_SlavePrsnt_LIN3
        COMRXL_EOPB_HW_VER_EOPB_VER_Lin3_Received: symbol=ApplLinComAb_LIN3_COMRXL_EOPB_HW_VER_EOPB_VER_Lin3_Received  # Received -
          data-receive-point-by-arguments:
            access DRP_Lin3ComRxSignalsSR_COMRXL_EOPB_HW_VER_EOPB_VER_Lin3: accessed-variable=Lin3ComRxSignalsSR.COMRXL_EOPB_HW_VER_EOPB_VER_Lin3
          data-send-points:
            access DSP_VeLINR_y_EOPB_HW_VER_VeLINR_y_EOPB_HW_VER: accessed-variable=VeLINR_y_EOPB_HW_VER.VeLINR_y_EOPB_HW_VER
            access DSP_VeLINR_b_EOPB_HW_VER_TO_VeLINR_b_EOPB_HW_VER_TO: accessed-variable=VeLINR_b_EOPB_HW_VER_TO.VeLINR_b_EOPB_HW_VER_TO
        COMRXL_EOPB_HW_VER_EOPB_VER_Lin3_Error: symbol=ApplLinComAb_LIN3_COMRXL_EOPB_HW_VER_EOPB_VER_Lin3_Error  # Error -
          data-receive-point-by-arguments:
            access DRP_Lin3ComRxSignalsSR_COMRXL_EOPB_HW_VER_EOPB_VER_Lin3: accessed-variable=Lin3ComRxSignalsSR.COMRXL_EOPB_HW_VER_EOPB_VER_Lin3
          data-send-points:
            access DSP_VeLINR_y_EOPB_HW_VER_VeLINR_y_EOPB_HW_VER: accessed-variable=VeLINR_y_EOPB_HW_VER.VeLINR_y_EOPB_HW_VER
            access DSP_VeLINR_b_EOPB_HW_VER_TO_VeLINR_b_EOPB_HW_VER_TO: accessed-variable=VeLINR_b_EOPB_HW_VER_TO.VeLINR_b_EOPB_HW_VER_TO
          read-local-variables:
            access IRVRA_VeLINR_d_LIN_SlavePrsnt_LIN3: accessed-variable=VeLINR_d_LIN_SlavePrsnt_LIN3
        COMRXL_EOPB_SW_VER_EOPB_VER_Lin3_Received: symbol=ApplLinComAb_LIN3_COMRXL_EOPB_SW_VER_EOPB_VER_Lin3_Received  # Received -
          data-receive-point-by-arguments:
            access DRP_Lin3ComRxSignalsSR_COMRXL_EOPB_SW_VER_EOPB_VER_Lin3: accessed-variable=Lin3ComRxSignalsSR.COMRXL_EOPB_SW_VER_EOPB_VER_Lin3
          data-send-points:
            access DSP_VeLINR_y_EOPB_SW_VER_VeLINR_y_EOPB_SW_VER: accessed-variable=VeLINR_y_EOPB_SW_VER.VeLINR_y_EOPB_SW_VER
            access DSP_VeLINR_b_EOPB_SW_VER_TO_VeLINR_b_EOPB_SW_VER_TO: accessed-variable=VeLINR_b_EOPB_SW_VER_TO.VeLINR_b_EOPB_SW_VER_TO
        COMRXL_EOPB_SW_VER_EOPB_VER_Lin3_Error: symbol=ApplLinComAb_LIN3_COMRXL_EOPB_SW_VER_EOPB_VER_Lin3_Error  # Error -
          data-receive-point-by-arguments:
            access DRP_Lin3ComRxSignalsSR_COMRXL_EOPB_SW_VER_EOPB_VER_Lin3: accessed-variable=Lin3ComRxSignalsSR.COMRXL_EOPB_SW_VER_EOPB_VER_Lin3
          data-send-points:
            access DSP_VeLINR_y_EOPB_SW_VER_VeLINR_y_EOPB_SW_VER: accessed-variable=VeLINR_y_EOPB_SW_VER.VeLINR_y_EOPB_SW_VER
            access DSP_VeLINR_b_EOPB_SW_VER_TO_VeLINR_b_EOPB_SW_VER_TO: accessed-variable=VeLINR_b_EOPB_SW_VER_TO.VeLINR_b_EOPB_SW_VER_TO
          read-local-variables:
            access IRVRA_VeLINR_d_LIN_SlavePrsnt_LIN3: accessed-variable=VeLINR_d_LIN_SlavePrsnt_LIN3
        COMRXL_HTLBV_PosAct_HTLBV_STAT_Lin3_Received: symbol=ApplLinComAb_LIN3_COMRXL_HTLBV_PosAct_HTLBV_STAT_Lin3_Received  # Received -
          data-receive-point-by-arguments:
            access DRP_Lin3ComRxSignalsSR_COMRXL_HTLBV_PosAct_HTLBV_STAT_Lin3: accessed-variable=Lin3ComRxSignalsSR.COMRXL_HTLBV_PosAct_HTLBV_STAT_Lin3
          data-send-points:
            access DSP_VeLINR_Pct_HTLBV_PosAct_VeLINR_Pct_HTLBV_PosAct: accessed-variable=VeLINR_Pct_HTLBV_PosAct.VeLINR_Pct_HTLBV_PosAct
            access DSP_VeLINR_b_HTLBV_PosActTO_VeLINR_b_HTLBV_PosActTO: accessed-variable=VeLINR_b_HTLBV_PosActTO.VeLINR_b_HTLBV_PosActTO
        COMRXL_HTLBV_PosAct_HTLBV_STAT_Lin3_Error: symbol=ApplLinComAb_LIN3_COMRXL_HTLBV_PosAct_HTLBV_STAT_Lin3_Error  # Error -
          data-receive-point-by-arguments:
            access DRP_Lin3ComRxSignalsSR_COMRXL_HTLBV_PosAct_HTLBV_STAT_Lin3: accessed-variable=Lin3ComRxSignalsSR.COMRXL_HTLBV_PosAct_HTLBV_STAT_Lin3
          data-send-points:
            access DSP_VeLINR_Pct_HTLBV_PosAct_VeLINR_Pct_HTLBV_PosAct: accessed-variable=VeLINR_Pct_HTLBV_PosAct.VeLINR_Pct_HTLBV_PosAct
            access DSP_VeLINR_b_HTLBV_PosActTO_VeLINR_b_HTLBV_PosActTO: accessed-variable=VeLINR_b_HTLBV_PosActTO.VeLINR_b_HTLBV_PosActTO
          read-local-variables:
            access IRVRA_VeLINR_d_LIN_SlavePrsnt_LIN3: accessed-variable=VeLINR_d_LIN_SlavePrsnt_LIN3
        COMRXL_HTLBV_ERR_HTLBV_STAT_Lin3_Received: symbol=ApplLinComAb_LIN3_COMRXL_HTLBV_ERR_HTLBV_STAT_Lin3_Received  # Received -
          data-receive-point-by-arguments:
            access DRP_Lin3ComRxSignalsSR_COMRXL_HTLBV_ERR_HTLBV_STAT_Lin3: accessed-variable=Lin3ComRxSignalsSR.COMRXL_HTLBV_ERR_HTLBV_STAT_Lin3
          data-send-points:
            access DSP_VeLINR_e_HTLBV_ERR_VeLINR_e_HTLBV_ERR: accessed-variable=VeLINR_e_HTLBV_ERR.VeLINR_e_HTLBV_ERR
            access DSP_VeLINR_b_HTLBV_ERR_TO_VeLINR_b_HTLBV_ERR_TO: accessed-variable=VeLINR_b_HTLBV_ERR_TO.VeLINR_b_HTLBV_ERR_TO
        COMRXL_HTLBV_ERR_HTLBV_STAT_Lin3_Error: symbol=ApplLinComAb_LIN3_COMRXL_HTLBV_ERR_HTLBV_STAT_Lin3_Error  # Error -
          data-receive-point-by-arguments:
            access DRP_Lin3ComRxSignalsSR_COMRXL_HTLBV_ERR_HTLBV_STAT_Lin3: accessed-variable=Lin3ComRxSignalsSR.COMRXL_HTLBV_ERR_HTLBV_STAT_Lin3
          data-send-points:
            access DSP_VeLINR_e_HTLBV_ERR_VeLINR_e_HTLBV_ERR: accessed-variable=VeLINR_e_HTLBV_ERR.VeLINR_e_HTLBV_ERR
            access DSP_VeLINR_b_HTLBV_ERR_TO_VeLINR_b_HTLBV_ERR_TO: accessed-variable=VeLINR_b_HTLBV_ERR_TO.VeLINR_b_HTLBV_ERR_TO
          read-local-variables:
            access IRVRA_VeLINR_d_LIN_SlavePrsnt_LIN3: accessed-variable=VeLINR_d_LIN_SlavePrsnt_LIN3
        COMRXL_HTLBV_MotorVolt_HTLBV_STAT_Lin3_Received: symbol=ApplLinComAb_LIN3_COMRXL_HTLBV_MotorVolt_HTLBV_STAT_Lin3_Received  # Received -
          data-receive-point-by-arguments:
            access DRP_Lin3ComRxSignalsSR_COMRXL_HTLBV_MotorVolt_HTLBV_STAT_Lin3: accessed-variable=Lin3ComRxSignalsSR.COMRXL_HTLBV_MotorVolt_HTLBV_STAT_Lin3
          data-send-points:
            access DSP_VeLINR_U_HTLBV_MotorVolt_VeLINR_U_HTLBV_MotorVolt: accessed-variable=VeLINR_U_HTLBV_MotorVolt.VeLINR_U_HTLBV_MotorVolt
            access DSP_VeLINR_b_HTLBV_MotorVoltTO_VeLINR_b_HTLBV_MotorVoltTO: accessed-variable=VeLINR_b_HTLBV_MotorVoltTO.VeLINR_b_HTLBV_MotorVoltTO
        COMRXL_HTLBV_MotorVolt_HTLBV_STAT_Lin3_Error: symbol=ApplLinComAb_LIN3_COMRXL_HTLBV_MotorVolt_HTLBV_STAT_Lin3_Error  # Error -
          data-receive-point-by-arguments:
            access DRP_Lin3ComRxSignalsSR_COMRXL_HTLBV_MotorVolt_HTLBV_STAT_Lin3: accessed-variable=Lin3ComRxSignalsSR.COMRXL_HTLBV_MotorVolt_HTLBV_STAT_Lin3
          data-send-points:
            access DSP_VeLINR_U_HTLBV_MotorVolt_VeLINR_U_HTLBV_MotorVolt: accessed-variable=VeLINR_U_HTLBV_MotorVolt.VeLINR_U_HTLBV_MotorVolt
            access DSP_VeLINR_b_HTLBV_MotorVoltTO_VeLINR_b_HTLBV_MotorVoltTO: accessed-variable=VeLINR_b_HTLBV_MotorVoltTO.VeLINR_b_HTLBV_MotorVoltTO
          read-local-variables:
            access IRVRA_VeLINR_d_LIN_SlavePrsnt_LIN3: accessed-variable=VeLINR_d_LIN_SlavePrsnt_LIN3
        COMRXL_HTLBV_Sts_HTLBV_STAT_Lin3_Received: symbol=ApplLinComAb_LIN3_COMRXL_HTLBV_Sts_HTLBV_STAT_Lin3_Received  # Received -
          data-receive-point-by-arguments:
            access DRP_Lin3ComRxSignalsSR_COMRXL_HTLBV_Sts_HTLBV_STAT_Lin3: accessed-variable=Lin3ComRxSignalsSR.COMRXL_HTLBV_Sts_HTLBV_STAT_Lin3
          data-send-points:
            access DSP_VeLINR_e_HTLBV_Sts_VeLINR_e_HTLBV_Sts: accessed-variable=VeLINR_e_HTLBV_Sts.VeLINR_e_HTLBV_Sts
            access DSP_VeLINR_b_HTLBV_StsTO_VeLINR_b_HTLBV_StsTO: accessed-variable=VeLINR_b_HTLBV_StsTO.VeLINR_b_HTLBV_StsTO
        COMRXL_HTLBV_Sts_HTLBV_STAT_Lin3_Error: symbol=ApplLinComAb_LIN3_COMRXL_HTLBV_Sts_HTLBV_STAT_Lin3_Error  # Error -
          data-receive-point-by-arguments:
            access DRP_Lin3ComRxSignalsSR_COMRXL_HTLBV_Sts_HTLBV_STAT_Lin3: accessed-variable=Lin3ComRxSignalsSR.COMRXL_HTLBV_Sts_HTLBV_STAT_Lin3
          data-send-points:
            access DSP_VeLINR_e_HTLBV_Sts_VeLINR_e_HTLBV_Sts: accessed-variable=VeLINR_e_HTLBV_Sts.VeLINR_e_HTLBV_Sts
            access DSP_VeLINR_b_HTLBV_StsTO_VeLINR_b_HTLBV_StsTO: accessed-variable=VeLINR_b_HTLBV_StsTO.VeLINR_b_HTLBV_StsTO
          read-local-variables:
            access IRVRA_VeLINR_d_LIN_SlavePrsnt_LIN3: accessed-variable=VeLINR_d_LIN_SlavePrsnt_LIN3
        COMRXL_RsErr_HTLBV_HTLBV_STAT_Lin3_Received: symbol=ApplLinComAb_LIN3_COMRXL_RsErr_HTLBV_HTLBV_STAT_Lin3_Received  # Received -
          data-receive-point-by-arguments:
            access DRP_Lin3ComRxSignalsSR_COMRXL_RsErr_HTLBV_HTLBV_STAT_Lin3: accessed-variable=Lin3ComRxSignalsSR.COMRXL_RsErr_HTLBV_HTLBV_STAT_Lin3
          data-send-points:
            access DSP_VeLINR_b_RsErr_HTLBV_VeLINR_b_RsErr_HTLBV: accessed-variable=VeLINR_b_RsErr_HTLBV.VeLINR_b_RsErr_HTLBV
            access DSP_VeLINR_b_RsErr_HTLBV_TO_VeLINR_b_RsErr_HTLBV_TO: accessed-variable=VeLINR_b_RsErr_HTLBV_TO.VeLINR_b_RsErr_HTLBV_TO
        COMRXL_RsErr_HTLBV_HTLBV_STAT_Lin3_Error: symbol=ApplLinComAb_LIN3_COMRXL_RsErr_HTLBV_HTLBV_STAT_Lin3_Error  # Error -
          data-receive-point-by-arguments:
            access DRP_Lin3ComRxSignalsSR_COMRXL_RsErr_HTLBV_HTLBV_STAT_Lin3: accessed-variable=Lin3ComRxSignalsSR.COMRXL_RsErr_HTLBV_HTLBV_STAT_Lin3
          data-send-points:
            access DSP_VeLINR_b_RsErr_HTLBV_VeLINR_b_RsErr_HTLBV: accessed-variable=VeLINR_b_RsErr_HTLBV.VeLINR_b_RsErr_HTLBV
            access DSP_VeLINR_b_RsErr_HTLBV_TO_VeLINR_b_RsErr_HTLBV_TO: accessed-variable=VeLINR_b_RsErr_HTLBV_TO.VeLINR_b_RsErr_HTLBV_TO
          read-local-variables:
            access IRVRA_VeLINR_d_LIN_SlavePrsnt_LIN3: accessed-variable=VeLINR_d_LIN_SlavePrsnt_LIN3
        COMRXL_HTLBV_CalStat_HTLBV_STAT_Lin3_Received: symbol=ApplLinComAb_LIN3_COMRXL_HTLBV_CalStat_HTLBV_STAT_Lin3_Received  # Received -
          data-receive-point-by-arguments:
            access DRP_Lin3ComRxSignalsSR_COMRXL_HTLBV_CalStat_HTLBV_STAT_Lin3: accessed-variable=Lin3ComRxSignalsSR.COMRXL_HTLBV_CalStat_HTLBV_STAT_Lin3
          data-send-points:
            access DSP_VeLINR_e_HTLBV_CalStat_VeLINR_e_HTLBV_CalStat: accessed-variable=VeLINR_e_HTLBV_CalStat.VeLINR_e_HTLBV_CalStat
            access DSP_VeLINR_b_HTLBV_CalStatTO_VeLINR_b_HTLBV_CalStatTO: accessed-variable=VeLINR_b_HTLBV_CalStatTO.VeLINR_b_HTLBV_CalStatTO
        COMRXL_HTLBV_CalStat_HTLBV_STAT_Lin3_Error: symbol=ApplLinComAb_LIN3_COMRXL_HTLBV_CalStat_HTLBV_STAT_Lin3_Error  # Error -
          data-receive-point-by-arguments:
            access DRP_Lin3ComRxSignalsSR_COMRXL_HTLBV_CalStat_HTLBV_STAT_Lin3: accessed-variable=Lin3ComRxSignalsSR.COMRXL_HTLBV_CalStat_HTLBV_STAT_Lin3
          data-send-points:
            access DSP_VeLINR_e_HTLBV_CalStat_VeLINR_e_HTLBV_CalStat: accessed-variable=VeLINR_e_HTLBV_CalStat.VeLINR_e_HTLBV_CalStat
            access DSP_VeLINR_b_HTLBV_CalStatTO_VeLINR_b_HTLBV_CalStatTO: accessed-variable=VeLINR_b_HTLBV_CalStatTO.VeLINR_b_HTLBV_CalStatTO
          read-local-variables:
            access IRVRA_VeLINR_d_LIN_SlavePrsnt_LIN3: accessed-variable=VeLINR_d_LIN_SlavePrsnt_LIN3
        COMRXL_PECP2_RPM_TGT_PERCT_PECP2_STAT_GLOBAL_Lin3_Received: symbol=ApplLinComAb_LIN3_COMRXL_PECP2_RPM_TGT_PERCT_PECP2_STAT_GLOBAL_Lin3_Received  # Received -
          data-receive-point-by-arguments:
            access DRP_Lin3ComRxSignalsSR_COMRXL_PECP2_RPM_TGT_PERCT_PECP2_STAT_GLOBAL_Lin3: accessed-variable=Lin3ComRxSignalsSR.COMRXL_PECP2_RPM_TGT_PERCT_PECP2_STAT_GLOBAL_Lin3
          data-send-points:
            access DSP_VeLINR_Pct_PECP2_RPM_TGT_PERCT_VeLINR_Pct_PECP2_RPM_TGT_PERCT: accessed-variable=VeLINR_Pct_PECP2_RPM_TGT_PERCT.VeLINR_Pct_PECP2_RPM_TGT_PERCT
            access DSP_VeLINR_b_PECP2_RPM_TGT_PERCT_TO_VeLINR_b_PECP2_RPM_TGT_PERCT_TO: accessed-variable=VeLINR_b_PECP2_RPM_TGT_PERCT_TO.VeLINR_b_PECP2_RPM_TGT_PERCT_TO
        COMRXL_PECP2_RPM_TGT_PERCT_PECP2_STAT_GLOBAL_Lin3_Error: symbol=ApplLinComAb_LIN3_COMRXL_PECP2_RPM_TGT_PERCT_PECP2_STAT_GLOBAL_Lin3_Error  # Error -
          data-receive-point-by-arguments:
            access DRP_Lin3ComRxSignalsSR_COMRXL_PECP2_RPM_TGT_PERCT_PECP2_STAT_GLOBAL_Lin3: accessed-variable=Lin3ComRxSignalsSR.COMRXL_PECP2_RPM_TGT_PERCT_PECP2_STAT_GLOBAL_Lin3
          data-send-points:
            access DSP_VeLINR_Pct_PECP2_RPM_TGT_PERCT_VeLINR_Pct_PECP2_RPM_TGT_PERCT: accessed-variable=VeLINR_Pct_PECP2_RPM_TGT_PERCT.VeLINR_Pct_PECP2_RPM_TGT_PERCT
            access DSP_VeLINR_b_PECP2_RPM_TGT_PERCT_TO_VeLINR_b_PECP2_RPM_TGT_PERCT_TO: accessed-variable=VeLINR_b_PECP2_RPM_TGT_PERCT_TO.VeLINR_b_PECP2_RPM_TGT_PERCT_TO
          read-local-variables:
            access IRVRA_VeLINR_d_LIN_SlavePrsnt_LIN3: accessed-variable=VeLINR_d_LIN_SlavePrsnt_LIN3
        COMRXL_PECP2_RPM_ACTL_PERCT_PECP2_STAT_GLOBAL_Lin3_Received: symbol=ApplLinComAb_LIN3_COMRXL_PECP2_RPM_ACTL_PERCT_PECP2_STAT_GLOBAL_Lin3_Received  # Received -
          data-receive-point-by-arguments:
            access DRP_Lin3ComRxSignalsSR_COMRXL_PECP2_RPM_ACTL_PERCT_PECP2_STAT_GLOBAL_Lin3: accessed-variable=Lin3ComRxSignalsSR.COMRXL_PECP2_RPM_ACTL_PERCT_PECP2_STAT_GLOBAL_Lin3
          data-send-points:
            access DSP_VeLINR_Pct_PECP2_RPM_ACTL_PERCT_VeLINR_Pct_PECP2_RPM_ACTL_PERCT: accessed-variable=VeLINR_Pct_PECP2_RPM_ACTL_PERCT.VeLINR_Pct_PECP2_RPM_ACTL_PERCT
            access DSP_VeLINR_b_PECP2_RPM_ACTL_PERCT_TO_VeLINR_b_PECP2_RPM_ACTL_PERCT_TO: accessed-variable=VeLINR_b_PECP2_RPM_ACTL_PERCT_TO.VeLINR_b_PECP2_RPM_ACTL_PERCT_TO
        COMRXL_PECP2_RPM_ACTL_PERCT_PECP2_STAT_GLOBAL_Lin3_Error: symbol=ApplLinComAb_LIN3_COMRXL_PECP2_RPM_ACTL_PERCT_PECP2_STAT_GLOBAL_Lin3_Error  # Error -
          data-receive-point-by-arguments:
            access DRP_Lin3ComRxSignalsSR_COMRXL_PECP2_RPM_ACTL_PERCT_PECP2_STAT_GLOBAL_Lin3: accessed-variable=Lin3ComRxSignalsSR.COMRXL_PECP2_RPM_ACTL_PERCT_PECP2_STAT_GLOBAL_Lin3
          data-send-points:
            access DSP_VeLINR_Pct_PECP2_RPM_ACTL_PERCT_VeLINR_Pct_PECP2_RPM_ACTL_PERCT: accessed-variable=VeLINR_Pct_PECP2_RPM_ACTL_PERCT.VeLINR_Pct_PECP2_RPM_ACTL_PERCT
            access DSP_VeLINR_b_PECP2_RPM_ACTL_PERCT_TO_VeLINR_b_PECP2_RPM_ACTL_PERCT_TO: accessed-variable=VeLINR_b_PECP2_RPM_ACTL_PERCT_TO.VeLINR_b_PECP2_RPM_ACTL_PERCT_TO
          read-local-variables:
            access IRVRA_VeLINR_d_LIN_SlavePrsnt_LIN3: accessed-variable=VeLINR_d_LIN_SlavePrsnt_LIN3
        COMRXL_PECP2_VLTG_PECP2_STAT_GLOBAL_Lin3_Received: symbol=ApplLinComAb_LIN3_COMRXL_PECP2_VLTG_PECP2_STAT_GLOBAL_Lin3_Received  # Received -
          data-receive-point-by-arguments:
            access DRP_Lin3ComRxSignalsSR_COMRXL_PECP2_VLTG_PECP2_STAT_GLOBAL_Lin3: accessed-variable=Lin3ComRxSignalsSR.COMRXL_PECP2_VLTG_PECP2_STAT_GLOBAL_Lin3
          data-send-points:
            access DSP_VeLINR_U_PECP2_VLTG_VeLINR_U_PECP2_VLTG: accessed-variable=VeLINR_U_PECP2_VLTG.VeLINR_U_PECP2_VLTG
            access DSP_VeLINR_b_PECP2_VLTG_TO_VeLINR_b_PECP2_VLTG_TO: accessed-variable=VeLINR_b_PECP2_VLTG_TO.VeLINR_b_PECP2_VLTG_TO
        COMRXL_PECP2_VLTG_PECP2_STAT_GLOBAL_Lin3_Error: symbol=ApplLinComAb_LIN3_COMRXL_PECP2_VLTG_PECP2_STAT_GLOBAL_Lin3_Error  # Error -
          data-receive-point-by-arguments:
            access DRP_Lin3ComRxSignalsSR_COMRXL_PECP2_VLTG_PECP2_STAT_GLOBAL_Lin3: accessed-variable=Lin3ComRxSignalsSR.COMRXL_PECP2_VLTG_PECP2_STAT_GLOBAL_Lin3
          data-send-points:
            access DSP_VeLINR_U_PECP2_VLTG_VeLINR_U_PECP2_VLTG: accessed-variable=VeLINR_U_PECP2_VLTG.VeLINR_U_PECP2_VLTG
            access DSP_VeLINR_b_PECP2_VLTG_TO_VeLINR_b_PECP2_VLTG_TO: accessed-variable=VeLINR_b_PECP2_VLTG_TO.VeLINR_b_PECP2_VLTG_TO
          read-local-variables:
            access IRVRA_VeLINR_d_LIN_SlavePrsnt_LIN3: accessed-variable=VeLINR_d_LIN_SlavePrsnt_LIN3
        COMRXL_PECP2_TEMP_PECP2_STAT_GLOBAL_Lin3_Received: symbol=ApplLinComAb_LIN3_COMRXL_PECP2_TEMP_PECP2_STAT_GLOBAL_Lin3_Received  # Received -
          data-receive-point-by-arguments:
            access DRP_Lin3ComRxSignalsSR_COMRXL_PECP2_TEMP_PECP2_STAT_GLOBAL_Lin3: accessed-variable=Lin3ComRxSignalsSR.COMRXL_PECP2_TEMP_PECP2_STAT_GLOBAL_Lin3
          data-send-points:
            access DSP_VeLINR_T_PECP2_TEMP_VeLINR_T_PECP2_TEMP: accessed-variable=VeLINR_T_PECP2_TEMP.VeLINR_T_PECP2_TEMP
            access DSP_VeLINR_b_PECP2_TEMP_TO_VeLINR_b_PECP2_TEMP_TO: accessed-variable=VeLINR_b_PECP2_TEMP_TO.VeLINR_b_PECP2_TEMP_TO
        COMRXL_PECP2_TEMP_PECP2_STAT_GLOBAL_Lin3_Error: symbol=ApplLinComAb_LIN3_COMRXL_PECP2_TEMP_PECP2_STAT_GLOBAL_Lin3_Error  # Error -
          data-receive-point-by-arguments:
            access DRP_Lin3ComRxSignalsSR_COMRXL_PECP2_TEMP_PECP2_STAT_GLOBAL_Lin3: accessed-variable=Lin3ComRxSignalsSR.COMRXL_PECP2_TEMP_PECP2_STAT_GLOBAL_Lin3
          data-send-points:
            access DSP_VeLINR_T_PECP2_TEMP_VeLINR_T_PECP2_TEMP: accessed-variable=VeLINR_T_PECP2_TEMP.VeLINR_T_PECP2_TEMP
            access DSP_VeLINR_b_PECP2_TEMP_TO_VeLINR_b_PECP2_TEMP_TO: accessed-variable=VeLINR_b_PECP2_TEMP_TO.VeLINR_b_PECP2_TEMP_TO
          read-local-variables:
            access IRVRA_VeLINR_d_LIN_SlavePrsnt_LIN3: accessed-variable=VeLINR_d_LIN_SlavePrsnt_LIN3
        COMRXL_PECP2_CURR_PECP2_STAT_GLOBAL_Lin3_Received: symbol=ApplLinComAb_LIN3_COMRXL_PECP2_CURR_PECP2_STAT_GLOBAL_Lin3_Received  # Received -
          data-receive-point-by-arguments:
            access DRP_Lin3ComRxSignalsSR_COMRXL_PECP2_CURR_PECP2_STAT_GLOBAL_Lin3: accessed-variable=Lin3ComRxSignalsSR.COMRXL_PECP2_CURR_PECP2_STAT_GLOBAL_Lin3
          data-send-points:
            access DSP_VeLINR_I_PECP2_CURR_VeLINR_I_PECP2_CURR: accessed-variable=VeLINR_I_PECP2_CURR.VeLINR_I_PECP2_CURR
            access DSP_VeLINR_b_PECP2_CURR_TO_VeLINR_b_PECP2_CURR_TO: accessed-variable=VeLINR_b_PECP2_CURR_TO.VeLINR_b_PECP2_CURR_TO
        COMRXL_PECP2_CURR_PECP2_STAT_GLOBAL_Lin3_Error: symbol=ApplLinComAb_LIN3_COMRXL_PECP2_CURR_PECP2_STAT_GLOBAL_Lin3_Error  # Error -
          data-receive-point-by-arguments:
            access DRP_Lin3ComRxSignalsSR_COMRXL_PECP2_CURR_PECP2_STAT_GLOBAL_Lin3: accessed-variable=Lin3ComRxSignalsSR.COMRXL_PECP2_CURR_PECP2_STAT_GLOBAL_Lin3
          data-send-points:
            access DSP_VeLINR_I_PECP2_CURR_VeLINR_I_PECP2_CURR: accessed-variable=VeLINR_I_PECP2_CURR.VeLINR_I_PECP2_CURR
            access DSP_VeLINR_b_PECP2_CURR_TO_VeLINR_b_PECP2_CURR_TO: accessed-variable=VeLINR_b_PECP2_CURR_TO.VeLINR_b_PECP2_CURR_TO
          read-local-variables:
            access IRVRA_VeLINR_d_LIN_SlavePrsnt_LIN3: accessed-variable=VeLINR_d_LIN_SlavePrsnt_LIN3
        COMRXL_PECP2_FL_SAFE_ACTVTD_PECP2_STAT_GLOBAL_Lin3_Received: symbol=ApplLinComAb_LIN3_COMRXL_PECP2_FL_SAFE_ACTVTD_PECP2_STAT_GLOBAL_Lin3_Received  # Received -
          data-receive-point-by-arguments:
            access DRP_Lin3ComRxSignalsSR_COMRXL_PECP2_FL_SAFE_ACTVTD_PECP2_STAT_GLOBAL_Lin3: accessed-variable=Lin3ComRxSignalsSR.COMRXL_PECP2_FL_SAFE_ACTVTD_PECP2_STAT_GLOBAL_Lin3
          data-send-points:
            access DSP_VeLINR_e_PECP2_FL_SAFE_ACTVTD_VeLINR_e_PECP2_FL_SAFE_ACTVTD: accessed-variable=VeLINR_e_PECP2_FL_SAFE_ACTVTD.VeLINR_e_PECP2_FL_SAFE_ACTVTD
            access DSP_VeLINR_b_PECP2_FL_SAFE_ACTVTD_TO_VeLINR_b_PECP2_FL_SAFE_ACTVTD_TO: accessed-variable=VeLINR_b_PECP2_FL_SAFE_ACTVTD_TO.VeLINR_b_PECP2_FL_SAFE_ACTVTD_TO
        COMRXL_PECP2_FL_SAFE_ACTVTD_PECP2_STAT_GLOBAL_Lin3_Error: symbol=ApplLinComAb_LIN3_COMRXL_PECP2_FL_SAFE_ACTVTD_PECP2_STAT_GLOBAL_Lin3_Error  # Error -
          data-receive-point-by-arguments:
            access DRP_Lin3ComRxSignalsSR_COMRXL_PECP2_FL_SAFE_ACTVTD_PECP2_STAT_GLOBAL_Lin3: accessed-variable=Lin3ComRxSignalsSR.COMRXL_PECP2_FL_SAFE_ACTVTD_PECP2_STAT_GLOBAL_Lin3
          data-send-points:
            access DSP_VeLINR_e_PECP2_FL_SAFE_ACTVTD_VeLINR_e_PECP2_FL_SAFE_ACTVTD: accessed-variable=VeLINR_e_PECP2_FL_SAFE_ACTVTD.VeLINR_e_PECP2_FL_SAFE_ACTVTD
            access DSP_VeLINR_b_PECP2_FL_SAFE_ACTVTD_TO_VeLINR_b_PECP2_FL_SAFE_ACTVTD_TO: accessed-variable=VeLINR_b_PECP2_FL_SAFE_ACTVTD_TO.VeLINR_b_PECP2_FL_SAFE_ACTVTD_TO
          read-local-variables:
            access IRVRA_VeLINR_d_LIN_SlavePrsnt_LIN3: accessed-variable=VeLINR_d_LIN_SlavePrsnt_LIN3
        COMRXL_PECP2_LMP_HM_AN_ON_PECP2_STAT_GLOBAL_Lin3_Received: symbol=ApplLinComAb_LIN3_COMRXL_PECP2_LMP_HM_AN_ON_PECP2_STAT_GLOBAL_Lin3_Received  # Received -
          data-receive-point-by-arguments:
            access DRP_Lin3ComRxSignalsSR_COMRXL_PECP2_LMP_HM_AN_ON_PECP2_STAT_GLOBAL_Lin3: accessed-variable=Lin3ComRxSignalsSR.COMRXL_PECP2_LMP_HM_AN_ON_PECP2_STAT_GLOBAL_Lin3
          data-send-points:
            access DSP_VeLINR_e_PECP2_LMP_HM_AN_ON_VeLINR_e_PECP2_LMP_HM_AN_ON: accessed-variable=VeLINR_e_PECP2_LMP_HM_AN_ON.VeLINR_e_PECP2_LMP_HM_AN_ON
            access DSP_VeLINR_b_PECP2_LMP_HM_AN_ON_TO_VeLINR_b_PECP2_LMP_HM_AN_ON_TO: accessed-variable=VeLINR_b_PECP2_LMP_HM_AN_ON_TO.VeLINR_b_PECP2_LMP_HM_AN_ON_TO
