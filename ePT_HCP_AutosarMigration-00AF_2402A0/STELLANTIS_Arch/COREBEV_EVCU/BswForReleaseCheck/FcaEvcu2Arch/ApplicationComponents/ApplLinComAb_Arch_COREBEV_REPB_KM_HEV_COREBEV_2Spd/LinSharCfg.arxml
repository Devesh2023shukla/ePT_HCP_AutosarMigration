AUTOSAR XML (schema 4-0-2)
package /FCASharedInterfaces/IFCOEs/IFSharCfg
  31 x parameter interface:
    KeCFGR_b_AAD_Equid
      parameter data prototype KeCFGR_b_AAD_Equid: category=VALUE, type=boolean, init-value=0
    KeCFGR_b_AGS2_Equid
      parameter data prototype KeCFGR_b_AGS2_Equid: type=boolean
    KeCFGR_b_AGS_Equid
      parameter data prototype KeCFGR_b_AGS_Equid: category=VALUE, type=boolean, init-value=0
    KeCFGR_b_AHP_Equid
      parameter data prototype KeCFGR_b_AHP_Equid: category=VALUE, type=boolean, init-value=0
    KeCFGR_b_BCP_Equid
      parameter data prototype KeCFGR_b_BCP_Equid: category=VALUE, type=boolean, init-value=0
    KeCFGR_b_BHV_Equid
      parameter data prototype KeCFGR_b_BHV_Equid: type=boolean
    KeCFGR_b_CEXV_Equid
      parameter data prototype KeCFGR_b_CEXV_Equid: category=VALUE, type=boolean, init-value=0
    KeCFGR_b_CPIM_Equid
      parameter data prototype KeCFGR_b_CPIM_Equid: category=VALUE, type=boolean, init-value=0
    KeCFGR_b_CPV_Equid
      parameter data prototype KeCFGR_b_CPV_Equid: category=VALUE, type=boolean, init-value=0
    KeCFGR_b_EAC2_Equid
      parameter data prototype KeCFGR_b_EAC2_Equid: category=VALUE, type=boolean, init-value=0
    KeCFGR_b_EAH_Equid
      parameter data prototype KeCFGR_b_EAH_Equid: type=boolean
    KeCFGR_b_ECH_Equid
      parameter data prototype KeCFGR_b_ECH_Equid: category=VALUE, type=boolean, init-value=0
    KeCFGR_b_EEXV_Equid
      parameter data prototype KeCFGR_b_EEXV_Equid: category=VALUE, type=boolean, init-value=0
    KeCFGR_b_EOPA_Equid
      parameter data prototype KeCFGR_b_EOPA_Equid: category=VALUE, type=boolean, init-value=0
    KeCFGR_b_EOPB_Equid
      parameter data prototype KeCFGR_b_EOPB_Equid: category=VALUE, type=boolean, init-value=0
    KeCFGR_b_ESBM_Equid
      parameter data prototype KeCFGR_b_ESBM_Equid: type=boolean
    KeCFGR_b_EXVM_Equid
      parameter data prototype KeCFGR_b_EXVM_Equid: type=boolean
    KeCFGR_b_HTLBV_Equid
      parameter data prototype KeCFGR_b_HTLBV_Equid: category=VALUE, type=boolean, init-value=0
    KeCFGR_b_HTRBV_Equid
      parameter data prototype KeCFGR_b_HTRBV_Equid: category=VALUE, type=boolean, init-value=0
    KeCFGR_b_LIN1_Equid
      parameter data prototype KeCFGR_b_LIN1_Equid: category=VALUE, type=boolean, init-value=0
    KeCFGR_b_LIN2_Equid
      parameter data prototype KeCFGR_b_LIN2_Equid: category=VALUE, type=boolean, init-value=0
    KeCFGR_b_LIN3_Equid
      parameter data prototype KeCFGR_b_LIN3_Equid: category=VALUE, type=boolean, init-value=0
    KeCFGR_b_LTRBV_Equid
      parameter data prototype KeCFGR_b_LTRBV_Equid: category=VALUE, type=boolean, init-value=0
    KeCFGR_b_OEXV_Equid
      parameter data prototype KeCFGR_b_OEXV_Equid: category=VALUE, type=boolean, init-value=0
    KeCFGR_b_PECP2_Equid
      parameter data prototype KeCFGR_b_PECP2_Equid: category=VALUE, type=boolean, init-value=0
    KeCFGR_b_PECP_Equid
      parameter data prototype KeCFGR_b_PECP_Equid: category=VALUE, type=boolean, init-value=0
    KeCFGR_b_SPP2_Equid
      parameter data prototype KeCFGR_b_SPP2_Equid: type=boolean
    KeCFGR_b_SPP_Equid
      parameter data prototype KeCFGR_b_SPP_Equid: type=boolean
    KeLINR_y_LIN1SwtSchdTbl
      parameter data prototype KeLINR_y_LIN1SwtSchdTbl: type=uint8
    KeLINR_y_LIN2SwtSchdTbl
      parameter data prototype KeLINR_y_LIN2SwtSchdTbl: type=uint8
    KeLINR_y_LIN3SwtSchdTbl
      parameter data prototype KeLINR_y_LIN3SwtSchdTbl: type=uint8
