[part 2 of 3: package /STLASWCs]
AUTOSAR XML (schema 00044)
package /STLASWCs  (continued)
  complex device driver sw component type ApplLinComAb_LIN2  (continued)
    behavior IBApplLinComAb_LIN2: data-type-mapping=[MG_LinEquid_Mapping, ADTtoIDTMapping, BswMMappingSet], handle-termination-and-restart=NO-SUPPORT  (continued)
      data received event DRECOMRXL_PowerPanel_LED_C_FailStatus_PowerPanel_STAT_Lin2: start-on-event=COMRXL_PowerPanel_LED_C_FailStatus_PowerPanel_STAT_Lin2_Received, data=Lin2ComRxSignalsSR.COMRXL_PowerPanel_LED_C_FailStatus_PowerPanel_STAT_Lin2
      data receive error event DEECOMRXL_PowerPanel_LED_C_FailStatus_PowerPanel_STAT_Lin2: start-on-event=COMRXL_PowerPanel_LED_C_FailStatus_PowerPanel_STAT_Lin2_Error, data=Lin2ComRxSignalsSR.COMRXL_PowerPanel_LED_C_FailStatus_PowerPanel_STAT_Lin2
      data received event DRECOMRXL_PowerPanel_LED_A_Color_Feedback_PowerPanel_STAT_Lin2: start-on-event=COMRXL_PowerPanel_LED_A_Color_Feedback_PowerPanel_STAT_Lin2_Received, data=Lin2ComRxSignalsSR.COMRXL_PowerPanel_LED_A_Color_Feedback_PowerPanel_STAT_Lin2
      data receive error event DEECOMRXL_PowerPanel_LED_A_Color_Feedback_PowerPanel_STAT_Lin2: start-on-event=COMRXL_PowerPanel_LED_A_Color_Feedback_PowerPanel_STAT_Lin2_Error, data=Lin2ComRxSignalsSR.COMRXL_PowerPanel_LED_A_Color_Feedback_PowerPanel_STAT_Lin2
      data received event DRECOMRXL_PowerPanel_LED_B_Color_Feedback_PowerPanel_STAT_Lin2: start-on-event=COMRXL_PowerPanel_LED_B_Color_Feedback_PowerPanel_STAT_Lin2_Received, data=Lin2ComRxSignalsSR.COMRXL_PowerPanel_LED_B_Color_Feedback_PowerPanel_STAT_Lin2
      data receive error event DEECOMRXL_PowerPanel_LED_B_Color_Feedback_PowerPanel_STAT_Lin2: start-on-event=COMRXL_PowerPanel_LED_B_Color_Feedback_PowerPanel_STAT_Lin2_Error, data=Lin2ComRxSignalsSR.COMRXL_PowerPanel_LED_B_Color_Feedback_PowerPanel_STAT_Lin2
      data received event DRECOMRXL_PowerPanel_LED_C_Color_Feedback_PowerPanel_STAT_Lin2: start-on-event=COMRXL_PowerPanel_LED_C_Color_Feedback_PowerPanel_STAT_Lin2_Received, data=Lin2ComRxSignalsSR.COMRXL_PowerPanel_LED_C_Color_Feedback_PowerPanel_STAT_Lin2
      data receive error event DEECOMRXL_PowerPanel_LED_C_Color_Feedback_PowerPanel_STAT_Lin2: start-on-event=COMRXL_PowerPanel_LED_C_Color_Feedback_PowerPanel_STAT_Lin2_Error, data=Lin2ComRxSignalsSR.COMRXL_PowerPanel_LED_C_Color_Feedback_PowerPanel_STAT_Lin2
      data received event DRECOMRXL_PowerPanel_LIN_Checksum_Error_PowerPanel_STAT_Lin2: start-on-event=COMRXL_PowerPanel_LIN_Checksum_Error_PowerPanel_STAT_Lin2_Received, data=Lin2ComRxSignalsSR.COMRXL_PowerPanel_LIN_Checksum_Error_PowerPanel_STAT_Lin2
      data receive error event DEECOMRXL_PowerPanel_LIN_Checksum_Error_PowerPanel_STAT_Lin2: start-on-event=COMRXL_PowerPanel_LIN_Checksum_Error_PowerPanel_STAT_Lin2_Error, data=Lin2ComRxSignalsSR.COMRXL_PowerPanel_LIN_Checksum_Error_PowerPanel_STAT_Lin2
      data received event DRECOMRXL_PowerPanel_LIN_Data_Error_PowerPanel_STAT_Lin2: start-on-event=COMRXL_PowerPanel_LIN_Data_Error_PowerPanel_STAT_Lin2_Received, data=Lin2ComRxSignalsSR.COMRXL_PowerPanel_LIN_Data_Error_PowerPanel_STAT_Lin2
      data receive error event DEECOMRXL_PowerPanel_LIN_Data_Error_PowerPanel_STAT_Lin2: start-on-event=COMRXL_PowerPanel_LIN_Data_Error_PowerPanel_STAT_Lin2_Error, data=Lin2ComRxSignalsSR.COMRXL_PowerPanel_LIN_Data_Error_PowerPanel_STAT_Lin2
      data received event DRECOMRXL_PowerPanel_LIN_Parity_Error_PowerPanel_STAT_Lin2: start-on-event=COMRXL_PowerPanel_LIN_Parity_Error_PowerPanel_STAT_Lin2_Received, data=Lin2ComRxSignalsSR.COMRXL_PowerPanel_LIN_Parity_Error_PowerPanel_STAT_Lin2
      data receive error event DEECOMRXL_PowerPanel_LIN_Parity_Error_PowerPanel_STAT_Lin2: start-on-event=COMRXL_PowerPanel_LIN_Parity_Error_PowerPanel_STAT_Lin2_Error, data=Lin2ComRxSignalsSR.COMRXL_PowerPanel_LIN_Parity_Error_PowerPanel_STAT_Lin2
      data received event DRECOMRXL_PowerPanel_Gnd_Fault_Detected_PowerPanel_STAT_Lin2: start-on-event=COMRXL_PowerPanel_Gnd_Fault_Detected_PowerPanel_STAT_Lin2_Received, data=Lin2ComRxSignalsSR.COMRXL_PowerPanel_Gnd_Fault_Detected_PowerPanel_STAT_Lin2
      data receive error event DEECOMRXL_PowerPanel_Gnd_Fault_Detected_PowerPanel_STAT_Lin2: start-on-event=COMRXL_PowerPanel_Gnd_Fault_Detected_PowerPanel_STAT_Lin2_Error, data=Lin2ComRxSignalsSR.COMRXL_PowerPanel_Gnd_Fault_Detected_PowerPanel_STAT_Lin2
      data received event DRECOMRXL_RsErr_EAC2_EAC_STAT_Lin2: start-on-event=COMRXL_RsErr_EAC2_EAC_STAT_Lin2_Received, data=Lin2ComRxSignalsSR.COMRXL_RsErr_EAC2_EAC_STAT_Lin2
      data receive error event DEECOMRXL_RsErr_EAC2_EAC_STAT_Lin2: start-on-event=COMRXL_RsErr_EAC2_EAC_STAT_Lin2_Error, data=Lin2ComRxSignalsSR.COMRXL_RsErr_EAC2_EAC_STAT_Lin2
      data received event DRECOMRXL_PowerPanel_Fault_PowerPanel_STAT_Lin2: start-on-event=COMRXL_PowerPanel_Fault_PowerPanel_STAT_Lin2_Received, data=Lin2ComRxSignalsSR.COMRXL_PowerPanel_Fault_PowerPanel_STAT_Lin2
      data receive error event DEECOMRXL_PowerPanel_Fault_PowerPanel_STAT_Lin2: start-on-event=COMRXL_PowerPanel_Fault_PowerPanel_STAT_Lin2_Error, data=Lin2ComRxSignalsSR.COMRXL_PowerPanel_Fault_PowerPanel_STAT_Lin2
      data received event DRECOMRXL_PowerPanel_RatedPower_PowerPanel_STAT_Lin2: start-on-event=COMRXL_PowerPanel_RatedPower_PowerPanel_STAT_Lin2_Received, data=Lin2ComRxSignalsSR.COMRXL_PowerPanel_RatedPower_PowerPanel_STAT_Lin2
      data receive error event DEECOMRXL_PowerPanel_RatedPower_PowerPanel_STAT_Lin2: start-on-event=COMRXL_PowerPanel_RatedPower_PowerPanel_STAT_Lin2_Error, data=Lin2ComRxSignalsSR.COMRXL_PowerPanel_RatedPower_PowerPanel_STAT_Lin2
      data received event DRECOMRXL_PowerPanel_Current_Draw_Sens2_PowerPanel_STAT_Lin2: start-on-event=COMRXL_PowerPanel_Current_Draw_Sens2_PowerPanel_STAT_Lin2_Received, data=Lin2ComRxSignalsSR.COMRXL_PowerPanel_Current_Draw_Sens2_PowerPanel_STAT_Lin2
      data receive error event DEECOMRXL_PowerPanel_Current_Draw_Sens2_PowerPanel_STAT_Lin2: start-on-event=COMRXL_PowerPanel_Current_Draw_Sens2_PowerPanel_STAT_Lin2_Error, data=Lin2ComRxSignalsSR.COMRXL_PowerPanel_Current_Draw_Sens2_PowerPanel_STAT_Lin2
      data received event DRECOMRXL_PowerPanel_AC_Present_Sens1_PowerPanel_STAT_Lin2: start-on-event=COMRXL_PowerPanel_AC_Present_Sens1_PowerPanel_STAT_Lin2_Received, data=Lin2ComRxSignalsSR.COMRXL_PowerPanel_AC_Present_Sens1_PowerPanel_STAT_Lin2
      data receive error event DEECOMRXL_PowerPanel_AC_Present_Sens1_PowerPanel_STAT_Lin2: start-on-event=COMRXL_PowerPanel_AC_Present_Sens1_PowerPanel_STAT_Lin2_Error, data=Lin2ComRxSignalsSR.COMRXL_PowerPanel_AC_Present_Sens1_PowerPanel_STAT_Lin2
      data received event DRECOMRXL_PowerPanel_AC_Present_Sens2_PowerPanel_STAT_Lin2: start-on-event=COMRXL_PowerPanel_AC_Present_Sens2_PowerPanel_STAT_Lin2_Received, data=Lin2ComRxSignalsSR.COMRXL_PowerPanel_AC_Present_Sens2_PowerPanel_STAT_Lin2
      data receive error event DEECOMRXL_PowerPanel_AC_Present_Sens2_PowerPanel_STAT_Lin2: start-on-event=COMRXL_PowerPanel_AC_Present_Sens2_PowerPanel_STAT_Lin2_Error, data=Lin2ComRxSignalsSR.COMRXL_PowerPanel_AC_Present_Sens2_PowerPanel_STAT_Lin2
      data received event DRECOMRXL_PowerPanel_Current_Draw_Sens1_PowerPanel_STAT_Lin2: start-on-event=COMRXL_PowerPanel_Current_Draw_Sens1_PowerPanel_STAT_Lin2_Received, data=Lin2ComRxSignalsSR.COMRXL_PowerPanel_Current_Draw_Sens1_PowerPanel_STAT_Lin2
      data receive error event DEECOMRXL_PowerPanel_Current_Draw_Sens1_PowerPanel_STAT_Lin2: start-on-event=COMRXL_PowerPanel_Current_Draw_Sens1_PowerPanel_STAT_Lin2_Error, data=Lin2ComRxSignalsSR.COMRXL_PowerPanel_Current_Draw_Sens1_PowerPanel_STAT_Lin2
      explicit-inter-runnable-variables:
        data VeLINR_d_LIN_SlavePrsnt_LIN2: type=uint16, init-value=Value:0  # Each bit inidicates whether a LIN slave is present (equipped or learned). 0 = not present, 1 = present.
        data VeLINR_d_LIN_SlaveRdyToSleep_LIN2: type=uint16, init-value=Value:0  # Each bit indicates whether a LIN slave is ready to sleep. 0 = not ready, 1 = ready
        data VeLINR_d_LIN_SysSts_LIN2: type=uint16, init-value=Value:0  # Bits which indicate LIN system status.
      282 x runnable:
        ApplLinComAb_LIN2Inin: symbol=ApplLinComAb_LIN2_ApplLinComAb_LIN2Inin  # CAN SWC initialization runnable
          data-send-points:
            access DSP_VeLINR_b_LIN2_RequestsPostRun_VeSPLR_b_PostRunRqrdSt: accessed-variable=VeLINR_b_LIN2_RequestsPostRun.VeSPLR_b_PostRunRqrdSt
          mode switch point MSP_ApplLinComAbLin2EquidMN_MDGP_MSI_Lin2Equid: mode-group=ApplLinComAbLin2EquidMN.MDGP_MSI_Lin2Equid
          parameter access CPA_KeCFGR_b_LIN2_Equid_KeCFGR_b_LIN2_Equid: accessed-parameter=KeCFGR_b_LIN2_Equid.KeCFGR_b_LIN2_Equid
        LinsmComModNotifyRdyToPwrDwn: symbol=ApplLinComAb_LIN2_LinsmComModNotifyRdyToPwrDwn  # Runs when all slaves are ready for power down. Notifies AppModeIf LIN is ready for power down.
          data-send-points:
            access DSP_VeLINR_b_LIN2_RequestsPostRun_VeSPLR_b_PostRunRqrdSt: accessed-variable=VeLINR_b_LIN2_RequestsPostRun.VeSPLR_b_PostRunRqrdSt
          mode-access-point mode-group=MdulPwrMod.AppMode_MDGP_ESH_Mode:
            ident MAP_BswM_MSI_ESH_Mode_BswM_MDGP_ESH_Mode
        LinsmComModPostrun: symbol=ApplLinComAb_LIN2_LinsmComModPostrun  # Runs when ECU goes to POSTRUN state. If LIN is not running when POSTRUN is active, this will immediately notify AppModeIf to power down. Keeps LIN from hanging the power down sequence.
          data-send-points:
            access DSP_VeLINR_b_LIN2_RequestsPostRun_VeSPLR_b_PostRunRqrdSt: accessed-variable=VeLINR_b_LIN2_RequestsPostRun.VeSPLR_b_PostRunRqrdSt
          mode-access-point mode-group=MdulPwrMod.AppMode_MDGP_ESH_Mode:
            ident MAP_BswM_MSI_ESH_Mode_BswM_MDGP_ESH_Mode
          mode-access-point mode-group=PP_MS_LinSMComMod.MDGP_MSI_LinSMComMod:
            ident MAP_BswM_MSI_MDG_LinsmComMod_BswM_MDGP_MDG_LinsmComMod
          parameter access CPA_KeCFGR_b_LIN2_Equid_KeCFGR_b_LIN2_Equid: accessed-parameter=KeCFGR_b_LIN2_Equid.KeCFGR_b_LIN2_Equid
          read-local-variables:
            access IRVRA_VeLINR_d_LIN_SlavePrsnt_LIN2: accessed-variable=VeLINR_d_LIN_SlavePrsnt_LIN2
            access IRVRA_VeLINR_d_LIN_SysSts_LIN2: accessed-variable=VeLINR_d_LIN_SysSts_LIN2
        LinsmComModSetScheduleTbl: symbol=ApplLinComAb_LIN2_LinsmComModSetScheduleTbl  # Sets LIN schedule table based on slaves present (equipped or learned).
          data-send-points:
            access DSP__VeLINR_d_LIN_SlavePrsntSts_LIN2_VeLINR_d_LIN_SlavePrsntSts_LIN2: accessed-variable=VeLINR_d_LIN_SlavePrsntSts_LIN2.VeLINR_d_LIN_SlavePrsntSts_LIN2
          mode-access-point mode-group=PP_MS_LinSMComMod.MDGP_MSI_LinSMComMod:
            ident MAP_BswM_MSI_MDG_LinsmComMod_BswM_MDGP_MDG_LinsmComMod
          10 x parameter access:
            CPA_KeCFGR_b_AGS2_Equid_KeCFGR_b_AGS2_Equid: accessed-parameter=KeCFGR_b_AGS2_Equid.KeCFGR_b_AGS2_Equid
            CPA_KeCFGR_b_AHP_Equid_KeCFGR_b_AHP_Equid: accessed-parameter=KeCFGR_b_AHP_Equid.KeCFGR_b_AHP_Equid
            CPA_KeCFGR_b_BHV_Equid_KeCFGR_b_BHV_Equid: accessed-parameter=KeCFGR_b_BHV_Equid.KeCFGR_b_BHV_Equid
            CPA_KeCFGR_b_EAC2_Equid_KeCFGR_b_EAC2_Equid: accessed-parameter=KeCFGR_b_EAC2_Equid.KeCFGR_b_EAC2_Equid
            CPA_KeCFGR_b_ESBM_Equid_KeCFGR_b_ESBM_Equid: accessed-parameter=KeCFGR_b_ESBM_Equid.KeCFGR_b_ESBM_Equid
            CPA_KeCFGR_b_LIN2_Equid_KeCFGR_b_LIN2_Equid: accessed-parameter=KeCFGR_b_LIN2_Equid.KeCFGR_b_LIN2_Equid
            CPA_KeCFGR_b_OEXV_Equid_KeCFGR_b_OEXV_Equid: accessed-parameter=KeCFGR_b_OEXV_Equid.KeCFGR_b_OEXV_Equid
            CPA_KeCFGR_b_PECP_Equid_KeCFGR_b_PECP_Equid: accessed-parameter=KeCFGR_b_PECP_Equid.KeCFGR_b_PECP_Equid
            CPA_KeCFGR_b_SPP_Equid_KeCFGR_b_SPP_Equid: accessed-parameter=KeCFGR_b_SPP_Equid.KeCFGR_b_SPP_Equid
            CPA_KeLINR_y_LIN2SwtSchdTbl_KeLINR_y_LIN2SwtSchdTbl: accessed-parameter=KeLINR_y_LIN2SwtSchdTbl.KeLINR_y_LIN2SwtSchdTbl
          read-local-variables:
            access IRVRA_VeLINR_d_LIN_SlavePrsnt_LIN2: accessed-variable=VeLINR_d_LIN_SlavePrsnt_LIN2
            access IRVRA_VeLINR_d_LIN_SysSts_LIN2: accessed-variable=VeLINR_d_LIN_SysSts_LIN2
          written-local-variables:
            access IRVWA_VeLINR_d_LIN_SlavePrsnt_LIN2: accessed-variable=VeLINR_d_LIN_SlavePrsnt_LIN2
            access IRVWA_VeLINR_d_LIN_SysSts_LIN2: accessed-variable=VeLINR_d_LIN_SysSts_LIN2
        COMRXL_AGS2_CurrPos_AGS2_ECM_STATUS_Lin2_Received: symbol=ApplLinComAb_LIN2_COMRXL_AGS2_CurrPos_AGS2_ECM_STATUS_Lin2_Received  # Received -
          data-receive-point-by-arguments:
            access DRP_Lin2ComRxSignalsSR_COMRXL_AGS2_CurrPos_AGS2_ECM_STATUS_Lin2: accessed-variable=Lin2ComRxSignalsSR.COMRXL_AGS2_CurrPos_AGS2_ECM_STATUS_Lin2
          data-send-points:
            access DSP_VeLINR_e_AGS2_CurrPos_VeLINR_e_AGS2_CurrPos: accessed-variable=VeLINR_e_AGS2_CurrPos.VeLINR_e_AGS2_CurrPos
            access DSP_VeLINR_b_AGS2_CurrPosTO_VeLINR_b_AGS2_CurrPosTO: accessed-variable=VeLINR_b_AGS2_CurrPosTO.VeLINR_b_AGS2_CurrPosTO
        COMRXL_AGS2_CurrPos_AGS2_ECM_STATUS_Lin2_Error: symbol=ApplLinComAb_LIN2_COMRXL_AGS2_CurrPos_AGS2_ECM_STATUS_Lin2_Error  # Error -
          data-receive-point-by-arguments:
            access DRP_Lin2ComRxSignalsSR_COMRXL_AGS2_CurrPos_AGS2_ECM_STATUS_Lin2: accessed-variable=Lin2ComRxSignalsSR.COMRXL_AGS2_CurrPos_AGS2_ECM_STATUS_Lin2
          data-send-points:
            access DSP_VeLINR_e_AGS2_CurrPos_VeLINR_e_AGS2_CurrPos: accessed-variable=VeLINR_e_AGS2_CurrPos.VeLINR_e_AGS2_CurrPos
            access DSP_VeLINR_b_AGS2_CurrPosTO_VeLINR_b_AGS2_CurrPosTO: accessed-variable=VeLINR_b_AGS2_CurrPosTO.VeLINR_b_AGS2_CurrPosTO
          read-local-variables:
            access IRVRA_VeLINR_d_LIN_SlavePrsnt_LIN2: accessed-variable=VeLINR_d_LIN_SlavePrsnt_LIN2
        COMRXL_AGS2_CalStat_AGS2_ECM_STATUS_Lin2_Received: symbol=ApplLinComAb_LIN2_COMRXL_AGS2_CalStat_AGS2_ECM_STATUS_Lin2_Received  # Received -
          data-receive-point-by-arguments:
            access DRP_Lin2ComRxSignalsSR_COMRXL_AGS2_CalStat_AGS2_ECM_STATUS_Lin2: accessed-variable=Lin2ComRxSignalsSR.COMRXL_AGS2_CalStat_AGS2_ECM_STATUS_Lin2
          data-send-points:
            access DSP_VeLINR_b_AGS2_CalStat_VeLINR_b_AGS2_CalStat: accessed-variable=VeLINR_b_AGS2_CalStat.VeLINR_b_AGS2_CalStat
            access DSP_VeLINR_b_AGS2_CalStatTO_VeLINR_b_AGS2_CalStatTO: accessed-variable=VeLINR_b_AGS2_CalStatTO.VeLINR_b_AGS2_CalStatTO
        COMRXL_AGS2_CalStat_AGS2_ECM_STATUS_Lin2_Error: symbol=ApplLinComAb_LIN2_COMRXL_AGS2_CalStat_AGS2_ECM_STATUS_Lin2_Error  # Error -
          data-receive-point-by-arguments:
            access DRP_Lin2ComRxSignalsSR_COMRXL_AGS2_CalStat_AGS2_ECM_STATUS_Lin2: accessed-variable=Lin2ComRxSignalsSR.COMRXL_AGS2_CalStat_AGS2_ECM_STATUS_Lin2
          data-send-points:
            access DSP_VeLINR_b_AGS2_CalStat_VeLINR_b_AGS2_CalStat: accessed-variable=VeLINR_b_AGS2_CalStat.VeLINR_b_AGS2_CalStat
            access DSP_VeLINR_b_AGS2_CalStatTO_VeLINR_b_AGS2_CalStatTO: accessed-variable=VeLINR_b_AGS2_CalStatTO.VeLINR_b_AGS2_CalStatTO
          read-local-variables:
            access IRVRA_VeLINR_d_LIN_SlavePrsnt_LIN2: accessed-variable=VeLINR_d_LIN_SlavePrsnt_LIN2
        COMRXL_AGS2_CalActv_AGS2_ECM_STATUS_Lin2_Received: symbol=ApplLinComAb_LIN2_COMRXL_AGS2_CalActv_AGS2_ECM_STATUS_Lin2_Received  # Received -
          data-receive-point-by-arguments:
            access DRP_Lin2ComRxSignalsSR_COMRXL_AGS2_CalActv_AGS2_ECM_STATUS_Lin2: accessed-variable=Lin2ComRxSignalsSR.COMRXL_AGS2_CalActv_AGS2_ECM_STATUS_Lin2
          data-send-points:
            access DSP_VeLINR_b_AGS2_CalActv_VeLINR_b_AGS2_CalActv: accessed-variable=VeLINR_b_AGS2_CalActv.VeLINR_b_AGS2_CalActv
            access DSP_VeLINR_b_AGS2_CalActvTO_VeLINR_b_AGS2_CalActvTO: accessed-variable=VeLINR_b_AGS2_CalActvTO.VeLINR_b_AGS2_CalActvTO
        COMRXL_AGS2_CalActv_AGS2_ECM_STATUS_Lin2_Error: symbol=ApplLinComAb_LIN2_COMRXL_AGS2_CalActv_AGS2_ECM_STATUS_Lin2_Error  # Error -
          data-receive-point-by-arguments:
            access DRP_Lin2ComRxSignalsSR_COMRXL_AGS2_CalActv_AGS2_ECM_STATUS_Lin2: accessed-variable=Lin2ComRxSignalsSR.COMRXL_AGS2_CalActv_AGS2_ECM_STATUS_Lin2
          data-send-points:
            access DSP_VeLINR_b_AGS2_CalActv_VeLINR_b_AGS2_CalActv: accessed-variable=VeLINR_b_AGS2_CalActv.VeLINR_b_AGS2_CalActv
            access DSP_VeLINR_b_AGS2_CalActvTO_VeLINR_b_AGS2_CalActvTO: accessed-variable=VeLINR_b_AGS2_CalActvTO.VeLINR_b_AGS2_CalActvTO
          read-local-variables:
            access IRVRA_VeLINR_d_LIN_SlavePrsnt_LIN2: accessed-variable=VeLINR_d_LIN_SlavePrsnt_LIN2
        COMRXL_AGS2_ErrUnVolt_AGS2_ECM_STATUS_Lin2_Received: symbol=ApplLinComAb_LIN2_COMRXL_AGS2_ErrUnVolt_AGS2_ECM_STATUS_Lin2_Received  # Received -
          data-receive-point-by-arguments:
            access DRP_Lin2ComRxSignalsSR_COMRXL_AGS2_ErrUnVolt_AGS2_ECM_STATUS_Lin2: accessed-variable=Lin2ComRxSignalsSR.COMRXL_AGS2_ErrUnVolt_AGS2_ECM_STATUS_Lin2
          data-send-points:
            access DSP_VeLINR_b_AGS2_ErrUnVolt_VeLINR_b_AGS2_ErrUnVolt: accessed-variable=VeLINR_b_AGS2_ErrUnVolt.VeLINR_b_AGS2_ErrUnVolt
            access DSP_VeLINR_b_AGS2_ErrUnVoltTO_VeLINR_b_AGS2_ErrUnVoltTO: accessed-variable=VeLINR_b_AGS2_ErrUnVoltTO.VeLINR_b_AGS2_ErrUnVoltTO
        COMRXL_AGS2_ErrUnVolt_AGS2_ECM_STATUS_Lin2_Error: symbol=ApplLinComAb_LIN2_COMRXL_AGS2_ErrUnVolt_AGS2_ECM_STATUS_Lin2_Error  # Error -
          data-receive-point-by-arguments:
            access DRP_Lin2ComRxSignalsSR_COMRXL_AGS2_ErrUnVolt_AGS2_ECM_STATUS_Lin2: accessed-variable=Lin2ComRxSignalsSR.COMRXL_AGS2_ErrUnVolt_AGS2_ECM_STATUS_Lin2
          data-send-points:
            access DSP_VeLINR_b_AGS2_ErrUnVolt_VeLINR_b_AGS2_ErrUnVolt: accessed-variable=VeLINR_b_AGS2_ErrUnVolt.VeLINR_b_AGS2_ErrUnVolt
            access DSP_VeLINR_b_AGS2_ErrUnVoltTO_VeLINR_b_AGS2_ErrUnVoltTO: accessed-variable=VeLINR_b_AGS2_ErrUnVoltTO.VeLINR_b_AGS2_ErrUnVoltTO
          read-local-variables:
            access IRVRA_VeLINR_d_LIN_SlavePrsnt_LIN2: accessed-variable=VeLINR_d_LIN_SlavePrsnt_LIN2
        COMRXL_AGS2_ErrOvrVolt_AGS2_ECM_STATUS_Lin2_Received: symbol=ApplLinComAb_LIN2_COMRXL_AGS2_ErrOvrVolt_AGS2_ECM_STATUS_Lin2_Received  # Received -
          data-receive-point-by-arguments:
            access DRP_Lin2ComRxSignalsSR_COMRXL_AGS2_ErrOvrVolt_AGS2_ECM_STATUS_Lin2: accessed-variable=Lin2ComRxSignalsSR.COMRXL_AGS2_ErrOvrVolt_AGS2_ECM_STATUS_Lin2
          data-send-points:
            access DSP_VeLINR_b_AGS2_ErrOvrVolt_VeLINR_b_AGS2_ErrOvrVolt: accessed-variable=VeLINR_b_AGS2_ErrOvrVolt.VeLINR_b_AGS2_ErrOvrVolt
            access DSP_VeLINR_b_AGS2_ErrOvrVoltTO_VeLINR_b_AGS2_ErrOvrVoltTO: accessed-variable=VeLINR_b_AGS2_ErrOvrVoltTO.VeLINR_b_AGS2_ErrOvrVoltTO
        COMRXL_AGS2_ErrOvrVolt_AGS2_ECM_STATUS_Lin2_Error: symbol=ApplLinComAb_LIN2_COMRXL_AGS2_ErrOvrVolt_AGS2_ECM_STATUS_Lin2_Error  # Error -
          data-receive-point-by-arguments:
            access DRP_Lin2ComRxSignalsSR_COMRXL_AGS2_ErrOvrVolt_AGS2_ECM_STATUS_Lin2: accessed-variable=Lin2ComRxSignalsSR.COMRXL_AGS2_ErrOvrVolt_AGS2_ECM_STATUS_Lin2
          data-send-points:
            access DSP_VeLINR_b_AGS2_ErrOvrVolt_VeLINR_b_AGS2_ErrOvrVolt: accessed-variable=VeLINR_b_AGS2_ErrOvrVolt.VeLINR_b_AGS2_ErrOvrVolt
            access DSP_VeLINR_b_AGS2_ErrOvrVoltTO_VeLINR_b_AGS2_ErrOvrVoltTO: accessed-variable=VeLINR_b_AGS2_ErrOvrVoltTO.VeLINR_b_AGS2_ErrOvrVoltTO
          read-local-variables:
            access IRVRA_VeLINR_d_LIN_SlavePrsnt_LIN2: accessed-variable=VeLINR_d_LIN_SlavePrsnt_LIN2
        COMRXL_AGS2_ErrOvrTemp_AGS2_ECM_STATUS_Lin2_Received: symbol=ApplLinComAb_LIN2_COMRXL_AGS2_ErrOvrTemp_AGS2_ECM_STATUS_Lin2_Received  # Received -
          data-receive-point-by-arguments:
            access DRP_Lin2ComRxSignalsSR_COMRXL_AGS2_ErrOvrTemp_AGS2_ECM_STATUS_Lin2: accessed-variable=Lin2ComRxSignalsSR.COMRXL_AGS2_ErrOvrTemp_AGS2_ECM_STATUS_Lin2
          data-send-points:
            access DSP_VeLINR_b_AGS2_ErrOvrTemp_VeLINR_b_AGS2_ErrOvrTemp: accessed-variable=VeLINR_b_AGS2_ErrOvrTemp.VeLINR_b_AGS2_ErrOvrTemp
            access DSP_VeLINR_b_AGS2_ErrOvrTempTO_VeLINR_b_AGS2_ErrOvrTempTO: accessed-variable=VeLINR_b_AGS2_ErrOvrTempTO.VeLINR_b_AGS2_ErrOvrTempTO
        COMRXL_AGS2_ErrOvrTemp_AGS2_ECM_STATUS_Lin2_Error: symbol=ApplLinComAb_LIN2_COMRXL_AGS2_ErrOvrTemp_AGS2_ECM_STATUS_Lin2_Error  # Error -
          data-receive-point-by-arguments:
            access DRP_Lin2ComRxSignalsSR_COMRXL_AGS2_ErrOvrTemp_AGS2_ECM_STATUS_Lin2: accessed-variable=Lin2ComRxSignalsSR.COMRXL_AGS2_ErrOvrTemp_AGS2_ECM_STATUS_Lin2
          data-send-points:
            access DSP_VeLINR_b_AGS2_ErrOvrTemp_VeLINR_b_AGS2_ErrOvrTemp: accessed-variable=VeLINR_b_AGS2_ErrOvrTemp.VeLINR_b_AGS2_ErrOvrTemp
            access DSP_VeLINR_b_AGS2_ErrOvrTempTO_VeLINR_b_AGS2_ErrOvrTempTO: accessed-variable=VeLINR_b_AGS2_ErrOvrTempTO.VeLINR_b_AGS2_ErrOvrTempTO
          read-local-variables:
            access IRVRA_VeLINR_d_LIN_SlavePrsnt_LIN2: accessed-variable=VeLINR_d_LIN_SlavePrsnt_LIN2
        COMRXL_AGS2_ErrMechStuck_AGS2_ECM_STATUS_Lin2_Received: symbol=ApplLinComAb_LIN2_COMRXL_AGS2_ErrMechStuck_AGS2_ECM_STATUS_Lin2_Received  # Received -
          data-receive-point-by-arguments:
            access DRP_Lin2ComRxSignalsSR_COMRXL_AGS2_ErrMechStuck_AGS2_ECM_STATUS_Lin2: accessed-variable=Lin2ComRxSignalsSR.COMRXL_AGS2_ErrMechStuck_AGS2_ECM_STATUS_Lin2
          data-send-points:
            access DSP_VeLINR_b_AGS2_ErrMechStuck_VeLINR_b_AGS2_ErrMechStuck: accessed-variable=VeLINR_b_AGS2_ErrMechStuck.VeLINR_b_AGS2_ErrMechStuck
            access DSP_VeLINR_b_AGS2_ErrMechStuckTO_VeLINR_b_AGS2_ErrMechStuckTO: accessed-variable=VeLINR_b_AGS2_ErrMechStuckTO.VeLINR_b_AGS2_ErrMechStuckTO
        COMRXL_AGS2_ErrMechStuck_AGS2_ECM_STATUS_Lin2_Error: symbol=ApplLinComAb_LIN2_COMRXL_AGS2_ErrMechStuck_AGS2_ECM_STATUS_Lin2_Error  # Error -
          data-receive-point-by-arguments:
            access DRP_Lin2ComRxSignalsSR_COMRXL_AGS2_ErrMechStuck_AGS2_ECM_STATUS_Lin2: accessed-variable=Lin2ComRxSignalsSR.COMRXL_AGS2_ErrMechStuck_AGS2_ECM_STATUS_Lin2
          data-send-points:
            access DSP_VeLINR_b_AGS2_ErrMechStuck_VeLINR_b_AGS2_ErrMechStuck: accessed-variable=VeLINR_b_AGS2_ErrMechStuck.VeLINR_b_AGS2_ErrMechStuck
            access DSP_VeLINR_b_AGS2_ErrMechStuckTO_VeLINR_b_AGS2_ErrMechStuckTO: accessed-variable=VeLINR_b_AGS2_ErrMechStuckTO.VeLINR_b_AGS2_ErrMechStuckTO
          read-local-variables:
            access IRVRA_VeLINR_d_LIN_SlavePrsnt_LIN2: accessed-variable=VeLINR_d_LIN_SlavePrsnt_LIN2
        COMRXL_AGS2_ErrMechBreak_AGS2_ECM_STATUS_Lin2_Received: symbol=ApplLinComAb_LIN2_COMRXL_AGS2_ErrMechBreak_AGS2_ECM_STATUS_Lin2_Received  # Received -
          data-receive-point-by-arguments:
            access DRP_Lin2ComRxSignalsSR_COMRXL_AGS2_ErrMechBreak_AGS2_ECM_STATUS_Lin2: accessed-variable=Lin2ComRxSignalsSR.COMRXL_AGS2_ErrMechBreak_AGS2_ECM_STATUS_Lin2
          data-send-points:
            access DSP_VeLINR_b_AGS2_ErrMechBreak_VeLINR_b_AGS2_ErrMechBreak: accessed-variable=VeLINR_b_AGS2_ErrMechBreak.VeLINR_b_AGS2_ErrMechBreak
            access DSP_VeLINR_b_AGS2_ErrMechBreakTO_VeLINR_b_AGS2_ErrMechBreakTO: accessed-variable=VeLINR_b_AGS2_ErrMechBreakTO.VeLINR_b_AGS2_ErrMechBreakTO
        COMRXL_AGS2_ErrMechBreak_AGS2_ECM_STATUS_Lin2_Error: symbol=ApplLinComAb_LIN2_COMRXL_AGS2_ErrMechBreak_AGS2_ECM_STATUS_Lin2_Error  # Error -
          data-receive-point-by-arguments:
            access DRP_Lin2ComRxSignalsSR_COMRXL_AGS2_ErrMechBreak_AGS2_ECM_STATUS_Lin2: accessed-variable=Lin2ComRxSignalsSR.COMRXL_AGS2_ErrMechBreak_AGS2_ECM_STATUS_Lin2
          data-send-points:
            access DSP_VeLINR_b_AGS2_ErrMechBreak_VeLINR_b_AGS2_ErrMechBreak: accessed-variable=VeLINR_b_AGS2_ErrMechBreak.VeLINR_b_AGS2_ErrMechBreak
            access DSP_VeLINR_b_AGS2_ErrMechBreakTO_VeLINR_b_AGS2_ErrMechBreakTO: accessed-variable=VeLINR_b_AGS2_ErrMechBreakTO.VeLINR_b_AGS2_ErrMechBreakTO
          read-local-variables:
            access IRVRA_VeLINR_d_LIN_SlavePrsnt_LIN2: accessed-variable=VeLINR_d_LIN_SlavePrsnt_LIN2
        COMRXL_AGS2_ErrLIN_AGS2_ECM_STATUS_Lin2_Received: symbol=ApplLinComAb_LIN2_COMRXL_AGS2_ErrLIN_AGS2_ECM_STATUS_Lin2_Received  # Received -
          data-receive-point-by-arguments:
            access DRP_Lin2ComRxSignalsSR_COMRXL_AGS2_ErrLIN_AGS2_ECM_STATUS_Lin2: accessed-variable=Lin2ComRxSignalsSR.COMRXL_AGS2_ErrLIN_AGS2_ECM_STATUS_Lin2
          data-send-points:
            access DSP_VeLINR_e_AGS2_ErrLIN_VeLINR_e_AGS2_ErrLIN: accessed-variable=VeLINR_e_AGS2_ErrLIN.VeLINR_e_AGS2_ErrLIN
            access DSP_VeLINR_b_AGS2_ErrLIN_TO_VeLINR_b_AGS2_ErrLIN_TO: accessed-variable=VeLINR_b_AGS2_ErrLIN_TO.VeLINR_b_AGS2_ErrLIN_TO
        COMRXL_AGS2_ErrLIN_AGS2_ECM_STATUS_Lin2_Error: symbol=ApplLinComAb_LIN2_COMRXL_AGS2_ErrLIN_AGS2_ECM_STATUS_Lin2_Error  # Error -
          data-receive-point-by-arguments:
            access DRP_Lin2ComRxSignalsSR_COMRXL_AGS2_ErrLIN_AGS2_ECM_STATUS_Lin2: accessed-variable=Lin2ComRxSignalsSR.COMRXL_AGS2_ErrLIN_AGS2_ECM_STATUS_Lin2
          data-send-points:
            access DSP_VeLINR_e_AGS2_ErrLIN_VeLINR_e_AGS2_ErrLIN: accessed-variable=VeLINR_e_AGS2_ErrLIN.VeLINR_e_AGS2_ErrLIN
            access DSP_VeLINR_b_AGS2_ErrLIN_TO_VeLINR_b_AGS2_ErrLIN_TO: accessed-variable=VeLINR_b_AGS2_ErrLIN_TO.VeLINR_b_AGS2_ErrLIN_TO
          read-local-variables:
            access IRVRA_VeLINR_d_LIN_SlavePrsnt_LIN2: accessed-variable=VeLINR_d_LIN_SlavePrsnt_LIN2
        COMRXL_RsErr_AGS2_AGS2_ECM_STATUS_Lin2_Received: symbol=ApplLinComAb_LIN2_COMRXL_RsErr_AGS2_AGS2_ECM_STATUS_Lin2_Received  # Received -
          data-receive-point-by-arguments:
            access DRP_Lin2ComRxSignalsSR_COMRXL_RsErr_AGS2_AGS2_ECM_STATUS_Lin2: accessed-variable=Lin2ComRxSignalsSR.COMRXL_RsErr_AGS2_AGS2_ECM_STATUS_Lin2
          data-send-points:
            access DSP_VeLINR_b_RsErr_AGS2_VeLINR_b_RsErr_AGS2: accessed-variable=VeLINR_b_RsErr_AGS2.VeLINR_b_RsErr_AGS2
            access DSP_VeLINR_b_RsErr_AGS2TO_VeLINR_b_RsErr_AGS2TO: accessed-variable=VeLINR_b_RsErr_AGS2TO.VeLINR_b_RsErr_AGS2TO
        COMRXL_RsErr_AGS2_AGS2_ECM_STATUS_Lin2_Error: symbol=ApplLinComAb_LIN2_COMRXL_RsErr_AGS2_AGS2_ECM_STATUS_Lin2_Error  # Error -
          data-receive-point-by-arguments:
            access DRP_Lin2ComRxSignalsSR_COMRXL_RsErr_AGS2_AGS2_ECM_STATUS_Lin2: accessed-variable=Lin2ComRxSignalsSR.COMRXL_RsErr_AGS2_AGS2_ECM_STATUS_Lin2
          data-send-points:
            access DSP_VeLINR_b_RsErr_AGS2_VeLINR_b_RsErr_AGS2: accessed-variable=VeLINR_b_RsErr_AGS2.VeLINR_b_RsErr_AGS2
            access DSP_VeLINR_b_RsErr_AGS2TO_VeLINR_b_RsErr_AGS2TO: accessed-variable=VeLINR_b_RsErr_AGS2TO.VeLINR_b_RsErr_AGS2TO
          read-local-variables:
            access IRVRA_VeLINR_d_LIN_SlavePrsnt_LIN2: accessed-variable=VeLINR_d_LIN_SlavePrsnt_LIN2
        COMRXL_AGS2_BoostStat_AGS2_ECM_STATUS_Lin2_Received: symbol=ApplLinComAb_LIN2_COMRXL_AGS2_BoostStat_AGS2_ECM_STATUS_Lin2_Received  # Received -
          data-receive-point-by-arguments:
            access DRP_Lin2ComRxSignalsSR_COMRXL_AGS2_BoostStat_AGS2_ECM_STATUS_Lin2: accessed-variable=Lin2ComRxSignalsSR.COMRXL_AGS2_BoostStat_AGS2_ECM_STATUS_Lin2
          data-send-points:
            access DSP_VeLINR_b_AGS2_BoostStat_VeLINR_b_AGS2_BoostStat: accessed-variable=VeLINR_b_AGS2_BoostStat.VeLINR_b_AGS2_BoostStat
            access DSP_VeLINR_b_AGS2_BoostStatTO_VeLINR_b_AGS2_BoostStatTO: accessed-variable=VeLINR_b_AGS2_BoostStatTO.VeLINR_b_AGS2_BoostStatTO
        COMRXL_AGS2_BoostStat_AGS2_ECM_STATUS_Lin2_Error: symbol=ApplLinComAb_LIN2_COMRXL_AGS2_BoostStat_AGS2_ECM_STATUS_Lin2_Error  # Error -
          data-receive-point-by-arguments:
            access DRP_Lin2ComRxSignalsSR_COMRXL_AGS2_BoostStat_AGS2_ECM_STATUS_Lin2: accessed-variable=Lin2ComRxSignalsSR.COMRXL_AGS2_BoostStat_AGS2_ECM_STATUS_Lin2
          data-send-points:
            access DSP_VeLINR_b_AGS2_BoostStat_VeLINR_b_AGS2_BoostStat: accessed-variable=VeLINR_b_AGS2_BoostStat.VeLINR_b_AGS2_BoostStat
            access DSP_VeLINR_b_AGS2_BoostStatTO_VeLINR_b_AGS2_BoostStatTO: accessed-variable=VeLINR_b_AGS2_BoostStatTO.VeLINR_b_AGS2_BoostStatTO
          read-local-variables:
            access IRVRA_VeLINR_d_LIN_SlavePrsnt_LIN2: accessed-variable=VeLINR_d_LIN_SlavePrsnt_LIN2
        COMRXL_S2MResBit1_AGS2_AGS2_ECM_STATUS_Lin2_Received: symbol=ApplLinComAb_LIN2_COMRXL_S2MResBit1_AGS2_AGS2_ECM_STATUS_Lin2_Received  # Received -
          data-receive-point-by-arguments:
            access DRP_Lin2ComRxSignalsSR_COMRXL_S2MResBit1_AGS2_AGS2_ECM_STATUS_Lin2: accessed-variable=Lin2ComRxSignalsSR.COMRXL_S2MResBit1_AGS2_AGS2_ECM_STATUS_Lin2
          data-send-points:
            access DSP_VeLINR_b_S2MResBit1_AGS2_VeLINR_b_S2MResBit1_AGS2: accessed-variable=VeLINR_b_S2MResBit1_AGS2.VeLINR_b_S2MResBit1_AGS2
            access DSP_VeLINR_b_S2MResBit1_AGS2TO_VeLINR_b_S2MResBit1_AGS2TO: accessed-variable=VeLINR_b_S2MResBit1_AGS2TO.VeLINR_b_S2MResBit1_AGS2TO
        COMRXL_S2MResBit1_AGS2_AGS2_ECM_STATUS_Lin2_Error: symbol=ApplLinComAb_LIN2_COMRXL_S2MResBit1_AGS2_AGS2_ECM_STATUS_Lin2_Error  # Error -
          data-receive-point-by-arguments:
            access DRP_Lin2ComRxSignalsSR_COMRXL_S2MResBit1_AGS2_AGS2_ECM_STATUS_Lin2: accessed-variable=Lin2ComRxSignalsSR.COMRXL_S2MResBit1_AGS2_AGS2_ECM_STATUS_Lin2
          data-send-points:
            access DSP_VeLINR_b_S2MResBit1_AGS2_VeLINR_b_S2MResBit1_AGS2: accessed-variable=VeLINR_b_S2MResBit1_AGS2.VeLINR_b_S2MResBit1_AGS2
            access DSP_VeLINR_b_S2MResBit1_AGS2TO_VeLINR_b_S2MResBit1_AGS2TO: accessed-variable=VeLINR_b_S2MResBit1_AGS2TO.VeLINR_b_S2MResBit1_AGS2TO
          read-local-variables:
            access IRVRA_VeLINR_d_LIN_SlavePrsnt_LIN2: accessed-variable=VeLINR_d_LIN_SlavePrsnt_LIN2
        COMRXL_AHP_RPM_TGT_PERCT_AHP_STAT_GLOBAL_Lin2_Received: symbol=ApplLinComAb_LIN2_COMRXL_AHP_RPM_TGT_PERCT_AHP_STAT_GLOBAL_Lin2_Received  # Received -
          data-receive-point-by-arguments:
            access DRP_Lin2ComRxSignalsSR_COMRXL_AHP_RPM_TGT_PERCT_AHP_STAT_GLOBAL_Lin2: accessed-variable=Lin2ComRxSignalsSR.COMRXL_AHP_RPM_TGT_PERCT_AHP_STAT_GLOBAL_Lin2
          data-send-points:
            access DSP_VeLINR_Pct_AHP_RPM_TGT_PERCT_VeLINR_Pct_AHP_RPM_TGT_PERCT: accessed-variable=VeLINR_Pct_AHP_RPM_TGT_PERCT.VeLINR_Pct_AHP_RPM_TGT_PERCT
            access DSP_VeLINR_b_AHP_RPM_TGT_PERCT_TO_VeLINR_b_AHP_RPM_TGT_PERCT_TO: accessed-variable=VeLINR_b_AHP_RPM_TGT_PERCT_TO.VeLINR_b_AHP_RPM_TGT_PERCT_TO
        COMRXL_AHP_RPM_TGT_PERCT_AHP_STAT_GLOBAL_Lin2_Error: symbol=ApplLinComAb_LIN2_COMRXL_AHP_RPM_TGT_PERCT_AHP_STAT_GLOBAL_Lin2_Error  # Error -
          data-receive-point-by-arguments:
            access DRP_Lin2ComRxSignalsSR_COMRXL_AHP_RPM_TGT_PERCT_AHP_STAT_GLOBAL_Lin2: accessed-variable=Lin2ComRxSignalsSR.COMRXL_AHP_RPM_TGT_PERCT_AHP_STAT_GLOBAL_Lin2
          data-send-points:
            access DSP_VeLINR_Pct_AHP_RPM_TGT_PERCT_VeLINR_Pct_AHP_RPM_TGT_PERCT: accessed-variable=VeLINR_Pct_AHP_RPM_TGT_PERCT.VeLINR_Pct_AHP_RPM_TGT_PERCT
            access DSP_VeLINR_b_AHP_RPM_TGT_PERCT_TO_VeLINR_b_AHP_RPM_TGT_PERCT_TO: accessed-variable=VeLINR_b_AHP_RPM_TGT_PERCT_TO.VeLINR_b_AHP_RPM_TGT_PERCT_TO
          read-local-variables:
            access IRVRA_VeLINR_d_LIN_SlavePrsnt_LIN2: accessed-variable=VeLINR_d_LIN_SlavePrsnt_LIN2
        COMRXL_AHP_RPM_ACTL_PERCT_AHP_STAT_GLOBAL_Lin2_Received: symbol=ApplLinComAb_LIN2_COMRXL_AHP_RPM_ACTL_PERCT_AHP_STAT_GLOBAL_Lin2_Received  # Received -
          data-receive-point-by-arguments:
            access DRP_Lin2ComRxSignalsSR_COMRXL_AHP_RPM_ACTL_PERCT_AHP_STAT_GLOBAL_Lin2: accessed-variable=Lin2ComRxSignalsSR.COMRXL_AHP_RPM_ACTL_PERCT_AHP_STAT_GLOBAL_Lin2
          data-send-points:
            access DSP_VeLINR_Pct_AHP_RPM_ACTL_PERCT_VeLINR_Pct_AHP_RPM_ACTL_PERCT: accessed-variable=VeLINR_Pct_AHP_RPM_ACTL_PERCT.VeLINR_Pct_AHP_RPM_ACTL_PERCT
            access DSP_VeLINR_b_AHP_RPM_ACTL_PERCT_TO_VeLINR_b_AHP_RPM_ACTL_PERCT_TO: accessed-variable=VeLINR_b_AHP_RPM_ACTL_PERCT_TO.VeLINR_b_AHP_RPM_ACTL_PERCT_TO
        COMRXL_AHP_RPM_ACTL_PERCT_AHP_STAT_GLOBAL_Lin2_Error: symbol=ApplLinComAb_LIN2_COMRXL_AHP_RPM_ACTL_PERCT_AHP_STAT_GLOBAL_Lin2_Error  # Error -
          data-receive-point-by-arguments:
            access DRP_Lin2ComRxSignalsSR_COMRXL_AHP_RPM_ACTL_PERCT_AHP_STAT_GLOBAL_Lin2: accessed-variable=Lin2ComRxSignalsSR.COMRXL_AHP_RPM_ACTL_PERCT_AHP_STAT_GLOBAL_Lin2
          data-send-points:
            access DSP_VeLINR_Pct_AHP_RPM_ACTL_PERCT_VeLINR_Pct_AHP_RPM_ACTL_PERCT: accessed-variable=VeLINR_Pct_AHP_RPM_ACTL_PERCT.VeLINR_Pct_AHP_RPM_ACTL_PERCT
            access DSP_VeLINR_b_AHP_RPM_ACTL_PERCT_TO_VeLINR_b_AHP_RPM_ACTL_PERCT_TO: accessed-variable=VeLINR_b_AHP_RPM_ACTL_PERCT_TO.VeLINR_b_AHP_RPM_ACTL_PERCT_TO
          read-local-variables:
            access IRVRA_VeLINR_d_LIN_SlavePrsnt_LIN2: accessed-variable=VeLINR_d_LIN_SlavePrsnt_LIN2
        COMRXL_AHP_VLTG_AHP_STAT_GLOBAL_Lin2_Received: symbol=ApplLinComAb_LIN2_COMRXL_AHP_VLTG_AHP_STAT_GLOBAL_Lin2_Received  # Received -
          data-receive-point-by-arguments:
            access DRP_Lin2ComRxSignalsSR_COMRXL_AHP_VLTG_AHP_STAT_GLOBAL_Lin2: accessed-variable=Lin2ComRxSignalsSR.COMRXL_AHP_VLTG_AHP_STAT_GLOBAL_Lin2
          data-send-points:
            access DSP_VeLINR_U_AHP_VLTG_VeLINR_U_AHP_VLTG: accessed-variable=VeLINR_U_AHP_VLTG.VeLINR_U_AHP_VLTG
            access DSP_VeLINR_b_AHP_VLTG_TO_VeLINR_b_AHP_VLTG_TO: accessed-variable=VeLINR_b_AHP_VLTG_TO.VeLINR_b_AHP_VLTG_TO
        COMRXL_AHP_VLTG_AHP_STAT_GLOBAL_Lin2_Error: symbol=ApplLinComAb_LIN2_COMRXL_AHP_VLTG_AHP_STAT_GLOBAL_Lin2_Error  # Error -
          data-receive-point-by-arguments:
            access DRP_Lin2ComRxSignalsSR_COMRXL_AHP_VLTG_AHP_STAT_GLOBAL_Lin2: accessed-variable=Lin2ComRxSignalsSR.COMRXL_AHP_VLTG_AHP_STAT_GLOBAL_Lin2
          data-send-points:
            access DSP_VeLINR_U_AHP_VLTG_VeLINR_U_AHP_VLTG: accessed-variable=VeLINR_U_AHP_VLTG.VeLINR_U_AHP_VLTG
            access DSP_VeLINR_b_AHP_VLTG_TO_VeLINR_b_AHP_VLTG_TO: accessed-variable=VeLINR_b_AHP_VLTG_TO.VeLINR_b_AHP_VLTG_TO
          read-local-variables:
            access IRVRA_VeLINR_d_LIN_SlavePrsnt_LIN2: accessed-variable=VeLINR_d_LIN_SlavePrsnt_LIN2
        COMRXL_AHP_TEMP_AHP_STAT_GLOBAL_Lin2_Received: symbol=ApplLinComAb_LIN2_COMRXL_AHP_TEMP_AHP_STAT_GLOBAL_Lin2_Received  # Received -
          data-receive-point-by-arguments:
            access DRP_Lin2ComRxSignalsSR_COMRXL_AHP_TEMP_AHP_STAT_GLOBAL_Lin2: accessed-variable=Lin2ComRxSignalsSR.COMRXL_AHP_TEMP_AHP_STAT_GLOBAL_Lin2
          data-send-points:
            access DSP_VeLINR_T_AHP_TEMP_VeLINR_T_AHP_TEMP: accessed-variable=VeLINR_T_AHP_TEMP.VeLINR_T_AHP_TEMP
            access DSP_VeLINR_b_AHP_TEMP_TO_VeLINR_b_AHP_TEMP_TO: accessed-variable=VeLINR_b_AHP_TEMP_TO.VeLINR_b_AHP_TEMP_TO
        COMRXL_AHP_TEMP_AHP_STAT_GLOBAL_Lin2_Error: symbol=ApplLinComAb_LIN2_COMRXL_AHP_TEMP_AHP_STAT_GLOBAL_Lin2_Error  # Error -
          data-receive-point-by-arguments:
            access DRP_Lin2ComRxSignalsSR_COMRXL_AHP_TEMP_AHP_STAT_GLOBAL_Lin2: accessed-variable=Lin2ComRxSignalsSR.COMRXL_AHP_TEMP_AHP_STAT_GLOBAL_Lin2
          data-send-points:
            access DSP_VeLINR_T_AHP_TEMP_VeLINR_T_AHP_TEMP: accessed-variable=VeLINR_T_AHP_TEMP.VeLINR_T_AHP_TEMP
            access DSP_VeLINR_b_AHP_TEMP_TO_VeLINR_b_AHP_TEMP_TO: accessed-variable=VeLINR_b_AHP_TEMP_TO.VeLINR_b_AHP_TEMP_TO
          read-local-variables:
            access IRVRA_VeLINR_d_LIN_SlavePrsnt_LIN2: accessed-variable=VeLINR_d_LIN_SlavePrsnt_LIN2
        COMRXL_AHP_CURR_AHP_STAT_GLOBAL_Lin2_Received: symbol=ApplLinComAb_LIN2_COMRXL_AHP_CURR_AHP_STAT_GLOBAL_Lin2_Received  # Received -
          data-receive-point-by-arguments:
            access DRP_Lin2ComRxSignalsSR_COMRXL_AHP_CURR_AHP_STAT_GLOBAL_Lin2: accessed-variable=Lin2ComRxSignalsSR.COMRXL_AHP_CURR_AHP_STAT_GLOBAL_Lin2
          data-send-points:
            access DSP_VeLINR_I_AHP_CURR_VeLINR_I_AHP_CURR: accessed-variable=VeLINR_I_AHP_CURR.VeLINR_I_AHP_CURR
            access DSP_VeLINR_b_AHP_CURR_TO_VeLINR_b_AHP_CURR_TO: accessed-variable=VeLINR_b_AHP_CURR_TO.VeLINR_b_AHP_CURR_TO
        COMRXL_AHP_CURR_AHP_STAT_GLOBAL_Lin2_Error: symbol=ApplLinComAb_LIN2_COMRXL_AHP_CURR_AHP_STAT_GLOBAL_Lin2_Error  # Error -
          data-receive-point-by-arguments:
            access DRP_Lin2ComRxSignalsSR_COMRXL_AHP_CURR_AHP_STAT_GLOBAL_Lin2: accessed-variable=Lin2ComRxSignalsSR.COMRXL_AHP_CURR_AHP_STAT_GLOBAL_Lin2
          data-send-points:
            access DSP_VeLINR_I_AHP_CURR_VeLINR_I_AHP_CURR: accessed-variable=VeLINR_I_AHP_CURR.VeLINR_I_AHP_CURR
            access DSP_VeLINR_b_AHP_CURR_TO_VeLINR_b_AHP_CURR_TO: accessed-variable=VeLINR_b_AHP_CURR_TO.VeLINR_b_AHP_CURR_TO
          read-local-variables:
            access IRVRA_VeLINR_d_LIN_SlavePrsnt_LIN2: accessed-variable=VeLINR_d_LIN_SlavePrsnt_LIN2
        COMRXL_AHP_FL_SAFE_ACTVTD_AHP_STAT_GLOBAL_Lin2_Received: symbol=ApplLinComAb_LIN2_COMRXL_AHP_FL_SAFE_ACTVTD_AHP_STAT_GLOBAL_Lin2_Received  # Received -
          data-receive-point-by-arguments:
            access DRP_Lin2ComRxSignalsSR_COMRXL_AHP_FL_SAFE_ACTVTD_AHP_STAT_GLOBAL_Lin2: accessed-variable=Lin2ComRxSignalsSR.COMRXL_AHP_FL_SAFE_ACTVTD_AHP_STAT_GLOBAL_Lin2
          data-send-points:
            access DSP_VeLINR_e_AHP_FL_SAFE_ACTVTD_VeLINR_e_AHP_FL_SAFE_ACTVTD: accessed-variable=VeLINR_e_AHP_FL_SAFE_ACTVTD.VeLINR_e_AHP_FL_SAFE_ACTVTD
            access DSP_VeLINR_b_AHP_FL_SAFE_ACTVTD_TO_VeLINR_b_AHP_FL_SAFE_ACTVTD_TO: accessed-variable=VeLINR_b_AHP_FL_SAFE_ACTVTD_TO.VeLINR_b_AHP_FL_SAFE_ACTVTD_TO
        COMRXL_AHP_FL_SAFE_ACTVTD_AHP_STAT_GLOBAL_Lin2_Error: symbol=ApplLinComAb_LIN2_COMRXL_AHP_FL_SAFE_ACTVTD_AHP_STAT_GLOBAL_Lin2_Error  # Error -
          data-receive-point-by-arguments:
            access DRP_Lin2ComRxSignalsSR_COMRXL_AHP_FL_SAFE_ACTVTD_AHP_STAT_GLOBAL_Lin2: accessed-variable=Lin2ComRxSignalsSR.COMRXL_AHP_FL_SAFE_ACTVTD_AHP_STAT_GLOBAL_Lin2
          data-send-points:
            access DSP_VeLINR_e_AHP_FL_SAFE_ACTVTD_VeLINR_e_AHP_FL_SAFE_ACTVTD: accessed-variable=VeLINR_e_AHP_FL_SAFE_ACTVTD.VeLINR_e_AHP_FL_SAFE_ACTVTD
            access DSP_VeLINR_b_AHP_FL_SAFE_ACTVTD_TO_VeLINR_b_AHP_FL_SAFE_ACTVTD_TO: accessed-variable=VeLINR_b_AHP_FL_SAFE_ACTVTD_TO.VeLINR_b_AHP_FL_SAFE_ACTVTD_TO
          read-local-variables:
            access IRVRA_VeLINR_d_LIN_SlavePrsnt_LIN2: accessed-variable=VeLINR_d_LIN_SlavePrsnt_LIN2
        COMRXL_AHP_LMP_HM_AN_ON_AHP_STAT_GLOBAL_Lin2_Received: symbol=ApplLinComAb_LIN2_COMRXL_AHP_LMP_HM_AN_ON_AHP_STAT_GLOBAL_Lin2_Received  # Received -
          data-receive-point-by-arguments:
            access DRP_Lin2ComRxSignalsSR_COMRXL_AHP_LMP_HM_AN_ON_AHP_STAT_GLOBAL_Lin2: accessed-variable=Lin2ComRxSignalsSR.COMRXL_AHP_LMP_HM_AN_ON_AHP_STAT_GLOBAL_Lin2
          data-send-points:
            access DSP_VeLINR_e_AHP_LMP_HM_AN_ON_VeLINR_e_AHP_LMP_HM_AN_ON: accessed-variable=VeLINR_e_AHP_LMP_HM_AN_ON.VeLINR_e_AHP_LMP_HM_AN_ON
            access DSP_VeLINR_b_AHP_LMP_HM_AN_ON_TO_VeLINR_b_AHP_LMP_HM_AN_ON_TO: accessed-variable=VeLINR_b_AHP_LMP_HM_AN_ON_TO.VeLINR_b_AHP_LMP_HM_AN_ON_TO
        COMRXL_AHP_LMP_HM_AN_ON_AHP_STAT_GLOBAL_Lin2_Error: symbol=ApplLinComAb_LIN2_COMRXL_AHP_LMP_HM_AN_ON_AHP_STAT_GLOBAL_Lin2_Error  # Error -
          data-receive-point-by-arguments:
            access DRP_Lin2ComRxSignalsSR_COMRXL_AHP_LMP_HM_AN_ON_AHP_STAT_GLOBAL_Lin2: accessed-variable=Lin2ComRxSignalsSR.COMRXL_AHP_LMP_HM_AN_ON_AHP_STAT_GLOBAL_Lin2
          data-send-points:
            access DSP_VeLINR_e_AHP_LMP_HM_AN_ON_VeLINR_e_AHP_LMP_HM_AN_ON: accessed-variable=VeLINR_e_AHP_LMP_HM_AN_ON.VeLINR_e_AHP_LMP_HM_AN_ON
            access DSP_VeLINR_b_AHP_LMP_HM_AN_ON_TO_VeLINR_b_AHP_LMP_HM_AN_ON_TO: accessed-variable=VeLINR_b_AHP_LMP_HM_AN_ON_TO.VeLINR_b_AHP_LMP_HM_AN_ON_TO
          read-local-variables:
            access IRVRA_VeLINR_d_LIN_SlavePrsnt_LIN2: accessed-variable=VeLINR_d_LIN_SlavePrsnt_LIN2
        COMRXL_AHP_AIR_PRE_ERR_AHP_STAT_GLOBAL_Lin2_Received: symbol=ApplLinComAb_LIN2_COMRXL_AHP_AIR_PRE_ERR_AHP_STAT_GLOBAL_Lin2_Received  # Received -
          data-receive-point-by-arguments:
            access DRP_Lin2ComRxSignalsSR_COMRXL_AHP_AIR_PRE_ERR_AHP_STAT_GLOBAL_Lin2: accessed-variable=Lin2ComRxSignalsSR.COMRXL_AHP_AIR_PRE_ERR_AHP_STAT_GLOBAL_Lin2
          data-send-points:
            access DSP_VeLINR_e_AHP_AIR_PRE_ERR_VeLINR_e_AHP_AIR_PRE_ERR: accessed-variable=VeLINR_e_AHP_AIR_PRE_ERR.VeLINR_e_AHP_AIR_PRE_ERR
            access DSP_VeLINR_b_AHP_AIR_PRE_ERR_TO_VeLINR_b_AHP_AIR_PRE_ERR_TO: accessed-variable=VeLINR_b_AHP_AIR_PRE_ERR_TO.VeLINR_b_AHP_AIR_PRE_ERR_TO
        COMRXL_AHP_AIR_PRE_ERR_AHP_STAT_GLOBAL_Lin2_Error: symbol=ApplLinComAb_LIN2_COMRXL_AHP_AIR_PRE_ERR_AHP_STAT_GLOBAL_Lin2_Error  # Error -
          data-receive-point-by-arguments:
            access DRP_Lin2ComRxSignalsSR_COMRXL_AHP_AIR_PRE_ERR_AHP_STAT_GLOBAL_Lin2: accessed-variable=Lin2ComRxSignalsSR.COMRXL_AHP_AIR_PRE_ERR_AHP_STAT_GLOBAL_Lin2
          data-send-points:
            access DSP_VeLINR_e_AHP_AIR_PRE_ERR_VeLINR_e_AHP_AIR_PRE_ERR: accessed-variable=VeLINR_e_AHP_AIR_PRE_ERR.VeLINR_e_AHP_AIR_PRE_ERR
            access DSP_VeLINR_b_AHP_AIR_PRE_ERR_TO_VeLINR_b_AHP_AIR_PRE_ERR_TO: accessed-variable=VeLINR_b_AHP_AIR_PRE_ERR_TO.VeLINR_b_AHP_AIR_PRE_ERR_TO
          read-local-variables:
            access IRVRA_VeLINR_d_LIN_SlavePrsnt_LIN2: accessed-variable=VeLINR_d_LIN_SlavePrsnt_LIN2
        COMRXL_AHP_OVR_TMP_ERR_AHP_STAT_GLOBAL_Lin2_Received: symbol=ApplLinComAb_LIN2_COMRXL_AHP_OVR_TMP_ERR_AHP_STAT_GLOBAL_Lin2_Received  # Received -
          data-receive-point-by-arguments:
            access DRP_Lin2ComRxSignalsSR_COMRXL_AHP_OVR_TMP_ERR_AHP_STAT_GLOBAL_Lin2: accessed-variable=Lin2ComRxSignalsSR.COMRXL_AHP_OVR_TMP_ERR_AHP_STAT_GLOBAL_Lin2
          data-send-points:
            access DSP_VeLINR_e_AHP_OVR_TMP_ERR_VeLINR_e_AHP_OVR_TMP_ERR: accessed-variable=VeLINR_e_AHP_OVR_TMP_ERR.VeLINR_e_AHP_OVR_TMP_ERR
            access DSP_VeLINR_b_AHP_OVR_TMP_ERR_TO_VeLINR_b_AHP_OVR_TMP_ERR_TO: accessed-variable=VeLINR_b_AHP_OVR_TMP_ERR_TO.VeLINR_b_AHP_OVR_TMP_ERR_TO
        COMRXL_AHP_OVR_TMP_ERR_AHP_STAT_GLOBAL_Lin2_Error: symbol=ApplLinComAb_LIN2_COMRXL_AHP_OVR_TMP_ERR_AHP_STAT_GLOBAL_Lin2_Error  # Error -
          data-receive-point-by-arguments:
            access DRP_Lin2ComRxSignalsSR_COMRXL_AHP_OVR_TMP_ERR_AHP_STAT_GLOBAL_Lin2: accessed-variable=Lin2ComRxSignalsSR.COMRXL_AHP_OVR_TMP_ERR_AHP_STAT_GLOBAL_Lin2
          data-send-points:
            access DSP_VeLINR_e_AHP_OVR_TMP_ERR_VeLINR_e_AHP_OVR_TMP_ERR: accessed-variable=VeLINR_e_AHP_OVR_TMP_ERR.VeLINR_e_AHP_OVR_TMP_ERR
            access DSP_VeLINR_b_AHP_OVR_TMP_ERR_TO_VeLINR_b_AHP_OVR_TMP_ERR_TO: accessed-variable=VeLINR_b_AHP_OVR_TMP_ERR_TO.VeLINR_b_AHP_OVR_TMP_ERR_TO
          read-local-variables:
            access IRVRA_VeLINR_d_LIN_SlavePrsnt_LIN2: accessed-variable=VeLINR_d_LIN_SlavePrsnt_LIN2
        COMRXL_AHP_OVR_CUR_ERR_AHP_STAT_GLOBAL_Lin2_Received: symbol=ApplLinComAb_LIN2_COMRXL_AHP_OVR_CUR_ERR_AHP_STAT_GLOBAL_Lin2_Received  # Received -
          data-receive-point-by-arguments:
            access DRP_Lin2ComRxSignalsSR_COMRXL_AHP_OVR_CUR_ERR_AHP_STAT_GLOBAL_Lin2: accessed-variable=Lin2ComRxSignalsSR.COMRXL_AHP_OVR_CUR_ERR_AHP_STAT_GLOBAL_Lin2
          data-send-points:
            access DSP_VeLINR_e_AHP_OVR_CUR_ERR_VeLINR_e_AHP_OVR_CUR_ERR: accessed-variable=VeLINR_e_AHP_OVR_CUR_ERR.VeLINR_e_AHP_OVR_CUR_ERR
            access DSP_VeLINR_b_AHP_OVR_CUR_ERR_TO_VeLINR_b_AHP_OVR_CUR_ERR_TO: accessed-variable=VeLINR_b_AHP_OVR_CUR_ERR_TO.VeLINR_b_AHP_OVR_CUR_ERR_TO
        COMRXL_AHP_OVR_CUR_ERR_AHP_STAT_GLOBAL_Lin2_Error: symbol=ApplLinComAb_LIN2_COMRXL_AHP_OVR_CUR_ERR_AHP_STAT_GLOBAL_Lin2_Error  # Error -
          data-receive-point-by-arguments:
            access DRP_Lin2ComRxSignalsSR_COMRXL_AHP_OVR_CUR_ERR_AHP_STAT_GLOBAL_Lin2: accessed-variable=Lin2ComRxSignalsSR.COMRXL_AHP_OVR_CUR_ERR_AHP_STAT_GLOBAL_Lin2
          data-send-points:
            access DSP_VeLINR_e_AHP_OVR_CUR_ERR_VeLINR_e_AHP_OVR_CUR_ERR: accessed-variable=VeLINR_e_AHP_OVR_CUR_ERR.VeLINR_e_AHP_OVR_CUR_ERR
            access DSP_VeLINR_b_AHP_OVR_CUR_ERR_TO_VeLINR_b_AHP_OVR_CUR_ERR_TO: accessed-variable=VeLINR_b_AHP_OVR_CUR_ERR_TO.VeLINR_b_AHP_OVR_CUR_ERR_TO
          read-local-variables:
            access IRVRA_VeLINR_d_LIN_SlavePrsnt_LIN2: accessed-variable=VeLINR_d_LIN_SlavePrsnt_LIN2
        COMRXL_AHP_DR_RN_ERR_AHP_STAT_GLOBAL_Lin2_Received: symbol=ApplLinComAb_LIN2_COMRXL_AHP_DR_RN_ERR_AHP_STAT_GLOBAL_Lin2_Received  # Received -
          data-receive-point-by-arguments:
            access DRP_Lin2ComRxSignalsSR_COMRXL_AHP_DR_RN_ERR_AHP_STAT_GLOBAL_Lin2: accessed-variable=Lin2ComRxSignalsSR.COMRXL_AHP_DR_RN_ERR_AHP_STAT_GLOBAL_Lin2
          data-send-points:
            access DSP_VeLINR_e_AHP_DR_RN_ERR_VeLINR_e_AHP_DR_RN_ERR: accessed-variable=VeLINR_e_AHP_DR_RN_ERR.VeLINR_e_AHP_DR_RN_ERR
            access DSP_VeLINR_b_AHP_DR_RN_ERR_TO_VeLINR_b_AHP_DR_RN_ERR_TO: accessed-variable=VeLINR_b_AHP_DR_RN_ERR_TO.VeLINR_b_AHP_DR_RN_ERR_TO
        COMRXL_AHP_DR_RN_ERR_AHP_STAT_GLOBAL_Lin2_Error: symbol=ApplLinComAb_LIN2_COMRXL_AHP_DR_RN_ERR_AHP_STAT_GLOBAL_Lin2_Error  # Error -
          data-receive-point-by-arguments:
            access DRP_Lin2ComRxSignalsSR_COMRXL_AHP_DR_RN_ERR_AHP_STAT_GLOBAL_Lin2: accessed-variable=Lin2ComRxSignalsSR.COMRXL_AHP_DR_RN_ERR_AHP_STAT_GLOBAL_Lin2
          data-send-points:
            access DSP_VeLINR_e_AHP_DR_RN_ERR_VeLINR_e_AHP_DR_RN_ERR: accessed-variable=VeLINR_e_AHP_DR_RN_ERR.VeLINR_e_AHP_DR_RN_ERR
            access DSP_VeLINR_b_AHP_DR_RN_ERR_TO_VeLINR_b_AHP_DR_RN_ERR_TO: accessed-variable=VeLINR_b_AHP_DR_RN_ERR_TO.VeLINR_b_AHP_DR_RN_ERR_TO
          read-local-variables:
            access IRVRA_VeLINR_d_LIN_SlavePrsnt_LIN2: accessed-variable=VeLINR_d_LIN_SlavePrsnt_LIN2
        COMRXL_AHP_VLTG_ERR_AHP_STAT_GLOBAL_Lin2_Received: symbol=ApplLinComAb_LIN2_COMRXL_AHP_VLTG_ERR_AHP_STAT_GLOBAL_Lin2_Received  # Received -
          data-receive-point-by-arguments:
            access DRP_Lin2ComRxSignalsSR_COMRXL_AHP_VLTG_ERR_AHP_STAT_GLOBAL_Lin2: accessed-variable=Lin2ComRxSignalsSR.COMRXL_AHP_VLTG_ERR_AHP_STAT_GLOBAL_Lin2
          data-send-points:
            access DSP_VeLINR_e_AHP_VLTG_ERR_VeLINR_e_AHP_VLTG_ERR: accessed-variable=VeLINR_e_AHP_VLTG_ERR.VeLINR_e_AHP_VLTG_ERR
            access DSP_VeLINR_b_AHP_VLTG_ERR_TO_VeLINR_b_AHP_VLTG_ERR_TO: accessed-variable=VeLINR_b_AHP_VLTG_ERR_TO.VeLINR_b_AHP_VLTG_ERR_TO
        COMRXL_AHP_VLTG_ERR_AHP_STAT_GLOBAL_Lin2_Error: symbol=ApplLinComAb_LIN2_COMRXL_AHP_VLTG_ERR_AHP_STAT_GLOBAL_Lin2_Error  # Error -
          data-receive-point-by-arguments:
            access DRP_Lin2ComRxSignalsSR_COMRXL_AHP_VLTG_ERR_AHP_STAT_GLOBAL_Lin2: accessed-variable=Lin2ComRxSignalsSR.COMRXL_AHP_VLTG_ERR_AHP_STAT_GLOBAL_Lin2
          data-send-points:
            access DSP_VeLINR_e_AHP_VLTG_ERR_VeLINR_e_AHP_VLTG_ERR: accessed-variable=VeLINR_e_AHP_VLTG_ERR.VeLINR_e_AHP_VLTG_ERR
            access DSP_VeLINR_b_AHP_VLTG_ERR_TO_VeLINR_b_AHP_VLTG_ERR_TO: accessed-variable=VeLINR_b_AHP_VLTG_ERR_TO.VeLINR_b_AHP_VLTG_ERR_TO
          read-local-variables:
            access IRVRA_VeLINR_d_LIN_SlavePrsnt_LIN2: accessed-variable=VeLINR_d_LIN_SlavePrsnt_LIN2
        COMRXL_AHP_DBLK_ACTV_AHP_STAT_GLOBAL_Lin2_Received: symbol=ApplLinComAb_LIN2_COMRXL_AHP_DBLK_ACTV_AHP_STAT_GLOBAL_Lin2_Received  # Received -
          data-receive-point-by-arguments:
            access DRP_Lin2ComRxSignalsSR_COMRXL_AHP_DBLK_ACTV_AHP_STAT_GLOBAL_Lin2: accessed-variable=Lin2ComRxSignalsSR.COMRXL_AHP_DBLK_ACTV_AHP_STAT_GLOBAL_Lin2
          data-send-points:
            access DSP_VeLINR_e_AHP_DBLK_ACTV_VeLINR_e_AHP_DBLK_ACTV: accessed-variable=VeLINR_e_AHP_DBLK_ACTV.VeLINR_e_AHP_DBLK_ACTV
            access DSP_VeLINR_b_AHP_DBLK_ACTV_TO_VeLINR_b_AHP_DBLK_ACTV_TO: accessed-variable=VeLINR_b_AHP_DBLK_ACTV_TO.VeLINR_b_AHP_DBLK_ACTV_TO
        COMRXL_AHP_DBLK_ACTV_AHP_STAT_GLOBAL_Lin2_Error: symbol=ApplLinComAb_LIN2_COMRXL_AHP_DBLK_ACTV_AHP_STAT_GLOBAL_Lin2_Error  # Error -
          data-receive-point-by-arguments:
            access DRP_Lin2ComRxSignalsSR_COMRXL_AHP_DBLK_ACTV_AHP_STAT_GLOBAL_Lin2: accessed-variable=Lin2ComRxSignalsSR.COMRXL_AHP_DBLK_ACTV_AHP_STAT_GLOBAL_Lin2
          data-send-points:
            access DSP_VeLINR_e_AHP_DBLK_ACTV_VeLINR_e_AHP_DBLK_ACTV: accessed-variable=VeLINR_e_AHP_DBLK_ACTV.VeLINR_e_AHP_DBLK_ACTV
            access DSP_VeLINR_b_AHP_DBLK_ACTV_TO_VeLINR_b_AHP_DBLK_ACTV_TO: accessed-variable=VeLINR_b_AHP_DBLK_ACTV_TO.VeLINR_b_AHP_DBLK_ACTV_TO
          read-local-variables:
            access IRVRA_VeLINR_d_LIN_SlavePrsnt_LIN2: accessed-variable=VeLINR_d_LIN_SlavePrsnt_LIN2
        COMRXL_AHP_MONTRNG_RPM_AHP_STAT_GLOBAL_Lin2_Received: symbol=ApplLinComAb_LIN2_COMRXL_AHP_MONTRNG_RPM_AHP_STAT_GLOBAL_Lin2_Received  # Received -
          data-receive-point-by-arguments:
            access DRP_Lin2ComRxSignalsSR_COMRXL_AHP_MONTRNG_RPM_AHP_STAT_GLOBAL_Lin2: accessed-variable=Lin2ComRxSignalsSR.COMRXL_AHP_MONTRNG_RPM_AHP_STAT_GLOBAL_Lin2
          data-send-points:
            access DSP_VeLINR_e_AHP_MONTRNG_RPM_VeLINR_e_AHP_MONTRNG_RPM: accessed-variable=VeLINR_e_AHP_MONTRNG_RPM.VeLINR_e_AHP_MONTRNG_RPM
            access DSP_VeLINR_b_AHP_MONTRNG_RPM_TO_VeLINR_b_AHP_MONTRNG_RPM_TO: accessed-variable=VeLINR_b_AHP_MONTRNG_RPM_TO.VeLINR_b_AHP_MONTRNG_RPM_TO
        COMRXL_AHP_MONTRNG_RPM_AHP_STAT_GLOBAL_Lin2_Error: symbol=ApplLinComAb_LIN2_COMRXL_AHP_MONTRNG_RPM_AHP_STAT_GLOBAL_Lin2_Error  # Error -
          data-receive-point-by-arguments:
            access DRP_Lin2ComRxSignalsSR_COMRXL_AHP_MONTRNG_RPM_AHP_STAT_GLOBAL_Lin2: accessed-variable=Lin2ComRxSignalsSR.COMRXL_AHP_MONTRNG_RPM_AHP_STAT_GLOBAL_Lin2
          data-send-points:
            access DSP_VeLINR_e_AHP_MONTRNG_RPM_VeLINR_e_AHP_MONTRNG_RPM: accessed-variable=VeLINR_e_AHP_MONTRNG_RPM.VeLINR_e_AHP_MONTRNG_RPM
            access DSP_VeLINR_b_AHP_MONTRNG_RPM_TO_VeLINR_b_AHP_MONTRNG_RPM_TO: accessed-variable=VeLINR_b_AHP_MONTRNG_RPM_TO.VeLINR_b_AHP_MONTRNG_RPM_TO
          read-local-variables:
            access IRVRA_VeLINR_d_LIN_SlavePrsnt_LIN2: accessed-variable=VeLINR_d_LIN_SlavePrsnt_LIN2
        COMRXL_AHP_NODE_ERR_AHP_STAT_GLOBAL_Lin2_Received: symbol=ApplLinComAb_LIN2_COMRXL_AHP_NODE_ERR_AHP_STAT_GLOBAL_Lin2_Received  # Received -
          data-receive-point-by-arguments:
            access DRP_Lin2ComRxSignalsSR_COMRXL_AHP_NODE_ERR_AHP_STAT_GLOBAL_Lin2: accessed-variable=Lin2ComRxSignalsSR.COMRXL_AHP_NODE_ERR_AHP_STAT_GLOBAL_Lin2
          data-send-points:
            access DSP_VeLINR_e_AHP_NODE_ERR_VeLINR_e_AHP_NODE_ERR: accessed-variable=VeLINR_e_AHP_NODE_ERR.VeLINR_e_AHP_NODE_ERR
            access DSP_VeLINR_b_AHP_NODE_ERR_TO_VeLINR_b_AHP_NODE_ERR_TO: accessed-variable=VeLINR_b_AHP_NODE_ERR_TO.VeLINR_b_AHP_NODE_ERR_TO
        COMRXL_AHP_NODE_ERR_AHP_STAT_GLOBAL_Lin2_Error: symbol=ApplLinComAb_LIN2_COMRXL_AHP_NODE_ERR_AHP_STAT_GLOBAL_Lin2_Error  # Error -
          data-receive-point-by-arguments:
            access DRP_Lin2ComRxSignalsSR_COMRXL_AHP_NODE_ERR_AHP_STAT_GLOBAL_Lin2: accessed-variable=Lin2ComRxSignalsSR.COMRXL_AHP_NODE_ERR_AHP_STAT_GLOBAL_Lin2
          data-send-points:
            access DSP_VeLINR_e_AHP_NODE_ERR_VeLINR_e_AHP_NODE_ERR: accessed-variable=VeLINR_e_AHP_NODE_ERR.VeLINR_e_AHP_NODE_ERR
            access DSP_VeLINR_b_AHP_NODE_ERR_TO_VeLINR_b_AHP_NODE_ERR_TO: accessed-variable=VeLINR_b_AHP_NODE_ERR_TO.VeLINR_b_AHP_NODE_ERR_TO
          read-local-variables:
            access IRVRA_VeLINR_d_LIN_SlavePrsnt_LIN2: accessed-variable=VeLINR_d_LIN_SlavePrsnt_LIN2
        COMRXL_AHP_POST_RUN_STAT_AHP_STAT_GLOBAL_Lin2_Received: symbol=ApplLinComAb_LIN2_COMRXL_AHP_POST_RUN_STAT_AHP_STAT_GLOBAL_Lin2_Received  # Received -
          data-receive-point-by-arguments:
            access DRP_Lin2ComRxSignalsSR_COMRXL_AHP_POST_RUN_STAT_AHP_STAT_GLOBAL_Lin2: accessed-variable=Lin2ComRxSignalsSR.COMRXL_AHP_POST_RUN_STAT_AHP_STAT_GLOBAL_Lin2
          data-send-points:
            access DSP_VeLINR_e_AHP_POST_RUN_STAT_VeLINR_e_AHP_POST_RUN_STAT: accessed-variable=VeLINR_e_AHP_POST_RUN_STAT.VeLINR_e_AHP_POST_RUN_STAT
            access DSP_VeLINR_b_AHP_POST_RUN_STAT_TO_VeLINR_b_AHP_POST_RUN_STAT_TO: accessed-variable=VeLINR_b_AHP_POST_RUN_STAT_TO.VeLINR_b_AHP_POST_RUN_STAT_TO
        COMRXL_AHP_POST_RUN_STAT_AHP_STAT_GLOBAL_Lin2_Error: symbol=ApplLinComAb_LIN2_COMRXL_AHP_POST_RUN_STAT_AHP_STAT_GLOBAL_Lin2_Error  # Error -
          data-receive-point-by-arguments:
            access DRP_Lin2ComRxSignalsSR_COMRXL_AHP_POST_RUN_STAT_AHP_STAT_GLOBAL_Lin2: accessed-variable=Lin2ComRxSignalsSR.COMRXL_AHP_POST_RUN_STAT_AHP_STAT_GLOBAL_Lin2
          data-send-points:
            access DSP_VeLINR_e_AHP_POST_RUN_STAT_VeLINR_e_AHP_POST_RUN_STAT: accessed-variable=VeLINR_e_AHP_POST_RUN_STAT.VeLINR_e_AHP_POST_RUN_STAT
            access DSP_VeLINR_b_AHP_POST_RUN_STAT_TO_VeLINR_b_AHP_POST_RUN_STAT_TO: accessed-variable=VeLINR_b_AHP_POST_RUN_STAT_TO.VeLINR_b_AHP_POST_RUN_STAT_TO
          read-local-variables:
            access IRVRA_VeLINR_d_LIN_SlavePrsnt_LIN2: accessed-variable=VeLINR_d_LIN_SlavePrsnt_LIN2
        COMRXL_RsErr_AHP_PUMP_AHP_STAT_GLOBAL_Lin2_Received: symbol=ApplLinComAb_LIN2_COMRXL_RsErr_AHP_PUMP_AHP_STAT_GLOBAL_Lin2_Received  # Received -
          data-receive-point-by-arguments:
            access DRP_Lin2ComRxSignalsSR_COMRXL_RsErr_AHP_PUMP_AHP_STAT_GLOBAL_Lin2: accessed-variable=Lin2ComRxSignalsSR.COMRXL_RsErr_AHP_PUMP_AHP_STAT_GLOBAL_Lin2
          data-send-points:
            access DSP_VeLINR_b_RsErr_AHP_PUMP_VeLINR_b_RsErr_AHP_PUMP: accessed-variable=VeLINR_b_RsErr_AHP_PUMP.VeLINR_b_RsErr_AHP_PUMP
            access DSP_VeLINR_b_RsErr_AHP_PUMP_TO_VeLINR_b_RsErr_AHP_PUMP_TO: accessed-variable=VeLINR_b_RsErr_AHP_PUMP_TO.VeLINR_b_RsErr_AHP_PUMP_TO
        COMRXL_RsErr_AHP_PUMP_AHP_STAT_GLOBAL_Lin2_Error: symbol=ApplLinComAb_LIN2_COMRXL_RsErr_AHP_PUMP_AHP_STAT_GLOBAL_Lin2_Error  # Error -
          data-receive-point-by-arguments:
            access DRP_Lin2ComRxSignalsSR_COMRXL_RsErr_AHP_PUMP_AHP_STAT_GLOBAL_Lin2: accessed-variable=Lin2ComRxSignalsSR.COMRXL_RsErr_AHP_PUMP_AHP_STAT_GLOBAL_Lin2
          data-send-points:
            access DSP_VeLINR_b_RsErr_AHP_PUMP_VeLINR_b_RsErr_AHP_PUMP: accessed-variable=VeLINR_b_RsErr_AHP_PUMP.VeLINR_b_RsErr_AHP_PUMP
            access DSP_VeLINR_b_RsErr_AHP_PUMP_TO_VeLINR_b_RsErr_AHP_PUMP_TO: accessed-variable=VeLINR_b_RsErr_AHP_PUMP_TO.VeLINR_b_RsErr_AHP_PUMP_TO
          read-local-variables:
            access IRVRA_VeLINR_d_LIN_SlavePrsnt_LIN2: accessed-variable=VeLINR_d_LIN_SlavePrsnt_LIN2
        COMRXL_AHP_SUPPLIER_AHP_VER_Lin2_Received: symbol=ApplLinComAb_LIN2_COMRXL_AHP_SUPPLIER_AHP_VER_Lin2_Received  # Received -
          data-receive-point-by-arguments:
            access DRP_Lin2ComRxSignalsSR_COMRXL_AHP_SUPPLIER_AHP_VER_Lin2: accessed-variable=Lin2ComRxSignalsSR.COMRXL_AHP_SUPPLIER_AHP_VER_Lin2
          data-send-points:
            access DSP_VeLINR_e_AHP_SUPPLIER_VeLINR_e_AHP_SUPPLIER: accessed-variable=VeLINR_e_AHP_SUPPLIER.VeLINR_e_AHP_SUPPLIER
            access DSP_VeLINR_b_AHP_SUPPLIER_TO_VeLINR_b_AHP_SUPPLIER_TO: accessed-variable=VeLINR_b_AHP_SUPPLIER_TO.VeLINR_b_AHP_SUPPLIER_TO
        COMRXL_AHP_SUPPLIER_AHP_VER_Lin2_Error: symbol=ApplLinComAb_LIN2_COMRXL_AHP_SUPPLIER_AHP_VER_Lin2_Error  # Error -
          data-receive-point-by-arguments:
            access DRP_Lin2ComRxSignalsSR_COMRXL_AHP_SUPPLIER_AHP_VER_Lin2: accessed-variable=Lin2ComRxSignalsSR.COMRXL_AHP_SUPPLIER_AHP_VER_Lin2
          data-send-points:
            access DSP_VeLINR_e_AHP_SUPPLIER_VeLINR_e_AHP_SUPPLIER: accessed-variable=VeLINR_e_AHP_SUPPLIER.VeLINR_e_AHP_SUPPLIER
            access DSP_VeLINR_b_AHP_SUPPLIER_TO_VeLINR_b_AHP_SUPPLIER_TO: accessed-variable=VeLINR_b_AHP_SUPPLIER_TO.VeLINR_b_AHP_SUPPLIER_TO
          read-local-variables:
            access IRVRA_VeLINR_d_LIN_SlavePrsnt_LIN2: accessed-variable=VeLINR_d_LIN_SlavePrsnt_LIN2
        COMRXL_BHV_PosAct_BHV_STAT_V2_Lin2_Received: symbol=ApplLinComAb_LIN2_COMRXL_BHV_PosAct_BHV_STAT_V2_Lin2_Received  # Received -
          data-receive-point-by-arguments:
            access DRP_Lin2ComRxSignalsSR_COMRXL_BHV_PosAct_BHV_STAT_V2_Lin2: accessed-variable=Lin2ComRxSignalsSR.COMRXL_BHV_PosAct_BHV_STAT_V2_Lin2
          data-send-points:
            access DSP_VeLINR_Pct_BHV_PosAct_VeLINR_Pct_BHV_PosAct: accessed-variable=VeLINR_Pct_BHV_PosAct.VeLINR_Pct_BHV_PosAct
            access DSP_VeLINR_b_BHV_PosActTO_VeLINR_b_BHV_PosActTO: accessed-variable=VeLINR_b_BHV_PosActTO.VeLINR_b_BHV_PosActTO
        COMRXL_BHV_PosAct_BHV_STAT_V2_Lin2_Error: symbol=ApplLinComAb_LIN2_COMRXL_BHV_PosAct_BHV_STAT_V2_Lin2_Error  # Error -
          data-receive-point-by-arguments:
            access DRP_Lin2ComRxSignalsSR_COMRXL_BHV_PosAct_BHV_STAT_V2_Lin2: accessed-variable=Lin2ComRxSignalsSR.COMRXL_BHV_PosAct_BHV_STAT_V2_Lin2
          data-send-points:
            access DSP_VeLINR_Pct_BHV_PosAct_VeLINR_Pct_BHV_PosAct: accessed-variable=VeLINR_Pct_BHV_PosAct.VeLINR_Pct_BHV_PosAct
            access DSP_VeLINR_b_BHV_PosActTO_VeLINR_b_BHV_PosActTO: accessed-variable=VeLINR_b_BHV_PosActTO.VeLINR_b_BHV_PosActTO
          read-local-variables:
            access IRVRA_VeLINR_d_LIN_SlavePrsnt_LIN2: accessed-variable=VeLINR_d_LIN_SlavePrsnt_LIN2
        COMRXL_BHV_ERR_BHV_STAT_V2_Lin2_Received: symbol=ApplLinComAb_LIN2_COMRXL_BHV_ERR_BHV_STAT_V2_Lin2_Received  # Received -
          data-receive-point-by-arguments:
            access DRP_Lin2ComRxSignalsSR_COMRXL_BHV_ERR_BHV_STAT_V2_Lin2: accessed-variable=Lin2ComRxSignalsSR.COMRXL_BHV_ERR_BHV_STAT_V2_Lin2
          data-send-points:
            access DSP_VeLINR_e_BHV_ERR_VeLINR_e_BHV_ERR: accessed-variable=VeLINR_e_BHV_ERR.VeLINR_e_BHV_ERR
            access DSP_VeLINR_b_BHV_ERR_TO_VeLINR_b_BHV_ERR_TO: accessed-variable=VeLINR_b_BHV_ERR_TO.VeLINR_b_BHV_ERR_TO
        COMRXL_BHV_ERR_BHV_STAT_V2_Lin2_Error: symbol=ApplLinComAb_LIN2_COMRXL_BHV_ERR_BHV_STAT_V2_Lin2_Error  # Error -
          data-receive-point-by-arguments:
            access DRP_Lin2ComRxSignalsSR_COMRXL_BHV_ERR_BHV_STAT_V2_Lin2: accessed-variable=Lin2ComRxSignalsSR.COMRXL_BHV_ERR_BHV_STAT_V2_Lin2
          data-send-points:
            access DSP_VeLINR_e_BHV_ERR_VeLINR_e_BHV_ERR: accessed-variable=VeLINR_e_BHV_ERR.VeLINR_e_BHV_ERR
            access DSP_VeLINR_b_BHV_ERR_TO_VeLINR_b_BHV_ERR_TO: accessed-variable=VeLINR_b_BHV_ERR_TO.VeLINR_b_BHV_ERR_TO
          read-local-variables:
            access IRVRA_VeLINR_d_LIN_SlavePrsnt_LIN2: accessed-variable=VeLINR_d_LIN_SlavePrsnt_LIN2
        COMRXL_BHV_Sts_BHV_STAT_V2_Lin2_Received: symbol=ApplLinComAb_LIN2_COMRXL_BHV_Sts_BHV_STAT_V2_Lin2_Received  # Received -
          data-receive-point-by-arguments:
            access DRP_Lin2ComRxSignalsSR_COMRXL_BHV_Sts_BHV_STAT_V2_Lin2: accessed-variable=Lin2ComRxSignalsSR.COMRXL_BHV_Sts_BHV_STAT_V2_Lin2
          data-send-points:
            access DSP_VeLINR_e_BHV_Sts_VeLINR_e_BHV_Sts: accessed-variable=VeLINR_e_BHV_Sts.VeLINR_e_BHV_Sts
            access DSP_VeLINR_b_BHV_StsTO_VeLINR_b_BHV_StsTO: accessed-variable=VeLINR_b_BHV_StsTO.VeLINR_b_BHV_StsTO
        COMRXL_BHV_Sts_BHV_STAT_V2_Lin2_Error: symbol=ApplLinComAb_LIN2_COMRXL_BHV_Sts_BHV_STAT_V2_Lin2_Error  # Error -
          data-receive-point-by-arguments:
            access DRP_Lin2ComRxSignalsSR_COMRXL_BHV_Sts_BHV_STAT_V2_Lin2: accessed-variable=Lin2ComRxSignalsSR.COMRXL_BHV_Sts_BHV_STAT_V2_Lin2
          data-send-points:
            access DSP_VeLINR_e_BHV_Sts_VeLINR_e_BHV_Sts: accessed-variable=VeLINR_e_BHV_Sts.VeLINR_e_BHV_Sts
            access DSP_VeLINR_b_BHV_StsTO_VeLINR_b_BHV_StsTO: accessed-variable=VeLINR_b_BHV_StsTO.VeLINR_b_BHV_StsTO
          read-local-variables:
            access IRVRA_VeLINR_d_LIN_SlavePrsnt_LIN2: accessed-variable=VeLINR_d_LIN_SlavePrsnt_LIN2
        COMRXL_RsErr_BHV_BHV_STAT_V2_Lin2_Received: symbol=ApplLinComAb_LIN2_COMRXL_RsErr_BHV_BHV_STAT_V2_Lin2_Received  # Received -
          data-receive-point-by-arguments:
            access DRP_Lin2ComRxSignalsSR_COMRXL_RsErr_BHV_BHV_STAT_V2_Lin2: accessed-variable=Lin2ComRxSignalsSR.COMRXL_RsErr_BHV_BHV_STAT_V2_Lin2
          data-send-points:
            access DSP_VeLINR_b_RsErr_BHV_VeLINR_b_RsErr_BHV: accessed-variable=VeLINR_b_RsErr_BHV.VeLINR_b_RsErr_BHV
            access DSP_VeLINR_b_RsErr_BHV_TO_VeLINR_b_RsErr_BHV_TO: accessed-variable=VeLINR_b_RsErr_BHV_TO.VeLINR_b_RsErr_BHV_TO
        COMRXL_RsErr_BHV_BHV_STAT_V2_Lin2_Error: symbol=ApplLinComAb_LIN2_COMRXL_RsErr_BHV_BHV_STAT_V2_Lin2_Error  # Error -
          data-receive-point-by-arguments:
            access DRP_Lin2ComRxSignalsSR_COMRXL_RsErr_BHV_BHV_STAT_V2_Lin2: accessed-variable=Lin2ComRxSignalsSR.COMRXL_RsErr_BHV_BHV_STAT_V2_Lin2
          data-send-points:
            access DSP_VeLINR_b_RsErr_BHV_VeLINR_b_RsErr_BHV: accessed-variable=VeLINR_b_RsErr_BHV.VeLINR_b_RsErr_BHV
            access DSP_VeLINR_b_RsErr_BHV_TO_VeLINR_b_RsErr_BHV_TO: accessed-variable=VeLINR_b_RsErr_BHV_TO.VeLINR_b_RsErr_BHV_TO
          read-local-variables:
            access IRVRA_VeLINR_d_LIN_SlavePrsnt_LIN2: accessed-variable=VeLINR_d_LIN_SlavePrsnt_LIN2
        COMRXL_CompFaultStat_EAC_STAT_Lin2_Received: symbol=ApplLinComAb_LIN2_COMRXL_CompFaultStat_EAC_STAT_Lin2_Received  # Received -
          data-receive-point-by-arguments:
            access DRP_Lin2ComRxSignalsSR_COMRXL_CompFaultStat_EAC_STAT_Lin2: accessed-variable=Lin2ComRxSignalsSR.COMRXL_CompFaultStat_EAC_STAT_Lin2
          data-send-points:
            access DSP_VeLINR_e_CompFaultStat_VeLINR_e_CompFaultStat: accessed-variable=VeLINR_e_CompFaultStat.VeLINR_e_CompFaultStat
            access DSP_VeLINR_b_CompFaultStatTO_VeLINR_b_CompFaultStatTO: accessed-variable=VeLINR_b_CompFaultStatTO.VeLINR_b_CompFaultStatTO
        COMRXL_CompFaultStat_EAC_STAT_Lin2_Error: symbol=ApplLinComAb_LIN2_COMRXL_CompFaultStat_EAC_STAT_Lin2_Error  # Error -
          data-receive-point-by-arguments:
            access DRP_Lin2ComRxSignalsSR_COMRXL_CompFaultStat_EAC_STAT_Lin2: accessed-variable=Lin2ComRxSignalsSR.COMRXL_CompFaultStat_EAC_STAT_Lin2
          data-send-points:
            access DSP_VeLINR_e_CompFaultStat_VeLINR_e_CompFaultStat: accessed-variable=VeLINR_e_CompFaultStat.VeLINR_e_CompFaultStat
            access DSP_VeLINR_b_CompFaultStatTO_VeLINR_b_CompFaultStatTO: accessed-variable=VeLINR_b_CompFaultStatTO.VeLINR_b_CompFaultStatTO
          read-local-variables:
            access IRVRA_VeLINR_d_LIN_SlavePrsnt_LIN2: accessed-variable=VeLINR_d_LIN_SlavePrsnt_LIN2
        COMRXL_CompStat_EAC_STAT_Lin2_Received: symbol=ApplLinComAb_LIN2_COMRXL_CompStat_EAC_STAT_Lin2_Received  # Received -
          data-receive-point-by-arguments:
            access DRP_Lin2ComRxSignalsSR_COMRXL_CompStat_EAC_STAT_Lin2: accessed-variable=Lin2ComRxSignalsSR.COMRXL_CompStat_EAC_STAT_Lin2
          data-send-points:
            access DSP_VeLINR_e_CompStat_VeLINR_e_CompStat: accessed-variable=VeLINR_e_CompStat.VeLINR_e_CompStat
            access DSP_VeLINR_b_CompStatTO_VeLINR_b_CompStatTO: accessed-variable=VeLINR_b_CompStatTO.VeLINR_b_CompStatTO
        COMRXL_CompStat_EAC_STAT_Lin2_Error: symbol=ApplLinComAb_LIN2_COMRXL_CompStat_EAC_STAT_Lin2_Error  # Error -
          data-receive-point-by-arguments:
            access DRP_Lin2ComRxSignalsSR_COMRXL_CompStat_EAC_STAT_Lin2: accessed-variable=Lin2ComRxSignalsSR.COMRXL_CompStat_EAC_STAT_Lin2
          data-send-points:
            access DSP_VeLINR_e_CompStat_VeLINR_e_CompStat: accessed-variable=VeLINR_e_CompStat.VeLINR_e_CompStat
            access DSP_VeLINR_b_CompStatTO_VeLINR_b_CompStatTO: accessed-variable=VeLINR_b_CompStatTO.VeLINR_b_CompStatTO
          read-local-variables:
            access IRVRA_VeLINR_d_LIN_SlavePrsnt_LIN2: accessed-variable=VeLINR_d_LIN_SlavePrsnt_LIN2
        COMRXL_CompressorSpd_EAC_STAT_Lin2_Received: symbol=ApplLinComAb_LIN2_COMRXL_CompressorSpd_EAC_STAT_Lin2_Received  # Received -
          data-receive-point-by-arguments:
            access DRP_Lin2ComRxSignalsSR_COMRXL_CompressorSpd_EAC_STAT_Lin2: accessed-variable=Lin2ComRxSignalsSR.COMRXL_CompressorSpd_EAC_STAT_Lin2
          data-send-points:
            access DSP_VeLINR_n_CompressorSpd_VeLINR_n_CompressorSpd: accessed-variable=VeLINR_n_CompressorSpd.VeLINR_n_CompressorSpd
            access DSP_VeLINR_b_CompressorSpdTO_VeLINR_b_CompressorSpdTO: accessed-variable=VeLINR_b_CompressorSpdTO.VeLINR_b_CompressorSpdTO
        COMRXL_CompressorSpd_EAC_STAT_Lin2_Error: symbol=ApplLinComAb_LIN2_COMRXL_CompressorSpd_EAC_STAT_Lin2_Error  # Error -
          data-receive-point-by-arguments:
            access DRP_Lin2ComRxSignalsSR_COMRXL_CompressorSpd_EAC_STAT_Lin2: accessed-variable=Lin2ComRxSignalsSR.COMRXL_CompressorSpd_EAC_STAT_Lin2
          data-send-points:
            access DSP_VeLINR_n_CompressorSpd_VeLINR_n_CompressorSpd: accessed-variable=VeLINR_n_CompressorSpd.VeLINR_n_CompressorSpd
            access DSP_VeLINR_b_CompressorSpdTO_VeLINR_b_CompressorSpdTO: accessed-variable=VeLINR_b_CompressorSpdTO.VeLINR_b_CompressorSpdTO
          read-local-variables:
            access IRVRA_VeLINR_d_LIN_SlavePrsnt_LIN2: accessed-variable=VeLINR_d_LIN_SlavePrsnt_LIN2
        COMRXL_CompSpdIncrReq_EAC_STAT_Lin2_Received: symbol=ApplLinComAb_LIN2_COMRXL_CompSpdIncrReq_EAC_STAT_Lin2_Received  # Received -
          data-receive-point-by-arguments:
            access DRP_Lin2ComRxSignalsSR_COMRXL_CompSpdIncrReq_EAC_STAT_Lin2: accessed-variable=Lin2ComRxSignalsSR.COMRXL_CompSpdIncrReq_EAC_STAT_Lin2
          data-send-points:
            access DSP_VeLINR_b_CompSpdIncrReq_VeLINR_b_CompSpdIncrReq: accessed-variable=VeLINR_b_CompSpdIncrReq.VeLINR_b_CompSpdIncrReq
            access DSP_VeLINR_b_CompSpdIncrReqTO_VeLINR_b_CompSpdIncrReqTO: accessed-variable=VeLINR_b_CompSpdIncrReqTO.VeLINR_b_CompSpdIncrReqTO
        COMRXL_CompSpdIncrReq_EAC_STAT_Lin2_Error: symbol=ApplLinComAb_LIN2_COMRXL_CompSpdIncrReq_EAC_STAT_Lin2_Error  # Error -
          data-receive-point-by-arguments:
            access DRP_Lin2ComRxSignalsSR_COMRXL_CompSpdIncrReq_EAC_STAT_Lin2: accessed-variable=Lin2ComRxSignalsSR.COMRXL_CompSpdIncrReq_EAC_STAT_Lin2
          data-send-points:
            access DSP_VeLINR_b_CompSpdIncrReq_VeLINR_b_CompSpdIncrReq: accessed-variable=VeLINR_b_CompSpdIncrReq.VeLINR_b_CompSpdIncrReq
            access DSP_VeLINR_b_CompSpdIncrReqTO_VeLINR_b_CompSpdIncrReqTO: accessed-variable=VeLINR_b_CompSpdIncrReqTO.VeLINR_b_CompSpdIncrReqTO
          read-local-variables:
            access IRVRA_VeLINR_d_LIN_SlavePrsnt_LIN2: accessed-variable=VeLINR_d_LIN_SlavePrsnt_LIN2
        COMRXL_CompElecPwr_EAC_STAT_Lin2_Received: symbol=ApplLinComAb_LIN2_COMRXL_CompElecPwr_EAC_STAT_Lin2_Received  # Received -
          data-receive-point-by-arguments:
            access DRP_Lin2ComRxSignalsSR_COMRXL_CompElecPwr_EAC_STAT_Lin2: accessed-variable=Lin2ComRxSignalsSR.COMRXL_CompElecPwr_EAC_STAT_Lin2
          data-send-points:
            access DSP_VeLINR_P_CompElecPwr_VeLINR_P_CompElecPwr: accessed-variable=VeLINR_P_CompElecPwr.VeLINR_P_CompElecPwr
            access DSP_VeLINR_b_CompElecPwrTO_VeLINR_b_CompElecPwrTO: accessed-variable=VeLINR_b_CompElecPwrTO.VeLINR_b_CompElecPwrTO
        COMRXL_CompElecPwr_EAC_STAT_Lin2_Error: symbol=ApplLinComAb_LIN2_COMRXL_CompElecPwr_EAC_STAT_Lin2_Error  # Error -
          data-receive-point-by-arguments:
            access DRP_Lin2ComRxSignalsSR_COMRXL_CompElecPwr_EAC_STAT_Lin2: accessed-variable=Lin2ComRxSignalsSR.COMRXL_CompElecPwr_EAC_STAT_Lin2
          data-send-points:
            access DSP_VeLINR_P_CompElecPwr_VeLINR_P_CompElecPwr: accessed-variable=VeLINR_P_CompElecPwr.VeLINR_P_CompElecPwr
            access DSP_VeLINR_b_CompElecPwrTO_VeLINR_b_CompElecPwrTO: accessed-variable=VeLINR_b_CompElecPwrTO.VeLINR_b_CompElecPwrTO
          read-local-variables:
            access IRVRA_VeLINR_d_LIN_SlavePrsnt_LIN2: accessed-variable=VeLINR_d_LIN_SlavePrsnt_LIN2
        COMRXL_CompBoardTemp_EAC_STAT_Lin2_Received: symbol=ApplLinComAb_LIN2_COMRXL_CompBoardTemp_EAC_STAT_Lin2_Received  # Received -
          data-receive-point-by-arguments:
            access DRP_Lin2ComRxSignalsSR_COMRXL_CompBoardTemp_EAC_STAT_Lin2: accessed-variable=Lin2ComRxSignalsSR.COMRXL_CompBoardTemp_EAC_STAT_Lin2
          data-send-points:
            access DSP_VeLINR_T_CompBoardTemp_VeLINR_T_CompBoardTemp: accessed-variable=VeLINR_T_CompBoardTemp.VeLINR_T_CompBoardTemp
            access DSP_VeLINR_b_CompBoardTempTO_VeLINR_b_CompBoardTempTO: accessed-variable=VeLINR_b_CompBoardTempTO.VeLINR_b_CompBoardTempTO
        COMRXL_CompBoardTemp_EAC_STAT_Lin2_Error: symbol=ApplLinComAb_LIN2_COMRXL_CompBoardTemp_EAC_STAT_Lin2_Error  # Error -
          data-receive-point-by-arguments:
            access DRP_Lin2ComRxSignalsSR_COMRXL_CompBoardTemp_EAC_STAT_Lin2: accessed-variable=Lin2ComRxSignalsSR.COMRXL_CompBoardTemp_EAC_STAT_Lin2
          data-send-points:
            access DSP_VeLINR_T_CompBoardTemp_VeLINR_T_CompBoardTemp: accessed-variable=VeLINR_T_CompBoardTemp.VeLINR_T_CompBoardTemp
            access DSP_VeLINR_b_CompBoardTempTO_VeLINR_b_CompBoardTempTO: accessed-variable=VeLINR_b_CompBoardTempTO.VeLINR_b_CompBoardTempTO
          read-local-variables:
            access IRVRA_VeLINR_d_LIN_SlavePrsnt_LIN2: accessed-variable=VeLINR_d_LIN_SlavePrsnt_LIN2
        COMRXL_CompIGBTTemp_EAC_STAT_Lin2_Received: symbol=ApplLinComAb_LIN2_COMRXL_CompIGBTTemp_EAC_STAT_Lin2_Received  # Received -
          data-receive-point-by-arguments:
            access DRP_Lin2ComRxSignalsSR_COMRXL_CompIGBTTemp_EAC_STAT_Lin2: accessed-variable=Lin2ComRxSignalsSR.COMRXL_CompIGBTTemp_EAC_STAT_Lin2
          data-send-points:
            access DSP_VeLINR_T_CompIGBTTemp_VeLINR_T_CompIGBTTemp: accessed-variable=VeLINR_T_CompIGBTTemp.VeLINR_T_CompIGBTTemp
            access DSP_VeLINR_b_CompIGBTTempTO_VeLINR_b_CompIGBTTempTO: accessed-variable=VeLINR_b_CompIGBTTempTO.VeLINR_b_CompIGBTTempTO
        COMRXL_CompIGBTTemp_EAC_STAT_Lin2_Error: symbol=ApplLinComAb_LIN2_COMRXL_CompIGBTTemp_EAC_STAT_Lin2_Error  # Error -
          data-receive-point-by-arguments:
            access DRP_Lin2ComRxSignalsSR_COMRXL_CompIGBTTemp_EAC_STAT_Lin2: accessed-variable=Lin2ComRxSignalsSR.COMRXL_CompIGBTTemp_EAC_STAT_Lin2
          data-send-points:
            access DSP_VeLINR_T_CompIGBTTemp_VeLINR_T_CompIGBTTemp: accessed-variable=VeLINR_T_CompIGBTTemp.VeLINR_T_CompIGBTTemp
            access DSP_VeLINR_b_CompIGBTTempTO_VeLINR_b_CompIGBTTempTO: accessed-variable=VeLINR_b_CompIGBTTempTO.VeLINR_b_CompIGBTTempTO
          read-local-variables:
            access IRVRA_VeLINR_d_LIN_SlavePrsnt_LIN2: accessed-variable=VeLINR_d_LIN_SlavePrsnt_LIN2
        COMRXL_CompElecCurr_EAC_STAT_Lin2_Received: symbol=ApplLinComAb_LIN2_COMRXL_CompElecCurr_EAC_STAT_Lin2_Received  # Received -
          data-receive-point-by-arguments:
            access DRP_Lin2ComRxSignalsSR_COMRXL_CompElecCurr_EAC_STAT_Lin2: accessed-variable=Lin2ComRxSignalsSR.COMRXL_CompElecCurr_EAC_STAT_Lin2
          data-send-points:
            access DSP_VeLINR_I_CompElecCurr_VeLINR_I_CompElecCurr: accessed-variable=VeLINR_I_CompElecCurr.VeLINR_I_CompElecCurr
            access DSP_VeLINR_b_CompElecCurrTO_VeLINR_b_CompElecCurrTO: accessed-variable=VeLINR_b_CompElecCurrTO.VeLINR_b_CompElecCurrTO
        COMRXL_CompElecCurr_EAC_STAT_Lin2_Error: symbol=ApplLinComAb_LIN2_COMRXL_CompElecCurr_EAC_STAT_Lin2_Error  # Error -
          data-receive-point-by-arguments:
            access DRP_Lin2ComRxSignalsSR_COMRXL_CompElecCurr_EAC_STAT_Lin2: accessed-variable=Lin2ComRxSignalsSR.COMRXL_CompElecCurr_EAC_STAT_Lin2
          data-send-points:
            access DSP_VeLINR_I_CompElecCurr_VeLINR_I_CompElecCurr: accessed-variable=VeLINR_I_CompElecCurr.VeLINR_I_CompElecCurr
            access DSP_VeLINR_b_CompElecCurrTO_VeLINR_b_CompElecCurrTO: accessed-variable=VeLINR_b_CompElecCurrTO.VeLINR_b_CompElecCurrTO
          read-local-variables:
            access IRVRA_VeLINR_d_LIN_SlavePrsnt_LIN2: accessed-variable=VeLINR_d_LIN_SlavePrsnt_LIN2
        COMRXL_CompHVInput_EAC_STAT_Lin2_Received: symbol=ApplLinComAb_LIN2_COMRXL_CompHVInput_EAC_STAT_Lin2_Received  # Received -
          data-receive-point-by-arguments:
            access DRP_Lin2ComRxSignalsSR_COMRXL_CompHVInput_EAC_STAT_Lin2: accessed-variable=Lin2ComRxSignalsSR.COMRXL_CompHVInput_EAC_STAT_Lin2
          data-send-points:
            access DSP_VeLINR_U_CompHVInput_VeLINR_U_CompHVInput: accessed-variable=VeLINR_U_CompHVInput.VeLINR_U_CompHVInput
            access DSP_VeLINR_b_CompHVInputTO_VeLINR_b_CompHVInputTO: accessed-variable=VeLINR_b_CompHVInputTO.VeLINR_b_CompHVInputTO
        COMRXL_CompHVInput_EAC_STAT_Lin2_Error: symbol=ApplLinComAb_LIN2_COMRXL_CompHVInput_EAC_STAT_Lin2_Error  # Error -
          data-receive-point-by-arguments:
            access DRP_Lin2ComRxSignalsSR_COMRXL_CompHVInput_EAC_STAT_Lin2: accessed-variable=Lin2ComRxSignalsSR.COMRXL_CompHVInput_EAC_STAT_Lin2
          data-send-points:
            access DSP_VeLINR_U_CompHVInput_VeLINR_U_CompHVInput: accessed-variable=VeLINR_U_CompHVInput.VeLINR_U_CompHVInput
            access DSP_VeLINR_b_CompHVInputTO_VeLINR_b_CompHVInputTO: accessed-variable=VeLINR_b_CompHVInputTO.VeLINR_b_CompHVInputTO
          read-local-variables:
            access IRVRA_VeLINR_d_LIN_SlavePrsnt_LIN2: accessed-variable=VeLINR_d_LIN_SlavePrsnt_LIN2
        COMRXL_DriveMdReq_ESBM_1_Lin2_Received: symbol=ApplLinComAb_LIN2_COMRXL_DriveMdReq_ESBM_1_Lin2_Received  # Received -
          data-receive-point-by-arguments:
            access DRP_Lin2ComRxSignalsSR_COMRXL_DriveMdReq_ESBM_1_Lin2: accessed-variable=Lin2ComRxSignalsSR.COMRXL_DriveMdReq_ESBM_1_Lin2
          data-send-points:
            access DSP_VeLINR_e_DriveMdReq_VeLINR_e_DriveMdReq: accessed-variable=VeLINR_e_DriveMdReq.VeLINR_e_DriveMdReq
            access DSP_VeLINR_b_DriveMdReqTO_VeLINR_b_DriveMdReqTO: accessed-variable=VeLINR_b_DriveMdReqTO.VeLINR_b_DriveMdReqTO
        COMRXL_DriveMdReq_ESBM_1_Lin2_Error: symbol=ApplLinComAb_LIN2_COMRXL_DriveMdReq_ESBM_1_Lin2_Error  # Error -
          data-receive-point-by-arguments:
            access DRP_Lin2ComRxSignalsSR_COMRXL_DriveMdReq_ESBM_1_Lin2: accessed-variable=Lin2ComRxSignalsSR.COMRXL_DriveMdReq_ESBM_1_Lin2
          data-send-points:
            access DSP_VeLINR_e_DriveMdReq_VeLINR_e_DriveMdReq: accessed-variable=VeLINR_e_DriveMdReq.VeLINR_e_DriveMdReq
            access DSP_VeLINR_b_DriveMdReqTO_VeLINR_b_DriveMdReqTO: accessed-variable=VeLINR_b_DriveMdReqTO.VeLINR_b_DriveMdReqTO
          read-local-variables:
            access IRVRA_VeLINR_d_LIN_SlavePrsnt_LIN2: accessed-variable=VeLINR_d_LIN_SlavePrsnt_LIN2
        COMRXL_HybridModeRq_LIN_ESBM_1_Lin2_Received: symbol=ApplLinComAb_LIN2_COMRXL_HybridModeRq_LIN_ESBM_1_Lin2_Received  # Received -
          data-receive-point-by-arguments:
            access DRP_Lin2ComRxSignalsSR_COMRXL_HybridModeRq_LIN_ESBM_1_Lin2: accessed-variable=Lin2ComRxSignalsSR.COMRXL_HybridModeRq_LIN_ESBM_1_Lin2
          data-send-points:
            access DSP_VeLINR_e_HybridModeRq_LIN_VeLINR_e_HybridModeRq_LIN: accessed-variable=VeLINR_e_HybridModeRq_LIN.VeLINR_e_HybridModeRq_LIN
            access DSP_VeLINR_b_HybridModeRq_LIN_TO_VeLINR_b_HybridModeRq_LIN_TO: accessed-variable=VeLINR_b_HybridModeRq_LIN_TO.VeLINR_b_HybridModeRq_LIN_TO
        COMRXL_HybridModeRq_LIN_ESBM_1_Lin2_Error: symbol=ApplLinComAb_LIN2_COMRXL_HybridModeRq_LIN_ESBM_1_Lin2_Error  # Error -
          data-receive-point-by-arguments:
            access DRP_Lin2ComRxSignalsSR_COMRXL_HybridModeRq_LIN_ESBM_1_Lin2: accessed-variable=Lin2ComRxSignalsSR.COMRXL_HybridModeRq_LIN_ESBM_1_Lin2
          data-send-points:
            access DSP_VeLINR_e_HybridModeRq_LIN_VeLINR_e_HybridModeRq_LIN: accessed-variable=VeLINR_e_HybridModeRq_LIN.VeLINR_e_HybridModeRq_LIN
            access DSP_VeLINR_b_HybridModeRq_LIN_TO_VeLINR_b_HybridModeRq_LIN_TO: accessed-variable=VeLINR_b_HybridModeRq_LIN_TO.VeLINR_b_HybridModeRq_LIN_TO
          read-local-variables:
            access IRVRA_VeLINR_d_LIN_SlavePrsnt_LIN2: accessed-variable=VeLINR_d_LIN_SlavePrsnt_LIN2
        COMRXL_ESaveModeRq_LIN_ESBM_1_Lin2_Received: symbol=ApplLinComAb_LIN2_COMRXL_ESaveModeRq_LIN_ESBM_1_Lin2_Received  # Received -
          data-receive-point-by-arguments:
            access DRP_Lin2ComRxSignalsSR_COMRXL_ESaveModeRq_LIN_ESBM_1_Lin2: accessed-variable=Lin2ComRxSignalsSR.COMRXL_ESaveModeRq_LIN_ESBM_1_Lin2
          data-send-points:
            access DSP_VeLINR_e_ESaveModeRq_LIN_VeLINR_e_ESaveModeRq_LIN: accessed-variable=VeLINR_e_ESaveModeRq_LIN.VeLINR_e_ESaveModeRq_LIN
            access DSP_VeLINR_b_ESaveModeRq_LIN_TO_VeLINR_b_ESaveModeRq_LIN_TO: accessed-variable=VeLINR_b_ESaveModeRq_LIN_TO.VeLINR_b_ESaveModeRq_LIN_TO
        COMRXL_ESaveModeRq_LIN_ESBM_1_Lin2_Error: symbol=ApplLinComAb_LIN2_COMRXL_ESaveModeRq_LIN_ESBM_1_Lin2_Error  # Error -
          data-receive-point-by-arguments:
            access DRP_Lin2ComRxSignalsSR_COMRXL_ESaveModeRq_LIN_ESBM_1_Lin2: accessed-variable=Lin2ComRxSignalsSR.COMRXL_ESaveModeRq_LIN_ESBM_1_Lin2
          data-send-points:
            access DSP_VeLINR_e_ESaveModeRq_LIN_VeLINR_e_ESaveModeRq_LIN: accessed-variable=VeLINR_e_ESaveModeRq_LIN.VeLINR_e_ESaveModeRq_LIN
            access DSP_VeLINR_b_ESaveModeRq_LIN_TO_VeLINR_b_ESaveModeRq_LIN_TO: accessed-variable=VeLINR_b_ESaveModeRq_LIN_TO.VeLINR_b_ESaveModeRq_LIN_TO
          read-local-variables:
            access IRVRA_VeLINR_d_LIN_SlavePrsnt_LIN2: accessed-variable=VeLINR_d_LIN_SlavePrsnt_LIN2
        COMRXL_ElectricModeRq_LIN_ESBM_1_Lin2_Received: symbol=ApplLinComAb_LIN2_COMRXL_ElectricModeRq_LIN_ESBM_1_Lin2_Received  # Received -
          data-receive-point-by-arguments:
            access DRP_Lin2ComRxSignalsSR_COMRXL_ElectricModeRq_LIN_ESBM_1_Lin2: accessed-variable=Lin2ComRxSignalsSR.COMRXL_ElectricModeRq_LIN_ESBM_1_Lin2
          data-send-points:
            access DSP_VeLINR_e_ElectricModeRq_LIN_VeLINR_e_ElectricModeRq_LIN: accessed-variable=VeLINR_e_ElectricModeRq_LIN.VeLINR_e_ElectricModeRq_LIN
            access DSP_VeLINR_b_ElectricModeRq_LIN_TO_VeLINR_b_ElectricModeRq_LIN_TO: accessed-variable=VeLINR_b_ElectricModeRq_LIN_TO.VeLINR_b_ElectricModeRq_LIN_TO
        COMRXL_ElectricModeRq_LIN_ESBM_1_Lin2_Error: symbol=ApplLinComAb_LIN2_COMRXL_ElectricModeRq_LIN_ESBM_1_Lin2_Error  # Error -
          data-receive-point-by-arguments:
            access DRP_Lin2ComRxSignalsSR_COMRXL_ElectricModeRq_LIN_ESBM_1_Lin2: accessed-variable=Lin2ComRxSignalsSR.COMRXL_ElectricModeRq_LIN_ESBM_1_Lin2
          data-send-points:
            access DSP_VeLINR_e_ElectricModeRq_LIN_VeLINR_e_ElectricModeRq_LIN: accessed-variable=VeLINR_e_ElectricModeRq_LIN.VeLINR_e_ElectricModeRq_LIN
            access DSP_VeLINR_b_ElectricModeRq_LIN_TO_VeLINR_b_ElectricModeRq_LIN_TO: accessed-variable=VeLINR_b_ElectricModeRq_LIN_TO.VeLINR_b_ElectricModeRq_LIN_TO
          read-local-variables:
            access IRVRA_VeLINR_d_LIN_SlavePrsnt_LIN2: accessed-variable=VeLINR_d_LIN_SlavePrsnt_LIN2
        COMRXL_RsErr_ESBM_ESBM_1_Lin2_Received: symbol=ApplLinComAb_LIN2_COMRXL_RsErr_ESBM_ESBM_1_Lin2_Received  # Received -
          data-receive-point-by-arguments:
            access DRP_Lin2ComRxSignalsSR_COMRXL_RsErr_ESBM_ESBM_1_Lin2: accessed-variable=Lin2ComRxSignalsSR.COMRXL_RsErr_ESBM_ESBM_1_Lin2
          data-send-points:
            access DSP_VeLINR_b_RsErr_ESBM_VeLINR_b_RsErr_ESBM: accessed-variable=VeLINR_b_RsErr_ESBM.VeLINR_b_RsErr_ESBM
            access DSP_VeLINR_b_RsErr_ESBM_TO_VeLINR_b_RsErr_ESBM_TO: accessed-variable=VeLINR_b_RsErr_ESBM_TO.VeLINR_b_RsErr_ESBM_TO
        COMRXL_RsErr_ESBM_ESBM_1_Lin2_Error: symbol=ApplLinComAb_LIN2_COMRXL_RsErr_ESBM_ESBM_1_Lin2_Error  # Error -
          data-receive-point-by-arguments:
            access DRP_Lin2ComRxSignalsSR_COMRXL_RsErr_ESBM_ESBM_1_Lin2: accessed-variable=Lin2ComRxSignalsSR.COMRXL_RsErr_ESBM_ESBM_1_Lin2
          data-send-points:
            access DSP_VeLINR_b_RsErr_ESBM_VeLINR_b_RsErr_ESBM: accessed-variable=VeLINR_b_RsErr_ESBM.VeLINR_b_RsErr_ESBM
            access DSP_VeLINR_b_RsErr_ESBM_TO_VeLINR_b_RsErr_ESBM_TO: accessed-variable=VeLINR_b_RsErr_ESBM_TO.VeLINR_b_RsErr_ESBM_TO
          read-local-variables:
            access IRVRA_VeLINR_d_LIN_SlavePrsnt_LIN2: accessed-variable=VeLINR_d_LIN_SlavePrsnt_LIN2
        COMRXL_PECP_RPM_TGT_PERCT_PECP_STAT_GLOBAL_Lin2_Received: symbol=ApplLinComAb_LIN2_COMRXL_PECP_RPM_TGT_PERCT_PECP_STAT_GLOBAL_Lin2_Received  # Received -
          data-receive-point-by-arguments:
            access DRP_Lin2ComRxSignalsSR_COMRXL_PECP_RPM_TGT_PERCT_PECP_STAT_GLOBAL_Lin2: accessed-variable=Lin2ComRxSignalsSR.COMRXL_PECP_RPM_TGT_PERCT_PECP_STAT_GLOBAL_Lin2
          data-send-points:
            access DSP_VeLINR_Pct_PECP_RPM_TGT_PERCT_VeLINR_Pct_PECP_RPM_TGT_PERCT: accessed-variable=VeLINR_Pct_PECP_RPM_TGT_PERCT.VeLINR_Pct_PECP_RPM_TGT_PERCT
            access DSP_VeLINR_b_PECP_RPM_TGT_PERCT_TO_VeLINR_b_PECP_RPM_TGT_PERCT_TO: accessed-variable=VeLINR_b_PECP_RPM_TGT_PERCT_TO.VeLINR_b_PECP_RPM_TGT_PERCT_TO
        COMRXL_PECP_RPM_TGT_PERCT_PECP_STAT_GLOBAL_Lin2_Error: symbol=ApplLinComAb_LIN2_COMRXL_PECP_RPM_TGT_PERCT_PECP_STAT_GLOBAL_Lin2_Error  # Error -
          data-receive-point-by-arguments:
            access DRP_Lin2ComRxSignalsSR_COMRXL_PECP_RPM_TGT_PERCT_PECP_STAT_GLOBAL_Lin2: accessed-variable=Lin2ComRxSignalsSR.COMRXL_PECP_RPM_TGT_PERCT_PECP_STAT_GLOBAL_Lin2
          data-send-points:
            access DSP_VeLINR_Pct_PECP_RPM_TGT_PERCT_VeLINR_Pct_PECP_RPM_TGT_PERCT: accessed-variable=VeLINR_Pct_PECP_RPM_TGT_PERCT.VeLINR_Pct_PECP_RPM_TGT_PERCT
            access DSP_VeLINR_b_PECP_RPM_TGT_PERCT_TO_VeLINR_b_PECP_RPM_TGT_PERCT_TO: accessed-variable=VeLINR_b_PECP_RPM_TGT_PERCT_TO.VeLINR_b_PECP_RPM_TGT_PERCT_TO
          read-local-variables:
            access IRVRA_VeLINR_d_LIN_SlavePrsnt_LIN2: accessed-variable=VeLINR_d_LIN_SlavePrsnt_LIN2
        COMRXL_PECP_RPM_ACTL_PERCT_PECP_STAT_GLOBAL_Lin2_Received: symbol=ApplLinComAb_LIN2_COMRXL_PECP_RPM_ACTL_PERCT_PECP_STAT_GLOBAL_Lin2_Received  # Received -
          data-receive-point-by-arguments:
            access DRP_Lin2ComRxSignalsSR_COMRXL_PECP_RPM_ACTL_PERCT_PECP_STAT_GLOBAL_Lin2: accessed-variable=Lin2ComRxSignalsSR.COMRXL_PECP_RPM_ACTL_PERCT_PECP_STAT_GLOBAL_Lin2
          data-send-points:
            access DSP_VeLINR_Pct_PECP_RPM_ACTL_PERCT_VeLINR_Pct_PECP_RPM_ACTL_PERCT: accessed-variable=VeLINR_Pct_PECP_RPM_ACTL_PERCT.VeLINR_Pct_PECP_RPM_ACTL_PERCT
            access DSP_VeLINR_b_PECP_RPM_ACTL_PERCT_TO_VeLINR_b_PECP_RPM_ACTL_PERCT_TO: accessed-variable=VeLINR_b_PECP_RPM_ACTL_PERCT_TO.VeLINR_b_PECP_RPM_ACTL_PERCT_TO
        COMRXL_PECP_RPM_ACTL_PERCT_PECP_STAT_GLOBAL_Lin2_Error: symbol=ApplLinComAb_LIN2_COMRXL_PECP_RPM_ACTL_PERCT_PECP_STAT_GLOBAL_Lin2_Error  # Error -
          data-receive-point-by-arguments:
            access DRP_Lin2ComRxSignalsSR_COMRXL_PECP_RPM_ACTL_PERCT_PECP_STAT_GLOBAL_Lin2: accessed-variable=Lin2ComRxSignalsSR.COMRXL_PECP_RPM_ACTL_PERCT_PECP_STAT_GLOBAL_Lin2
          data-send-points:
            access DSP_VeLINR_Pct_PECP_RPM_ACTL_PERCT_VeLINR_Pct_PECP_RPM_ACTL_PERCT: accessed-variable=VeLINR_Pct_PECP_RPM_ACTL_PERCT.VeLINR_Pct_PECP_RPM_ACTL_PERCT
            access DSP_VeLINR_b_PECP_RPM_ACTL_PERCT_TO_VeLINR_b_PECP_RPM_ACTL_PERCT_TO: accessed-variable=VeLINR_b_PECP_RPM_ACTL_PERCT_TO.VeLINR_b_PECP_RPM_ACTL_PERCT_TO
          read-local-variables:
            access IRVRA_VeLINR_d_LIN_SlavePrsnt_LIN2: accessed-variable=VeLINR_d_LIN_SlavePrsnt_LIN2
        COMRXL_PECP_VLTG_PECP_STAT_GLOBAL_Lin2_Received: symbol=ApplLinComAb_LIN2_COMRXL_PECP_VLTG_PECP_STAT_GLOBAL_Lin2_Received  # Received -
          data-receive-point-by-arguments:
            access DRP_Lin2ComRxSignalsSR_COMRXL_PECP_VLTG_PECP_STAT_GLOBAL_Lin2: accessed-variable=Lin2ComRxSignalsSR.COMRXL_PECP_VLTG_PECP_STAT_GLOBAL_Lin2
          data-send-points:
            access DSP_VeLINR_U_PECP_VLTG_VeLINR_U_PECP_VLTG: accessed-variable=VeLINR_U_PECP_VLTG.VeLINR_U_PECP_VLTG
            access DSP_VeLINR_b_PECP_VLTG_TO_VeLINR_b_PECP_VLTG_TO: accessed-variable=VeLINR_b_PECP_VLTG_TO.VeLINR_b_PECP_VLTG_TO
        COMRXL_PECP_VLTG_PECP_STAT_GLOBAL_Lin2_Error: symbol=ApplLinComAb_LIN2_COMRXL_PECP_VLTG_PECP_STAT_GLOBAL_Lin2_Error  # Error -
          data-receive-point-by-arguments:
            access DRP_Lin2ComRxSignalsSR_COMRXL_PECP_VLTG_PECP_STAT_GLOBAL_Lin2: accessed-variable=Lin2ComRxSignalsSR.COMRXL_PECP_VLTG_PECP_STAT_GLOBAL_Lin2
          data-send-points:
            access DSP_VeLINR_U_PECP_VLTG_VeLINR_U_PECP_VLTG: accessed-variable=VeLINR_U_PECP_VLTG.VeLINR_U_PECP_VLTG
            access DSP_VeLINR_b_PECP_VLTG_TO_VeLINR_b_PECP_VLTG_TO: accessed-variable=VeLINR_b_PECP_VLTG_TO.VeLINR_b_PECP_VLTG_TO
          read-local-variables:
            access IRVRA_VeLINR_d_LIN_SlavePrsnt_LIN2: accessed-variable=VeLINR_d_LIN_SlavePrsnt_LIN2
        COMRXL_PECP_TEMP_PECP_STAT_GLOBAL_Lin2_Received: symbol=ApplLinComAb_LIN2_COMRXL_PECP_TEMP_PECP_STAT_GLOBAL_Lin2_Received  # Received -
          data-receive-point-by-arguments:
            access DRP_Lin2ComRxSignalsSR_COMRXL_PECP_TEMP_PECP_STAT_GLOBAL_Lin2: accessed-variable=Lin2ComRxSignalsSR.COMRXL_PECP_TEMP_PECP_STAT_GLOBAL_Lin2
          data-send-points:
            access DSP_VeLINR_T_PECP_TEMP_VeLINR_T_PECP_TEMP: accessed-variable=VeLINR_T_PECP_TEMP.VeLINR_T_PECP_TEMP
            access DSP_VeLINR_b_PECP_TEMP_TO_VeLINR_b_PECP_TEMP_TO: accessed-variable=VeLINR_b_PECP_TEMP_TO.VeLINR_b_PECP_TEMP_TO
        COMRXL_PECP_TEMP_PECP_STAT_GLOBAL_Lin2_Error: symbol=ApplLinComAb_LIN2_COMRXL_PECP_TEMP_PECP_STAT_GLOBAL_Lin2_Error  # Error -
          data-receive-point-by-arguments:
            access DRP_Lin2ComRxSignalsSR_COMRXL_PECP_TEMP_PECP_STAT_GLOBAL_Lin2: accessed-variable=Lin2ComRxSignalsSR.COMRXL_PECP_TEMP_PECP_STAT_GLOBAL_Lin2
          data-send-points:
            access DSP_VeLINR_T_PECP_TEMP_VeLINR_T_PECP_TEMP: accessed-variable=VeLINR_T_PECP_TEMP.VeLINR_T_PECP_TEMP
            access DSP_VeLINR_b_PECP_TEMP_TO_VeLINR_b_PECP_TEMP_TO: accessed-variable=VeLINR_b_PECP_TEMP_TO.VeLINR_b_PECP_TEMP_TO
          read-local-variables:
            access IRVRA_VeLINR_d_LIN_SlavePrsnt_LIN2: accessed-variable=VeLINR_d_LIN_SlavePrsnt_LIN2
        COMRXL_PECP_CURR_PECP_STAT_GLOBAL_Lin2_Received: symbol=ApplLinComAb_LIN2_COMRXL_PECP_CURR_PECP_STAT_GLOBAL_Lin2_Received  # Received -
          data-receive-point-by-arguments:
            access DRP_Lin2ComRxSignalsSR_COMRXL_PECP_CURR_PECP_STAT_GLOBAL_Lin2: accessed-variable=Lin2ComRxSignalsSR.COMRXL_PECP_CURR_PECP_STAT_GLOBAL_Lin2
          data-send-points:
            access DSP_VeLINR_I_PECP_CURR_VeLINR_I_PECP_CURR: accessed-variable=VeLINR_I_PECP_CURR.VeLINR_I_PECP_CURR
            access DSP_VeLINR_b_PECP_CURR_TO_VeLINR_b_PECP_CURR_TO: accessed-variable=VeLINR_b_PECP_CURR_TO.VeLINR_b_PECP_CURR_TO
        COMRXL_PECP_CURR_PECP_STAT_GLOBAL_Lin2_Error: symbol=ApplLinComAb_LIN2_COMRXL_PECP_CURR_PECP_STAT_GLOBAL_Lin2_Error  # Error -
          data-receive-point-by-arguments:
            access DRP_Lin2ComRxSignalsSR_COMRXL_PECP_CURR_PECP_STAT_GLOBAL_Lin2: accessed-variable=Lin2ComRxSignalsSR.COMRXL_PECP_CURR_PECP_STAT_GLOBAL_Lin2
          data-send-points:
            access DSP_VeLINR_I_PECP_CURR_VeLINR_I_PECP_CURR: accessed-variable=VeLINR_I_PECP_CURR.VeLINR_I_PECP_CURR
            access DSP_VeLINR_b_PECP_CURR_TO_VeLINR_b_PECP_CURR_TO: accessed-variable=VeLINR_b_PECP_CURR_TO.VeLINR_b_PECP_CURR_TO
          read-local-variables:
            access IRVRA_VeLINR_d_LIN_SlavePrsnt_LIN2: accessed-variable=VeLINR_d_LIN_SlavePrsnt_LIN2
        COMRXL_PECP_FL_SAFE_ACTVTD_PECP_STAT_GLOBAL_Lin2_Received: symbol=ApplLinComAb_LIN2_COMRXL_PECP_FL_SAFE_ACTVTD_PECP_STAT_GLOBAL_Lin2_Received  # Received -
          data-receive-point-by-arguments:
            access DRP_Lin2ComRxSignalsSR_COMRXL_PECP_FL_SAFE_ACTVTD_PECP_STAT_GLOBAL_Lin2: accessed-variable=Lin2ComRxSignalsSR.COMRXL_PECP_FL_SAFE_ACTVTD_PECP_STAT_GLOBAL_Lin2
          data-send-points:
            access DSP_VeLINR_e_PECP_FL_SAFE_ACTVTD_VeLINR_e_PECP_FL_SAFE_ACTVTD: accessed-variable=VeLINR_e_PECP_FL_SAFE_ACTVTD.VeLINR_e_PECP_FL_SAFE_ACTVTD
            access DSP_VeLINR_b_PECP_FL_SAFE_ACTVTD_TO_VeLINR_b_PECP_FL_SAFE_ACTVTD_TO: accessed-variable=VeLINR_b_PECP_FL_SAFE_ACTVTD_TO.VeLINR_b_PECP_FL_SAFE_ACTVTD_TO
        COMRXL_PECP_FL_SAFE_ACTVTD_PECP_STAT_GLOBAL_Lin2_Error: symbol=ApplLinComAb_LIN2_COMRXL_PECP_FL_SAFE_ACTVTD_PECP_STAT_GLOBAL_Lin2_Error  # Error -
          data-receive-point-by-arguments:
            access DRP_Lin2ComRxSignalsSR_COMRXL_PECP_FL_SAFE_ACTVTD_PECP_STAT_GLOBAL_Lin2: accessed-variable=Lin2ComRxSignalsSR.COMRXL_PECP_FL_SAFE_ACTVTD_PECP_STAT_GLOBAL_Lin2
          data-send-points:
            access DSP_VeLINR_e_PECP_FL_SAFE_ACTVTD_VeLINR_e_PECP_FL_SAFE_ACTVTD: accessed-variable=VeLINR_e_PECP_FL_SAFE_ACTVTD.VeLINR_e_PECP_FL_SAFE_ACTVTD
            access DSP_VeLINR_b_PECP_FL_SAFE_ACTVTD_TO_VeLINR_b_PECP_FL_SAFE_ACTVTD_TO: accessed-variable=VeLINR_b_PECP_FL_SAFE_ACTVTD_TO.VeLINR_b_PECP_FL_SAFE_ACTVTD_TO
          read-local-variables:
            access IRVRA_VeLINR_d_LIN_SlavePrsnt_LIN2: accessed-variable=VeLINR_d_LIN_SlavePrsnt_LIN2
        COMRXL_PECP_LMP_HM_AN_ON_PECP_STAT_GLOBAL_Lin2_Received: symbol=ApplLinComAb_LIN2_COMRXL_PECP_LMP_HM_AN_ON_PECP_STAT_GLOBAL_Lin2_Received  # Received -
          data-receive-point-by-arguments:
            access DRP_Lin2ComRxSignalsSR_COMRXL_PECP_LMP_HM_AN_ON_PECP_STAT_GLOBAL_Lin2: accessed-variable=Lin2ComRxSignalsSR.COMRXL_PECP_LMP_HM_AN_ON_PECP_STAT_GLOBAL_Lin2
          data-send-points:
            access DSP_VeLINR_e_PECP_LMP_HM_AN_ON_VeLINR_e_PECP_LMP_HM_AN_ON: accessed-variable=VeLINR_e_PECP_LMP_HM_AN_ON.VeLINR_e_PECP_LMP_HM_AN_ON
            access DSP_VeLINR_b_PECP_LMP_HM_AN_ON_TO_VeLINR_b_PECP_LMP_HM_AN_ON_TO: accessed-variable=VeLINR_b_PECP_LMP_HM_AN_ON_TO.VeLINR_b_PECP_LMP_HM_AN_ON_TO
        COMRXL_PECP_LMP_HM_AN_ON_PECP_STAT_GLOBAL_Lin2_Error: symbol=ApplLinComAb_LIN2_COMRXL_PECP_LMP_HM_AN_ON_PECP_STAT_GLOBAL_Lin2_Error  # Error -
          data-receive-point-by-arguments:
            access DRP_Lin2ComRxSignalsSR_COMRXL_PECP_LMP_HM_AN_ON_PECP_STAT_GLOBAL_Lin2: accessed-variable=Lin2ComRxSignalsSR.COMRXL_PECP_LMP_HM_AN_ON_PECP_STAT_GLOBAL_Lin2
          data-send-points:
            access DSP_VeLINR_e_PECP_LMP_HM_AN_ON_VeLINR_e_PECP_LMP_HM_AN_ON: accessed-variable=VeLINR_e_PECP_LMP_HM_AN_ON.VeLINR_e_PECP_LMP_HM_AN_ON
            access DSP_VeLINR_b_PECP_LMP_HM_AN_ON_TO_VeLINR_b_PECP_LMP_HM_AN_ON_TO: accessed-variable=VeLINR_b_PECP_LMP_HM_AN_ON_TO.VeLINR_b_PECP_LMP_HM_AN_ON_TO
          read-local-variables:
            access IRVRA_VeLINR_d_LIN_SlavePrsnt_LIN2: accessed-variable=VeLINR_d_LIN_SlavePrsnt_LIN2
        COMRXL_PECP_AIR_PRE_ERR_PECP_STAT_GLOBAL_Lin2_Received: symbol=ApplLinComAb_LIN2_COMRXL_PECP_AIR_PRE_ERR_PECP_STAT_GLOBAL_Lin2_Received  # Received -
          data-receive-point-by-arguments:
            access DRP_Lin2ComRxSignalsSR_COMRXL_PECP_AIR_PRE_ERR_PECP_STAT_GLOBAL_Lin2: accessed-variable=Lin2ComRxSignalsSR.COMRXL_PECP_AIR_PRE_ERR_PECP_STAT_GLOBAL_Lin2
          data-send-points:
            access DSP_VeLINR_e_PECP_AIR_PRE_ERR_VeLINR_e_PECP_AIR_PRE_ERR: accessed-variable=VeLINR_e_PECP_AIR_PRE_ERR.VeLINR_e_PECP_AIR_PRE_ERR
            access DSP_VeLINR_b_PECP_AIR_PRE_ERR_TO_VeLINR_b_PECP_AIR_PRE_ERR_TO: accessed-variable=VeLINR_b_PECP_AIR_PRE_ERR_TO.VeLINR_b_PECP_AIR_PRE_ERR_TO
        COMRXL_PECP_AIR_PRE_ERR_PECP_STAT_GLOBAL_Lin2_Error: symbol=ApplLinComAb_LIN2_COMRXL_PECP_AIR_PRE_ERR_PECP_STAT_GLOBAL_Lin2_Error  # Error -
          data-receive-point-by-arguments:
            access DRP_Lin2ComRxSignalsSR_COMRXL_PECP_AIR_PRE_ERR_PECP_STAT_GLOBAL_Lin2: accessed-variable=Lin2ComRxSignalsSR.COMRXL_PECP_AIR_PRE_ERR_PECP_STAT_GLOBAL_Lin2
          data-send-points:
            access DSP_VeLINR_e_PECP_AIR_PRE_ERR_VeLINR_e_PECP_AIR_PRE_ERR: accessed-variable=VeLINR_e_PECP_AIR_PRE_ERR.VeLINR_e_PECP_AIR_PRE_ERR
            access DSP_VeLINR_b_PECP_AIR_PRE_ERR_TO_VeLINR_b_PECP_AIR_PRE_ERR_TO: accessed-variable=VeLINR_b_PECP_AIR_PRE_ERR_TO.VeLINR_b_PECP_AIR_PRE_ERR_TO
          read-local-variables:
            access IRVRA_VeLINR_d_LIN_SlavePrsnt_LIN2: accessed-variable=VeLINR_d_LIN_SlavePrsnt_LIN2
        COMRXL_PECP_OVR_TMP_ERR_PECP_STAT_GLOBAL_Lin2_Received: symbol=ApplLinComAb_LIN2_COMRXL_PECP_OVR_TMP_ERR_PECP_STAT_GLOBAL_Lin2_Received  # Received -
          data-receive-point-by-arguments:
            access DRP_Lin2ComRxSignalsSR_COMRXL_PECP_OVR_TMP_ERR_PECP_STAT_GLOBAL_Lin2: accessed-variable=Lin2ComRxSignalsSR.COMRXL_PECP_OVR_TMP_ERR_PECP_STAT_GLOBAL_Lin2
          data-send-points:
            access DSP_VeLINR_e_PECP_OVR_TMP_ERR_VeLINR_e_PECP_OVR_TMP_ERR: accessed-variable=VeLINR_e_PECP_OVR_TMP_ERR.VeLINR_e_PECP_OVR_TMP_ERR
            access DSP_VeLINR_b_PECP_OVR_TMP_ERR_TO_VeLINR_b_PECP_OVR_TMP_ERR_TO: accessed-variable=VeLINR_b_PECP_OVR_TMP_ERR_TO.VeLINR_b_PECP_OVR_TMP_ERR_TO
        COMRXL_PECP_OVR_TMP_ERR_PECP_STAT_GLOBAL_Lin2_Error: symbol=ApplLinComAb_LIN2_COMRXL_PECP_OVR_TMP_ERR_PECP_STAT_GLOBAL_Lin2_Error  # Error -
          data-receive-point-by-arguments:
            access DRP_Lin2ComRxSignalsSR_COMRXL_PECP_OVR_TMP_ERR_PECP_STAT_GLOBAL_Lin2: accessed-variable=Lin2ComRxSignalsSR.COMRXL_PECP_OVR_TMP_ERR_PECP_STAT_GLOBAL_Lin2
          data-send-points:
            access DSP_VeLINR_e_PECP_OVR_TMP_ERR_VeLINR_e_PECP_OVR_TMP_ERR: accessed-variable=VeLINR_e_PECP_OVR_TMP_ERR.VeLINR_e_PECP_OVR_TMP_ERR
            access DSP_VeLINR_b_PECP_OVR_TMP_ERR_TO_VeLINR_b_PECP_OVR_TMP_ERR_TO: accessed-variable=VeLINR_b_PECP_OVR_TMP_ERR_TO.VeLINR_b_PECP_OVR_TMP_ERR_TO
          read-local-variables:
            access IRVRA_VeLINR_d_LIN_SlavePrsnt_LIN2: accessed-variable=VeLINR_d_LIN_SlavePrsnt_LIN2
        COMRXL_PECP_OVR_CUR_ERR_PECP_STAT_GLOBAL_Lin2_Received: symbol=ApplLinComAb_LIN2_COMRXL_PECP_OVR_CUR_ERR_PECP_STAT_GLOBAL_Lin2_Received  # Received -
          data-receive-point-by-arguments:
            access DRP_Lin2ComRxSignalsSR_COMRXL_PECP_OVR_CUR_ERR_PECP_STAT_GLOBAL_Lin2: accessed-variable=Lin2ComRxSignalsSR.COMRXL_PECP_OVR_CUR_ERR_PECP_STAT_GLOBAL_Lin2
          data-send-points:
            access DSP_VeLINR_e_PECP_OVR_CUR_ERR_VeLINR_e_PECP_OVR_CUR_ERR: accessed-variable=VeLINR_e_PECP_OVR_CUR_ERR.VeLINR_e_PECP_OVR_CUR_ERR
            access DSP_VeLINR_b_PECP_OVR_CUR_ERR_TO_VeLINR_b_PECP_OVR_CUR_ERR_TO: accessed-variable=VeLINR_b_PECP_OVR_CUR_ERR_TO.VeLINR_b_PECP_OVR_CUR_ERR_TO
        COMRXL_PECP_OVR_CUR_ERR_PECP_STAT_GLOBAL_Lin2_Error: symbol=ApplLinComAb_LIN2_COMRXL_PECP_OVR_CUR_ERR_PECP_STAT_GLOBAL_Lin2_Error  # Error -
          data-receive-point-by-arguments:
            access DRP_Lin2ComRxSignalsSR_COMRXL_PECP_OVR_CUR_ERR_PECP_STAT_GLOBAL_Lin2: accessed-variable=Lin2ComRxSignalsSR.COMRXL_PECP_OVR_CUR_ERR_PECP_STAT_GLOBAL_Lin2
          data-send-points:
            access DSP_VeLINR_e_PECP_OVR_CUR_ERR_VeLINR_e_PECP_OVR_CUR_ERR: accessed-variable=VeLINR_e_PECP_OVR_CUR_ERR.VeLINR_e_PECP_OVR_CUR_ERR
            access DSP_VeLINR_b_PECP_OVR_CUR_ERR_TO_VeLINR_b_PECP_OVR_CUR_ERR_TO: accessed-variable=VeLINR_b_PECP_OVR_CUR_ERR_TO.VeLINR_b_PECP_OVR_CUR_ERR_TO
          read-local-variables:
            access IRVRA_VeLINR_d_LIN_SlavePrsnt_LIN2: accessed-variable=VeLINR_d_LIN_SlavePrsnt_LIN2
        COMRXL_PECP_DR_RN_ERR_PECP_STAT_GLOBAL_Lin2_Received: symbol=ApplLinComAb_LIN2_COMRXL_PECP_DR_RN_ERR_PECP_STAT_GLOBAL_Lin2_Received  # Received -
          data-receive-point-by-arguments:
            access DRP_Lin2ComRxSignalsSR_COMRXL_PECP_DR_RN_ERR_PECP_STAT_GLOBAL_Lin2: accessed-variable=Lin2ComRxSignalsSR.COMRXL_PECP_DR_RN_ERR_PECP_STAT_GLOBAL_Lin2
          data-send-points:
            access DSP_VeLINR_e_PECP_DR_RN_ERR_VeLINR_e_PECP_DR_RN_ERR: accessed-variable=VeLINR_e_PECP_DR_RN_ERR.VeLINR_e_PECP_DR_RN_ERR
            access DSP_VeLINR_b_PECP_DR_RN_ERR_TO_VeLINR_b_PECP_DR_RN_ERR_TO: accessed-variable=VeLINR_b_PECP_DR_RN_ERR_TO.VeLINR_b_PECP_DR_RN_ERR_TO
        COMRXL_PECP_DR_RN_ERR_PECP_STAT_GLOBAL_Lin2_Error: symbol=ApplLinComAb_LIN2_COMRXL_PECP_DR_RN_ERR_PECP_STAT_GLOBAL_Lin2_Error  # Error -
          data-receive-point-by-arguments:
            access DRP_Lin2ComRxSignalsSR_COMRXL_PECP_DR_RN_ERR_PECP_STAT_GLOBAL_Lin2: accessed-variable=Lin2ComRxSignalsSR.COMRXL_PECP_DR_RN_ERR_PECP_STAT_GLOBAL_Lin2
          data-send-points:
            access DSP_VeLINR_e_PECP_DR_RN_ERR_VeLINR_e_PECP_DR_RN_ERR: accessed-variable=VeLINR_e_PECP_DR_RN_ERR.VeLINR_e_PECP_DR_RN_ERR
            access DSP_VeLINR_b_PECP_DR_RN_ERR_TO_VeLINR_b_PECP_DR_RN_ERR_TO: accessed-variable=VeLINR_b_PECP_DR_RN_ERR_TO.VeLINR_b_PECP_DR_RN_ERR_TO
          read-local-variables:
            access IRVRA_VeLINR_d_LIN_SlavePrsnt_LIN2: accessed-variable=VeLINR_d_LIN_SlavePrsnt_LIN2
        COMRXL_PECP_VLTG_ERR_PECP_STAT_GLOBAL_Lin2_Received: symbol=ApplLinComAb_LIN2_COMRXL_PECP_VLTG_ERR_PECP_STAT_GLOBAL_Lin2_Received  # Received -
          data-receive-point-by-arguments:
            access DRP_Lin2ComRxSignalsSR_COMRXL_PECP_VLTG_ERR_PECP_STAT_GLOBAL_Lin2: accessed-variable=Lin2ComRxSignalsSR.COMRXL_PECP_VLTG_ERR_PECP_STAT_GLOBAL_Lin2
          data-send-points:
            access DSP_VeLINR_e_PECP_VLTG_ERR_VeLINR_e_PECP_VLTG_ERR: accessed-variable=VeLINR_e_PECP_VLTG_ERR.VeLINR_e_PECP_VLTG_ERR
            access DSP_VeLINR_b_PECP_VLTG_ERR_TO_VeLINR_b_PECP_VLTG_ERR_TO: accessed-variable=VeLINR_b_PECP_VLTG_ERR_TO.VeLINR_b_PECP_VLTG_ERR_TO
        COMRXL_PECP_VLTG_ERR_PECP_STAT_GLOBAL_Lin2_Error: symbol=ApplLinComAb_LIN2_COMRXL_PECP_VLTG_ERR_PECP_STAT_GLOBAL_Lin2_Error  # Error -
          data-receive-point-by-arguments:
            access DRP_Lin2ComRxSignalsSR_COMRXL_PECP_VLTG_ERR_PECP_STAT_GLOBAL_Lin2: accessed-variable=Lin2ComRxSignalsSR.COMRXL_PECP_VLTG_ERR_PECP_STAT_GLOBAL_Lin2
          data-send-points:
            access DSP_VeLINR_e_PECP_VLTG_ERR_VeLINR_e_PECP_VLTG_ERR: accessed-variable=VeLINR_e_PECP_VLTG_ERR.VeLINR_e_PECP_VLTG_ERR
            access DSP_VeLINR_b_PECP_VLTG_ERR_TO_VeLINR_b_PECP_VLTG_ERR_TO: accessed-variable=VeLINR_b_PECP_VLTG_ERR_TO.VeLINR_b_PECP_VLTG_ERR_TO
          read-local-variables:
            access IRVRA_VeLINR_d_LIN_SlavePrsnt_LIN2: accessed-variable=VeLINR_d_LIN_SlavePrsnt_LIN2
        COMRXL_PECP_DBLK_ACTV_PECP_STAT_GLOBAL_Lin2_Received: symbol=ApplLinComAb_LIN2_COMRXL_PECP_DBLK_ACTV_PECP_STAT_GLOBAL_Lin2_Received  # Received -
          data-receive-point-by-arguments:
            access DRP_Lin2ComRxSignalsSR_COMRXL_PECP_DBLK_ACTV_PECP_STAT_GLOBAL_Lin2: accessed-variable=Lin2ComRxSignalsSR.COMRXL_PECP_DBLK_ACTV_PECP_STAT_GLOBAL_Lin2
          data-send-points:
            access DSP_VeLINR_e_PECP_DBLK_ACTV_VeLINR_e_PECP_DBLK_ACTV: accessed-variable=VeLINR_e_PECP_DBLK_ACTV.VeLINR_e_PECP_DBLK_ACTV
            access DSP_VeLINR_b_PECP_DBLK_ACTV_TO_VeLINR_b_PECP_DBLK_ACTV_TO: accessed-variable=VeLINR_b_PECP_DBLK_ACTV_TO.VeLINR_b_PECP_DBLK_ACTV_TO
        COMRXL_PECP_DBLK_ACTV_PECP_STAT_GLOBAL_Lin2_Error: symbol=ApplLinComAb_LIN2_COMRXL_PECP_DBLK_ACTV_PECP_STAT_GLOBAL_Lin2_Error  # Error -
          data-receive-point-by-arguments:
            access DRP_Lin2ComRxSignalsSR_COMRXL_PECP_DBLK_ACTV_PECP_STAT_GLOBAL_Lin2: accessed-variable=Lin2ComRxSignalsSR.COMRXL_PECP_DBLK_ACTV_PECP_STAT_GLOBAL_Lin2
          data-send-points:
            access DSP_VeLINR_e_PECP_DBLK_ACTV_VeLINR_e_PECP_DBLK_ACTV: accessed-variable=VeLINR_e_PECP_DBLK_ACTV.VeLINR_e_PECP_DBLK_ACTV
            access DSP_VeLINR_b_PECP_DBLK_ACTV_TO_VeLINR_b_PECP_DBLK_ACTV_TO: accessed-variable=VeLINR_b_PECP_DBLK_ACTV_TO.VeLINR_b_PECP_DBLK_ACTV_TO
          read-local-variables:
            access IRVRA_VeLINR_d_LIN_SlavePrsnt_LIN2: accessed-variable=VeLINR_d_LIN_SlavePrsnt_LIN2
        COMRXL_PECP_MONTRNG_RPM_PECP_STAT_GLOBAL_Lin2_Received: symbol=ApplLinComAb_LIN2_COMRXL_PECP_MONTRNG_RPM_PECP_STAT_GLOBAL_Lin2_Received  # Received -
          data-receive-point-by-arguments:
            access DRP_Lin2ComRxSignalsSR_COMRXL_PECP_MONTRNG_RPM_PECP_STAT_GLOBAL_Lin2: accessed-variable=Lin2ComRxSignalsSR.COMRXL_PECP_MONTRNG_RPM_PECP_STAT_GLOBAL_Lin2
          data-send-points:
            access DSP_VeLINR_e_PECP_MONTRNG_RPM_VeLINR_e_PECP_MONTRNG_RPM: accessed-variable=VeLINR_e_PECP_MONTRNG_RPM.VeLINR_e_PECP_MONTRNG_RPM
            access DSP_VeLINR_b_PECP_MONTRNG_RPM_TO_VeLINR_b_PECP_MONTRNG_RPM_TO: accessed-variable=VeLINR_b_PECP_MONTRNG_RPM_TO.VeLINR_b_PECP_MONTRNG_RPM_TO
        COMRXL_PECP_MONTRNG_RPM_PECP_STAT_GLOBAL_Lin2_Error: symbol=ApplLinComAb_LIN2_COMRXL_PECP_MONTRNG_RPM_PECP_STAT_GLOBAL_Lin2_Error  # Error -
          data-receive-point-by-arguments:
            access DRP_Lin2ComRxSignalsSR_COMRXL_PECP_MONTRNG_RPM_PECP_STAT_GLOBAL_Lin2: accessed-variable=Lin2ComRxSignalsSR.COMRXL_PECP_MONTRNG_RPM_PECP_STAT_GLOBAL_Lin2
          data-send-points:
            access DSP_VeLINR_e_PECP_MONTRNG_RPM_VeLINR_e_PECP_MONTRNG_RPM: accessed-variable=VeLINR_e_PECP_MONTRNG_RPM.VeLINR_e_PECP_MONTRNG_RPM
            access DSP_VeLINR_b_PECP_MONTRNG_RPM_TO_VeLINR_b_PECP_MONTRNG_RPM_TO: accessed-variable=VeLINR_b_PECP_MONTRNG_RPM_TO.VeLINR_b_PECP_MONTRNG_RPM_TO
          read-local-variables:
            access IRVRA_VeLINR_d_LIN_SlavePrsnt_LIN2: accessed-variable=VeLINR_d_LIN_SlavePrsnt_LIN2
        COMRXL_PECP_NODE_ERR_PECP_STAT_GLOBAL_Lin2_Received: symbol=ApplLinComAb_LIN2_COMRXL_PECP_NODE_ERR_PECP_STAT_GLOBAL_Lin2_Received  # Received -
          data-receive-point-by-arguments:
            access DRP_Lin2ComRxSignalsSR_COMRXL_PECP_NODE_ERR_PECP_STAT_GLOBAL_Lin2: accessed-variable=Lin2ComRxSignalsSR.COMRXL_PECP_NODE_ERR_PECP_STAT_GLOBAL_Lin2
          data-send-points:
            access DSP_VeLINR_e_PECP_NODE_ERR_VeLINR_e_PECP_NODE_ERR: accessed-variable=VeLINR_e_PECP_NODE_ERR.VeLINR_e_PECP_NODE_ERR
            access DSP_VeLINR_b_PECP_NODE_ERR_TO_VeLINR_b_PECP_NODE_ERR_TO: accessed-variable=VeLINR_b_PECP_NODE_ERR_TO.VeLINR_b_PECP_NODE_ERR_TO
        COMRXL_PECP_NODE_ERR_PECP_STAT_GLOBAL_Lin2_Error: symbol=ApplLinComAb_LIN2_COMRXL_PECP_NODE_ERR_PECP_STAT_GLOBAL_Lin2_Error  # Error -
          data-receive-point-by-arguments:
            access DRP_Lin2ComRxSignalsSR_COMRXL_PECP_NODE_ERR_PECP_STAT_GLOBAL_Lin2: accessed-variable=Lin2ComRxSignalsSR.COMRXL_PECP_NODE_ERR_PECP_STAT_GLOBAL_Lin2
          data-send-points:
            access DSP_VeLINR_e_PECP_NODE_ERR_VeLINR_e_PECP_NODE_ERR: accessed-variable=VeLINR_e_PECP_NODE_ERR.VeLINR_e_PECP_NODE_ERR
            access DSP_VeLINR_b_PECP_NODE_ERR_TO_VeLINR_b_PECP_NODE_ERR_TO: accessed-variable=VeLINR_b_PECP_NODE_ERR_TO.VeLINR_b_PECP_NODE_ERR_TO
          read-local-variables:
            access IRVRA_VeLINR_d_LIN_SlavePrsnt_LIN2: accessed-variable=VeLINR_d_LIN_SlavePrsnt_LIN2
        COMRXL_PECP_POST_RUN_STAT_PECP_STAT_GLOBAL_Lin2_Received: symbol=ApplLinComAb_LIN2_COMRXL_PECP_POST_RUN_STAT_PECP_STAT_GLOBAL_Lin2_Received  # Received -
          data-receive-point-by-arguments:
            access DRP_Lin2ComRxSignalsSR_COMRXL_PECP_POST_RUN_STAT_PECP_STAT_GLOBAL_Lin2: accessed-variable=Lin2ComRxSignalsSR.COMRXL_PECP_POST_RUN_STAT_PECP_STAT_GLOBAL_Lin2
          data-send-points:
            access DSP_VeLINR_e_PECP_POST_RUN_STAT_VeLINR_e_PECP_POST_RUN_STAT: accessed-variable=VeLINR_e_PECP_POST_RUN_STAT.VeLINR_e_PECP_POST_RUN_STAT
            access DSP_VeLINR_b_PECP_POST_RUN_STAT_TO_VeLINR_b_PECP_POST_RUN_STAT_TO: accessed-variable=VeLINR_b_PECP_POST_RUN_STAT_TO.VeLINR_b_PECP_POST_RUN_STAT_TO
        COMRXL_PECP_POST_RUN_STAT_PECP_STAT_GLOBAL_Lin2_Error: symbol=ApplLinComAb_LIN2_COMRXL_PECP_POST_RUN_STAT_PECP_STAT_GLOBAL_Lin2_Error  # Error -
          data-receive-point-by-arguments:
            access DRP_Lin2ComRxSignalsSR_COMRXL_PECP_POST_RUN_STAT_PECP_STAT_GLOBAL_Lin2: accessed-variable=Lin2ComRxSignalsSR.COMRXL_PECP_POST_RUN_STAT_PECP_STAT_GLOBAL_Lin2
          data-send-points:
            access DSP_VeLINR_e_PECP_POST_RUN_STAT_VeLINR_e_PECP_POST_RUN_STAT: accessed-variable=VeLINR_e_PECP_POST_RUN_STAT.VeLINR_e_PECP_POST_RUN_STAT
            access DSP_VeLINR_b_PECP_POST_RUN_STAT_TO_VeLINR_b_PECP_POST_RUN_STAT_TO: accessed-variable=VeLINR_b_PECP_POST_RUN_STAT_TO.VeLINR_b_PECP_POST_RUN_STAT_TO
          read-local-variables:
            access IRVRA_VeLINR_d_LIN_SlavePrsnt_LIN2: accessed-variable=VeLINR_d_LIN_SlavePrsnt_LIN2
        COMRXL_RsErr_PECP_PUMP_PECP_STAT_GLOBAL_Lin2_Received: symbol=ApplLinComAb_LIN2_COMRXL_RsErr_PECP_PUMP_PECP_STAT_GLOBAL_Lin2_Received  # Received -
          data-receive-point-by-arguments:
            access DRP_Lin2ComRxSignalsSR_COMRXL_RsErr_PECP_PUMP_PECP_STAT_GLOBAL_Lin2: accessed-variable=Lin2ComRxSignalsSR.COMRXL_RsErr_PECP_PUMP_PECP_STAT_GLOBAL_Lin2
          data-send-points:
            access DSP_VeLINR_b_RsErr_PECP_PUMP_VeLINR_b_RsErr_PECP_PUMP: accessed-variable=VeLINR_b_RsErr_PECP_PUMP.VeLINR_b_RsErr_PECP_PUMP
            access DSP_VeLINR_b_RsErr_PECP_PUMP_TO_VeLINR_b_RsErr_PECP_PUMP_TO: accessed-variable=VeLINR_b_RsErr_PECP_PUMP_TO.VeLINR_b_RsErr_PECP_PUMP_TO
        COMRXL_RsErr_PECP_PUMP_PECP_STAT_GLOBAL_Lin2_Error: symbol=ApplLinComAb_LIN2_COMRXL_RsErr_PECP_PUMP_PECP_STAT_GLOBAL_Lin2_Error  # Error -
          data-receive-point-by-arguments:
            access DRP_Lin2ComRxSignalsSR_COMRXL_RsErr_PECP_PUMP_PECP_STAT_GLOBAL_Lin2: accessed-variable=Lin2ComRxSignalsSR.COMRXL_RsErr_PECP_PUMP_PECP_STAT_GLOBAL_Lin2
          data-send-points:
            access DSP_VeLINR_b_RsErr_PECP_PUMP_VeLINR_b_RsErr_PECP_PUMP: accessed-variable=VeLINR_b_RsErr_PECP_PUMP.VeLINR_b_RsErr_PECP_PUMP
            access DSP_VeLINR_b_RsErr_PECP_PUMP_TO_VeLINR_b_RsErr_PECP_PUMP_TO: accessed-variable=VeLINR_b_RsErr_PECP_PUMP_TO.VeLINR_b_RsErr_PECP_PUMP_TO
          read-local-variables:
            access IRVRA_VeLINR_d_LIN_SlavePrsnt_LIN2: accessed-variable=VeLINR_d_LIN_SlavePrsnt_LIN2
        COMRXL_PECP_SUPPLIER_PECP_VER_Lin2_Received: symbol=ApplLinComAb_LIN2_COMRXL_PECP_SUPPLIER_PECP_VER_Lin2_Received  # Received -
          data-receive-point-by-arguments:
            access DRP_Lin2ComRxSignalsSR_COMRXL_PECP_SUPPLIER_PECP_VER_Lin2: accessed-variable=Lin2ComRxSignalsSR.COMRXL_PECP_SUPPLIER_PECP_VER_Lin2
          data-send-points:
            access DSP_VeLINR_e_PECP_SUPPLIER_VeLINR_e_PECP_SUPPLIER: accessed-variable=VeLINR_e_PECP_SUPPLIER.VeLINR_e_PECP_SUPPLIER
            access DSP_VeLINR_b_PECP_SUPPLIER_TO_VeLINR_b_PECP_SUPPLIER_TO: accessed-variable=VeLINR_b_PECP_SUPPLIER_TO.VeLINR_b_PECP_SUPPLIER_TO
        COMRXL_PECP_SUPPLIER_PECP_VER_Lin2_Error: symbol=ApplLinComAb_LIN2_COMRXL_PECP_SUPPLIER_PECP_VER_Lin2_Error  # Error -
          data-receive-point-by-arguments:
            access DRP_Lin2ComRxSignalsSR_COMRXL_PECP_SUPPLIER_PECP_VER_Lin2: accessed-variable=Lin2ComRxSignalsSR.COMRXL_PECP_SUPPLIER_PECP_VER_Lin2
          data-send-points:
            access DSP_VeLINR_e_PECP_SUPPLIER_VeLINR_e_PECP_SUPPLIER: accessed-variable=VeLINR_e_PECP_SUPPLIER.VeLINR_e_PECP_SUPPLIER
            access DSP_VeLINR_b_PECP_SUPPLIER_TO_VeLINR_b_PECP_SUPPLIER_TO: accessed-variable=VeLINR_b_PECP_SUPPLIER_TO.VeLINR_b_PECP_SUPPLIER_TO
          read-local-variables:
            access IRVRA_VeLINR_d_LIN_SlavePrsnt_LIN2: accessed-variable=VeLINR_d_LIN_SlavePrsnt_LIN2
        COMRXL_PowerPanel_Button_State_PowerPanel_STAT_Lin2_Received: symbol=ApplLinComAb_LIN2_COMRXL_PowerPanel_Button_State_PowerPanel_STAT_Lin2_Received  # Received -
          data-receive-point-by-arguments:
            access DRP_Lin2ComRxSignalsSR_COMRXL_PowerPanel_Button_State_PowerPanel_STAT_Lin2: accessed-variable=Lin2ComRxSignalsSR.COMRXL_PowerPanel_Button_State_PowerPanel_STAT_Lin2
          data-send-points:
            access DSP_VeLINR_b_PowerPanelButton_State_VeLINR_b_PowerPanelButton_State: accessed-variable=VeLINR_b_PowerPanelButton_State.VeLINR_b_PowerPanelButton_State
            access DSP_VeLINR_b_PowerPanelButton_StateTO_VeLINR_b_PowerPanelButton_StateTO: accessed-variable=VeLINR_b_PowerPanelButton_StateTO.VeLINR_b_PowerPanelButton_StateTO
        COMRXL_PowerPanel_Button_State_PowerPanel_STAT_Lin2_Error: symbol=ApplLinComAb_LIN2_COMRXL_PowerPanel_Button_State_PowerPanel_STAT_Lin2_Error  # Error -
          data-receive-point-by-arguments:
            access DRP_Lin2ComRxSignalsSR_COMRXL_PowerPanel_Button_State_PowerPanel_STAT_Lin2: accessed-variable=Lin2ComRxSignalsSR.COMRXL_PowerPanel_Button_State_PowerPanel_STAT_Lin2
          data-send-points:
            access DSP_VeLINR_b_PowerPanelButton_State_VeLINR_b_PowerPanelButton_State: accessed-variable=VeLINR_b_PowerPanelButton_State.VeLINR_b_PowerPanelButton_State
            access DSP_VeLINR_b_PowerPanelButton_StateTO_VeLINR_b_PowerPanelButton_StateTO: accessed-variable=VeLINR_b_PowerPanelButton_StateTO.VeLINR_b_PowerPanelButton_StateTO
          read-local-variables:
            access IRVRA_VeLINR_d_LIN_SlavePrsnt_LIN2: accessed-variable=VeLINR_d_LIN_SlavePrsnt_LIN2
        COMRXL_PowerPanel_Lid_Switch_Sts_120A_PowerPanel_STAT_Lin2_Received: symbol=ApplLinComAb_LIN2_COMRXL_PowerPanel_Lid_Switch_Sts_120A_PowerPanel_STAT_Lin2_Received  # Received -
          data-receive-point-by-arguments:
            access DRP_Lin2ComRxSignalsSR_COMRXL_PowerPanel_Lid_Switch_Sts_120A_PowerPanel_STAT_Lin2: accessed-variable=Lin2ComRxSignalsSR.COMRXL_PowerPanel_Lid_Switch_Sts_120A_PowerPanel_STAT_Lin2
          data-send-points:
            access DSP_VeLINR_b_PwrPanelLidSwtSts120A_VeLINR_b_PwrPanelLidSwtSts120A: accessed-variable=VeLINR_b_PwrPanelLidSwtSts120A.VeLINR_b_PwrPanelLidSwtSts120A
            access DSP_VeLINR_b_PwrPanelLidSwtSts120A_TO_VeLINR_b_PwrPanelLidSwtSts120A_TO: accessed-variable=VeLINR_b_PwrPanelLidSwtSts120A_TO.VeLINR_b_PwrPanelLidSwtSts120A_TO
        COMRXL_PowerPanel_Lid_Switch_Sts_120A_PowerPanel_STAT_Lin2_Error: symbol=ApplLinComAb_LIN2_COMRXL_PowerPanel_Lid_Switch_Sts_120A_PowerPanel_STAT_Lin2_Error  # Error -
          data-receive-point-by-arguments:
            access DRP_Lin2ComRxSignalsSR_COMRXL_PowerPanel_Lid_Switch_Sts_120A_PowerPanel_STAT_Lin2: accessed-variable=Lin2ComRxSignalsSR.COMRXL_PowerPanel_Lid_Switch_Sts_120A_PowerPanel_STAT_Lin2
          data-send-points:
            access DSP_VeLINR_b_PwrPanelLidSwtSts120A_VeLINR_b_PwrPanelLidSwtSts120A: accessed-variable=VeLINR_b_PwrPanelLidSwtSts120A.VeLINR_b_PwrPanelLidSwtSts120A
            access DSP_VeLINR_b_PwrPanelLidSwtSts120A_TO_VeLINR_b_PwrPanelLidSwtSts120A_TO: accessed-variable=VeLINR_b_PwrPanelLidSwtSts120A_TO.VeLINR_b_PwrPanelLidSwtSts120A_TO
          read-local-variables:
            access IRVRA_VeLINR_d_LIN_SlavePrsnt_LIN2: accessed-variable=VeLINR_d_LIN_SlavePrsnt_LIN2
        COMRXL_PowerPanel_Lid_Switch_Sts_120B_PowerPanel_STAT_Lin2_Received: symbol=ApplLinComAb_LIN2_COMRXL_PowerPanel_Lid_Switch_Sts_120B_PowerPanel_STAT_Lin2_Received  # Received -
          data-receive-point-by-arguments:
            access DRP_Lin2ComRxSignalsSR_COMRXL_PowerPanel_Lid_Switch_Sts_120B_PowerPanel_STAT_Lin2: accessed-variable=Lin2ComRxSignalsSR.COMRXL_PowerPanel_Lid_Switch_Sts_120B_PowerPanel_STAT_Lin2
          data-send-points:
            access DSP_VeLINR_b_PwrPanelLidSwtSts120B_VeLINR_b_PwrPanelLidSwtSts120B: accessed-variable=VeLINR_b_PwrPanelLidSwtSts120B.VeLINR_b_PwrPanelLidSwtSts120B
            access DSP_VeLINR_b_PwrPanelLidSwtSts120B_TO_VeLINR_b_PwrPanelLidSwtSts120B_TO: accessed-variable=VeLINR_b_PwrPanelLidSwtSts120B_TO.VeLINR_b_PwrPanelLidSwtSts120B_TO
        COMRXL_PowerPanel_Lid_Switch_Sts_120B_PowerPanel_STAT_Lin2_Error: symbol=ApplLinComAb_LIN2_COMRXL_PowerPanel_Lid_Switch_Sts_120B_PowerPanel_STAT_Lin2_Error  # Error -
          data-receive-point-by-arguments:
            access DRP_Lin2ComRxSignalsSR_COMRXL_PowerPanel_Lid_Switch_Sts_120B_PowerPanel_STAT_Lin2: accessed-variable=Lin2ComRxSignalsSR.COMRXL_PowerPanel_Lid_Switch_Sts_120B_PowerPanel_STAT_Lin2
          data-send-points:
            access DSP_VeLINR_b_PwrPanelLidSwtSts120B_VeLINR_b_PwrPanelLidSwtSts120B: accessed-variable=VeLINR_b_PwrPanelLidSwtSts120B.VeLINR_b_PwrPanelLidSwtSts120B
            access DSP_VeLINR_b_PwrPanelLidSwtSts120B_TO_VeLINR_b_PwrPanelLidSwtSts120B_TO: accessed-variable=VeLINR_b_PwrPanelLidSwtSts120B_TO.VeLINR_b_PwrPanelLidSwtSts120B_TO
          read-local-variables:
            access IRVRA_VeLINR_d_LIN_SlavePrsnt_LIN2: accessed-variable=VeLINR_d_LIN_SlavePrsnt_LIN2
        COMRXL_PowerPanel_Lid_Switch_Sts_240_PowerPanel_STAT_Lin2_Received: symbol=ApplLinComAb_LIN2_COMRXL_PowerPanel_Lid_Switch_Sts_240_PowerPanel_STAT_Lin2_Received  # Received -
          data-receive-point-by-arguments:
            access DRP_Lin2ComRxSignalsSR_COMRXL_PowerPanel_Lid_Switch_Sts_240_PowerPanel_STAT_Lin2: accessed-variable=Lin2ComRxSignalsSR.COMRXL_PowerPanel_Lid_Switch_Sts_240_PowerPanel_STAT_Lin2
          data-send-points:
            access DSP_VeLINR_b_PwrPanelLidSwtSts240_VeLINR_b_PwrPanelLidSwtSts240: accessed-variable=VeLINR_b_PwrPanelLidSwtSts240.VeLINR_b_PwrPanelLidSwtSts240
            access DSP_VeLINR_b_PwrPanelLidSwtSts240TO_VeLINR_b_PwrPanelLidSwtSts240TO: accessed-variable=VeLINR_b_PwrPanelLidSwtSts240TO.VeLINR_b_PwrPanelLidSwtSts240TO
        COMRXL_PowerPanel_Lid_Switch_Sts_240_PowerPanel_STAT_Lin2_Error: symbol=ApplLinComAb_LIN2_COMRXL_PowerPanel_Lid_Switch_Sts_240_PowerPanel_STAT_Lin2_Error  # Error -
          data-receive-point-by-arguments:
            access DRP_Lin2ComRxSignalsSR_COMRXL_PowerPanel_Lid_Switch_Sts_240_PowerPanel_STAT_Lin2: accessed-variable=Lin2ComRxSignalsSR.COMRXL_PowerPanel_Lid_Switch_Sts_240_PowerPanel_STAT_Lin2
          data-send-points:
            access DSP_VeLINR_b_PwrPanelLidSwtSts240_VeLINR_b_PwrPanelLidSwtSts240: accessed-variable=VeLINR_b_PwrPanelLidSwtSts240.VeLINR_b_PwrPanelLidSwtSts240
            access DSP_VeLINR_b_PwrPanelLidSwtSts240TO_VeLINR_b_PwrPanelLidSwtSts240TO: accessed-variable=VeLINR_b_PwrPanelLidSwtSts240TO.VeLINR_b_PwrPanelLidSwtSts240TO
          read-local-variables:
            access IRVRA_VeLINR_d_LIN_SlavePrsnt_LIN2: accessed-variable=VeLINR_d_LIN_SlavePrsnt_LIN2
        COMRXL_PowerPanel_AC_Present_Sens1_PowerPanel_STAT_Lin2_Received: symbol=ApplLinComAb_LIN2_COMRXL_PowerPanel_AC_Present_Sens1_PowerPanel_STAT_Lin2_Received  # Received -
          data-receive-point-by-arguments:
            access DRP_Lin2ComRxSignalsSR_COMRXL_PowerPanel_AC_Present_Sens1_PowerPanel_STAT_Lin2: accessed-variable=Lin2ComRxSignalsSR.COMRXL_PowerPanel_AC_Present_Sens1_PowerPanel_STAT_Lin2
          data-send-points:
            access DSP_VeLINR_b_PwrPanelAC_PresntSens1_VeLINR_b_PwrPanelAC_PresntSens1: accessed-variable=VeLINR_b_PwrPanelAC_PresntSens1.VeLINR_b_PwrPanelAC_PresntSens1
            access DSP_VeLINR_b_PwrPanelAC_PresntSens1TO_VeLINR_b_PwrPanelAC_PresntSens1TO: accessed-variable=VeLINR_b_PwrPanelAC_PresntSens1TO.VeLINR_b_PwrPanelAC_PresntSens1TO
        COMRXL_PowerPanel_AC_Present_Sens1_PowerPanel_STAT_Lin2_Error: symbol=ApplLinComAb_LIN2_COMRXL_PowerPanel_AC_Present_Sens1_PowerPanel_STAT_Lin2_Error  # Error -
          data-receive-point-by-arguments:
            access DRP_Lin2ComRxSignalsSR_COMRXL_PowerPanel_AC_Present_Sens1_PowerPanel_STAT_Lin2: accessed-variable=Lin2ComRxSignalsSR.COMRXL_PowerPanel_AC_Present_Sens1_PowerPanel_STAT_Lin2
          data-send-points:
            access DSP_VeLINR_b_PwrPanelAC_PresntSens1_VeLINR_b_PwrPanelAC_PresntSens1: accessed-variable=VeLINR_b_PwrPanelAC_PresntSens1.VeLINR_b_PwrPanelAC_PresntSens1
            access DSP_VeLINR_b_PwrPanelAC_PresntSens1TO_VeLINR_b_PwrPanelAC_PresntSens1TO: accessed-variable=VeLINR_b_PwrPanelAC_PresntSens1TO.VeLINR_b_PwrPanelAC_PresntSens1TO
          read-local-variables:
            access IRVRA_VeLINR_d_LIN_SlavePrsnt_LIN2: accessed-variable=VeLINR_d_LIN_SlavePrsnt_LIN2
        COMRXL_PowerPanel_AC_Present_Sens2_PowerPanel_STAT_Lin2_Received: symbol=ApplLinComAb_LIN2_COMRXL_PowerPanel_AC_Present_Sens2_PowerPanel_STAT_Lin2_Received  # Received -
          data-receive-point-by-arguments:
            access DRP_Lin2ComRxSignalsSR_COMRXL_PowerPanel_AC_Present_Sens2_PowerPanel_STAT_Lin2: accessed-variable=Lin2ComRxSignalsSR.COMRXL_PowerPanel_AC_Present_Sens2_PowerPanel_STAT_Lin2
          data-send-points:
            access DSP_VeLINR_b_PwrPanelAC_PresntSens2_VeLINR_b_PwrPanelAC_PresntSens2: accessed-variable=VeLINR_b_PwrPanelAC_PresntSens2.VeLINR_b_PwrPanelAC_PresntSens2
            access DSP_VeLINR_b_PwrPanelAC_PresntSens2TO_VeLINR_b_PwrPanelAC_PresntSens2TO: accessed-variable=VeLINR_b_PwrPanelAC_PresntSens2TO.VeLINR_b_PwrPanelAC_PresntSens2TO
        COMRXL_PowerPanel_AC_Present_Sens2_PowerPanel_STAT_Lin2_Error: symbol=ApplLinComAb_LIN2_COMRXL_PowerPanel_AC_Present_Sens2_PowerPanel_STAT_Lin2_Error  # Error -
          data-receive-point-by-arguments:
            access DRP_Lin2ComRxSignalsSR_COMRXL_PowerPanel_AC_Present_Sens2_PowerPanel_STAT_Lin2: accessed-variable=Lin2ComRxSignalsSR.COMRXL_PowerPanel_AC_Present_Sens2_PowerPanel_STAT_Lin2
          data-send-points:
            access DSP_VeLINR_b_PwrPanelAC_PresntSens2_VeLINR_b_PwrPanelAC_PresntSens2: accessed-variable=VeLINR_b_PwrPanelAC_PresntSens2.VeLINR_b_PwrPanelAC_PresntSens2
            access DSP_VeLINR_b_PwrPanelAC_PresntSens2TO_VeLINR_b_PwrPanelAC_PresntSens2TO: accessed-variable=VeLINR_b_PwrPanelAC_PresntSens2TO.VeLINR_b_PwrPanelAC_PresntSens2TO
          read-local-variables:
            access IRVRA_VeLINR_d_LIN_SlavePrsnt_LIN2: accessed-variable=VeLINR_d_LIN_SlavePrsnt_LIN2
        COMRXL_PowerPanel_Fault_Reason_PowerPanel_STAT_Lin2_Received: symbol=ApplLinComAb_LIN2_COMRXL_PowerPanel_Fault_Reason_PowerPanel_STAT_Lin2_Received  # Received -
          data-receive-point-by-arguments:
            access DRP_Lin2ComRxSignalsSR_COMRXL_PowerPanel_Fault_Reason_PowerPanel_STAT_Lin2: accessed-variable=Lin2ComRxSignalsSR.COMRXL_PowerPanel_Fault_Reason_PowerPanel_STAT_Lin2
          data-send-points:
            access DSP_VeLINR_e_PowerPanel_FaultReason_VeLINR_e_PowerPanel_FaultReason: accessed-variable=VeLINR_e_PowerPanel_FaultReason.VeLINR_e_PowerPanel_FaultReason
            access DSP_VeLINR_b_PowerPanel_FaultReasonTO_VeLINR_b_PowerPanel_FaultReasonTO: accessed-variable=VeLINR_b_PowerPanel_FaultReasonTO.VeLINR_b_PowerPanel_FaultReasonTO
        COMRXL_PowerPanel_Fault_Reason_PowerPanel_STAT_Lin2_Error: symbol=ApplLinComAb_LIN2_COMRXL_PowerPanel_Fault_Reason_PowerPanel_STAT_Lin2_Error  # Error -
          data-receive-point-by-arguments:
            access DRP_Lin2ComRxSignalsSR_COMRXL_PowerPanel_Fault_Reason_PowerPanel_STAT_Lin2: accessed-variable=Lin2ComRxSignalsSR.COMRXL_PowerPanel_Fault_Reason_PowerPanel_STAT_Lin2
          data-send-points:
            access DSP_VeLINR_e_PowerPanel_FaultReason_VeLINR_e_PowerPanel_FaultReason: accessed-variable=VeLINR_e_PowerPanel_FaultReason.VeLINR_e_PowerPanel_FaultReason
            access DSP_VeLINR_b_PowerPanel_FaultReasonTO_VeLINR_b_PowerPanel_FaultReasonTO: accessed-variable=VeLINR_b_PowerPanel_FaultReasonTO.VeLINR_b_PowerPanel_FaultReasonTO
          read-local-variables:
            access IRVRA_VeLINR_d_LIN_SlavePrsnt_LIN2: accessed-variable=VeLINR_d_LIN_SlavePrsnt_LIN2
        COMRXL_RsErr_SPP_PowerPanel_STAT_Lin2_Received: symbol=ApplLinComAb_LIN2_COMRXL_RsErr_SPP_PowerPanel_STAT_Lin2_Received  # Received -
          data-receive-point-by-arguments:
            access DRP_Lin2ComRxSignalsSR_COMRXL_RsErr_SPP_PowerPanel_STAT_Lin2: accessed-variable=Lin2ComRxSignalsSR.COMRXL_RsErr_SPP_PowerPanel_STAT_Lin2
          data-send-points:
            access DSP_VeLINR_b_RsErr_SPP_VeLINR_b_RsErr_SPP: accessed-variable=VeLINR_b_RsErr_SPP.VeLINR_b_RsErr_SPP
            access DSP_VeLINR_b_RsErr_SPP_TO_VeLINR_b_RsErr_SPP_TO: accessed-variable=VeLINR_b_RsErr_SPP_TO.VeLINR_b_RsErr_SPP_TO
        COMRXL_RsErr_SPP_PowerPanel_STAT_Lin2_Error: symbol=ApplLinComAb_LIN2_COMRXL_RsErr_SPP_PowerPanel_STAT_Lin2_Error  # Error -
          data-receive-point-by-arguments:
            access DRP_Lin2ComRxSignalsSR_COMRXL_RsErr_SPP_PowerPanel_STAT_Lin2: accessed-variable=Lin2ComRxSignalsSR.COMRXL_RsErr_SPP_PowerPanel_STAT_Lin2
          data-send-points:
            access DSP_VeLINR_b_RsErr_SPP_VeLINR_b_RsErr_SPP: accessed-variable=VeLINR_b_RsErr_SPP.VeLINR_b_RsErr_SPP
            access DSP_VeLINR_b_RsErr_SPP_TO_VeLINR_b_RsErr_SPP_TO: accessed-variable=VeLINR_b_RsErr_SPP_TO.VeLINR_b_RsErr_SPP_TO
          read-local-variables:
            access IRVRA_VeLINR_d_LIN_SlavePrsnt_LIN2: accessed-variable=VeLINR_d_LIN_SlavePrsnt_LIN2
        SendLINR_AGS2_PosRq: can-be-invoked-concurrently=true, symbol=ApplLinComAb_LIN2_SendLINR_AGS2_PosRq  # Transmit
          data-receive-point-by-arguments:
            access DRP_SendLINR_AGS2_PosRq_SendLINR_AGS2_PosRq: accessed-variable=SendLINR_AGS2_PosRq.SendLINR_AGS2_PosRq
            access DRP_SendLINR_AGS2_PosRqVld_SendLINR_AGS2_PosRqVld: accessed-variable=SendLINR_AGS2_PosRqVld.SendLINR_AGS2_PosRqVld
          data-send-points:
            access DSP_Lin2ComTxSignalsSR_COMTXL_AGS2_PosRq_ECM_AGS2_DEMAND_Lin2: accessed-variable=Lin2ComTxSignalsSR.COMTXL_AGS2_PosRq_ECM_AGS2_DEMAND_Lin2
        SendLINR_AGS2_CalRq: can-be-invoked-concurrently=true, symbol=ApplLinComAb_LIN2_SendLINR_AGS2_CalRq  # Transmit
          data-receive-point-by-arguments:
            access DRP_SendLINR_AGS2_CalRq_SendLINR_AGS2_CalRq: accessed-variable=SendLINR_AGS2_CalRq.SendLINR_AGS2_CalRq
            access DRP_SendLINR_AGS2_CalRqVld_SendLINR_AGS2_CalRqVld: accessed-variable=SendLINR_AGS2_CalRqVld.SendLINR_AGS2_CalRqVld
          data-send-points:
            access DSP_Lin2ComTxSignalsSR_COMTXL_AGS2_CalRq_ECM_AGS2_DEMAND_Lin2: accessed-variable=Lin2ComTxSignalsSR.COMTXL_AGS2_CalRq_ECM_AGS2_DEMAND_Lin2
        SendLINR_AGS2_BoostRq: can-be-invoked-concurrently=true, symbol=ApplLinComAb_LIN2_SendLINR_AGS2_BoostRq  # Transmit
          data-receive-point-by-arguments:
            access DRP_SendLINR_AGS2_BoostRq_SendLINR_AGS2_BoostRq: accessed-variable=SendLINR_AGS2_BoostRq.SendLINR_AGS2_BoostRq
            access DRP_SendLINR_AGS2_BoostRqVld_SendLINR_AGS2_BoostRqVld: accessed-variable=SendLINR_AGS2_BoostRqVld.SendLINR_AGS2_BoostRqVld
          data-send-points:
            access DSP_Lin2ComTxSignalsSR_COMTXL_AGS2_BoostRq_ECM_AGS2_DEMAND_Lin2: accessed-variable=Lin2ComTxSignalsSR.COMTXL_AGS2_BoostRq_ECM_AGS2_DEMAND_Lin2
        SendLINR_M2SRes2Bit_AGS2: can-be-invoked-concurrently=true, symbol=ApplLinComAb_LIN2_SendLINR_M2SRes2Bit_AGS2  # Transmit
          data-receive-point-by-arguments:
            access DRP_SendLINR_M2SRes2Bit_AGS2_SendLINR_M2SRes2Bit_AGS2: accessed-variable=SendLINR_M2SRes2Bit_AGS2.SendLINR_M2SRes2Bit_AGS2
            access DRP_SendLINR_M2SRes2Bit_AGS2Vld_SendLINR_M2SRes2Bit_AGS2Vld: accessed-variable=SendLINR_M2SRes2Bit_AGS2Vld.SendLINR_M2SRes2Bit_AGS2Vld
          data-send-points:
            access DSP_Lin2ComTxSignalsSR_COMTXL_M2SRes2Bit_AGS2_ECM_AGS2_DEMAND_Lin2: accessed-variable=Lin2ComTxSignalsSR.COMTXL_M2SRes2Bit_AGS2_ECM_AGS2_DEMAND_Lin2
        SendLINR_M2SResByte1_AGS2: can-be-invoked-concurrently=true, symbol=ApplLinComAb_LIN2_SendLINR_M2SResByte1_AGS2  # Transmit
          data-receive-point-by-arguments:
            access DRP_SendLINR_M2SResByte1_AGS2_SendLINR_M2SResByte1_AGS2: accessed-variable=SendLINR_M2SResByte1_AGS2.SendLINR_M2SResByte1_AGS2
            access DRP_SendLINR_M2SResByte1_AGS2Vld_SendLINR_M2SResByte1_AGS2Vld: accessed-variable=SendLINR_M2SResByte1_AGS2Vld.SendLINR_M2SResByte1_AGS2Vld
          data-send-points:
            access DSP_Lin2ComTxSignalsSR_COMTXL_M2SResByte1_AGS2_ECM_AGS2_DEMAND_Lin2: accessed-variable=Lin2ComTxSignalsSR.COMTXL_M2SResByte1_AGS2_ECM_AGS2_DEMAND_Lin2
        SendLINR_M2SResByte2_AGS2: can-be-invoked-concurrently=true, symbol=ApplLinComAb_LIN2_SendLINR_M2SResByte2_AGS2  # Transmit
          data-receive-point-by-arguments:
            access DRP_SendLINR_M2SResByte2_AGS2_SendLINR_M2SResByte2_AGS2: accessed-variable=SendLINR_M2SResByte2_AGS2.SendLINR_M2SResByte2_AGS2
            access DRP_SendLINR_M2SResByte2_AGS2Vld_SendLINR_M2SResByte2_AGS2Vld: accessed-variable=SendLINR_M2SResByte2_AGS2Vld.SendLINR_M2SResByte2_AGS2Vld
          data-send-points:
            access DSP_Lin2ComTxSignalsSR_COMTXL_M2SResByte2_AGS2_ECM_AGS2_DEMAND_Lin2: accessed-variable=Lin2ComTxSignalsSR.COMTXL_M2SResByte2_AGS2_ECM_AGS2_DEMAND_Lin2
        SendLINR_M2SResByte3_AGS2: can-be-invoked-concurrently=true, symbol=ApplLinComAb_LIN2_SendLINR_M2SResByte3_AGS2  # Transmit
          data-receive-point-by-arguments:
            access DRP_SendLINR_M2SResByte3_AGS2_SendLINR_M2SResByte3_AGS2: accessed-variable=SendLINR_M2SResByte3_AGS2.SendLINR_M2SResByte3_AGS2
            access DRP_SendLINR_M2SResByte3_AGS2Vld_SendLINR_M2SResByte3_AGS2Vld: accessed-variable=SendLINR_M2SResByte3_AGS2Vld.SendLINR_M2SResByte3_AGS2Vld
          data-send-points:
            access DSP_Lin2ComTxSignalsSR_COMTXL_M2SResByte3_AGS2_ECM_AGS2_DEMAND_Lin2: accessed-variable=Lin2ComTxSignalsSR.COMTXL_M2SResByte3_AGS2_ECM_AGS2_DEMAND_Lin2
        SendLINR_AHP_RPM_REQ_PERCT: can-be-invoked-concurrently=true, symbol=ApplLinComAb_LIN2_SendLINR_AHP_RPM_REQ_PERCT  # Transmit
          data-receive-point-by-arguments:
            access DRP_SendLINR_AHP_RPM_REQ_PERCT_SendLINR_AHP_RPM_REQ_PERCT: accessed-variable=SendLINR_AHP_RPM_REQ_PERCT.SendLINR_AHP_RPM_REQ_PERCT
            access DRP_SendLINR_AHP_RPM_REQ_PERCT_Vld_SendLINR_AHP_RPM_REQ_PERCT_Vld: accessed-variable=SendLINR_AHP_RPM_REQ_PERCT_Vld.SendLINR_AHP_RPM_REQ_PERCT_Vld
          data-send-points:
            access DSP_Lin2ComTxSignalsSR_COMTXL_AHP_RPM_REQ_PERCT_AHP_REQ_GLOBAL_Lin2: accessed-variable=Lin2ComTxSignalsSR.COMTXL_AHP_RPM_REQ_PERCT_AHP_REQ_GLOBAL_Lin2
        SendLINR_AHP_POST_RUN_REQ: can-be-invoked-concurrently=true, symbol=ApplLinComAb_LIN2_SendLINR_AHP_POST_RUN_REQ  # Transmit
          data-receive-point-by-arguments:
            access DRP_SendLINR_AHP_POST_RUN_REQ_SendLINR_AHP_POST_RUN_REQ: accessed-variable=SendLINR_AHP_POST_RUN_REQ.SendLINR_AHP_POST_RUN_REQ
            access DRP_SendLINR_AHP_POST_RUN_REQ_Vld_SendLINR_AHP_POST_RUN_REQ_Vld: accessed-variable=SendLINR_AHP_POST_RUN_REQ_Vld.SendLINR_AHP_POST_RUN_REQ_Vld
          data-send-points:
            access DSP_Lin2ComTxSignalsSR_COMTXL_AHP_POST_RUN_REQ_AHP_REQ_GLOBAL_Lin2: accessed-variable=Lin2ComTxSignalsSR.COMTXL_AHP_POST_RUN_REQ_AHP_REQ_GLOBAL_Lin2
        SendLINR_AHP_FL_SAFE_ACTVT: can-be-invoked-concurrently=true, symbol=ApplLinComAb_LIN2_SendLINR_AHP_FL_SAFE_ACTVT  # Transmit
          data-receive-point-by-arguments:
            access DRP_SendLINR_AHP_FL_SAFE_ACTVT_SendLINR_AHP_FL_SAFE_ACTVT: accessed-variable=SendLINR_AHP_FL_SAFE_ACTVT.SendLINR_AHP_FL_SAFE_ACTVT
            access DRP_SendLINR_AHP_FL_SAFE_ACTVT_Vld_SendLINR_AHP_FL_SAFE_ACTVT_Vld: accessed-variable=SendLINR_AHP_FL_SAFE_ACTVT_Vld.SendLINR_AHP_FL_SAFE_ACTVT_Vld
          data-send-points:
            access DSP_Lin2ComTxSignalsSR_COMTXL_AHP_FL_SAFE_ACTVT_AHP_REQ_GLOBAL_Lin2: accessed-variable=Lin2ComTxSignalsSR.COMTXL_AHP_FL_SAFE_ACTVT_AHP_REQ_GLOBAL_Lin2
        SendLINR_BHV_PosRq: can-be-invoked-concurrently=true, symbol=ApplLinComAb_LIN2_SendLINR_BHV_PosRq  # Transmit
          data-receive-point-by-arguments:
            access DRP_SendLINR_BHV_PosRq_SendLINR_BHV_PosRq: accessed-variable=SendLINR_BHV_PosRq.SendLINR_BHV_PosRq
            access DRP_SendLINR_BHV_PosRqVld_SendLINR_BHV_PosRqVld: accessed-variable=SendLINR_BHV_PosRqVld.SendLINR_BHV_PosRqVld
          data-send-points:
            access DSP_Lin2ComTxSignalsSR_COMTXL_BHV_PosRq_BHV_REQ_Lin2: accessed-variable=Lin2ComTxSignalsSR.COMTXL_BHV_PosRq_BHV_REQ_Lin2
        SendLINR_BHV_PosSv: can-be-invoked-concurrently=true, symbol=ApplLinComAb_LIN2_SendLINR_BHV_PosSv  # Transmit
          data-receive-point-by-arguments:
            access DRP_SendLINR_BHV_PosSv_SendLINR_BHV_PosSv: accessed-variable=SendLINR_BHV_PosSv.SendLINR_BHV_PosSv
            access DRP_SendLINR_BHV_PosSvVld_SendLINR_BHV_PosSvVld: accessed-variable=SendLINR_BHV_PosSvVld.SendLINR_BHV_PosSvVld
          data-send-points:
            access DSP_Lin2ComTxSignalsSR_COMTXL_BHV_PosSv_BHV_REQ_Lin2: accessed-variable=Lin2ComTxSignalsSR.COMTXL_BHV_PosSv_BHV_REQ_Lin2
        SendLINR_BHV_CalRq: can-be-invoked-concurrently=true, symbol=ApplLinComAb_LIN2_SendLINR_BHV_CalRq  # Transmit
          data-receive-point-by-arguments:
            access DRP_SendLINR_BHV_CalRq_SendLINR_BHV_CalRq: accessed-variable=SendLINR_BHV_CalRq.SendLINR_BHV_CalRq
            access DRP_SendLINR_BHV_CalRqVld_SendLINR_BHV_CalRqVld: accessed-variable=SendLINR_BHV_CalRqVld.SendLINR_BHV_CalRqVld
          data-send-points:
            access DSP_Lin2ComTxSignalsSR_COMTXL_BHV_CalRq_BHV_REQ_Lin2: accessed-variable=Lin2ComTxSignalsSR.COMTXL_BHV_CalRq_BHV_REQ_Lin2
        SendLINR_CompressorSpdReq: can-be-invoked-concurrently=true, symbol=ApplLinComAb_LIN2_SendLINR_CompressorSpdReq  # Transmit
          data-receive-point-by-arguments:
            access DRP_SendLINR_CompressorSpdReq_SendLINR_CompressorSpdReq: accessed-variable=SendLINR_CompressorSpdReq.SendLINR_CompressorSpdReq
            access DRP_SendLINR_CompressorSpdReqVld_SendLINR_CompressorSpdReqVld: accessed-variable=SendLINR_CompressorSpdReqVld.SendLINR_CompressorSpdReqVld
          data-send-points:
            access DSP_Lin2ComTxSignalsSR_COMTXL_CompressorSpdReq_COMP_REQ_Lin2: accessed-variable=Lin2ComTxSignalsSR.COMTXL_CompressorSpdReq_COMP_REQ_Lin2
        SendLINR_CompEnable: can-be-invoked-concurrently=true, symbol=ApplLinComAb_LIN2_SendLINR_CompEnable  # Transmit
          data-receive-point-by-arguments:
            access DRP_SendLINR_CompEnable_SendLINR_CompEnable: accessed-variable=SendLINR_CompEnable.SendLINR_CompEnable
            access DRP_SendLINR_CompEnableVld_SendLINR_CompEnableVld: accessed-variable=SendLINR_CompEnableVld.SendLINR_CompEnableVld
          data-send-points:
            access DSP_Lin2ComTxSignalsSR_COMTXL_CompEnable_COMP_REQ_Lin2: accessed-variable=Lin2ComTxSignalsSR.COMTXL_CompEnable_COMP_REQ_Lin2
        SendLINR_DriveEcohybridLmp: can-be-invoked-concurrently=true, symbol=ApplLinComAb_LIN2_SendLINR_DriveEcohybridLmp  # Transmit
          data-receive-point-by-arguments:
            access DRP_SendLINR_DriveEcohybridLmp_SendLINR_DriveEcohybridLmp: accessed-variable=SendLINR_DriveEcohybridLmp.SendLINR_DriveEcohybridLmp
            access DRP_SendLINR_DriveEcohybridLmpVld_SendLINR_DriveEcohybridLmpVld: accessed-variable=SendLINR_DriveEcohybridLmpVld.SendLINR_DriveEcohybridLmpVld
          data-send-points:
            access DSP_Lin2ComTxSignalsSR_COMTXL_DriveEcohybridLmp_MASTER_ESBM_1_Lin2: accessed-variable=Lin2ComTxSignalsSR.COMTXL_DriveEcohybridLmp_MASTER_ESBM_1_Lin2
        SendLINR_DriveElectricLmp: can-be-invoked-concurrently=true, symbol=ApplLinComAb_LIN2_SendLINR_DriveElectricLmp  # Transmit
          data-receive-point-by-arguments:
            access DRP_SendLINR_DriveElectricLmp_SendLINR_DriveElectricLmp: accessed-variable=SendLINR_DriveElectricLmp.SendLINR_DriveElectricLmp
            access DRP_SendLINR_DriveElectricLmpVld_SendLINR_DriveElectricLmpVld: accessed-variable=SendLINR_DriveElectricLmpVld.SendLINR_DriveElectricLmpVld
          data-send-points:
            access DSP_Lin2ComTxSignalsSR_COMTXL_DriveElectricLmp_MASTER_ESBM_1_Lin2: accessed-variable=Lin2ComTxSignalsSR.COMTXL_DriveElectricLmp_MASTER_ESBM_1_Lin2
        SendLINR_DriveESaveLmp: can-be-invoked-concurrently=true, symbol=ApplLinComAb_LIN2_SendLINR_DriveESaveLmp  # Transmit
          data-receive-point-by-arguments:
            access DRP_SendLINR_DriveESaveLmp_SendLINR_DriveESaveLmp: accessed-variable=SendLINR_DriveESaveLmp.SendLINR_DriveESaveLmp
            access DRP_SendLINR_DriveESaveLmpVld_SendLINR_DriveESaveLmpVld: accessed-variable=SendLINR_DriveESaveLmpVld.SendLINR_DriveESaveLmpVld
          data-send-points:
            access DSP_Lin2ComTxSignalsSR_COMTXL_DriveESaveLmp_MASTER_ESBM_1_Lin2: accessed-variable=Lin2ComTxSignalsSR.COMTXL_DriveESaveLmp_MASTER_ESBM_1_Lin2
        SendLINR_DriveSportHybridLmp: can-be-invoked-concurrently=true, symbol=ApplLinComAb_LIN2_SendLINR_DriveSportHybridLmp  # Transmit
          data-receive-point-by-arguments:
            access DRP_SendLINR_DriveSportHybridLmp_SendLINR_DriveSportHybridLmp: accessed-variable=SendLINR_DriveSportHybridLmp.SendLINR_DriveSportHybridLmp
            access DRP_SendLINR_DriveSportHybridLmpVld_SendLINR_DriveSportHybridLmpVld: accessed-variable=SendLINR_DriveSportHybridLmpVld.SendLINR_DriveSportHybridLmpVld
          data-send-points:
            access DSP_Lin2ComTxSignalsSR_COMTXL_DriveSportHybridLmp_MASTER_ESBM_1_Lin2: accessed-variable=Lin2ComTxSignalsSR.COMTXL_DriveSportHybridLmp_MASTER_ESBM_1_Lin2
        SendLINR_PanelIntensitySts: can-be-invoked-concurrently=true, symbol=ApplLinComAb_LIN2_SendLINR_PanelIntensitySts  # Transmit
          data-receive-point-by-arguments:
            access DRP_SendLINR_PanelIntensitySts_SendLINR_PanelIntensitySts: accessed-variable=SendLINR_PanelIntensitySts.SendLINR_PanelIntensitySts
            access DRP_SendLINR_PanelIntensityStsVld_SendLINR_PanelIntensityStsVld: accessed-variable=SendLINR_PanelIntensityStsVld.SendLINR_PanelIntensityStsVld
          data-send-points:
            access DSP_Lin2ComTxSignalsSR_COMTXL_PanelIntensitySts_MASTER_ESBM_1_Lin2: accessed-variable=Lin2ComTxSignalsSR.COMTXL_PanelIntensitySts_MASTER_ESBM_1_Lin2
        SendLINR_DAY_LGT_MD: can-be-invoked-concurrently=true, symbol=ApplLinComAb_LIN2_SendLINR_DAY_LGT_MD  # Transmit
          data-receive-point-by-arguments:
            access DRP_SendLINR_DAY_LGT_MD_SendLINR_DAY_LGT_MD: accessed-variable=SendLINR_DAY_LGT_MD.SendLINR_DAY_LGT_MD
            access DRP_SendLINR_DAY_LGT_MD_Vld_SendLINR_DAY_LGT_MD_Vld: accessed-variable=SendLINR_DAY_LGT_MD_Vld.SendLINR_DAY_LGT_MD_Vld
          data-send-points:
            access DSP_Lin2ComTxSignalsSR_COMTXL_DAY_LGT_MD_MASTER_ESBM_1_Lin2: accessed-variable=Lin2ComTxSignalsSR.COMTXL_DAY_LGT_MD_MASTER_ESBM_1_Lin2
        SendLINR_PECP_RPM_REQ_PERCT: can-be-invoked-concurrently=true, symbol=ApplLinComAb_LIN2_SendLINR_PECP_RPM_REQ_PERCT  # Transmit
          data-receive-point-by-arguments:
            access DRP_SendLINR_PECP_RPM_REQ_PERCT_SendLINR_PECP_RPM_REQ_PERCT: accessed-variable=SendLINR_PECP_RPM_REQ_PERCT.SendLINR_PECP_RPM_REQ_PERCT
            access DRP_SendLINR_PECP_RPM_REQ_PERCT_Vld_SendLINR_PECP_RPM_REQ_PERCT_Vld: accessed-variable=SendLINR_PECP_RPM_REQ_PERCT_Vld.SendLINR_PECP_RPM_REQ_PERCT_Vld
          data-send-points:
            access DSP_Lin2ComTxSignalsSR_COMTXL_PECP_RPM_REQ_PERCT_PECP_REQ_GLOBAL_Lin2: accessed-variable=Lin2ComTxSignalsSR.COMTXL_PECP_RPM_REQ_PERCT_PECP_REQ_GLOBAL_Lin2
        SendLINR_PECP_POST_RUN_REQ: can-be-invoked-concurrently=true, symbol=ApplLinComAb_LIN2_SendLINR_PECP_POST_RUN_REQ  # Transmit
          data-receive-point-by-arguments:
            access DRP_SendLINR_PECP_POST_RUN_REQ_SendLINR_PECP_POST_RUN_REQ: accessed-variable=SendLINR_PECP_POST_RUN_REQ.SendLINR_PECP_POST_RUN_REQ
            access DRP_SendLINR_PECP_POST_RUN_REQ_Vld_SendLINR_PECP_POST_RUN_REQ_Vld: accessed-variable=SendLINR_PECP_POST_RUN_REQ_Vld.SendLINR_PECP_POST_RUN_REQ_Vld
          data-send-points:
            access DSP_Lin2ComTxSignalsSR_COMTXL_PECP_POST_RUN_REQ_PECP_REQ_GLOBAL_Lin2: accessed-variable=Lin2ComTxSignalsSR.COMTXL_PECP_POST_RUN_REQ_PECP_REQ_GLOBAL_Lin2
        SendLINR_PECP_FL_SAFE_ACTVT: can-be-invoked-concurrently=true, symbol=ApplLinComAb_LIN2_SendLINR_PECP_FL_SAFE_ACTVT  # Transmit
          data-receive-point-by-arguments:
            access DRP_SendLINR_PECP_FL_SAFE_ACTVT_SendLINR_PECP_FL_SAFE_ACTVT: accessed-variable=SendLINR_PECP_FL_SAFE_ACTVT.SendLINR_PECP_FL_SAFE_ACTVT
            access DRP_SendLINR_PECP_FL_SAFE_ACTVT_Vld_SendLINR_PECP_FL_SAFE_ACTVT_Vld: accessed-variable=SendLINR_PECP_FL_SAFE_ACTVT_Vld.SendLINR_PECP_FL_SAFE_ACTVT_Vld
          data-send-points:
            access DSP_Lin2ComTxSignalsSR_COMTXL_PECP_FL_SAFE_ACTVT_PECP_REQ_GLOBAL_Lin2: accessed-variable=Lin2ComTxSignalsSR.COMTXL_PECP_FL_SAFE_ACTVT_PECP_REQ_GLOBAL_Lin2
        SendLINR_PwrPanel_LED_A_Command: can-be-invoked-concurrently=true, symbol=ApplLinComAb_LIN2_SendLINR_PwrPanel_LED_A_Command  # Transmit
          data-receive-point-by-arguments:
            access DRP_SendLINR_PwrPanel_LED_A_Command_SendLINR_PwrPanel_LED_A_Command: accessed-variable=SendLINR_PwrPanel_LED_A_Command.SendLINR_PwrPanel_LED_A_Command
            access DRP_SendLINR_PwrPanel_LED_A_CommandVld_SendLINR_PwrPanel_LED_A_CommandVld: accessed-variable=SendLINR_PwrPanel_LED_A_CommandVld.SendLINR_PwrPanel_LED_A_CommandVld
          data-send-points:
            access DSP_Lin2ComTxSignalsSR_COMTXL_PowerPanel_LED_A_Command_PowerPanel_REQ_Lin2: accessed-variable=Lin2ComTxSignalsSR.COMTXL_PowerPanel_LED_A_Command_PowerPanel_REQ_Lin2
        SendLINR_PwrPanel_LED_B_Command: can-be-invoked-concurrently=true, symbol=ApplLinComAb_LIN2_SendLINR_PwrPanel_LED_B_Command  # Transmit
          data-receive-point-by-arguments:
            access DRP_SendLINR_PwrPanel_LED_B_Command_SendLINR_PwrPanel_LED_B_Command: accessed-variable=SendLINR_PwrPanel_LED_B_Command.SendLINR_PwrPanel_LED_B_Command
            access DRP_SendLINR_PwrPanel_LED_B_CommandVld_SendLINR_PwrPanel_LED_B_CommandVld: accessed-variable=SendLINR_PwrPanel_LED_B_CommandVld.SendLINR_PwrPanel_LED_B_CommandVld
          data-send-points:
            access DSP_Lin2ComTxSignalsSR_COMTXL_PowerPanel_LED_B_Command_PowerPanel_REQ_Lin2: accessed-variable=Lin2ComTxSignalsSR.COMTXL_PowerPanel_LED_B_Command_PowerPanel_REQ_Lin2
        SendLINR_DAY_LGT_MD_PowerPanel: can-be-invoked-concurrently=true, symbol=ApplLinComAb_LIN2_SendLINR_DAY_LGT_MD_PowerPanel  # Transmit
          data-receive-point-by-arguments:
            access DRP_SendLINR_DAY_LGT_MD_PowerPanel_SendLINR_DAY_LGT_MD_PowerPanel: accessed-variable=SendLINR_DAY_LGT_MD_PowerPanel.SendLINR_DAY_LGT_MD_PowerPanel
            access DRP_SendLINR_DAY_LGT_MD_PowerPanelVld_SendLINR_DAY_LGT_MD_PowerPanelVld: accessed-variable=SendLINR_DAY_LGT_MD_PowerPanelVld.SendLINR_DAY_LGT_MD_PowerPanelVld
          data-send-points:
            access DSP_Lin2ComTxSignalsSR_COMTXL_DAY_LGT_MD_PowerPanel_PowerPanel_REQ_Lin2: accessed-variable=Lin2ComTxSignalsSR.COMTXL_DAY_LGT_MD_PowerPanel_PowerPanel_REQ_Lin2
        SignalLINR_AGS2_RdyForSleep: symbol=ApplLinComAb_LIN2_SignalLINR_AGS2_RdyForSleep  # AGS2 is ready for sleep. Set it's bit in Lin slave ready to sleep.Transmit
          data-receive-point-by-arguments:
            access DRP_SignalLINR_AGS2_RdyForSleep_SignalLINR_AGS2_RdyForSleep: accessed-variable=SignalLINR_AGS2_RdyForSleep.SignalLINR_AGS2_RdyForSleep
          mode-access-point mode-group=MdulPwrMod.AppMode_MDGP_ESH_Mode:
            ident MAP_MdulPwrMod_AppMode_MDGP_ESH_Mode
          parameter access CPA_KeCFGR_b_LIN2_Equid: accessed-parameter=KeCFGR_b_LIN2_Equid.KeCFGR_b_LIN2_Equid
          read-local-variables:
            access IRVRA_VeLINR_d_LIN_SlavePrsnt_LIN2: accessed-variable=VeLINR_d_LIN_SlavePrsnt_LIN2
            access IRVRA_VeLINR_d_LIN_SlaveRdyToSleep_LIN2: accessed-variable=VeLINR_d_LIN_SlaveRdyToSleep_LIN2
          sync call SSCP_GetRteMode_GetMODR_b_InPostRunMode: operation=GetRteMode.GetMODR_b_InPostRunMode, timeout=0.01
          written-local-variables:
            access IRVWA_VeLINR_d_LIN_SlaveRdyToSleep_LIN2: accessed-variable=VeLINR_d_LIN_SlaveRdyToSleep_LIN2
        SignalLINR_AHP_RdyForSleep: symbol=ApplLinComAb_LIN2_SignalLINR_AHP_RdyForSleep  # AHP is ready for sleep. Set it's bit in Lin slave ready to sleep.Transmit
          data-receive-point-by-arguments:
            access DRP_SignalLINR_AHP_RdyForSleep_SignalLINR_AHP_RdyForSleep: accessed-variable=SignalLINR_AHP_RdyForSleep.SignalLINR_AHP_RdyForSleep
          mode-access-point mode-group=MdulPwrMod.AppMode_MDGP_ESH_Mode:
            ident MAP_MdulPwrMod_AppMode_MDGP_ESH_Mode
          parameter access CPA_KeCFGR_b_LIN2_Equid: accessed-parameter=KeCFGR_b_LIN2_Equid.KeCFGR_b_LIN2_Equid
          read-local-variables:
            access IRVRA_VeLINR_d_LIN_SlavePrsnt_LIN2: accessed-variable=VeLINR_d_LIN_SlavePrsnt_LIN2
            access IRVRA_VeLINR_d_LIN_SlaveRdyToSleep_LIN2: accessed-variable=VeLINR_d_LIN_SlaveRdyToSleep_LIN2
          sync call SSCP_GetRteMode_GetMODR_b_InPostRunMode: operation=GetRteMode.GetMODR_b_InPostRunMode, timeout=0.01
          written-local-variables:
            access IRVWA_VeLINR_d_LIN_SlaveRdyToSleep_LIN2: accessed-variable=VeLINR_d_LIN_SlaveRdyToSleep_LIN2
