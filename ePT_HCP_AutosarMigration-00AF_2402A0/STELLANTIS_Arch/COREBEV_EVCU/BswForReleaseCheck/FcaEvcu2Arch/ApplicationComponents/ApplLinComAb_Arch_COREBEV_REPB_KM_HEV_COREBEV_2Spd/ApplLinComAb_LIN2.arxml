[part 3 of 3: packages /STLASWCs to /STLASWCs/ComSwCpts/ComPrivateInterfaces]
AUTOSAR XML (schema 00044)
package /STLASWCs  (continued)
  complex device driver sw component type ApplLinComAb_LIN2  (continued)
    behavior IBApplLinComAb_LIN2: data-type-mapping=[MG_LinEquid_Mapping, ADTtoIDTMapping, BswMMappingSet], handle-termination-and-restart=NO-SUPPORT  (continued)
      282 x runnable:  (continued)
        SignalLINR_BHV_RdyForSleep: symbol=ApplLinComAb_LIN2_SignalLINR_BHV_RdyForSleep  # BHV is ready for sleep. Set it's bit in Lin slave ready to sleep.Transmit
          data-receive-point-by-arguments:
            access DRP_SignalLINR_BHV_RdyForSleep_SignalLINR_BHV_RdyForSleep: accessed-variable=SignalLINR_BHV_RdyForSleep.SignalLINR_BHV_RdyForSleep
          mode-access-point mode-group=MdulPwrMod.AppMode_MDGP_ESH_Mode:
            ident MAP_MdulPwrMod_AppMode_MDGP_ESH_Mode
          parameter access CPA_KeCFGR_b_LIN2_Equid: accessed-parameter=KeCFGR_b_LIN2_Equid.KeCFGR_b_LIN2_Equid
          read-local-variables:
            access IRVRA_VeLINR_d_LIN_SlavePrsnt_LIN2: accessed-variable=VeLINR_d_LIN_SlavePrsnt_LIN2
            access IRVRA_VeLINR_d_LIN_SlaveRdyToSleep_LIN2: accessed-variable=VeLINR_d_LIN_SlaveRdyToSleep_LIN2
          sync call SSCP_GetRteMode_GetMODR_b_InPostRunMode: operation=GetRteMode.GetMODR_b_InPostRunMode, timeout=0.01
          written-local-variables:
            access IRVWA_VeLINR_d_LIN_SlaveRdyToSleep_LIN2: accessed-variable=VeLINR_d_LIN_SlaveRdyToSleep_LIN2
        SignalLINR_EAC2_RdyForSleep: symbol=ApplLinComAb_LIN2_SignalLINR_EAC2_RdyForSleep  # EAC2 is ready for sleep. Set it's bit in Lin slave ready to sleep.Transmit
          data-receive-point-by-arguments:
            access DRP_SignalLINR_EAC2_RdyForSleep_SignalLINR_EAC2_RdyForSleep: accessed-variable=SignalLINR_EAC2_RdyForSleep.SignalLINR_EAC2_RdyForSleep
          mode-access-point mode-group=MdulPwrMod.AppMode_MDGP_ESH_Mode:
            ident MAP_MdulPwrMod_AppMode_MDGP_ESH_Mode
          parameter access CPA_KeCFGR_b_LIN2_Equid: accessed-parameter=KeCFGR_b_LIN2_Equid.KeCFGR_b_LIN2_Equid
          read-local-variables:
            access IRVRA_VeLINR_d_LIN_SlavePrsnt_LIN2: accessed-variable=VeLINR_d_LIN_SlavePrsnt_LIN2
            access IRVRA_VeLINR_d_LIN_SlaveRdyToSleep_LIN2: accessed-variable=VeLINR_d_LIN_SlaveRdyToSleep_LIN2
          sync call SSCP_GetRteMode_GetMODR_b_InPostRunMode: operation=GetRteMode.GetMODR_b_InPostRunMode, timeout=0.01
          written-local-variables:
            access IRVWA_VeLINR_d_LIN_SlaveRdyToSleep_LIN2: accessed-variable=VeLINR_d_LIN_SlaveRdyToSleep_LIN2
        SignalLINR_ESBM_RdyForSleep: symbol=ApplLinComAb_LIN2_SignalLINR_ESBM_RdyForSleep  # ESBM is ready for sleep. Set it's bit in Lin slave ready to sleep.Transmit
          data-receive-point-by-arguments:
            access DRP_SignalLINR_ESBM_RdyForSleep_SignalLINR_ESBM_RdyForSleep: accessed-variable=SignalLINR_ESBM_RdyForSleep.SignalLINR_ESBM_RdyForSleep
          mode-access-point mode-group=MdulPwrMod.AppMode_MDGP_ESH_Mode:
            ident MAP_MdulPwrMod_AppMode_MDGP_ESH_Mode
          parameter access CPA_KeCFGR_b_LIN2_Equid: accessed-parameter=KeCFGR_b_LIN2_Equid.KeCFGR_b_LIN2_Equid
          read-local-variables:
            access IRVRA_VeLINR_d_LIN_SlavePrsnt_LIN2: accessed-variable=VeLINR_d_LIN_SlavePrsnt_LIN2
            access IRVRA_VeLINR_d_LIN_SlaveRdyToSleep_LIN2: accessed-variable=VeLINR_d_LIN_SlaveRdyToSleep_LIN2
          sync call SSCP_GetRteMode_GetMODR_b_InPostRunMode: operation=GetRteMode.GetMODR_b_InPostRunMode, timeout=0.01
          written-local-variables:
            access IRVWA_VeLINR_d_LIN_SlaveRdyToSleep_LIN2: accessed-variable=VeLINR_d_LIN_SlaveRdyToSleep_LIN2
        SignalLINR_OEXV_RdyForSleep: symbol=ApplLinComAb_LIN2_SignalLINR_OEXV_RdyForSleep  # OEXV is ready for sleep. Set it's bit in Lin slave ready to sleep.Transmit
          data-receive-point-by-arguments:
            access DRP_SignalLINR_OEXV_RdyForSleep_SignalLINR_OEXV_RdyForSleep: accessed-variable=SignalLINR_OEXV_RdyForSleep.SignalLINR_OEXV_RdyForSleep
          mode-access-point mode-group=MdulPwrMod.AppMode_MDGP_ESH_Mode:
            ident MAP_MdulPwrMod_AppMode_MDGP_ESH_Mode
          parameter access CPA_KeCFGR_b_LIN2_Equid: accessed-parameter=KeCFGR_b_LIN2_Equid.KeCFGR_b_LIN2_Equid
          read-local-variables:
            access IRVRA_VeLINR_d_LIN_SlavePrsnt_LIN2: accessed-variable=VeLINR_d_LIN_SlavePrsnt_LIN2
            access IRVRA_VeLINR_d_LIN_SlaveRdyToSleep_LIN2: accessed-variable=VeLINR_d_LIN_SlaveRdyToSleep_LIN2
          sync call SSCP_GetRteMode_GetMODR_b_InPostRunMode: operation=GetRteMode.GetMODR_b_InPostRunMode, timeout=0.01
          written-local-variables:
            access IRVWA_VeLINR_d_LIN_SlaveRdyToSleep_LIN2: accessed-variable=VeLINR_d_LIN_SlaveRdyToSleep_LIN2
        SignalLINR_PECP_RdyForSleep: symbol=ApplLinComAb_LIN2_SignalLINR_PECP_RdyForSleep  # PECP is ready for sleep. Set it's bit in Lin slave ready to sleep.Transmit
          data-receive-point-by-arguments:
            access DRP_SignalLINR_PECP_RdyForSleep_SignalLINR_PECP_RdyForSleep: accessed-variable=SignalLINR_PECP_RdyForSleep.SignalLINR_PECP_RdyForSleep
          mode-access-point mode-group=MdulPwrMod.AppMode_MDGP_ESH_Mode:
            ident MAP_MdulPwrMod_AppMode_MDGP_ESH_Mode
          parameter access CPA_KeCFGR_b_LIN2_Equid: accessed-parameter=KeCFGR_b_LIN2_Equid.KeCFGR_b_LIN2_Equid
          read-local-variables:
            access IRVRA_VeLINR_d_LIN_SlavePrsnt_LIN2: accessed-variable=VeLINR_d_LIN_SlavePrsnt_LIN2
            access IRVRA_VeLINR_d_LIN_SlaveRdyToSleep_LIN2: accessed-variable=VeLINR_d_LIN_SlaveRdyToSleep_LIN2
          sync call SSCP_GetRteMode_GetMODR_b_InPostRunMode: operation=GetRteMode.GetMODR_b_InPostRunMode, timeout=0.01
          written-local-variables:
            access IRVWA_VeLINR_d_LIN_SlaveRdyToSleep_LIN2: accessed-variable=VeLINR_d_LIN_SlaveRdyToSleep_LIN2
        SignalLINR_SPP_RdyForSleep: symbol=ApplLinComAb_LIN2_SignalLINR_SPP_RdyForSleep  # SPP is ready for sleep. Set it's bit in Lin slave ready to sleep.Transmit
          data-receive-point-by-arguments:
            access DRP_SignalLINR_SPP_RdyForSleep_SignalLINR_SPP_RdyForSleep: accessed-variable=SignalLINR_SPP_RdyForSleep.SignalLINR_SPP_RdyForSleep
          mode-access-point mode-group=MdulPwrMod.AppMode_MDGP_ESH_Mode:
            ident MAP_MdulPwrMod_AppMode_MDGP_ESH_Mode
          parameter access CPA_KeCFGR_b_LIN2_Equid: accessed-parameter=KeCFGR_b_LIN2_Equid.KeCFGR_b_LIN2_Equid
          read-local-variables:
            access IRVRA_VeLINR_d_LIN_SlavePrsnt_LIN2: accessed-variable=VeLINR_d_LIN_SlavePrsnt_LIN2
            access IRVRA_VeLINR_d_LIN_SlaveRdyToSleep_LIN2: accessed-variable=VeLINR_d_LIN_SlaveRdyToSleep_LIN2
          sync call SSCP_GetRteMode_GetMODR_b_InPostRunMode: operation=GetRteMode.GetMODR_b_InPostRunMode, timeout=0.01
          written-local-variables:
            access IRVWA_VeLINR_d_LIN_SlaveRdyToSleep_LIN2: accessed-variable=VeLINR_d_LIN_SlaveRdyToSleep_LIN2
        COMRXL_AHP_VERSION_AHP_VER_Lin2_Received: symbol=ApplLinComAb_LIN2_COMRXL_AHP_VERSION_AHP_VER_Lin2_Received  # Received -
          data-receive-point-by-arguments:
            access DRP_Lin2ComRxSignalsSR_COMRXL_AHP_VERSION_AHP_VER_Lin2: accessed-variable=Lin2ComRxSignalsSR.COMRXL_AHP_VERSION_AHP_VER_Lin2
          data-send-points:
            access DSP_VeLINR_y_AHP_VERSION_VeLINR_y_AHP_VERSION: accessed-variable=VeLINR_y_AHP_VERSION.VeLINR_y_AHP_VERSION
            access DSP_VeLINR_b_AHP_VERSION_TO_VeLINR_b_AHP_VERSION_TO: accessed-variable=VeLINR_b_AHP_VERSION_TO.VeLINR_b_AHP_VERSION_TO
        COMRXL_AHP_VERSION_AHP_VER_Lin2_Error: symbol=ApplLinComAb_LIN2_COMRXL_AHP_VERSION_AHP_VER_Lin2_Error  # Error -
          data-receive-point-by-arguments:
            access DRP_Lin2ComRxSignalsSR_COMRXL_AHP_VERSION_AHP_VER_Lin2: accessed-variable=Lin2ComRxSignalsSR.COMRXL_AHP_VERSION_AHP_VER_Lin2
          data-send-points:
            access DSP_VeLINR_y_AHP_VERSION_VeLINR_y_AHP_VERSION: accessed-variable=VeLINR_y_AHP_VERSION.VeLINR_y_AHP_VERSION
            access DSP_VeLINR_b_AHP_VERSION_TO_VeLINR_b_AHP_VERSION_TO: accessed-variable=VeLINR_b_AHP_VERSION_TO.VeLINR_b_AHP_VERSION_TO
          read-local-variables:
            access IRVRA_VeLINR_d_LIN_SlavePrsnt_LIN2: accessed-variable=VeLINR_d_LIN_SlavePrsnt_LIN2
        COMRXL_PECP_VERSION_PECP_VER_Lin2_Received: symbol=ApplLinComAb_LIN2_COMRXL_PECP_VERSION_PECP_VER_Lin2_Received  # Received -
          data-receive-point-by-arguments:
            access DRP_Lin2ComRxSignalsSR_COMRXL_PECP_VERSION_PECP_VER_Lin2: accessed-variable=Lin2ComRxSignalsSR.COMRXL_PECP_VERSION_PECP_VER_Lin2
          data-send-points:
            access DSP_VeLINR_y_PECP_VERSION_VeLINR_y_PECP_VERSION: accessed-variable=VeLINR_y_PECP_VERSION.VeLINR_y_PECP_VERSION
            access DSP_VeLINR_b_PECP_VERSION_TO_VeLINR_b_PECP_VERSION_TO: accessed-variable=VeLINR_b_PECP_VERSION_TO.VeLINR_b_PECP_VERSION_TO
        COMRXL_PECP_VERSION_PECP_VER_Lin2_Error: symbol=ApplLinComAb_LIN2_COMRXL_PECP_VERSION_PECP_VER_Lin2_Error  # Error -
          data-receive-point-by-arguments:
            access DRP_Lin2ComRxSignalsSR_COMRXL_PECP_VERSION_PECP_VER_Lin2: accessed-variable=Lin2ComRxSignalsSR.COMRXL_PECP_VERSION_PECP_VER_Lin2
          data-send-points:
            access DSP_VeLINR_y_PECP_VERSION_VeLINR_y_PECP_VERSION: accessed-variable=VeLINR_y_PECP_VERSION.VeLINR_y_PECP_VERSION
            access DSP_VeLINR_b_PECP_VERSION_TO_VeLINR_b_PECP_VERSION_TO: accessed-variable=VeLINR_b_PECP_VERSION_TO.VeLINR_b_PECP_VERSION_TO
          read-local-variables:
            access IRVRA_VeLINR_d_LIN_SlavePrsnt_LIN2: accessed-variable=VeLINR_d_LIN_SlavePrsnt_LIN2
        COMRXL_S2MResByte1_AGS2_AGS2_ECM_STATUS_Lin2_Received: symbol=ApplLinComAb_LIN2_COMRXL_S2MResByte1_AGS2_AGS2_ECM_STATUS_Lin2_Received  # Received -
          data-receive-point-by-arguments:
            access DRP_Lin2ComRxSignalsSR_COMRXL_S2MResByte1_AGS2_AGS2_ECM_STATUS_Lin2: accessed-variable=Lin2ComRxSignalsSR.COMRXL_S2MResByte1_AGS2_AGS2_ECM_STATUS_Lin2
          data-send-points:
            access DSP_VeLINR_e_S2MResByte1_AGS2_VeLINR_e_S2MResByte1_AGS2: accessed-variable=VeLINR_e_S2MResByte1_AGS2.VeLINR_e_S2MResByte1_AGS2
            access DSP_VeLINR_b_S2MResByte1_AGS2TO_VeLINR_b_S2MResByte1_AGS2TO: accessed-variable=VeLINR_b_S2MResByte1_AGS2TO.VeLINR_b_S2MResByte1_AGS2TO
        COMRXL_S2MResByte1_AGS2_AGS2_ECM_STATUS_Lin2_Error: symbol=ApplLinComAb_LIN2_COMRXL_S2MResByte1_AGS2_AGS2_ECM_STATUS_Lin2_Error  # Error -
          data-receive-point-by-arguments:
            access DRP_Lin2ComRxSignalsSR_COMRXL_S2MResByte1_AGS2_AGS2_ECM_STATUS_Lin2: accessed-variable=Lin2ComRxSignalsSR.COMRXL_S2MResByte1_AGS2_AGS2_ECM_STATUS_Lin2
          data-send-points:
            access DSP_VeLINR_e_S2MResByte1_AGS2_VeLINR_e_S2MResByte1_AGS2: accessed-variable=VeLINR_e_S2MResByte1_AGS2.VeLINR_e_S2MResByte1_AGS2
            access DSP_VeLINR_b_S2MResByte1_AGS2TO_VeLINR_b_S2MResByte1_AGS2TO: accessed-variable=VeLINR_b_S2MResByte1_AGS2TO.VeLINR_b_S2MResByte1_AGS2TO
          read-local-variables:
            access IRVRA_VeLINR_d_LIN_SlavePrsnt_LIN2: accessed-variable=VeLINR_d_LIN_SlavePrsnt_LIN2
        COMRXL_S2MResByte2_AGS2_AGS2_ECM_STATUS_Lin2_Received: symbol=ApplLinComAb_LIN2_COMRXL_S2MResByte2_AGS2_AGS2_ECM_STATUS_Lin2_Received  # Received -
          data-receive-point-by-arguments:
            access DRP_Lin2ComRxSignalsSR_COMRXL_S2MResByte2_AGS2_AGS2_ECM_STATUS_Lin2: accessed-variable=Lin2ComRxSignalsSR.COMRXL_S2MResByte2_AGS2_AGS2_ECM_STATUS_Lin2
          data-send-points:
            access DSP_VeLINR_e_S2MResByte2_AGS2_VeLINR_e_S2MResByte2_AGS2: accessed-variable=VeLINR_e_S2MResByte2_AGS2.VeLINR_e_S2MResByte2_AGS2
            access DSP_VeLINR_b_S2MResByte2_AGS2TO_VeLINR_b_S2MResByte2_AGS2TO: accessed-variable=VeLINR_b_S2MResByte2_AGS2TO.VeLINR_b_S2MResByte2_AGS2TO
        COMRXL_S2MResByte2_AGS2_AGS2_ECM_STATUS_Lin2_Error: symbol=ApplLinComAb_LIN2_COMRXL_S2MResByte2_AGS2_AGS2_ECM_STATUS_Lin2_Error  # Error -
          data-receive-point-by-arguments:
            access DRP_Lin2ComRxSignalsSR_COMRXL_S2MResByte2_AGS2_AGS2_ECM_STATUS_Lin2: accessed-variable=Lin2ComRxSignalsSR.COMRXL_S2MResByte2_AGS2_AGS2_ECM_STATUS_Lin2
          data-send-points:
            access DSP_VeLINR_e_S2MResByte2_AGS2_VeLINR_e_S2MResByte2_AGS2: accessed-variable=VeLINR_e_S2MResByte2_AGS2.VeLINR_e_S2MResByte2_AGS2
            access DSP_VeLINR_b_S2MResByte2_AGS2TO_VeLINR_b_S2MResByte2_AGS2TO: accessed-variable=VeLINR_b_S2MResByte2_AGS2TO.VeLINR_b_S2MResByte2_AGS2TO
          read-local-variables:
            access IRVRA_VeLINR_d_LIN_SlavePrsnt_LIN2: accessed-variable=VeLINR_d_LIN_SlavePrsnt_LIN2
        COMRXL_BHV_MotorVolt_BHV_STAT_V2_Lin2_Received: symbol=ApplLinComAb_LIN2_COMRXL_BHV_MotorVolt_BHV_STAT_V2_Lin2_Received  # Received -
          data-receive-point-by-arguments:
            access DRP_Lin2ComRxSignalsSR_COMRXL_BHV_MotorVolt_BHV_STAT_V2_Lin2: accessed-variable=Lin2ComRxSignalsSR.COMRXL_BHV_MotorVolt_BHV_STAT_V2_Lin2
          data-send-points:
            access DSP_VeLINR_U_BHV_MotorVolt_VeLINR_U_BHV_MotorVolt: accessed-variable=VeLINR_U_BHV_MotorVolt.VeLINR_U_BHV_MotorVolt
            access DSP_VeLINR_b_BHV_MotorVoltTO_VeLINR_b_BHV_MotorVoltTO: accessed-variable=VeLINR_b_BHV_MotorVoltTO.VeLINR_b_BHV_MotorVoltTO
        COMRXL_BHV_MotorVolt_BHV_STAT_V2_Lin2_Error: symbol=ApplLinComAb_LIN2_COMRXL_BHV_MotorVolt_BHV_STAT_V2_Lin2_Error  # Error -
          data-receive-point-by-arguments:
            access DRP_Lin2ComRxSignalsSR_COMRXL_BHV_MotorVolt_BHV_STAT_V2_Lin2: accessed-variable=Lin2ComRxSignalsSR.COMRXL_BHV_MotorVolt_BHV_STAT_V2_Lin2
          data-send-points:
            access DSP_VeLINR_U_BHV_MotorVolt_VeLINR_U_BHV_MotorVolt: accessed-variable=VeLINR_U_BHV_MotorVolt.VeLINR_U_BHV_MotorVolt
            access DSP_VeLINR_b_BHV_MotorVoltTO_VeLINR_b_BHV_MotorVoltTO: accessed-variable=VeLINR_b_BHV_MotorVoltTO.VeLINR_b_BHV_MotorVoltTO
          read-local-variables:
            access IRVRA_VeLINR_d_LIN_SlavePrsnt_LIN2: accessed-variable=VeLINR_d_LIN_SlavePrsnt_LIN2
        COMRXL_BHV_CalStat_BHV_STAT_V2_Lin2_Received: symbol=ApplLinComAb_LIN2_COMRXL_BHV_CalStat_BHV_STAT_V2_Lin2_Received  # Received -
          data-receive-point-by-arguments:
            access DRP_Lin2ComRxSignalsSR_COMRXL_BHV_CalStat_BHV_STAT_V2_Lin2: accessed-variable=Lin2ComRxSignalsSR.COMRXL_BHV_CalStat_BHV_STAT_V2_Lin2
          data-send-points:
            access DSP_VeLINR_e_BHV_CalStat_VeLINR_e_BHV_CalStat: accessed-variable=VeLINR_e_BHV_CalStat.VeLINR_e_BHV_CalStat
            access DSP_VeLINR_b_BHV_CalStatTO_VeLINR_b_BHV_CalStatTO: accessed-variable=VeLINR_b_BHV_CalStatTO.VeLINR_b_BHV_CalStatTO
        COMRXL_BHV_CalStat_BHV_STAT_V2_Lin2_Error: symbol=ApplLinComAb_LIN2_COMRXL_BHV_CalStat_BHV_STAT_V2_Lin2_Error  # Error -
          data-receive-point-by-arguments:
            access DRP_Lin2ComRxSignalsSR_COMRXL_BHV_CalStat_BHV_STAT_V2_Lin2: accessed-variable=Lin2ComRxSignalsSR.COMRXL_BHV_CalStat_BHV_STAT_V2_Lin2
          data-send-points:
            access DSP_VeLINR_e_BHV_CalStat_VeLINR_e_BHV_CalStat: accessed-variable=VeLINR_e_BHV_CalStat.VeLINR_e_BHV_CalStat
            access DSP_VeLINR_b_BHV_CalStatTO_VeLINR_b_BHV_CalStatTO: accessed-variable=VeLINR_b_BHV_CalStatTO.VeLINR_b_BHV_CalStatTO
          read-local-variables:
            access IRVRA_VeLINR_d_LIN_SlavePrsnt_LIN2: accessed-variable=VeLINR_d_LIN_SlavePrsnt_LIN2
        COMRXL_OEXV_PosAct_OEXV_STAT_Lin2_Received: symbol=ApplLinComAb_LIN2_COMRXL_OEXV_PosAct_OEXV_STAT_Lin2_Received  # Received -
          data-receive-point-by-arguments:
            access DRP_Lin2ComRxSignalsSR_COMRXL_OEXV_PosAct_OEXV_STAT_Lin2: accessed-variable=Lin2ComRxSignalsSR.COMRXL_OEXV_PosAct_OEXV_STAT_Lin2
          data-send-points:
            access DSP_VeLINR_Pct_OEXV_PosAct_VeLINR_Pct_OEXV_PosAct: accessed-variable=VeLINR_Pct_OEXV_PosAct.VeLINR_Pct_OEXV_PosAct
            access DSP_VeLINR_b_OEXV_PosActTO_VeLINR_b_OEXV_PosActTO: accessed-variable=VeLINR_b_OEXV_PosActTO.VeLINR_b_OEXV_PosActTO
        COMRXL_OEXV_PosAct_OEXV_STAT_Lin2_Error: symbol=ApplLinComAb_LIN2_COMRXL_OEXV_PosAct_OEXV_STAT_Lin2_Error  # Error -
          data-receive-point-by-arguments:
            access DRP_Lin2ComRxSignalsSR_COMRXL_OEXV_PosAct_OEXV_STAT_Lin2: accessed-variable=Lin2ComRxSignalsSR.COMRXL_OEXV_PosAct_OEXV_STAT_Lin2
          data-send-points:
            access DSP_VeLINR_Pct_OEXV_PosAct_VeLINR_Pct_OEXV_PosAct: accessed-variable=VeLINR_Pct_OEXV_PosAct.VeLINR_Pct_OEXV_PosAct
            access DSP_VeLINR_b_OEXV_PosActTO_VeLINR_b_OEXV_PosActTO: accessed-variable=VeLINR_b_OEXV_PosActTO.VeLINR_b_OEXV_PosActTO
          read-local-variables:
            access IRVRA_VeLINR_d_LIN_SlavePrsnt_LIN2: accessed-variable=VeLINR_d_LIN_SlavePrsnt_LIN2
        COMRXL_OEXV_CalStat_OEXV_STAT_Lin2_Received: symbol=ApplLinComAb_LIN2_COMRXL_OEXV_CalStat_OEXV_STAT_Lin2_Received  # Received -
          data-receive-point-by-arguments:
            access DRP_Lin2ComRxSignalsSR_COMRXL_OEXV_CalStat_OEXV_STAT_Lin2: accessed-variable=Lin2ComRxSignalsSR.COMRXL_OEXV_CalStat_OEXV_STAT_Lin2
          data-send-points:
            access DSP_VeLINR_e_OEXV_CalStat_VeLINR_e_OEXV_CalStat: accessed-variable=VeLINR_e_OEXV_CalStat.VeLINR_e_OEXV_CalStat
            access DSP_VeLINR_b_OEXV_CalStatTO_VeLINR_b_OEXV_CalStatTO: accessed-variable=VeLINR_b_OEXV_CalStatTO.VeLINR_b_OEXV_CalStatTO
        COMRXL_OEXV_CalStat_OEXV_STAT_Lin2_Error: symbol=ApplLinComAb_LIN2_COMRXL_OEXV_CalStat_OEXV_STAT_Lin2_Error  # Error -
          data-receive-point-by-arguments:
            access DRP_Lin2ComRxSignalsSR_COMRXL_OEXV_CalStat_OEXV_STAT_Lin2: accessed-variable=Lin2ComRxSignalsSR.COMRXL_OEXV_CalStat_OEXV_STAT_Lin2
          data-send-points:
            access DSP_VeLINR_e_OEXV_CalStat_VeLINR_e_OEXV_CalStat: accessed-variable=VeLINR_e_OEXV_CalStat.VeLINR_e_OEXV_CalStat
            access DSP_VeLINR_b_OEXV_CalStatTO_VeLINR_b_OEXV_CalStatTO: accessed-variable=VeLINR_b_OEXV_CalStatTO.VeLINR_b_OEXV_CalStatTO
          read-local-variables:
            access IRVRA_VeLINR_d_LIN_SlavePrsnt_LIN2: accessed-variable=VeLINR_d_LIN_SlavePrsnt_LIN2
        COMRXL_OEXV_CalRq_OEXV_STAT_Lin2_Received: symbol=ApplLinComAb_LIN2_COMRXL_OEXV_CalRq_OEXV_STAT_Lin2_Received  # Received -
          data-receive-point-by-arguments:
            access DRP_Lin2ComRxSignalsSR_COMRXL_OEXV_CalRq_OEXV_STAT_Lin2: accessed-variable=Lin2ComRxSignalsSR.COMRXL_OEXV_CalRq_OEXV_STAT_Lin2
          data-send-points:
            access DSP_VeLINR_b_OEXV_CalRq_VeLINR_b_OEXV_CalRq: accessed-variable=VeLINR_b_OEXV_CalRq.VeLINR_b_OEXV_CalRq
            access DSP_VeLINR_b_OEXV_CalRqTO_VeLINR_b_OEXV_CalRqTO: accessed-variable=VeLINR_b_OEXV_CalRqTO.VeLINR_b_OEXV_CalRqTO
        COMRXL_OEXV_CalRq_OEXV_STAT_Lin2_Error: symbol=ApplLinComAb_LIN2_COMRXL_OEXV_CalRq_OEXV_STAT_Lin2_Error  # Error -
          data-receive-point-by-arguments:
            access DRP_Lin2ComRxSignalsSR_COMRXL_OEXV_CalRq_OEXV_STAT_Lin2: accessed-variable=Lin2ComRxSignalsSR.COMRXL_OEXV_CalRq_OEXV_STAT_Lin2
          data-send-points:
            access DSP_VeLINR_b_OEXV_CalRq_VeLINR_b_OEXV_CalRq: accessed-variable=VeLINR_b_OEXV_CalRq.VeLINR_b_OEXV_CalRq
            access DSP_VeLINR_b_OEXV_CalRqTO_VeLINR_b_OEXV_CalRqTO: accessed-variable=VeLINR_b_OEXV_CalRqTO.VeLINR_b_OEXV_CalRqTO
          read-local-variables:
            access IRVRA_VeLINR_d_LIN_SlavePrsnt_LIN2: accessed-variable=VeLINR_d_LIN_SlavePrsnt_LIN2
        COMRXL_RsErr_OEXV_OEXV_STAT_Lin2_Received: symbol=ApplLinComAb_LIN2_COMRXL_RsErr_OEXV_OEXV_STAT_Lin2_Received  # Received -
          data-receive-point-by-arguments:
            access DRP_Lin2ComRxSignalsSR_COMRXL_RsErr_OEXV_OEXV_STAT_Lin2: accessed-variable=Lin2ComRxSignalsSR.COMRXL_RsErr_OEXV_OEXV_STAT_Lin2
          data-send-points:
            access DSP_VeLINR_b_RsErr_OEXV_VeLINR_b_RsErr_OEXV: accessed-variable=VeLINR_b_RsErr_OEXV.VeLINR_b_RsErr_OEXV
            access DSP_VeLINR_b_RsErr_OEXV_TO_VeLINR_b_RsErr_OEXV_TO: accessed-variable=VeLINR_b_RsErr_OEXV_TO.VeLINR_b_RsErr_OEXV_TO
        COMRXL_RsErr_OEXV_OEXV_STAT_Lin2_Error: symbol=ApplLinComAb_LIN2_COMRXL_RsErr_OEXV_OEXV_STAT_Lin2_Error  # Error -
          data-receive-point-by-arguments:
            access DRP_Lin2ComRxSignalsSR_COMRXL_RsErr_OEXV_OEXV_STAT_Lin2: accessed-variable=Lin2ComRxSignalsSR.COMRXL_RsErr_OEXV_OEXV_STAT_Lin2
          data-send-points:
            access DSP_VeLINR_b_RsErr_OEXV_VeLINR_b_RsErr_OEXV: accessed-variable=VeLINR_b_RsErr_OEXV.VeLINR_b_RsErr_OEXV
            access DSP_VeLINR_b_RsErr_OEXV_TO_VeLINR_b_RsErr_OEXV_TO: accessed-variable=VeLINR_b_RsErr_OEXV_TO.VeLINR_b_RsErr_OEXV_TO
          read-local-variables:
            access IRVRA_VeLINR_d_LIN_SlavePrsnt_LIN2: accessed-variable=VeLINR_d_LIN_SlavePrsnt_LIN2
        COMRXL_OEXV_Sts_OEXV_STAT_Lin2_Received: symbol=ApplLinComAb_LIN2_COMRXL_OEXV_Sts_OEXV_STAT_Lin2_Received  # Received -
          data-receive-point-by-arguments:
            access DRP_Lin2ComRxSignalsSR_COMRXL_OEXV_Sts_OEXV_STAT_Lin2: accessed-variable=Lin2ComRxSignalsSR.COMRXL_OEXV_Sts_OEXV_STAT_Lin2
          data-send-points:
            access DSP_VeLINR_e_OEXV_Sts_VeLINR_e_OEXV_Sts: accessed-variable=VeLINR_e_OEXV_Sts.VeLINR_e_OEXV_Sts
            access DSP_VeLINR_b_OEXV_StsTO_VeLINR_b_OEXV_StsTO: accessed-variable=VeLINR_b_OEXV_StsTO.VeLINR_b_OEXV_StsTO
        COMRXL_OEXV_Sts_OEXV_STAT_Lin2_Error: symbol=ApplLinComAb_LIN2_COMRXL_OEXV_Sts_OEXV_STAT_Lin2_Error  # Error -
          data-receive-point-by-arguments:
            access DRP_Lin2ComRxSignalsSR_COMRXL_OEXV_Sts_OEXV_STAT_Lin2: accessed-variable=Lin2ComRxSignalsSR.COMRXL_OEXV_Sts_OEXV_STAT_Lin2
          data-send-points:
            access DSP_VeLINR_e_OEXV_Sts_VeLINR_e_OEXV_Sts: accessed-variable=VeLINR_e_OEXV_Sts.VeLINR_e_OEXV_Sts
            access DSP_VeLINR_b_OEXV_StsTO_VeLINR_b_OEXV_StsTO: accessed-variable=VeLINR_b_OEXV_StsTO.VeLINR_b_OEXV_StsTO
          read-local-variables:
            access IRVRA_VeLINR_d_LIN_SlavePrsnt_LIN2: accessed-variable=VeLINR_d_LIN_SlavePrsnt_LIN2
        COMRXL_OEXV_ERR_OEXV_STAT_Lin2_Received: symbol=ApplLinComAb_LIN2_COMRXL_OEXV_ERR_OEXV_STAT_Lin2_Received  # Received -
          data-receive-point-by-arguments:
            access DRP_Lin2ComRxSignalsSR_COMRXL_OEXV_ERR_OEXV_STAT_Lin2: accessed-variable=Lin2ComRxSignalsSR.COMRXL_OEXV_ERR_OEXV_STAT_Lin2
          data-send-points:
            access DSP_VeLINR_e_OEXV_ERR_VeLINR_e_OEXV_ERR: accessed-variable=VeLINR_e_OEXV_ERR.VeLINR_e_OEXV_ERR
            access DSP_VeLINR_b_OEXV_ERR_TO_VeLINR_b_OEXV_ERR_TO: accessed-variable=VeLINR_b_OEXV_ERR_TO.VeLINR_b_OEXV_ERR_TO
        COMRXL_OEXV_ERR_OEXV_STAT_Lin2_Error: symbol=ApplLinComAb_LIN2_COMRXL_OEXV_ERR_OEXV_STAT_Lin2_Error  # Error -
          data-receive-point-by-arguments:
            access DRP_Lin2ComRxSignalsSR_COMRXL_OEXV_ERR_OEXV_STAT_Lin2: accessed-variable=Lin2ComRxSignalsSR.COMRXL_OEXV_ERR_OEXV_STAT_Lin2
          data-send-points:
            access DSP_VeLINR_e_OEXV_ERR_VeLINR_e_OEXV_ERR: accessed-variable=VeLINR_e_OEXV_ERR.VeLINR_e_OEXV_ERR
            access DSP_VeLINR_b_OEXV_ERR_TO_VeLINR_b_OEXV_ERR_TO: accessed-variable=VeLINR_b_OEXV_ERR_TO.VeLINR_b_OEXV_ERR_TO
          read-local-variables:
            access IRVRA_VeLINR_d_LIN_SlavePrsnt_LIN2: accessed-variable=VeLINR_d_LIN_SlavePrsnt_LIN2
        COMRXL_OEXV_SupplyVolt_OEXV_STAT_Lin2_Received: symbol=ApplLinComAb_LIN2_COMRXL_OEXV_SupplyVolt_OEXV_STAT_Lin2_Received  # Received -
          data-receive-point-by-arguments:
            access DRP_Lin2ComRxSignalsSR_COMRXL_OEXV_SupplyVolt_OEXV_STAT_Lin2: accessed-variable=Lin2ComRxSignalsSR.COMRXL_OEXV_SupplyVolt_OEXV_STAT_Lin2
          data-send-points:
            access DSP_VeLINR_U_OEXV_SupplyVolt_VeLINR_U_OEXV_SupplyVolt: accessed-variable=VeLINR_U_OEXV_SupplyVolt.VeLINR_U_OEXV_SupplyVolt
            access DSP_VeLINR_b_OEXV_SupplyVoltTO_VeLINR_b_OEXV_SupplyVoltTO: accessed-variable=VeLINR_b_OEXV_SupplyVoltTO.VeLINR_b_OEXV_SupplyVoltTO
        COMRXL_OEXV_SupplyVolt_OEXV_STAT_Lin2_Error: symbol=ApplLinComAb_LIN2_COMRXL_OEXV_SupplyVolt_OEXV_STAT_Lin2_Error  # Error -
          data-receive-point-by-arguments:
            access DRP_Lin2ComRxSignalsSR_COMRXL_OEXV_SupplyVolt_OEXV_STAT_Lin2: accessed-variable=Lin2ComRxSignalsSR.COMRXL_OEXV_SupplyVolt_OEXV_STAT_Lin2
          data-send-points:
            access DSP_VeLINR_U_OEXV_SupplyVolt_VeLINR_U_OEXV_SupplyVolt: accessed-variable=VeLINR_U_OEXV_SupplyVolt.VeLINR_U_OEXV_SupplyVolt
            access DSP_VeLINR_b_OEXV_SupplyVoltTO_VeLINR_b_OEXV_SupplyVoltTO: accessed-variable=VeLINR_b_OEXV_SupplyVoltTO.VeLINR_b_OEXV_SupplyVoltTO
          read-local-variables:
            access IRVRA_VeLINR_d_LIN_SlavePrsnt_LIN2: accessed-variable=VeLINR_d_LIN_SlavePrsnt_LIN2
        COMRXL_OEXV_Refrigerant_Pressure_OEXV_STAT_Lin2_Received: symbol=ApplLinComAb_LIN2_COMRXL_OEXV_Refrigerant_Pressure_OEXV_STAT_Lin2_Received  # Received -
          data-receive-point-by-arguments:
            access DRP_Lin2ComRxSignalsSR_COMRXL_OEXV_Refrigerant_Pressure_OEXV_STAT_Lin2: accessed-variable=Lin2ComRxSignalsSR.COMRXL_OEXV_Refrigerant_Pressure_OEXV_STAT_Lin2
          data-send-points:
            access DSP_VeLINR_e_OEXV_Refrig_Pres_VeLINR_e_OEXV_Refrig_Pres: accessed-variable=VeLINR_e_OEXV_Refrig_Pres.VeLINR_e_OEXV_Refrig_Pres
            access DSP_VeLINR_b_OEXV_Refrig_PresTO_VeLINR_b_OEXV_Refrig_PresTO: accessed-variable=VeLINR_b_OEXV_Refrig_PresTO.VeLINR_b_OEXV_Refrig_PresTO
        COMRXL_OEXV_Refrigerant_Pressure_OEXV_STAT_Lin2_Error: symbol=ApplLinComAb_LIN2_COMRXL_OEXV_Refrigerant_Pressure_OEXV_STAT_Lin2_Error  # Error -
          data-receive-point-by-arguments:
            access DRP_Lin2ComRxSignalsSR_COMRXL_OEXV_Refrigerant_Pressure_OEXV_STAT_Lin2: accessed-variable=Lin2ComRxSignalsSR.COMRXL_OEXV_Refrigerant_Pressure_OEXV_STAT_Lin2
          data-send-points:
            access DSP_VeLINR_e_OEXV_Refrig_Pres_VeLINR_e_OEXV_Refrig_Pres: accessed-variable=VeLINR_e_OEXV_Refrig_Pres.VeLINR_e_OEXV_Refrig_Pres
            access DSP_VeLINR_b_OEXV_Refrig_PresTO_VeLINR_b_OEXV_Refrig_PresTO: accessed-variable=VeLINR_b_OEXV_Refrig_PresTO.VeLINR_b_OEXV_Refrig_PresTO
          read-local-variables:
            access IRVRA_VeLINR_d_LIN_SlavePrsnt_LIN2: accessed-variable=VeLINR_d_LIN_SlavePrsnt_LIN2
        COMRXL_OEXV_Board_Temp_OEXV_STAT_Lin2_Received: symbol=ApplLinComAb_LIN2_COMRXL_OEXV_Board_Temp_OEXV_STAT_Lin2_Received  # Received -
          data-receive-point-by-arguments:
            access DRP_Lin2ComRxSignalsSR_COMRXL_OEXV_Board_Temp_OEXV_STAT_Lin2: accessed-variable=Lin2ComRxSignalsSR.COMRXL_OEXV_Board_Temp_OEXV_STAT_Lin2
          data-send-points:
            access DSP_VeLINR_T_OEXV_Board_Temp_VeLINR_T_OEXV_Board_Temp: accessed-variable=VeLINR_T_OEXV_Board_Temp.VeLINR_T_OEXV_Board_Temp
            access DSP_VeLINR_b_OEXV_Board_TempTO_VeLINR_b_OEXV_Board_TempTO: accessed-variable=VeLINR_b_OEXV_Board_TempTO.VeLINR_b_OEXV_Board_TempTO
        COMRXL_OEXV_Board_Temp_OEXV_STAT_Lin2_Error: symbol=ApplLinComAb_LIN2_COMRXL_OEXV_Board_Temp_OEXV_STAT_Lin2_Error  # Error -
          data-receive-point-by-arguments:
            access DRP_Lin2ComRxSignalsSR_COMRXL_OEXV_Board_Temp_OEXV_STAT_Lin2: accessed-variable=Lin2ComRxSignalsSR.COMRXL_OEXV_Board_Temp_OEXV_STAT_Lin2
          data-send-points:
            access DSP_VeLINR_T_OEXV_Board_Temp_VeLINR_T_OEXV_Board_Temp: accessed-variable=VeLINR_T_OEXV_Board_Temp.VeLINR_T_OEXV_Board_Temp
            access DSP_VeLINR_b_OEXV_Board_TempTO_VeLINR_b_OEXV_Board_TempTO: accessed-variable=VeLINR_b_OEXV_Board_TempTO.VeLINR_b_OEXV_Board_TempTO
          read-local-variables:
            access IRVRA_VeLINR_d_LIN_SlavePrsnt_LIN2: accessed-variable=VeLINR_d_LIN_SlavePrsnt_LIN2
        COMRXL_OEXV_Refrigerant_Temp_OEXV_STAT_Lin2_Received: symbol=ApplLinComAb_LIN2_COMRXL_OEXV_Refrigerant_Temp_OEXV_STAT_Lin2_Received  # Received -
          data-receive-point-by-arguments:
            access DRP_Lin2ComRxSignalsSR_COMRXL_OEXV_Refrigerant_Temp_OEXV_STAT_Lin2: accessed-variable=Lin2ComRxSignalsSR.COMRXL_OEXV_Refrigerant_Temp_OEXV_STAT_Lin2
          data-send-points:
            access DSP_VeLINR_e_OEXV_Refrigerant_Temp_VeLINR_e_OEXV_Refrigerant_Temp: accessed-variable=VeLINR_e_OEXV_Refrigerant_Temp.VeLINR_e_OEXV_Refrigerant_Temp
            access DSP_VeLINR_b_OEXV_Refrigerant_TempTO_VeLINR_b_OEXV_Refrigerant_TempTO: accessed-variable=VeLINR_b_OEXV_Refrigerant_TempTO.VeLINR_b_OEXV_Refrigerant_TempTO
        COMRXL_OEXV_Refrigerant_Temp_OEXV_STAT_Lin2_Error: symbol=ApplLinComAb_LIN2_COMRXL_OEXV_Refrigerant_Temp_OEXV_STAT_Lin2_Error  # Error -
          data-receive-point-by-arguments:
            access DRP_Lin2ComRxSignalsSR_COMRXL_OEXV_Refrigerant_Temp_OEXV_STAT_Lin2: accessed-variable=Lin2ComRxSignalsSR.COMRXL_OEXV_Refrigerant_Temp_OEXV_STAT_Lin2
          data-send-points:
            access DSP_VeLINR_e_OEXV_Refrigerant_Temp_VeLINR_e_OEXV_Refrigerant_Temp: accessed-variable=VeLINR_e_OEXV_Refrigerant_Temp.VeLINR_e_OEXV_Refrigerant_Temp
            access DSP_VeLINR_b_OEXV_Refrigerant_TempTO_VeLINR_b_OEXV_Refrigerant_TempTO: accessed-variable=VeLINR_b_OEXV_Refrigerant_TempTO.VeLINR_b_OEXV_Refrigerant_TempTO
          read-local-variables:
            access IRVRA_VeLINR_d_LIN_SlavePrsnt_LIN2: accessed-variable=VeLINR_d_LIN_SlavePrsnt_LIN2
        SendLINR_OEXV_PosRq: can-be-invoked-concurrently=true, symbol=ApplLinComAb_LIN2_SendLINR_OEXV_PosRq  # Transmit
          data-receive-point-by-arguments:
            access DRP_SendLINR_OEXV_PosRq_SendLINR_OEXV_PosRq: accessed-variable=SendLINR_OEXV_PosRq.SendLINR_OEXV_PosRq
            access DRP_SendLINR_OEXV_PosRqVld_SendLINR_OEXV_PosRqVld: accessed-variable=SendLINR_OEXV_PosRqVld.SendLINR_OEXV_PosRqVld
          data-send-points:
            access DSP_Lin2ComTxSignalsSR_COMTXL_OEXV_PosRq_OEXV_REQ_Lin2: accessed-variable=Lin2ComTxSignalsSR.COMTXL_OEXV_PosRq_OEXV_REQ_Lin2
        SendLINR_OEXV_CalCmd: can-be-invoked-concurrently=true, symbol=ApplLinComAb_LIN2_SendLINR_OEXV_CalCmd  # Transmit
          data-receive-point-by-arguments:
            access DRP_SendLINR_OEXV_CalCmd_SendLINR_OEXV_CalCmd: accessed-variable=SendLINR_OEXV_CalCmd.SendLINR_OEXV_CalCmd
            access DRP_SendLINR_OEXV_CalCmdVld_SendLINR_OEXV_CalCmdVld: accessed-variable=SendLINR_OEXV_CalCmdVld.SendLINR_OEXV_CalCmdVld
          data-send-points:
            access DSP_Lin2ComTxSignalsSR_COMTXL_OEXV_CalCmd_OEXV_REQ_Lin2: accessed-variable=Lin2ComTxSignalsSR.COMTXL_OEXV_CalCmd_OEXV_REQ_Lin2
        COMRXL_CompFaultStat_800_EAC_STAT_800_Lin2_Received: symbol=ApplLinComAb_LIN2_COMRXL_CompFaultStat_800_EAC_STAT_800_Lin2_Received  # Received -
          data-receive-point-by-arguments:
            access DRP_Lin2ComRxSignalsSR_COMRXL_CompFaultStat_800_EAC_STAT_800_Lin2: accessed-variable=Lin2ComRxSignalsSR.COMRXL_CompFaultStat_800_EAC_STAT_800_Lin2
          data-send-points:
            access DSP_VeLINR_e_CompFaultStat_800_VeLINR_e_CompFaultStat_800: accessed-variable=VeLINR_e_CompFaultStat_800.VeLINR_e_CompFaultStat_800
            access DSP_VeLINR_b_CompFaultStat_800TO_VeLINR_b_CompFaultStat_800TO: accessed-variable=VeLINR_b_CompFaultStat_800TO.VeLINR_b_CompFaultStat_800TO
        COMRXL_CompFaultStat_800_EAC_STAT_800_Lin2_Error: symbol=ApplLinComAb_LIN2_COMRXL_CompFaultStat_800_EAC_STAT_800_Lin2_Error  # Error -
          data-receive-point-by-arguments:
            access DRP_Lin2ComRxSignalsSR_COMRXL_CompFaultStat_800_EAC_STAT_800_Lin2: accessed-variable=Lin2ComRxSignalsSR.COMRXL_CompFaultStat_800_EAC_STAT_800_Lin2
          data-send-points:
            access DSP_VeLINR_e_CompFaultStat_800_VeLINR_e_CompFaultStat_800: accessed-variable=VeLINR_e_CompFaultStat_800.VeLINR_e_CompFaultStat_800
            access DSP_VeLINR_b_CompFaultStat_800TO_VeLINR_b_CompFaultStat_800TO: accessed-variable=VeLINR_b_CompFaultStat_800TO.VeLINR_b_CompFaultStat_800TO
          read-local-variables:
            access IRVRA_VeLINR_d_LIN_SlavePrsnt_LIN2: accessed-variable=VeLINR_d_LIN_SlavePrsnt_LIN2
        COMRXL_CompStat_800_EAC_STAT_800_Lin2_Received: symbol=ApplLinComAb_LIN2_COMRXL_CompStat_800_EAC_STAT_800_Lin2_Received  # Received -
          data-receive-point-by-arguments:
            access DRP_Lin2ComRxSignalsSR_COMRXL_CompStat_800_EAC_STAT_800_Lin2: accessed-variable=Lin2ComRxSignalsSR.COMRXL_CompStat_800_EAC_STAT_800_Lin2
          data-send-points:
            access DSP_VeLINR_e_CompStat_800_VeLINR_e_CompStat_800: accessed-variable=VeLINR_e_CompStat_800.VeLINR_e_CompStat_800
            access DSP_VeLINR_b_CompStat_800TO_VeLINR_b_CompStat_800TO: accessed-variable=VeLINR_b_CompStat_800TO.VeLINR_b_CompStat_800TO
        COMRXL_CompStat_800_EAC_STAT_800_Lin2_Error: symbol=ApplLinComAb_LIN2_COMRXL_CompStat_800_EAC_STAT_800_Lin2_Error  # Error -
          data-receive-point-by-arguments:
            access DRP_Lin2ComRxSignalsSR_COMRXL_CompStat_800_EAC_STAT_800_Lin2: accessed-variable=Lin2ComRxSignalsSR.COMRXL_CompStat_800_EAC_STAT_800_Lin2
          data-send-points:
            access DSP_VeLINR_e_CompStat_800_VeLINR_e_CompStat_800: accessed-variable=VeLINR_e_CompStat_800.VeLINR_e_CompStat_800
            access DSP_VeLINR_b_CompStat_800TO_VeLINR_b_CompStat_800TO: accessed-variable=VeLINR_b_CompStat_800TO.VeLINR_b_CompStat_800TO
          read-local-variables:
            access IRVRA_VeLINR_d_LIN_SlavePrsnt_LIN2: accessed-variable=VeLINR_d_LIN_SlavePrsnt_LIN2
        COMRXL_CompressorSpd_800_EAC_STAT_800_Lin2_Received: symbol=ApplLinComAb_LIN2_COMRXL_CompressorSpd_800_EAC_STAT_800_Lin2_Received  # Received -
          data-receive-point-by-arguments:
            access DRP_Lin2ComRxSignalsSR_COMRXL_CompressorSpd_800_EAC_STAT_800_Lin2: accessed-variable=Lin2ComRxSignalsSR.COMRXL_CompressorSpd_800_EAC_STAT_800_Lin2
          data-send-points:
            access DSP_VeLINR_n_CompressorSpd_800_VeLINR_n_CompressorSpd_800: accessed-variable=VeLINR_n_CompressorSpd_800.VeLINR_n_CompressorSpd_800
            access DSP_VeLINR_b_CompressorSpd_800TO_VeLINR_b_CompressorSpd_800TO: accessed-variable=VeLINR_b_CompressorSpd_800TO.VeLINR_b_CompressorSpd_800TO
        COMRXL_CompressorSpd_800_EAC_STAT_800_Lin2_Error: symbol=ApplLinComAb_LIN2_COMRXL_CompressorSpd_800_EAC_STAT_800_Lin2_Error  # Error -
          data-receive-point-by-arguments:
            access DRP_Lin2ComRxSignalsSR_COMRXL_CompressorSpd_800_EAC_STAT_800_Lin2: accessed-variable=Lin2ComRxSignalsSR.COMRXL_CompressorSpd_800_EAC_STAT_800_Lin2
          data-send-points:
            access DSP_VeLINR_n_CompressorSpd_800_VeLINR_n_CompressorSpd_800: accessed-variable=VeLINR_n_CompressorSpd_800.VeLINR_n_CompressorSpd_800
            access DSP_VeLINR_b_CompressorSpd_800TO_VeLINR_b_CompressorSpd_800TO: accessed-variable=VeLINR_b_CompressorSpd_800TO.VeLINR_b_CompressorSpd_800TO
          read-local-variables:
            access IRVRA_VeLINR_d_LIN_SlavePrsnt_LIN2: accessed-variable=VeLINR_d_LIN_SlavePrsnt_LIN2
        COMRXL_CompSpdIncrReq_800_EAC_STAT_800_Lin2_Received: symbol=ApplLinComAb_LIN2_COMRXL_CompSpdIncrReq_800_EAC_STAT_800_Lin2_Received  # Received -
          data-receive-point-by-arguments:
            access DRP_Lin2ComRxSignalsSR_COMRXL_CompSpdIncrReq_800_EAC_STAT_800_Lin2: accessed-variable=Lin2ComRxSignalsSR.COMRXL_CompSpdIncrReq_800_EAC_STAT_800_Lin2
          data-send-points:
            access DSP_VeLINR_b_CompSpdIncrReq_800_VeLINR_b_CompSpdIncrReq_800: accessed-variable=VeLINR_b_CompSpdIncrReq_800.VeLINR_b_CompSpdIncrReq_800
            access DSP_VeLINR_b_CompSpdIncrReq_800TO_VeLINR_b_CompSpdIncrReq_800TO: accessed-variable=VeLINR_b_CompSpdIncrReq_800TO.VeLINR_b_CompSpdIncrReq_800TO
        COMRXL_CompSpdIncrReq_800_EAC_STAT_800_Lin2_Error: symbol=ApplLinComAb_LIN2_COMRXL_CompSpdIncrReq_800_EAC_STAT_800_Lin2_Error  # Error -
          data-receive-point-by-arguments:
            access DRP_Lin2ComRxSignalsSR_COMRXL_CompSpdIncrReq_800_EAC_STAT_800_Lin2: accessed-variable=Lin2ComRxSignalsSR.COMRXL_CompSpdIncrReq_800_EAC_STAT_800_Lin2
          data-send-points:
            access DSP_VeLINR_b_CompSpdIncrReq_800_VeLINR_b_CompSpdIncrReq_800: accessed-variable=VeLINR_b_CompSpdIncrReq_800.VeLINR_b_CompSpdIncrReq_800
            access DSP_VeLINR_b_CompSpdIncrReq_800TO_VeLINR_b_CompSpdIncrReq_800TO: accessed-variable=VeLINR_b_CompSpdIncrReq_800TO.VeLINR_b_CompSpdIncrReq_800TO
          read-local-variables:
            access IRVRA_VeLINR_d_LIN_SlavePrsnt_LIN2: accessed-variable=VeLINR_d_LIN_SlavePrsnt_LIN2
        COMRXL_RsErr_EAC2_800_EAC_STAT_800_Lin2_Received: symbol=ApplLinComAb_LIN2_COMRXL_RsErr_EAC2_800_EAC_STAT_800_Lin2_Received  # Received -
          data-receive-point-by-arguments:
            access DRP_Lin2ComRxSignalsSR_COMRXL_RsErr_EAC2_800_EAC_STAT_800_Lin2: accessed-variable=Lin2ComRxSignalsSR.COMRXL_RsErr_EAC2_800_EAC_STAT_800_Lin2
          data-send-points:
            access DSP_VeLINR_b_RsErr_EAC2_800_VeLINR_b_RsErr_EAC2_800: accessed-variable=VeLINR_b_RsErr_EAC2_800.VeLINR_b_RsErr_EAC2_800
            access DSP_VeLINR_b_RsErr_EAC2_800TO_VeLINR_b_RsErr_EAC2_800TO: accessed-variable=VeLINR_b_RsErr_EAC2_800TO.VeLINR_b_RsErr_EAC2_800TO
        COMRXL_RsErr_EAC2_800_EAC_STAT_800_Lin2_Error: symbol=ApplLinComAb_LIN2_COMRXL_RsErr_EAC2_800_EAC_STAT_800_Lin2_Error  # Error -
          data-receive-point-by-arguments:
            access DRP_Lin2ComRxSignalsSR_COMRXL_RsErr_EAC2_800_EAC_STAT_800_Lin2: accessed-variable=Lin2ComRxSignalsSR.COMRXL_RsErr_EAC2_800_EAC_STAT_800_Lin2
          data-send-points:
            access DSP_VeLINR_b_RsErr_EAC2_800_VeLINR_b_RsErr_EAC2_800: accessed-variable=VeLINR_b_RsErr_EAC2_800.VeLINR_b_RsErr_EAC2_800
            access DSP_VeLINR_b_RsErr_EAC2_800TO_VeLINR_b_RsErr_EAC2_800TO: accessed-variable=VeLINR_b_RsErr_EAC2_800TO.VeLINR_b_RsErr_EAC2_800TO
          read-local-variables:
            access IRVRA_VeLINR_d_LIN_SlavePrsnt_LIN2: accessed-variable=VeLINR_d_LIN_SlavePrsnt_LIN2
        COMRXL_CompElecPwr_800_EAC_STAT_800_Lin2_Received: symbol=ApplLinComAb_LIN2_COMRXL_CompElecPwr_800_EAC_STAT_800_Lin2_Received  # Received -
          data-receive-point-by-arguments:
            access DRP_Lin2ComRxSignalsSR_COMRXL_CompElecPwr_800_EAC_STAT_800_Lin2: accessed-variable=Lin2ComRxSignalsSR.COMRXL_CompElecPwr_800_EAC_STAT_800_Lin2
          data-send-points:
            access DSP_VeLINR_P_CompElecPwr_800_VeLINR_P_CompElecPwr_800: accessed-variable=VeLINR_P_CompElecPwr_800.VeLINR_P_CompElecPwr_800
            access DSP_VeLINR_b_CompElecPwr_800TO_VeLINR_b_CompElecPwr_800TO: accessed-variable=VeLINR_b_CompElecPwr_800TO.VeLINR_b_CompElecPwr_800TO
        COMRXL_CompElecPwr_800_EAC_STAT_800_Lin2_Error: symbol=ApplLinComAb_LIN2_COMRXL_CompElecPwr_800_EAC_STAT_800_Lin2_Error  # Error -
          data-receive-point-by-arguments:
            access DRP_Lin2ComRxSignalsSR_COMRXL_CompElecPwr_800_EAC_STAT_800_Lin2: accessed-variable=Lin2ComRxSignalsSR.COMRXL_CompElecPwr_800_EAC_STAT_800_Lin2
          data-send-points:
            access DSP_VeLINR_P_CompElecPwr_800_VeLINR_P_CompElecPwr_800: accessed-variable=VeLINR_P_CompElecPwr_800.VeLINR_P_CompElecPwr_800
            access DSP_VeLINR_b_CompElecPwr_800TO_VeLINR_b_CompElecPwr_800TO: accessed-variable=VeLINR_b_CompElecPwr_800TO.VeLINR_b_CompElecPwr_800TO
          read-local-variables:
            access IRVRA_VeLINR_d_LIN_SlavePrsnt_LIN2: accessed-variable=VeLINR_d_LIN_SlavePrsnt_LIN2
        COMRXL_CompBoardTemp_800_EAC_STAT_800_Lin2_Received: symbol=ApplLinComAb_LIN2_COMRXL_CompBoardTemp_800_EAC_STAT_800_Lin2_Received  # Received -
          data-receive-point-by-arguments:
            access DRP_Lin2ComRxSignalsSR_COMRXL_CompBoardTemp_800_EAC_STAT_800_Lin2: accessed-variable=Lin2ComRxSignalsSR.COMRXL_CompBoardTemp_800_EAC_STAT_800_Lin2
          data-send-points:
            access DSP_VeLINR_T_CompBoardTemp_800_VeLINR_T_CompBoardTemp_800: accessed-variable=VeLINR_T_CompBoardTemp_800.VeLINR_T_CompBoardTemp_800
            access DSP_VeLINR_b_CompBoardTemp_800TO_VeLINR_b_CompBoardTemp_800TO: accessed-variable=VeLINR_b_CompBoardTemp_800TO.VeLINR_b_CompBoardTemp_800TO
        COMRXL_CompBoardTemp_800_EAC_STAT_800_Lin2_Error: symbol=ApplLinComAb_LIN2_COMRXL_CompBoardTemp_800_EAC_STAT_800_Lin2_Error  # Error -
          data-receive-point-by-arguments:
            access DRP_Lin2ComRxSignalsSR_COMRXL_CompBoardTemp_800_EAC_STAT_800_Lin2: accessed-variable=Lin2ComRxSignalsSR.COMRXL_CompBoardTemp_800_EAC_STAT_800_Lin2
          data-send-points:
            access DSP_VeLINR_T_CompBoardTemp_800_VeLINR_T_CompBoardTemp_800: accessed-variable=VeLINR_T_CompBoardTemp_800.VeLINR_T_CompBoardTemp_800
            access DSP_VeLINR_b_CompBoardTemp_800TO_VeLINR_b_CompBoardTemp_800TO: accessed-variable=VeLINR_b_CompBoardTemp_800TO.VeLINR_b_CompBoardTemp_800TO
          read-local-variables:
            access IRVRA_VeLINR_d_LIN_SlavePrsnt_LIN2: accessed-variable=VeLINR_d_LIN_SlavePrsnt_LIN2
        COMRXL_CompIGBTTemp_800_EAC_STAT_800_Lin2_Received: symbol=ApplLinComAb_LIN2_COMRXL_CompIGBTTemp_800_EAC_STAT_800_Lin2_Received  # Received -
          data-receive-point-by-arguments:
            access DRP_Lin2ComRxSignalsSR_COMRXL_CompIGBTTemp_800_EAC_STAT_800_Lin2: accessed-variable=Lin2ComRxSignalsSR.COMRXL_CompIGBTTemp_800_EAC_STAT_800_Lin2
          data-send-points:
            access DSP_VeLINR_T_CompIGBTTemp_800_VeLINR_T_CompIGBTTemp_800: accessed-variable=VeLINR_T_CompIGBTTemp_800.VeLINR_T_CompIGBTTemp_800
            access DSP_VeLINR_b_CompIGBTTemp_800TO_VeLINR_b_CompIGBTTemp_800TO: accessed-variable=VeLINR_b_CompIGBTTemp_800TO.VeLINR_b_CompIGBTTemp_800TO
        COMRXL_CompIGBTTemp_800_EAC_STAT_800_Lin2_Error: symbol=ApplLinComAb_LIN2_COMRXL_CompIGBTTemp_800_EAC_STAT_800_Lin2_Error  # Error -
          data-receive-point-by-arguments:
            access DRP_Lin2ComRxSignalsSR_COMRXL_CompIGBTTemp_800_EAC_STAT_800_Lin2: accessed-variable=Lin2ComRxSignalsSR.COMRXL_CompIGBTTemp_800_EAC_STAT_800_Lin2
          data-send-points:
            access DSP_VeLINR_T_CompIGBTTemp_800_VeLINR_T_CompIGBTTemp_800: accessed-variable=VeLINR_T_CompIGBTTemp_800.VeLINR_T_CompIGBTTemp_800
            access DSP_VeLINR_b_CompIGBTTemp_800TO_VeLINR_b_CompIGBTTemp_800TO: accessed-variable=VeLINR_b_CompIGBTTemp_800TO.VeLINR_b_CompIGBTTemp_800TO
          read-local-variables:
            access IRVRA_VeLINR_d_LIN_SlavePrsnt_LIN2: accessed-variable=VeLINR_d_LIN_SlavePrsnt_LIN2
        COMRXL_CompElecCurr_800_EAC_STAT_800_Lin2_Received: symbol=ApplLinComAb_LIN2_COMRXL_CompElecCurr_800_EAC_STAT_800_Lin2_Received  # Received -
          data-receive-point-by-arguments:
            access DRP_Lin2ComRxSignalsSR_COMRXL_CompElecCurr_800_EAC_STAT_800_Lin2: accessed-variable=Lin2ComRxSignalsSR.COMRXL_CompElecCurr_800_EAC_STAT_800_Lin2
          data-send-points:
            access DSP_VeLINR_I_CompElecCurr_800_VeLINR_I_CompElecCurr_800: accessed-variable=VeLINR_I_CompElecCurr_800.VeLINR_I_CompElecCurr_800
            access DSP_VeLINR_b_CompElecCurr_800TO_VeLINR_b_CompElecCurr_800TO: accessed-variable=VeLINR_b_CompElecCurr_800TO.VeLINR_b_CompElecCurr_800TO
        COMRXL_CompElecCurr_800_EAC_STAT_800_Lin2_Error: symbol=ApplLinComAb_LIN2_COMRXL_CompElecCurr_800_EAC_STAT_800_Lin2_Error  # Error -
          data-receive-point-by-arguments:
            access DRP_Lin2ComRxSignalsSR_COMRXL_CompElecCurr_800_EAC_STAT_800_Lin2: accessed-variable=Lin2ComRxSignalsSR.COMRXL_CompElecCurr_800_EAC_STAT_800_Lin2
          data-send-points:
            access DSP_VeLINR_I_CompElecCurr_800_VeLINR_I_CompElecCurr_800: accessed-variable=VeLINR_I_CompElecCurr_800.VeLINR_I_CompElecCurr_800
            access DSP_VeLINR_b_CompElecCurr_800TO_VeLINR_b_CompElecCurr_800TO: accessed-variable=VeLINR_b_CompElecCurr_800TO.VeLINR_b_CompElecCurr_800TO
          read-local-variables:
            access IRVRA_VeLINR_d_LIN_SlavePrsnt_LIN2: accessed-variable=VeLINR_d_LIN_SlavePrsnt_LIN2
        COMRXL_CompHVInput_800_EAC_STAT_800_Lin2_Received: symbol=ApplLinComAb_LIN2_COMRXL_CompHVInput_800_EAC_STAT_800_Lin2_Received  # Received -
          data-receive-point-by-arguments:
            access DRP_Lin2ComRxSignalsSR_COMRXL_CompHVInput_800_EAC_STAT_800_Lin2: accessed-variable=Lin2ComRxSignalsSR.COMRXL_CompHVInput_800_EAC_STAT_800_Lin2
          data-send-points:
            access DSP_VeLINR_U_CompHVInput_800_VeLINR_U_CompHVInput_800: accessed-variable=VeLINR_U_CompHVInput_800.VeLINR_U_CompHVInput_800
            access DSP_VeLINR_b_CompHVInput_800TO_VeLINR_b_CompHVInput_800TO: accessed-variable=VeLINR_b_CompHVInput_800TO.VeLINR_b_CompHVInput_800TO
        COMRXL_CompHVInput_800_EAC_STAT_800_Lin2_Error: symbol=ApplLinComAb_LIN2_COMRXL_CompHVInput_800_EAC_STAT_800_Lin2_Error  # Error -
          data-receive-point-by-arguments:
            access DRP_Lin2ComRxSignalsSR_COMRXL_CompHVInput_800_EAC_STAT_800_Lin2: accessed-variable=Lin2ComRxSignalsSR.COMRXL_CompHVInput_800_EAC_STAT_800_Lin2
          data-send-points:
            access DSP_VeLINR_U_CompHVInput_800_VeLINR_U_CompHVInput_800: accessed-variable=VeLINR_U_CompHVInput_800.VeLINR_U_CompHVInput_800
            access DSP_VeLINR_b_CompHVInput_800TO_VeLINR_b_CompHVInput_800TO: accessed-variable=VeLINR_b_CompHVInput_800TO.VeLINR_b_CompHVInput_800TO
          read-local-variables:
            access IRVRA_VeLINR_d_LIN_SlavePrsnt_LIN2: accessed-variable=VeLINR_d_LIN_SlavePrsnt_LIN2
        SendLINR_PwrPanel_LED_C_Command: can-be-invoked-concurrently=true, symbol=ApplLinComAb_LIN2_SendLINR_PwrPanel_LED_C_Command  # Transmit
          data-receive-point-by-arguments:
            access DRP_SendLINR_PwrPanel_LED_C_Command_SendLINR_PwrPanel_LED_C_Command: accessed-variable=SendLINR_PwrPanel_LED_C_Command.SendLINR_PwrPanel_LED_C_Command
            access DRP_SendLINR_PwrPanel_LED_C_CommandVld_SendLINR_PwrPanel_LED_C_CommandVld: accessed-variable=SendLINR_PwrPanel_LED_C_CommandVld.SendLINR_PwrPanel_LED_C_CommandVld
          data-send-points:
            access DSP_Lin2ComTxSignalsSR_COMTXL_PowerPanel_LED_C_Command_PowerPanel_REQ_Lin2: accessed-variable=Lin2ComTxSignalsSR.COMTXL_PowerPanel_LED_C_Command_PowerPanel_REQ_Lin2
        SendLINR_PwrPanel_LEDA_ColorCmd: can-be-invoked-concurrently=true, symbol=ApplLinComAb_LIN2_SendLINR_PwrPanel_LEDA_ColorCmd  # Transmit
          data-receive-point-by-arguments:
            access DRP_SendLINR_PwrPanel_LEDA_ColorCmd_SendLINR_PwrPanel_LEDA_ColorCmd: accessed-variable=SendLINR_PwrPanel_LEDA_ColorCmd.SendLINR_PwrPanel_LEDA_ColorCmd
            access DRP_SendLINR_PwrPanel_LEDA_ColorCmdVld_SendLINR_PwrPanel_LEDA_ColorCmdVld: accessed-variable=SendLINR_PwrPanel_LEDA_ColorCmdVld.SendLINR_PwrPanel_LEDA_ColorCmdVld
          data-send-points:
            access DSP_Lin2ComTxSignalsSR_COMTXL_PowerPanel_LED_A_Color_Command_PowerPanel_REQ_Lin2: accessed-variable=Lin2ComTxSignalsSR.COMTXL_PowerPanel_LED_A_Color_Command_PowerPanel_REQ_Lin2
        SendLINR_PwrPanel_LEDB_ColorCmd: can-be-invoked-concurrently=true, symbol=ApplLinComAb_LIN2_SendLINR_PwrPanel_LEDB_ColorCmd  # Transmit
          data-receive-point-by-arguments:
            access DRP_SendLINR_PwrPanel_LEDB_ColorCmd_SendLINR_PwrPanel_LEDB_ColorCmd: accessed-variable=SendLINR_PwrPanel_LEDB_ColorCmd.SendLINR_PwrPanel_LEDB_ColorCmd
            access DRP_SendLINR_PwrPanel_LEDB_ColorCmdVld_SendLINR_PwrPanel_LEDB_ColorCmdVld: accessed-variable=SendLINR_PwrPanel_LEDB_ColorCmdVld.SendLINR_PwrPanel_LEDB_ColorCmdVld
          data-send-points:
            access DSP_Lin2ComTxSignalsSR_COMTXL_PowerPanel_LED_B_Color_Command_PowerPanel_REQ_Lin2: accessed-variable=Lin2ComTxSignalsSR.COMTXL_PowerPanel_LED_B_Color_Command_PowerPanel_REQ_Lin2
        SendLINR_PwrPanel_LEDC_ColorCmd: can-be-invoked-concurrently=true, symbol=ApplLinComAb_LIN2_SendLINR_PwrPanel_LEDC_ColorCmd  # Transmit
          data-receive-point-by-arguments:
            access DRP_SendLINR_PwrPanel_LEDC_ColorCmd_SendLINR_PwrPanel_LEDC_ColorCmd: accessed-variable=SendLINR_PwrPanel_LEDC_ColorCmd.SendLINR_PwrPanel_LEDC_ColorCmd
            access DRP_SendLINR_PwrPanel_LEDC_ColorCmdVld_SendLINR_PwrPanel_LEDC_ColorCmdVld: accessed-variable=SendLINR_PwrPanel_LEDC_ColorCmdVld.SendLINR_PwrPanel_LEDC_ColorCmdVld
          data-send-points:
            access DSP_Lin2ComTxSignalsSR_COMTXL_PowerPanel_LED_C_Color_Command_PowerPanel_REQ_Lin2: accessed-variable=Lin2ComTxSignalsSR.COMTXL_PowerPanel_LED_C_Color_Command_PowerPanel_REQ_Lin2
        SignalLINR_CACV_RdyForSleep: symbol=ApplLinComAb_LIN2_SignalLINR_CACV_RdyForSleep  # CACV is ready for sleep. Set it's bit in Lin slave ready to sleep.Transmit
          data-receive-point-by-arguments:
            access DRP_SignalLINR_CACV_RdyForSleep_SignalLINR_CACV_RdyForSleep: accessed-variable=SignalLINR_CACV_RdyForSleep.SignalLINR_CACV_RdyForSleep
          mode-access-point mode-group=MdulPwrMod.AppMode_MDGP_ESH_Mode:
            ident MAP_MdulPwrMod_AppMode_MDGP_ESH_Mode
          parameter access CPA_KeCFGR_b_LIN2_Equid: accessed-parameter=KeCFGR_b_LIN2_Equid.KeCFGR_b_LIN2_Equid
          read-local-variables:
            access IRVRA_VeLINR_d_LIN_SlavePrsnt_LIN2: accessed-variable=VeLINR_d_LIN_SlavePrsnt_LIN2
            access IRVRA_VeLINR_d_LIN_SlaveRdyToSleep_LIN2: accessed-variable=VeLINR_d_LIN_SlaveRdyToSleep_LIN2
          sync call SSCP_GetRteMode_GetMODR_b_InPostRunMode: operation=GetRteMode.GetMODR_b_InPostRunMode, timeout=0.01
          written-local-variables:
            access IRVWA_VeLINR_d_LIN_SlaveRdyToSleep_LIN2: accessed-variable=VeLINR_d_LIN_SlaveRdyToSleep_LIN2
        COMRXL_PowerPanel_LED_A_Feedback_PowerPanel_STAT_Lin2_Received: symbol=ApplLinComAb_LIN2_COMRXL_PowerPanel_LED_A_Feedback_PowerPanel_STAT_Lin2_Received  # Received -
          data-receive-point-by-arguments:
            access DRP_Lin2ComRxSignalsSR_COMRXL_PowerPanel_LED_A_Feedback_PowerPanel_STAT_Lin2: accessed-variable=Lin2ComRxSignalsSR.COMRXL_PowerPanel_LED_A_Feedback_PowerPanel_STAT_Lin2
          data-send-points:
            access DSP_VeLINR_e_PwrPanel_LEDA_Feedback_VeLINR_e_PwrPanel_LEDA_Feedback: accessed-variable=VeLINR_e_PwrPanel_LEDA_Feedback.VeLINR_e_PwrPanel_LEDA_Feedback
            access DSP_VeLINR_b_PwrPanel_LEDA_FeedbackTO_VeLINR_b_PwrPanel_LEDA_FeedbackTO: accessed-variable=VeLINR_b_PwrPanel_LEDA_FeedbackTO.VeLINR_b_PwrPanel_LEDA_FeedbackTO
        COMRXL_PowerPanel_LED_A_Feedback_PowerPanel_STAT_Lin2_Error: symbol=ApplLinComAb_LIN2_COMRXL_PowerPanel_LED_A_Feedback_PowerPanel_STAT_Lin2_Error  # Error -
          data-receive-point-by-arguments:
            access DRP_Lin2ComRxSignalsSR_COMRXL_PowerPanel_LED_A_Feedback_PowerPanel_STAT_Lin2: accessed-variable=Lin2ComRxSignalsSR.COMRXL_PowerPanel_LED_A_Feedback_PowerPanel_STAT_Lin2
          data-send-points:
            access DSP_VeLINR_e_PwrPanel_LEDA_Feedback_VeLINR_e_PwrPanel_LEDA_Feedback: accessed-variable=VeLINR_e_PwrPanel_LEDA_Feedback.VeLINR_e_PwrPanel_LEDA_Feedback
            access DSP_VeLINR_b_PwrPanel_LEDA_FeedbackTO_VeLINR_b_PwrPanel_LEDA_FeedbackTO: accessed-variable=VeLINR_b_PwrPanel_LEDA_FeedbackTO.VeLINR_b_PwrPanel_LEDA_FeedbackTO
          read-local-variables:
            access IRVRA_VeLINR_d_LIN_SlavePrsnt_LIN2: accessed-variable=VeLINR_d_LIN_SlavePrsnt_LIN2
        COMRXL_PowerPanel_LED_B_Feedback_PowerPanel_STAT_Lin2_Received: symbol=ApplLinComAb_LIN2_COMRXL_PowerPanel_LED_B_Feedback_PowerPanel_STAT_Lin2_Received  # Received -
          data-receive-point-by-arguments:
            access DRP_Lin2ComRxSignalsSR_COMRXL_PowerPanel_LED_B_Feedback_PowerPanel_STAT_Lin2: accessed-variable=Lin2ComRxSignalsSR.COMRXL_PowerPanel_LED_B_Feedback_PowerPanel_STAT_Lin2
          data-send-points:
            access DSP_VeLINR_e_PwrPanel_LEDB_Feedback_VeLINR_e_PwrPanel_LEDB_Feedback: accessed-variable=VeLINR_e_PwrPanel_LEDB_Feedback.VeLINR_e_PwrPanel_LEDB_Feedback
            access DSP_VeLINR_b_PwrPanel_LEDB_FeedbackTO_VeLINR_b_PwrPanel_LEDB_FeedbackTO: accessed-variable=VeLINR_b_PwrPanel_LEDB_FeedbackTO.VeLINR_b_PwrPanel_LEDB_FeedbackTO
        COMRXL_PowerPanel_LED_B_Feedback_PowerPanel_STAT_Lin2_Error: symbol=ApplLinComAb_LIN2_COMRXL_PowerPanel_LED_B_Feedback_PowerPanel_STAT_Lin2_Error  # Error -
          data-receive-point-by-arguments:
            access DRP_Lin2ComRxSignalsSR_COMRXL_PowerPanel_LED_B_Feedback_PowerPanel_STAT_Lin2: accessed-variable=Lin2ComRxSignalsSR.COMRXL_PowerPanel_LED_B_Feedback_PowerPanel_STAT_Lin2
          data-send-points:
            access DSP_VeLINR_e_PwrPanel_LEDB_Feedback_VeLINR_e_PwrPanel_LEDB_Feedback: accessed-variable=VeLINR_e_PwrPanel_LEDB_Feedback.VeLINR_e_PwrPanel_LEDB_Feedback
            access DSP_VeLINR_b_PwrPanel_LEDB_FeedbackTO_VeLINR_b_PwrPanel_LEDB_FeedbackTO: accessed-variable=VeLINR_b_PwrPanel_LEDB_FeedbackTO.VeLINR_b_PwrPanel_LEDB_FeedbackTO
          read-local-variables:
            access IRVRA_VeLINR_d_LIN_SlavePrsnt_LIN2: accessed-variable=VeLINR_d_LIN_SlavePrsnt_LIN2
        COMRXL_PowerPanel_LED_C_Feedback_PowerPanel_STAT_Lin2_Received: symbol=ApplLinComAb_LIN2_COMRXL_PowerPanel_LED_C_Feedback_PowerPanel_STAT_Lin2_Received  # Received -
          data-receive-point-by-arguments:
            access DRP_Lin2ComRxSignalsSR_COMRXL_PowerPanel_LED_C_Feedback_PowerPanel_STAT_Lin2: accessed-variable=Lin2ComRxSignalsSR.COMRXL_PowerPanel_LED_C_Feedback_PowerPanel_STAT_Lin2
          data-send-points:
            access DSP_VeLINR_e_PwrPanel_LEDC_Feedback_VeLINR_e_PwrPanel_LEDC_Feedback: accessed-variable=VeLINR_e_PwrPanel_LEDC_Feedback.VeLINR_e_PwrPanel_LEDC_Feedback
            access DSP_VeLINR_b_PwrPanel_LEDC_FeedbackTO_VeLINR_b_PwrPanel_LEDC_FeedbackTO: accessed-variable=VeLINR_b_PwrPanel_LEDC_FeedbackTO.VeLINR_b_PwrPanel_LEDC_FeedbackTO
        COMRXL_PowerPanel_LED_C_Feedback_PowerPanel_STAT_Lin2_Error: symbol=ApplLinComAb_LIN2_COMRXL_PowerPanel_LED_C_Feedback_PowerPanel_STAT_Lin2_Error  # Error -
          data-receive-point-by-arguments:
            access DRP_Lin2ComRxSignalsSR_COMRXL_PowerPanel_LED_C_Feedback_PowerPanel_STAT_Lin2: accessed-variable=Lin2ComRxSignalsSR.COMRXL_PowerPanel_LED_C_Feedback_PowerPanel_STAT_Lin2
          data-send-points:
            access DSP_VeLINR_e_PwrPanel_LEDC_Feedback_VeLINR_e_PwrPanel_LEDC_Feedback: accessed-variable=VeLINR_e_PwrPanel_LEDC_Feedback.VeLINR_e_PwrPanel_LEDC_Feedback
            access DSP_VeLINR_b_PwrPanel_LEDC_FeedbackTO_VeLINR_b_PwrPanel_LEDC_FeedbackTO: accessed-variable=VeLINR_b_PwrPanel_LEDC_FeedbackTO.VeLINR_b_PwrPanel_LEDC_FeedbackTO
          read-local-variables:
            access IRVRA_VeLINR_d_LIN_SlavePrsnt_LIN2: accessed-variable=VeLINR_d_LIN_SlavePrsnt_LIN2
        COMRXL_PowerPanel_LED_A_FailStatus_PowerPanel_STAT_Lin2_Received: symbol=ApplLinComAb_LIN2_COMRXL_PowerPanel_LED_A_FailStatus_PowerPanel_STAT_Lin2_Received  # Received -
          data-receive-point-by-arguments:
            access DRP_Lin2ComRxSignalsSR_COMRXL_PowerPanel_LED_A_FailStatus_PowerPanel_STAT_Lin2: accessed-variable=Lin2ComRxSignalsSR.COMRXL_PowerPanel_LED_A_FailStatus_PowerPanel_STAT_Lin2
          data-send-points:
            access DSP_VeLINR_e_PwrPanel_LEDA_FailSts_VeLINR_e_PwrPanel_LEDA_FailSts: accessed-variable=VeLINR_e_PwrPanel_LEDA_FailSts.VeLINR_e_PwrPanel_LEDA_FailSts
            access DSP_VeLINR_b_PwrPanel_LEDA_FailStsTO_VeLINR_b_PwrPanel_LEDA_FailStsTO: accessed-variable=VeLINR_b_PwrPanel_LEDA_FailStsTO.VeLINR_b_PwrPanel_LEDA_FailStsTO
        COMRXL_PowerPanel_LED_A_FailStatus_PowerPanel_STAT_Lin2_Error: symbol=ApplLinComAb_LIN2_COMRXL_PowerPanel_LED_A_FailStatus_PowerPanel_STAT_Lin2_Error  # Error -
          data-receive-point-by-arguments:
            access DRP_Lin2ComRxSignalsSR_COMRXL_PowerPanel_LED_A_FailStatus_PowerPanel_STAT_Lin2: accessed-variable=Lin2ComRxSignalsSR.COMRXL_PowerPanel_LED_A_FailStatus_PowerPanel_STAT_Lin2
          data-send-points:
            access DSP_VeLINR_e_PwrPanel_LEDA_FailSts_VeLINR_e_PwrPanel_LEDA_FailSts: accessed-variable=VeLINR_e_PwrPanel_LEDA_FailSts.VeLINR_e_PwrPanel_LEDA_FailSts
            access DSP_VeLINR_b_PwrPanel_LEDA_FailStsTO_VeLINR_b_PwrPanel_LEDA_FailStsTO: accessed-variable=VeLINR_b_PwrPanel_LEDA_FailStsTO.VeLINR_b_PwrPanel_LEDA_FailStsTO
          read-local-variables:
            access IRVRA_VeLINR_d_LIN_SlavePrsnt_LIN2: accessed-variable=VeLINR_d_LIN_SlavePrsnt_LIN2
        COMRXL_PowerPanel_LED_B_FailStatus_PowerPanel_STAT_Lin2_Received: symbol=ApplLinComAb_LIN2_COMRXL_PowerPanel_LED_B_FailStatus_PowerPanel_STAT_Lin2_Received  # Received -
          data-receive-point-by-arguments:
            access DRP_Lin2ComRxSignalsSR_COMRXL_PowerPanel_LED_B_FailStatus_PowerPanel_STAT_Lin2: accessed-variable=Lin2ComRxSignalsSR.COMRXL_PowerPanel_LED_B_FailStatus_PowerPanel_STAT_Lin2
          data-send-points:
            access DSP_VeLINR_e_PwrPanel_LEDB_FailSts_VeLINR_e_PwrPanel_LEDB_FailSts: accessed-variable=VeLINR_e_PwrPanel_LEDB_FailSts.VeLINR_e_PwrPanel_LEDB_FailSts
            access DSP_VeLINR_b_PwrPanel_LEDB_FailStsTO_VeLINR_b_PwrPanel_LEDB_FailStsTO: accessed-variable=VeLINR_b_PwrPanel_LEDB_FailStsTO.VeLINR_b_PwrPanel_LEDB_FailStsTO
        COMRXL_PowerPanel_LED_B_FailStatus_PowerPanel_STAT_Lin2_Error: symbol=ApplLinComAb_LIN2_COMRXL_PowerPanel_LED_B_FailStatus_PowerPanel_STAT_Lin2_Error  # Error -
          data-receive-point-by-arguments:
            access DRP_Lin2ComRxSignalsSR_COMRXL_PowerPanel_LED_B_FailStatus_PowerPanel_STAT_Lin2: accessed-variable=Lin2ComRxSignalsSR.COMRXL_PowerPanel_LED_B_FailStatus_PowerPanel_STAT_Lin2
          data-send-points:
            access DSP_VeLINR_e_PwrPanel_LEDB_FailSts_VeLINR_e_PwrPanel_LEDB_FailSts: accessed-variable=VeLINR_e_PwrPanel_LEDB_FailSts.VeLINR_e_PwrPanel_LEDB_FailSts
            access DSP_VeLINR_b_PwrPanel_LEDB_FailStsTO_VeLINR_b_PwrPanel_LEDB_FailStsTO: accessed-variable=VeLINR_b_PwrPanel_LEDB_FailStsTO.VeLINR_b_PwrPanel_LEDB_FailStsTO
          read-local-variables:
            access IRVRA_VeLINR_d_LIN_SlavePrsnt_LIN2: accessed-variable=VeLINR_d_LIN_SlavePrsnt_LIN2
        COMRXL_PowerPanel_LED_C_FailStatus_PowerPanel_STAT_Lin2_Received: symbol=ApplLinComAb_LIN2_COMRXL_PowerPanel_LED_C_FailStatus_PowerPanel_STAT_Lin2_Received  # Received -
          data-receive-point-by-arguments:
            access DRP_Lin2ComRxSignalsSR_COMRXL_PowerPanel_LED_C_FailStatus_PowerPanel_STAT_Lin2: accessed-variable=Lin2ComRxSignalsSR.COMRXL_PowerPanel_LED_C_FailStatus_PowerPanel_STAT_Lin2
          data-send-points:
            access DSP_VeLINR_e_PwrPanel_LEDC_FailSts_VeLINR_e_PwrPanel_LEDC_FailSts: accessed-variable=VeLINR_e_PwrPanel_LEDC_FailSts.VeLINR_e_PwrPanel_LEDC_FailSts
            access DSP_VeLINR_b_PwrPanel_LEDC_FailStsTO_VeLINR_b_PwrPanel_LEDC_FailStsTO: accessed-variable=VeLINR_b_PwrPanel_LEDC_FailStsTO.VeLINR_b_PwrPanel_LEDC_FailStsTO
        COMRXL_PowerPanel_LED_C_FailStatus_PowerPanel_STAT_Lin2_Error: symbol=ApplLinComAb_LIN2_COMRXL_PowerPanel_LED_C_FailStatus_PowerPanel_STAT_Lin2_Error  # Error -
          data-receive-point-by-arguments:
            access DRP_Lin2ComRxSignalsSR_COMRXL_PowerPanel_LED_C_FailStatus_PowerPanel_STAT_Lin2: accessed-variable=Lin2ComRxSignalsSR.COMRXL_PowerPanel_LED_C_FailStatus_PowerPanel_STAT_Lin2
          data-send-points:
            access DSP_VeLINR_e_PwrPanel_LEDC_FailSts_VeLINR_e_PwrPanel_LEDC_FailSts: accessed-variable=VeLINR_e_PwrPanel_LEDC_FailSts.VeLINR_e_PwrPanel_LEDC_FailSts
            access DSP_VeLINR_b_PwrPanel_LEDC_FailStsTO_VeLINR_b_PwrPanel_LEDC_FailStsTO: accessed-variable=VeLINR_b_PwrPanel_LEDC_FailStsTO.VeLINR_b_PwrPanel_LEDC_FailStsTO
          read-local-variables:
            access IRVRA_VeLINR_d_LIN_SlavePrsnt_LIN2: accessed-variable=VeLINR_d_LIN_SlavePrsnt_LIN2
        COMRXL_PowerPanel_LED_A_Color_Feedback_PowerPanel_STAT_Lin2_Received: symbol=ApplLinComAb_LIN2_COMRXL_PowerPanel_LED_A_Color_Feedback_PowerPanel_STAT_Lin2_Received  # Received -
          data-receive-point-by-arguments:
            access DRP_Lin2ComRxSignalsSR_COMRXL_PowerPanel_LED_A_Color_Feedback_PowerPanel_STAT_Lin2: accessed-variable=Lin2ComRxSignalsSR.COMRXL_PowerPanel_LED_A_Color_Feedback_PowerPanel_STAT_Lin2
          data-send-points:
            access DSP_VeLINR_e_PwrPanelLEDAColorFdbck_VeLINR_e_PwrPanelLEDAColorFdbck: accessed-variable=VeLINR_e_PwrPanelLEDAColorFdbck.VeLINR_e_PwrPanelLEDAColorFdbck
            access DSP_VeLINR_b_PwrPanelLEDAColorFdbckTO_VeLINR_b_PwrPanelLEDAColorFdbckTO: accessed-variable=VeLINR_b_PwrPanelLEDAColorFdbckTO.VeLINR_b_PwrPanelLEDAColorFdbckTO
        COMRXL_PowerPanel_LED_A_Color_Feedback_PowerPanel_STAT_Lin2_Error: symbol=ApplLinComAb_LIN2_COMRXL_PowerPanel_LED_A_Color_Feedback_PowerPanel_STAT_Lin2_Error  # Error -
          data-receive-point-by-arguments:
            access DRP_Lin2ComRxSignalsSR_COMRXL_PowerPanel_LED_A_Color_Feedback_PowerPanel_STAT_Lin2: accessed-variable=Lin2ComRxSignalsSR.COMRXL_PowerPanel_LED_A_Color_Feedback_PowerPanel_STAT_Lin2
          data-send-points:
            access DSP_VeLINR_e_PwrPanelLEDAColorFdbck_VeLINR_e_PwrPanelLEDAColorFdbck: accessed-variable=VeLINR_e_PwrPanelLEDAColorFdbck.VeLINR_e_PwrPanelLEDAColorFdbck
            access DSP_VeLINR_b_PwrPanelLEDAColorFdbckTO_VeLINR_b_PwrPanelLEDAColorFdbckTO: accessed-variable=VeLINR_b_PwrPanelLEDAColorFdbckTO.VeLINR_b_PwrPanelLEDAColorFdbckTO
          read-local-variables:
            access IRVRA_VeLINR_d_LIN_SlavePrsnt_LIN2: accessed-variable=VeLINR_d_LIN_SlavePrsnt_LIN2
        COMRXL_PowerPanel_LED_B_Color_Feedback_PowerPanel_STAT_Lin2_Received: symbol=ApplLinComAb_LIN2_COMRXL_PowerPanel_LED_B_Color_Feedback_PowerPanel_STAT_Lin2_Received  # Received -
          data-receive-point-by-arguments:
            access DRP_Lin2ComRxSignalsSR_COMRXL_PowerPanel_LED_B_Color_Feedback_PowerPanel_STAT_Lin2: accessed-variable=Lin2ComRxSignalsSR.COMRXL_PowerPanel_LED_B_Color_Feedback_PowerPanel_STAT_Lin2
          data-send-points:
            access DSP_VeLINR_e_PwrPanelLEDBColorFdbck_VeLINR_e_PwrPanelLEDBColorFdbck: accessed-variable=VeLINR_e_PwrPanelLEDBColorFdbck.VeLINR_e_PwrPanelLEDBColorFdbck
            access DSP_VeLINR_b_PwrPanelLEDBColorFdbckTO_VeLINR_b_PwrPanelLEDBColorFdbckTO: accessed-variable=VeLINR_b_PwrPanelLEDBColorFdbckTO.VeLINR_b_PwrPanelLEDBColorFdbckTO
        COMRXL_PowerPanel_LED_B_Color_Feedback_PowerPanel_STAT_Lin2_Error: symbol=ApplLinComAb_LIN2_COMRXL_PowerPanel_LED_B_Color_Feedback_PowerPanel_STAT_Lin2_Error  # Error -
          data-receive-point-by-arguments:
            access DRP_Lin2ComRxSignalsSR_COMRXL_PowerPanel_LED_B_Color_Feedback_PowerPanel_STAT_Lin2: accessed-variable=Lin2ComRxSignalsSR.COMRXL_PowerPanel_LED_B_Color_Feedback_PowerPanel_STAT_Lin2
          data-send-points:
            access DSP_VeLINR_e_PwrPanelLEDBColorFdbck_VeLINR_e_PwrPanelLEDBColorFdbck: accessed-variable=VeLINR_e_PwrPanelLEDBColorFdbck.VeLINR_e_PwrPanelLEDBColorFdbck
            access DSP_VeLINR_b_PwrPanelLEDBColorFdbckTO_VeLINR_b_PwrPanelLEDBColorFdbckTO: accessed-variable=VeLINR_b_PwrPanelLEDBColorFdbckTO.VeLINR_b_PwrPanelLEDBColorFdbckTO
          read-local-variables:
            access IRVRA_VeLINR_d_LIN_SlavePrsnt_LIN2: accessed-variable=VeLINR_d_LIN_SlavePrsnt_LIN2
        COMRXL_PowerPanel_LED_C_Color_Feedback_PowerPanel_STAT_Lin2_Received: symbol=ApplLinComAb_LIN2_COMRXL_PowerPanel_LED_C_Color_Feedback_PowerPanel_STAT_Lin2_Received  # Received -
          data-receive-point-by-arguments:
            access DRP_Lin2ComRxSignalsSR_COMRXL_PowerPanel_LED_C_Color_Feedback_PowerPanel_STAT_Lin2: accessed-variable=Lin2ComRxSignalsSR.COMRXL_PowerPanel_LED_C_Color_Feedback_PowerPanel_STAT_Lin2
          data-send-points:
            access DSP_VeLINR_e_PwrPanelLEDCColorFdbck_VeLINR_e_PwrPanelLEDCColorFdbck: accessed-variable=VeLINR_e_PwrPanelLEDCColorFdbck.VeLINR_e_PwrPanelLEDCColorFdbck
            access DSP_VeLINR_b_PwrPanelLEDCColorFdbckTO_VeLINR_b_PwrPanelLEDCColorFdbckTO: accessed-variable=VeLINR_b_PwrPanelLEDCColorFdbckTO.VeLINR_b_PwrPanelLEDCColorFdbckTO
        COMRXL_PowerPanel_LED_C_Color_Feedback_PowerPanel_STAT_Lin2_Error: symbol=ApplLinComAb_LIN2_COMRXL_PowerPanel_LED_C_Color_Feedback_PowerPanel_STAT_Lin2_Error  # Error -
          data-receive-point-by-arguments:
            access DRP_Lin2ComRxSignalsSR_COMRXL_PowerPanel_LED_C_Color_Feedback_PowerPanel_STAT_Lin2: accessed-variable=Lin2ComRxSignalsSR.COMRXL_PowerPanel_LED_C_Color_Feedback_PowerPanel_STAT_Lin2
          data-send-points:
            access DSP_VeLINR_e_PwrPanelLEDCColorFdbck_VeLINR_e_PwrPanelLEDCColorFdbck: accessed-variable=VeLINR_e_PwrPanelLEDCColorFdbck.VeLINR_e_PwrPanelLEDCColorFdbck
            access DSP_VeLINR_b_PwrPanelLEDCColorFdbckTO_VeLINR_b_PwrPanelLEDCColorFdbckTO: accessed-variable=VeLINR_b_PwrPanelLEDCColorFdbckTO.VeLINR_b_PwrPanelLEDCColorFdbckTO
          read-local-variables:
            access IRVRA_VeLINR_d_LIN_SlavePrsnt_LIN2: accessed-variable=VeLINR_d_LIN_SlavePrsnt_LIN2
        COMRXL_PowerPanel_LIN_Checksum_Error_PowerPanel_STAT_Lin2_Received: symbol=ApplLinComAb_LIN2_COMRXL_PowerPanel_LIN_Checksum_Error_PowerPanel_STAT_Lin2_Received  # Received -
          data-receive-point-by-arguments:
            access DRP_Lin2ComRxSignalsSR_COMRXL_PowerPanel_LIN_Checksum_Error_PowerPanel_STAT_Lin2: accessed-variable=Lin2ComRxSignalsSR.COMRXL_PowerPanel_LIN_Checksum_Error_PowerPanel_STAT_Lin2
          data-send-points:
            access DSP_VeLINR_b_PwrPanel_LIN_ChksumErr_VeLINR_b_PwrPanel_LIN_ChksumErr: accessed-variable=VeLINR_b_PwrPanel_LIN_ChksumErr.VeLINR_b_PwrPanel_LIN_ChksumErr
            access DSP_VeLINR_b_PwrPanel_LIN_ChksumErrTO_VeLINR_b_PwrPanel_LIN_ChksumErrTO: accessed-variable=VeLINR_b_PwrPanel_LIN_ChksumErrTO.VeLINR_b_PwrPanel_LIN_ChksumErrTO
        COMRXL_PowerPanel_LIN_Checksum_Error_PowerPanel_STAT_Lin2_Error: symbol=ApplLinComAb_LIN2_COMRXL_PowerPanel_LIN_Checksum_Error_PowerPanel_STAT_Lin2_Error  # Error -
          data-receive-point-by-arguments:
            access DRP_Lin2ComRxSignalsSR_COMRXL_PowerPanel_LIN_Checksum_Error_PowerPanel_STAT_Lin2: accessed-variable=Lin2ComRxSignalsSR.COMRXL_PowerPanel_LIN_Checksum_Error_PowerPanel_STAT_Lin2
          data-send-points:
            access DSP_VeLINR_b_PwrPanel_LIN_ChksumErr_VeLINR_b_PwrPanel_LIN_ChksumErr: accessed-variable=VeLINR_b_PwrPanel_LIN_ChksumErr.VeLINR_b_PwrPanel_LIN_ChksumErr
            access DSP_VeLINR_b_PwrPanel_LIN_ChksumErrTO_VeLINR_b_PwrPanel_LIN_ChksumErrTO: accessed-variable=VeLINR_b_PwrPanel_LIN_ChksumErrTO.VeLINR_b_PwrPanel_LIN_ChksumErrTO
          read-local-variables:
            access IRVRA_VeLINR_d_LIN_SlavePrsnt_LIN2: accessed-variable=VeLINR_d_LIN_SlavePrsnt_LIN2
        COMRXL_PowerPanel_LIN_Data_Error_PowerPanel_STAT_Lin2_Received: symbol=ApplLinComAb_LIN2_COMRXL_PowerPanel_LIN_Data_Error_PowerPanel_STAT_Lin2_Received  # Received -
          data-receive-point-by-arguments:
            access DRP_Lin2ComRxSignalsSR_COMRXL_PowerPanel_LIN_Data_Error_PowerPanel_STAT_Lin2: accessed-variable=Lin2ComRxSignalsSR.COMRXL_PowerPanel_LIN_Data_Error_PowerPanel_STAT_Lin2
          data-send-points:
            access DSP_VeLINR_b_PwrPanel_LIN_DataError_VeLINR_b_PwrPanel_LIN_DataError: accessed-variable=VeLINR_b_PwrPanel_LIN_DataError.VeLINR_b_PwrPanel_LIN_DataError
            access DSP_VeLINR_b_PwrPanel_LIN_DataErrorTO_VeLINR_b_PwrPanel_LIN_DataErrorTO: accessed-variable=VeLINR_b_PwrPanel_LIN_DataErrorTO.VeLINR_b_PwrPanel_LIN_DataErrorTO
        COMRXL_PowerPanel_LIN_Data_Error_PowerPanel_STAT_Lin2_Error: symbol=ApplLinComAb_LIN2_COMRXL_PowerPanel_LIN_Data_Error_PowerPanel_STAT_Lin2_Error  # Error -
          data-receive-point-by-arguments:
            access DRP_Lin2ComRxSignalsSR_COMRXL_PowerPanel_LIN_Data_Error_PowerPanel_STAT_Lin2: accessed-variable=Lin2ComRxSignalsSR.COMRXL_PowerPanel_LIN_Data_Error_PowerPanel_STAT_Lin2
          data-send-points:
            access DSP_VeLINR_b_PwrPanel_LIN_DataError_VeLINR_b_PwrPanel_LIN_DataError: accessed-variable=VeLINR_b_PwrPanel_LIN_DataError.VeLINR_b_PwrPanel_LIN_DataError
            access DSP_VeLINR_b_PwrPanel_LIN_DataErrorTO_VeLINR_b_PwrPanel_LIN_DataErrorTO: accessed-variable=VeLINR_b_PwrPanel_LIN_DataErrorTO.VeLINR_b_PwrPanel_LIN_DataErrorTO
          read-local-variables:
            access IRVRA_VeLINR_d_LIN_SlavePrsnt_LIN2: accessed-variable=VeLINR_d_LIN_SlavePrsnt_LIN2
        COMRXL_PowerPanel_LIN_Parity_Error_PowerPanel_STAT_Lin2_Received: symbol=ApplLinComAb_LIN2_COMRXL_PowerPanel_LIN_Parity_Error_PowerPanel_STAT_Lin2_Received  # Received -
          data-receive-point-by-arguments:
            access DRP_Lin2ComRxSignalsSR_COMRXL_PowerPanel_LIN_Parity_Error_PowerPanel_STAT_Lin2: accessed-variable=Lin2ComRxSignalsSR.COMRXL_PowerPanel_LIN_Parity_Error_PowerPanel_STAT_Lin2
          data-send-points:
            access DSP_VeLINR_b_PwrPanel_LIN_ParityErr_VeLINR_b_PwrPanel_LIN_ParityErr: accessed-variable=VeLINR_b_PwrPanel_LIN_ParityErr.VeLINR_b_PwrPanel_LIN_ParityErr
            access DSP_VeLINR_b_PwrPanel_LIN_ParityErrTO_VeLINR_b_PwrPanel_LIN_ParityErrTO: accessed-variable=VeLINR_b_PwrPanel_LIN_ParityErrTO.VeLINR_b_PwrPanel_LIN_ParityErrTO
        COMRXL_PowerPanel_LIN_Parity_Error_PowerPanel_STAT_Lin2_Error: symbol=ApplLinComAb_LIN2_COMRXL_PowerPanel_LIN_Parity_Error_PowerPanel_STAT_Lin2_Error  # Error -
          data-receive-point-by-arguments:
            access DRP_Lin2ComRxSignalsSR_COMRXL_PowerPanel_LIN_Parity_Error_PowerPanel_STAT_Lin2: accessed-variable=Lin2ComRxSignalsSR.COMRXL_PowerPanel_LIN_Parity_Error_PowerPanel_STAT_Lin2
          data-send-points:
            access DSP_VeLINR_b_PwrPanel_LIN_ParityErr_VeLINR_b_PwrPanel_LIN_ParityErr: accessed-variable=VeLINR_b_PwrPanel_LIN_ParityErr.VeLINR_b_PwrPanel_LIN_ParityErr
            access DSP_VeLINR_b_PwrPanel_LIN_ParityErrTO_VeLINR_b_PwrPanel_LIN_ParityErrTO: accessed-variable=VeLINR_b_PwrPanel_LIN_ParityErrTO.VeLINR_b_PwrPanel_LIN_ParityErrTO
          read-local-variables:
            access IRVRA_VeLINR_d_LIN_SlavePrsnt_LIN2: accessed-variable=VeLINR_d_LIN_SlavePrsnt_LIN2
        COMRXL_PowerPanel_Gnd_Fault_Detected_PowerPanel_STAT_Lin2_Received: symbol=ApplLinComAb_LIN2_COMRXL_PowerPanel_Gnd_Fault_Detected_PowerPanel_STAT_Lin2_Received  # Received -
          data-receive-point-by-arguments:
            access DRP_Lin2ComRxSignalsSR_COMRXL_PowerPanel_Gnd_Fault_Detected_PowerPanel_STAT_Lin2: accessed-variable=Lin2ComRxSignalsSR.COMRXL_PowerPanel_Gnd_Fault_Detected_PowerPanel_STAT_Lin2
          data-send-points:
            access DSP_VeLINR_b_PwrPanelGndFltDetected_VeLINR_b_PwrPanelGndFltDetected: accessed-variable=VeLINR_b_PwrPanelGndFltDetected.VeLINR_b_PwrPanelGndFltDetected
            access DSP_VeLINR_b_PwrPanelGndFltDetectedTO_VeLINR_b_PwrPanelGndFltDetectedTO: accessed-variable=VeLINR_b_PwrPanelGndFltDetectedTO.VeLINR_b_PwrPanelGndFltDetectedTO
        COMRXL_PowerPanel_Gnd_Fault_Detected_PowerPanel_STAT_Lin2_Error: symbol=ApplLinComAb_LIN2_COMRXL_PowerPanel_Gnd_Fault_Detected_PowerPanel_STAT_Lin2_Error  # Error -
          data-receive-point-by-arguments:
            access DRP_Lin2ComRxSignalsSR_COMRXL_PowerPanel_Gnd_Fault_Detected_PowerPanel_STAT_Lin2: accessed-variable=Lin2ComRxSignalsSR.COMRXL_PowerPanel_Gnd_Fault_Detected_PowerPanel_STAT_Lin2
          data-send-points:
            access DSP_VeLINR_b_PwrPanelGndFltDetected_VeLINR_b_PwrPanelGndFltDetected: accessed-variable=VeLINR_b_PwrPanelGndFltDetected.VeLINR_b_PwrPanelGndFltDetected
            access DSP_VeLINR_b_PwrPanelGndFltDetectedTO_VeLINR_b_PwrPanelGndFltDetectedTO: accessed-variable=VeLINR_b_PwrPanelGndFltDetectedTO.VeLINR_b_PwrPanelGndFltDetectedTO
          read-local-variables:
            access IRVRA_VeLINR_d_LIN_SlavePrsnt_LIN2: accessed-variable=VeLINR_d_LIN_SlavePrsnt_LIN2
        COMRXL_RsErr_EAC2_EAC_STAT_Lin2_Received: symbol=ApplLinComAb_LIN2_COMRXL_RsErr_EAC2_EAC_STAT_Lin2_Received  # Received -
          data-receive-point-by-arguments:
            access DRP_Lin2ComRxSignalsSR_COMRXL_RsErr_EAC2_EAC_STAT_Lin2: accessed-variable=Lin2ComRxSignalsSR.COMRXL_RsErr_EAC2_EAC_STAT_Lin2
          data-send-points:
            access DSP_VeLINR_b_RsErr_EAC2_VeLINR_b_RsErr_EAC2: accessed-variable=VeLINR_b_RsErr_EAC2.VeLINR_b_RsErr_EAC2
            access DSP_VeLINR_b_RsErr_EAC2TO_VeLINR_b_RsErr_EAC2TO: accessed-variable=VeLINR_b_RsErr_EAC2TO.VeLINR_b_RsErr_EAC2TO
        COMRXL_RsErr_EAC2_EAC_STAT_Lin2_Error: symbol=ApplLinComAb_LIN2_COMRXL_RsErr_EAC2_EAC_STAT_Lin2_Error  # Error -
          data-receive-point-by-arguments:
            access DRP_Lin2ComRxSignalsSR_COMRXL_RsErr_EAC2_EAC_STAT_Lin2: accessed-variable=Lin2ComRxSignalsSR.COMRXL_RsErr_EAC2_EAC_STAT_Lin2
          data-send-points:
            access DSP_VeLINR_b_RsErr_EAC2_VeLINR_b_RsErr_EAC2: accessed-variable=VeLINR_b_RsErr_EAC2.VeLINR_b_RsErr_EAC2
            access DSP_VeLINR_b_RsErr_EAC2TO_VeLINR_b_RsErr_EAC2TO: accessed-variable=VeLINR_b_RsErr_EAC2TO.VeLINR_b_RsErr_EAC2TO
          read-local-variables:
            access IRVRA_VeLINR_d_LIN_SlavePrsnt_LIN2: accessed-variable=VeLINR_d_LIN_SlavePrsnt_LIN2
        COMRXL_PowerPanel_Fault_PowerPanel_STAT_Lin2_Received: symbol=ApplLinComAb_LIN2_COMRXL_PowerPanel_Fault_PowerPanel_STAT_Lin2_Received  # Received -
          data-receive-point-by-arguments:
            access DRP_Lin2ComRxSignalsSR_COMRXL_PowerPanel_Fault_PowerPanel_STAT_Lin2: accessed-variable=Lin2ComRxSignalsSR.COMRXL_PowerPanel_Fault_PowerPanel_STAT_Lin2
          data-send-points:
            access DSP_VeLINR_e_PowerPanel_Fault_VeLINR_e_PowerPanel_Fault: accessed-variable=VeLINR_e_PowerPanel_Fault.VeLINR_e_PowerPanel_Fault
            access DSP_VeLINR_b_PowerPanel_FaultTO_VeLINR_b_PowerPanel_FaultTO: accessed-variable=VeLINR_b_PowerPanel_FaultTO.VeLINR_b_PowerPanel_FaultTO
        COMRXL_PowerPanel_Fault_PowerPanel_STAT_Lin2_Error: symbol=ApplLinComAb_LIN2_COMRXL_PowerPanel_Fault_PowerPanel_STAT_Lin2_Error  # Error -
          data-receive-point-by-arguments:
            access DRP_Lin2ComRxSignalsSR_COMRXL_PowerPanel_Fault_PowerPanel_STAT_Lin2: accessed-variable=Lin2ComRxSignalsSR.COMRXL_PowerPanel_Fault_PowerPanel_STAT_Lin2
          data-send-points:
            access DSP_VeLINR_e_PowerPanel_Fault_VeLINR_e_PowerPanel_Fault: accessed-variable=VeLINR_e_PowerPanel_Fault.VeLINR_e_PowerPanel_Fault
            access DSP_VeLINR_b_PowerPanel_FaultTO_VeLINR_b_PowerPanel_FaultTO: accessed-variable=VeLINR_b_PowerPanel_FaultTO.VeLINR_b_PowerPanel_FaultTO
          read-local-variables:
            access IRVRA_VeLINR_d_LIN_SlavePrsnt_LIN2: accessed-variable=VeLINR_d_LIN_SlavePrsnt_LIN2
        COMRXL_PowerPanel_RatedPower_PowerPanel_STAT_Lin2_Received: symbol=ApplLinComAb_LIN2_COMRXL_PowerPanel_RatedPower_PowerPanel_STAT_Lin2_Received  # Received -
          data-receive-point-by-arguments:
            access DRP_Lin2ComRxSignalsSR_COMRXL_PowerPanel_RatedPower_PowerPanel_STAT_Lin2: accessed-variable=Lin2ComRxSignalsSR.COMRXL_PowerPanel_RatedPower_PowerPanel_STAT_Lin2
          data-send-points:
            access DSP_VeLINR_y_PowerPanel_RatedPower_VeLINR_y_PowerPanel_RatedPower: accessed-variable=VeLINR_y_PowerPanel_RatedPower.VeLINR_y_PowerPanel_RatedPower
            access DSP_VeLINR_b_PowerPanel_RatedPowerTO_VeLINR_b_PowerPanel_RatedPowerTO: accessed-variable=VeLINR_b_PowerPanel_RatedPowerTO.VeLINR_b_PowerPanel_RatedPowerTO
        COMRXL_PowerPanel_RatedPower_PowerPanel_STAT_Lin2_Error: symbol=ApplLinComAb_LIN2_COMRXL_PowerPanel_RatedPower_PowerPanel_STAT_Lin2_Error  # Error -
          data-receive-point-by-arguments:
            access DRP_Lin2ComRxSignalsSR_COMRXL_PowerPanel_RatedPower_PowerPanel_STAT_Lin2: accessed-variable=Lin2ComRxSignalsSR.COMRXL_PowerPanel_RatedPower_PowerPanel_STAT_Lin2
          data-send-points:
            access DSP_VeLINR_y_PowerPanel_RatedPower_VeLINR_y_PowerPanel_RatedPower: accessed-variable=VeLINR_y_PowerPanel_RatedPower.VeLINR_y_PowerPanel_RatedPower
            access DSP_VeLINR_b_PowerPanel_RatedPowerTO_VeLINR_b_PowerPanel_RatedPowerTO: accessed-variable=VeLINR_b_PowerPanel_RatedPowerTO.VeLINR_b_PowerPanel_RatedPowerTO
          read-local-variables:
            access IRVRA_VeLINR_d_LIN_SlavePrsnt_LIN2: accessed-variable=VeLINR_d_LIN_SlavePrsnt_LIN2
        COMRXL_PowerPanel_Current_Draw_Sens1_PowerPanel_STAT_Lin2_Received: symbol=ApplLinComAb_LIN2_COMRXL_PowerPanel_Current_Draw_Sens1_PowerPanel_STAT_Lin2_Received  # Received -
          data-receive-point-by-arguments:
            access DRP_Lin2ComRxSignalsSR_COMRXL_PowerPanel_Current_Draw_Sens1_PowerPanel_STAT_Lin2: accessed-variable=Lin2ComRxSignalsSR.COMRXL_PowerPanel_Current_Draw_Sens1_PowerPanel_STAT_Lin2
          data-send-points:
            access DSP_VeLINR_d_PwrPanelCurrDrawSens1_VeLINR_d_PwrPanelCurrDrawSens1: accessed-variable=VeLINR_d_PwrPanelCurrDrawSens1.VeLINR_d_PwrPanelCurrDrawSens1
            access DSP_VeLINR_b_PwrPanelCurrDrawSens1TO_VeLINR_b_PwrPanelCurrDrawSens1TO: accessed-variable=VeLINR_b_PwrPanelCurrDrawSens1TO.VeLINR_b_PwrPanelCurrDrawSens1TO
        COMRXL_PowerPanel_Current_Draw_Sens1_PowerPanel_STAT_Lin2_Error: symbol=ApplLinComAb_LIN2_COMRXL_PowerPanel_Current_Draw_Sens1_PowerPanel_STAT_Lin2_Error  # Error -
          data-receive-point-by-arguments:
            access DRP_Lin2ComRxSignalsSR_COMRXL_PowerPanel_Current_Draw_Sens1_PowerPanel_STAT_Lin2: accessed-variable=Lin2ComRxSignalsSR.COMRXL_PowerPanel_Current_Draw_Sens1_PowerPanel_STAT_Lin2
          data-send-points:
            access DSP_VeLINR_d_PwrPanelCurrDrawSens1_VeLINR_d_PwrPanelCurrDrawSens1: accessed-variable=VeLINR_d_PwrPanelCurrDrawSens1.VeLINR_d_PwrPanelCurrDrawSens1
            access DSP_VeLINR_b_PwrPanelCurrDrawSens1TO_VeLINR_b_PwrPanelCurrDrawSens1TO: accessed-variable=VeLINR_b_PwrPanelCurrDrawSens1TO.VeLINR_b_PwrPanelCurrDrawSens1TO
          read-local-variables:
            access IRVRA_VeLINR_d_LIN_SlavePrsnt_LIN2: accessed-variable=VeLINR_d_LIN_SlavePrsnt_LIN2
        COMRXL_PowerPanel_Current_Draw_Sens2_PowerPanel_STAT_Lin2_Received: symbol=ApplLinComAb_LIN2_COMRXL_PowerPanel_Current_Draw_Sens2_PowerPanel_STAT_Lin2_Received  # Received -
          data-receive-point-by-arguments:
            access DRP_Lin2ComRxSignalsSR_COMRXL_PowerPanel_Current_Draw_Sens2_PowerPanel_STAT_Lin2: accessed-variable=Lin2ComRxSignalsSR.COMRXL_PowerPanel_Current_Draw_Sens2_PowerPanel_STAT_Lin2
          data-send-points:
            access DSP_VeLINR_d_PwrPanelCurrDrawSens2_VeLINR_d_PwrPanelCurrDrawSens2: accessed-variable=VeLINR_d_PwrPanelCurrDrawSens2.VeLINR_d_PwrPanelCurrDrawSens2
            access DSP_VeLINR_b_PwrPanelCurrDrawSens2TO_VeLINR_b_PwrPanelCurrDrawSens2TO: accessed-variable=VeLINR_b_PwrPanelCurrDrawSens2TO.VeLINR_b_PwrPanelCurrDrawSens2TO
        COMRXL_PowerPanel_Current_Draw_Sens2_PowerPanel_STAT_Lin2_Error: symbol=ApplLinComAb_LIN2_COMRXL_PowerPanel_Current_Draw_Sens2_PowerPanel_STAT_Lin2_Error  # Error -
          data-receive-point-by-arguments:
            access DRP_Lin2ComRxSignalsSR_COMRXL_PowerPanel_Current_Draw_Sens2_PowerPanel_STAT_Lin2: accessed-variable=Lin2ComRxSignalsSR.COMRXL_PowerPanel_Current_Draw_Sens2_PowerPanel_STAT_Lin2
          data-send-points:
            access DSP_VeLINR_d_PwrPanelCurrDrawSens2_VeLINR_d_PwrPanelCurrDrawSens2: accessed-variable=VeLINR_d_PwrPanelCurrDrawSens2.VeLINR_d_PwrPanelCurrDrawSens2
            access DSP_VeLINR_b_PwrPanelCurrDrawSens2TO_VeLINR_b_PwrPanelCurrDrawSens2TO: accessed-variable=VeLINR_b_PwrPanelCurrDrawSens2TO.VeLINR_b_PwrPanelCurrDrawSens2TO
          read-local-variables:
            access IRVRA_VeLINR_d_LIN_SlavePrsnt_LIN2: accessed-variable=VeLINR_d_LIN_SlavePrsnt_LIN2
package /STLASWCs/ComSwCpts/ComDataDefinition/ComConstSpec
  151 x constant specification:
    COMRXL_AGS2_BoostStat_AGS2_ECM_STATUS_Lin2_Init: value-spec=Value:0
    COMRXL_AGS2_CalActv_AGS2_ECM_STATUS_Lin2_Init: value-spec=Value:0
    COMRXL_AGS2_CalStat_AGS2_ECM_STATUS_Lin2_Init: value-spec=Value:0
    COMRXL_AGS2_CurrPos_AGS2_ECM_STATUS_Lin2_Init: value-spec=Value:0
    COMRXL_AGS2_ErrLIN_AGS2_ECM_STATUS_Lin2_Init: value-spec=Value:0
    COMRXL_AGS2_ErrMechBreak_AGS2_ECM_STATUS_Lin2_Init: value-spec=Value:0
    COMRXL_AGS2_ErrMechStuck_AGS2_ECM_STATUS_Lin2_Init: value-spec=Value:0
    COMRXL_AGS2_ErrOvrTemp_AGS2_ECM_STATUS_Lin2_Init: value-spec=Value:0
    COMRXL_AGS2_ErrOvrVolt_AGS2_ECM_STATUS_Lin2_Init: value-spec=Value:0
    COMRXL_AGS2_ErrUnVolt_AGS2_ECM_STATUS_Lin2_Init: value-spec=Value:0
    COMRXL_AHP_AIR_PRE_ERR_AHP_STAT_GLOBAL_Lin2_Init: value-spec=Value:3
    COMRXL_AHP_CURR_AHP_STAT_GLOBAL_Lin2_Init: value-spec=Value:255
    COMRXL_AHP_DBLK_ACTV_AHP_STAT_GLOBAL_Lin2_Init: value-spec=Value:3
    COMRXL_AHP_DR_RN_ERR_AHP_STAT_GLOBAL_Lin2_Init: value-spec=Value:3
    COMRXL_AHP_FL_SAFE_ACTVTD_AHP_STAT_GLOBAL_Lin2_Init: value-spec=Value:3
    COMRXL_AHP_LMP_HM_AN_ON_AHP_STAT_GLOBAL_Lin2_Init: value-spec=Value:3
    COMRXL_AHP_MONTRNG_RPM_AHP_STAT_GLOBAL_Lin2_Init: value-spec=Value:3
    COMRXL_AHP_NODE_ERR_AHP_STAT_GLOBAL_Lin2_Init: value-spec=Value:3
    COMRXL_AHP_OVR_CUR_ERR_AHP_STAT_GLOBAL_Lin2_Init: value-spec=Value:3
    COMRXL_AHP_OVR_TMP_ERR_AHP_STAT_GLOBAL_Lin2_Init: value-spec=Value:3
    COMRXL_AHP_POST_RUN_STAT_AHP_STAT_GLOBAL_Lin2_Init: value-spec=Value:7
    COMRXL_AHP_RPM_ACTL_PERCT_AHP_STAT_GLOBAL_Lin2_Init: value-spec=Value:255
    COMRXL_AHP_RPM_TGT_PERCT_AHP_STAT_GLOBAL_Lin2_Init: value-spec=Value:255
    COMRXL_AHP_SUPPLIER_AHP_VER_Lin2_Init: value-spec=Value:0
    COMRXL_AHP_TEMP_AHP_STAT_GLOBAL_Lin2_Init: value-spec=Value:255
    COMRXL_AHP_VERSION_AHP_VER_Lin2_Init: value-spec=Value:255
    COMRXL_AHP_VLTG_AHP_STAT_GLOBAL_Lin2_Init: value-spec=Value:255
    COMRXL_AHP_VLTG_ERR_AHP_STAT_GLOBAL_Lin2_Init: value-spec=Value:3
    COMRXL_BHV_CalStat_BHV_STAT_V2_Lin2_Init: value-spec=Value:0
    COMRXL_BHV_ERR_BHV_STAT_V2_Lin2_Init: value-spec=Value:0
    COMRXL_BHV_MotorVolt_BHV_STAT_V2_Lin2_Init: value-spec=Value:0
    COMRXL_BHV_PosAct_BHV_STAT_V2_Lin2_Init: value-spec=Value:0
    COMRXL_BHV_Sts_BHV_STAT_V2_Lin2_Init: value-spec=Value:0
    COMRXL_CompBoardTemp_800_EAC_STAT_800_Lin2_Init: value-spec=Value:0
    COMRXL_CompBoardTemp_EAC_STAT_Lin2_Init: value-spec=Value:0
    COMRXL_CompElecCurr_800_EAC_STAT_800_Lin2_Init: value-spec=Value:0
    COMRXL_CompElecCurr_EAC_STAT_Lin2_Init: value-spec=Value:0
    COMRXL_CompElecPwr_800_EAC_STAT_800_Lin2_Init: value-spec=Value:0
    COMRXL_CompElecPwr_EAC_STAT_Lin2_Init: value-spec=Value:0
    COMRXL_CompFaultStat_800_EAC_STAT_800_Lin2_Init: value-spec=Value:0
    COMRXL_CompFaultStat_EAC_STAT_Lin2_Init: value-spec=Value:0
    COMRXL_CompHVInput_800_EAC_STAT_800_Lin2_Init: value-spec=Value:0
    COMRXL_CompHVInput_EAC_STAT_Lin2_Init: value-spec=Value:0
    COMRXL_CompIGBTTemp_800_EAC_STAT_800_Lin2_Init: value-spec=Value:0
    COMRXL_CompIGBTTemp_EAC_STAT_Lin2_Init: value-spec=Value:0
    COMRXL_CompSpdIncrReq_800_EAC_STAT_800_Lin2_Init: value-spec=Value:0
    COMRXL_CompSpdIncrReq_EAC_STAT_Lin2_Init: value-spec=Value:0
    COMRXL_CompStat_800_EAC_STAT_800_Lin2_Init: value-spec=Value:0
    COMRXL_CompStat_EAC_STAT_Lin2_Init: value-spec=Value:0
    COMRXL_CompressorSpd_800_EAC_STAT_800_Lin2_Init: value-spec=Value:0
    COMRXL_CompressorSpd_EAC_STAT_Lin2_Init: value-spec=Value:0
    COMRXL_DriveMdReq_ESBM_1_Lin2_Init: value-spec=Value:0
    COMRXL_ESaveModeRq_LIN_ESBM_1_Lin2_Init: value-spec=Value:0
    COMRXL_ElectricModeRq_LIN_ESBM_1_Lin2_Init: value-spec=Value:0
    COMRXL_HybridModeRq_LIN_ESBM_1_Lin2_Init: value-spec=Value:0
    COMRXL_OEXV_Board_Temp_OEXV_STAT_Lin2_Init: value-spec=Value:0
    COMRXL_OEXV_CalRq_OEXV_STAT_Lin2_Init: value-spec=Value:0
    COMRXL_OEXV_CalStat_OEXV_STAT_Lin2_Init: value-spec=Value:0
    COMRXL_OEXV_ERR_OEXV_STAT_Lin2_Init: value-spec=Value:0
    COMRXL_OEXV_PosAct_OEXV_STAT_Lin2_Init: value-spec=Value:0
    COMRXL_OEXV_Refrigerant_Pressure_OEXV_STAT_Lin2_Init: value-spec=Value:16383
    COMRXL_OEXV_Refrigerant_Temp_OEXV_STAT_Lin2_Init: value-spec=Value:0
    COMRXL_OEXV_Sts_OEXV_STAT_Lin2_Init: value-spec=Value:0
    COMRXL_OEXV_SupplyVolt_OEXV_STAT_Lin2_Init: value-spec=Value:0
    COMRXL_PECP_AIR_PRE_ERR_PECP_STAT_GLOBAL_Lin2_Init: value-spec=Value:3
    COMRXL_PECP_CURR_PECP_STAT_GLOBAL_Lin2_Init: value-spec=Value:255
    COMRXL_PECP_DBLK_ACTV_PECP_STAT_GLOBAL_Lin2_Init: value-spec=Value:3
    COMRXL_PECP_DR_RN_ERR_PECP_STAT_GLOBAL_Lin2_Init: value-spec=Value:3
    COMRXL_PECP_FL_SAFE_ACTVTD_PECP_STAT_GLOBAL_Lin2_Init: value-spec=Value:3
    COMRXL_PECP_LMP_HM_AN_ON_PECP_STAT_GLOBAL_Lin2_Init: value-spec=Value:3
    COMRXL_PECP_MONTRNG_RPM_PECP_STAT_GLOBAL_Lin2_Init: value-spec=Value:3
    COMRXL_PECP_NODE_ERR_PECP_STAT_GLOBAL_Lin2_Init: value-spec=Value:3
    COMRXL_PECP_OVR_CUR_ERR_PECP_STAT_GLOBAL_Lin2_Init: value-spec=Value:3
    COMRXL_PECP_OVR_TMP_ERR_PECP_STAT_GLOBAL_Lin2_Init: value-spec=Value:3
    COMRXL_PECP_POST_RUN_STAT_PECP_STAT_GLOBAL_Lin2_Init: value-spec=Value:7
    COMRXL_PECP_RPM_ACTL_PERCT_PECP_STAT_GLOBAL_Lin2_Init: value-spec=Value:255
    COMRXL_PECP_RPM_TGT_PERCT_PECP_STAT_GLOBAL_Lin2_Init: value-spec=Value:255
    COMRXL_PECP_SUPPLIER_PECP_VER_Lin2_Init: value-spec=Value:0
    COMRXL_PECP_TEMP_PECP_STAT_GLOBAL_Lin2_Init: value-spec=Value:255
    COMRXL_PECP_VERSION_PECP_VER_Lin2_Init: value-spec=Value:255
    COMRXL_PECP_VLTG_ERR_PECP_STAT_GLOBAL_Lin2_Init: value-spec=Value:3
    COMRXL_PECP_VLTG_PECP_STAT_GLOBAL_Lin2_Init: value-spec=Value:255
    COMRXL_PowerPanel_AC_Present_Sens1_PowerPanel_STAT_Lin2_Init: value-spec=Value:0
    COMRXL_PowerPanel_AC_Present_Sens2_PowerPanel_STAT_Lin2_Init: value-spec=Value:0
    COMRXL_PowerPanel_Button_State_PowerPanel_STAT_Lin2_Init: value-spec=Value:0
    COMRXL_PowerPanel_Current_Draw_Sens1_PowerPanel_STAT_Lin2_Init: value-spec=Value:0
    COMRXL_PowerPanel_Current_Draw_Sens2_PowerPanel_STAT_Lin2_Init: value-spec=Value:0
    COMRXL_PowerPanel_Fault_PowerPanel_STAT_Lin2_Init: value-spec=Value:0
    COMRXL_PowerPanel_Fault_Reason_PowerPanel_STAT_Lin2_Init: value-spec=Value:0
    COMRXL_PowerPanel_Gnd_Fault_Detected_PowerPanel_STAT_Lin2_Init: value-spec=Value:0
    COMRXL_PowerPanel_LED_A_Color_Feedback_PowerPanel_STAT_Lin2_Init: value-spec=Value:0
    COMRXL_PowerPanel_LED_A_FailStatus_PowerPanel_STAT_Lin2_Init: value-spec=Value:0
    COMRXL_PowerPanel_LED_A_Feedback_PowerPanel_STAT_Lin2_Init: value-spec=Value:0
    COMRXL_PowerPanel_LED_B_Color_Feedback_PowerPanel_STAT_Lin2_Init: value-spec=Value:0
    COMRXL_PowerPanel_LED_B_FailStatus_PowerPanel_STAT_Lin2_Init: value-spec=Value:0
    COMRXL_PowerPanel_LED_B_Feedback_PowerPanel_STAT_Lin2_Init: value-spec=Value:0
    COMRXL_PowerPanel_LED_C_Color_Feedback_PowerPanel_STAT_Lin2_Init: value-spec=Value:0
    COMRXL_PowerPanel_LED_C_FailStatus_PowerPanel_STAT_Lin2_Init: value-spec=Value:0
    COMRXL_PowerPanel_LED_C_Feedback_PowerPanel_STAT_Lin2_Init: value-spec=Value:0
    COMRXL_PowerPanel_LIN_Checksum_Error_PowerPanel_STAT_Lin2_Init: value-spec=Value:0
    COMRXL_PowerPanel_LIN_Data_Error_PowerPanel_STAT_Lin2_Init: value-spec=Value:0
    COMRXL_PowerPanel_LIN_Parity_Error_PowerPanel_STAT_Lin2_Init: value-spec=Value:0
    COMRXL_PowerPanel_Lid_Switch_Sts_120A_PowerPanel_STAT_Lin2_Init: value-spec=Value:0
    COMRXL_PowerPanel_Lid_Switch_Sts_120B_PowerPanel_STAT_Lin2_Init: value-spec=Value:0
    COMRXL_PowerPanel_Lid_Switch_Sts_240_PowerPanel_STAT_Lin2_Init: value-spec=Value:0
    COMRXL_PowerPanel_RatedPower_PowerPanel_STAT_Lin2_Init: value-spec=Value:0
    COMRXL_RsErr_AGS2_AGS2_ECM_STATUS_Lin2_Init: value-spec=Value:0
    COMRXL_RsErr_AHP_PUMP_AHP_STAT_GLOBAL_Lin2_Init: value-spec=Value:0
    COMRXL_RsErr_BHV_BHV_STAT_V2_Lin2_Init: value-spec=Value:0
    COMRXL_RsErr_EAC2_800_EAC_STAT_800_Lin2_Init: value-spec=Value:0
    COMRXL_RsErr_EAC2_EAC_STAT_Lin2_Init: value-spec=Value:0
    COMRXL_RsErr_ESBM_ESBM_1_Lin2_Init: value-spec=Value:0
    COMRXL_RsErr_OEXV_OEXV_STAT_Lin2_Init: value-spec=Value:0
    COMRXL_RsErr_PECP_PUMP_PECP_STAT_GLOBAL_Lin2_Init: value-spec=Value:0
    COMRXL_RsErr_SPP_PowerPanel_STAT_Lin2_Init: value-spec=Value:0
    COMRXL_S2MResBit1_AGS2_AGS2_ECM_STATUS_Lin2_Init: value-spec=Value:0
    COMRXL_S2MResByte1_AGS2_AGS2_ECM_STATUS_Lin2_Init: value-spec=Value:0
    COMRXL_S2MResByte2_AGS2_AGS2_ECM_STATUS_Lin2_Init: value-spec=Value:0
    COMTXL_AGS2_BoostRq_ECM_AGS2_DEMAND_Lin2_Init: value-spec=0
    COMTXL_AGS2_CalRq_ECM_AGS2_DEMAND_Lin2_Init: value-spec=0
    COMTXL_AGS2_PosRq_ECM_AGS2_DEMAND_Lin2_Init: value-spec=0
    COMTXL_AHP_FL_SAFE_ACTVT_AHP_REQ_GLOBAL_Lin2_Init: value-spec=3
    COMTXL_AHP_POST_RUN_REQ_AHP_REQ_GLOBAL_Lin2_Init: value-spec=7
    COMTXL_AHP_RPM_REQ_PERCT_AHP_REQ_GLOBAL_Lin2_Init: value-spec=255
    COMTXL_BHV_CalRq_BHV_REQ_Lin2_Init: value-spec=0
    COMTXL_BHV_PosRq_BHV_REQ_Lin2_Init: value-spec=0
    COMTXL_BHV_PosSv_BHV_REQ_Lin2_Init: value-spec=0
    COMTXL_CompEnable_COMP_REQ_Lin2_Init: value-spec=3
    COMTXL_CompressorSpdReq_COMP_REQ_Lin2_Init: value-spec=0
    COMTXL_DAY_LGT_MD_MASTER_ESBM_1_Lin2_Init: value-spec=0
    COMTXL_DAY_LGT_MD_PowerPanel_PowerPanel_REQ_Lin2_Init: value-spec=0
    COMTXL_DriveESaveLmp_MASTER_ESBM_1_Lin2_Init: value-spec=0
    COMTXL_DriveEcohybridLmp_MASTER_ESBM_1_Lin2_Init: value-spec=0
    COMTXL_DriveElectricLmp_MASTER_ESBM_1_Lin2_Init: value-spec=0
    COMTXL_DriveSportHybridLmp_MASTER_ESBM_1_Lin2_Init: value-spec=0
    COMTXL_M2SRes2Bit_AGS2_ECM_AGS2_DEMAND_Lin2_Init: value-spec=0
    COMTXL_M2SResByte{1..3}_AGS2_ECM_AGS2_DEMAND_Lin2_Init: value-spec=0
    COMTXL_OEXV_CalCmd_OEXV_REQ_Lin2_Init: value-spec=0
    COMTXL_OEXV_PosRq_OEXV_REQ_Lin2_Init: value-spec=0
    COMTXL_PECP_FL_SAFE_ACTVT_PECP_REQ_GLOBAL_Lin2_Init: value-spec=3
    COMTXL_PECP_POST_RUN_REQ_PECP_REQ_GLOBAL_Lin2_Init: value-spec=7
    COMTXL_PECP_RPM_REQ_PERCT_PECP_REQ_GLOBAL_Lin2_Init: value-spec=255
    COMTXL_PanelIntensitySts_MASTER_ESBM_1_Lin2_Init: value-spec=0
    COMTXL_PowerPanel_LED_A_Color_Command_PowerPanel_REQ_Lin2_Init: value-spec=0
    COMTXL_PowerPanel_LED_A_Command_PowerPanel_REQ_Lin2_Init: value-spec=0
    COMTXL_PowerPanel_LED_B_Color_Command_PowerPanel_REQ_Lin2_Init: value-spec=0
    COMTXL_PowerPanel_LED_B_Command_PowerPanel_REQ_Lin2_Init: value-spec=0
    COMTXL_PowerPanel_LED_C_Color_Command_PowerPanel_REQ_Lin2_Init: value-spec=0
    COMTXL_PowerPanel_LED_C_Command_PowerPanel_REQ_Lin2_Init: value-spec=0
package /STLASWCs/ComSwCpts/ComDataDefinition/ComImpDataType
  151 x impl type, all with category=TYPE_REFERENCE:
    IDTSAGS2_BoostRq_ECM_AGS2_DEMAND_Lin2: implementation-data-type=boolean
    IDTSAGS2_BoostStat_AGS2_ECM_STATUS_Lin2: implementation-data-type=boolean
    IDTSAGS2_CalActv_AGS2_ECM_STATUS_Lin2: implementation-data-type=boolean
    IDTSAGS2_CalRq_ECM_AGS2_DEMAND_Lin2: implementation-data-type=boolean
    IDTSAGS2_CalStat_AGS2_ECM_STATUS_Lin2: implementation-data-type=boolean
    IDTSAGS2_CurrPos_AGS2_ECM_STATUS_Lin2: implementation-data-type=uint8, invalid-value=Value:15
    IDTSAGS2_ErrLIN_AGS2_ECM_STATUS_Lin2: implementation-data-type=uint8, invalid-value=Value:3
    IDTSAGS2_ErrMechBreak_AGS2_ECM_STATUS_Lin2: implementation-data-type=boolean
    IDTSAGS2_ErrMechStuck_AGS2_ECM_STATUS_Lin2: implementation-data-type=boolean
    IDTSAGS2_ErrOvrTemp_AGS2_ECM_STATUS_Lin2: implementation-data-type=boolean
    IDTSAGS2_ErrOvrVolt_AGS2_ECM_STATUS_Lin2: implementation-data-type=boolean
    IDTSAGS2_ErrUnVolt_AGS2_ECM_STATUS_Lin2: implementation-data-type=boolean
    IDTSAGS2_PosRq_ECM_AGS2_DEMAND_Lin2: implementation-data-type=uint8, invalid-value=Value:15
    IDTSAHP_AIR_PRE_ERR_AHP_STAT_GLOBAL_Lin2: implementation-data-type=uint8, invalid-value=Value:3
    IDTSAHP_CURR_AHP_STAT_GLOBAL_Lin2: implementation-data-type=uint8, invalid-value=Value:255
    IDTSAHP_DBLK_ACTV_AHP_STAT_GLOBAL_Lin2: implementation-data-type=uint8, invalid-value=Value:3
    IDTSAHP_DR_RN_ERR_AHP_STAT_GLOBAL_Lin2: implementation-data-type=uint8, invalid-value=Value:3
    IDTSAHP_FL_SAFE_ACTVTD_AHP_STAT_GLOBAL_Lin2: implementation-data-type=uint8, invalid-value=Value:3
    IDTSAHP_FL_SAFE_ACTVT_AHP_REQ_GLOBAL_Lin2: implementation-data-type=uint8, invalid-value=Value:3
    IDTSAHP_LMP_HM_AN_ON_AHP_STAT_GLOBAL_Lin2: implementation-data-type=uint8, invalid-value=Value:3
    IDTSAHP_MONTRNG_RPM_AHP_STAT_GLOBAL_Lin2: implementation-data-type=uint8, invalid-value=Value:3
    IDTSAHP_NODE_ERR_AHP_STAT_GLOBAL_Lin2: implementation-data-type=uint8, invalid-value=Value:3
    IDTSAHP_OVR_CUR_ERR_AHP_STAT_GLOBAL_Lin2: implementation-data-type=uint8, invalid-value=Value:3
    IDTSAHP_OVR_TMP_ERR_AHP_STAT_GLOBAL_Lin2: implementation-data-type=uint8, invalid-value=Value:3
    IDTSAHP_POST_RUN_REQ_AHP_REQ_GLOBAL_Lin2: implementation-data-type=uint8, invalid-value=Value:7
    IDTSAHP_POST_RUN_STAT_AHP_STAT_GLOBAL_Lin2: implementation-data-type=uint8, invalid-value=Value:7
    IDTSAHP_RPM_ACTL_PERCT_AHP_STAT_GLOBAL_Lin2: implementation-data-type=uint8, invalid-value=Value:255
    IDTSAHP_RPM_REQ_PERCT_AHP_REQ_GLOBAL_Lin2: implementation-data-type=uint8, invalid-value=Value:255
    IDTSAHP_RPM_TGT_PERCT_AHP_STAT_GLOBAL_Lin2: implementation-data-type=uint8, invalid-value=Value:255
    IDTSAHP_SUPPLIER_AHP_VER_Lin2: implementation-data-type=uint8
    IDTSAHP_TEMP_AHP_STAT_GLOBAL_Lin2: implementation-data-type=uint8, invalid-value=Value:255
    IDTSAHP_VERSION_AHP_VER_Lin2: implementation-data-type=uint8, invalid-value=Value:255
    IDTSAHP_VLTG_AHP_STAT_GLOBAL_Lin2: implementation-data-type=uint8, invalid-value=Value:255
    IDTSAHP_VLTG_ERR_AHP_STAT_GLOBAL_Lin2: implementation-data-type=uint8, invalid-value=Value:3
    IDTSBHV_CalRq_BHV_REQ_Lin2: implementation-data-type=uint8
    IDTSBHV_CalStat_BHV_STAT_V2_Lin2: implementation-data-type=uint8
    IDTSBHV_ERR_BHV_STAT_V2_Lin2: implementation-data-type=uint8, invalid-value=Value:128
    IDTSBHV_MotorVolt_BHV_STAT_V2_Lin2: implementation-data-type=uint8
    IDTSBHV_PosAct_BHV_STAT_V2_Lin2: implementation-data-type=uint8, invalid-value=Value:255
    IDTSBHV_PosRq_BHV_REQ_Lin2: implementation-data-type=uint8
    IDTSBHV_PosSv_BHV_REQ_Lin2: implementation-data-type=boolean
    IDTSBHV_Sts_BHV_STAT_V2_Lin2: implementation-data-type=uint8, invalid-value=Value:3
    IDTSCompBoardTemp_800_EAC_STAT_800_Lin2: implementation-data-type=uint8, invalid-value=Value:255
    IDTSCompBoardTemp_EAC_STAT_Lin2: implementation-data-type=uint8, invalid-value=Value:255
    IDTSCompElecCurr_800_EAC_STAT_800_Lin2: implementation-data-type=uint8, invalid-value=Value:255
    IDTSCompElecCurr_EAC_STAT_Lin2: implementation-data-type=uint8, invalid-value=Value:255
    IDTSCompElecPwr_800_EAC_STAT_800_Lin2: implementation-data-type=uint8, invalid-value=Value:255
    IDTSCompElecPwr_EAC_STAT_Lin2: implementation-data-type=uint8, invalid-value=Value:255
    IDTSCompEnable_COMP_REQ_Lin2: implementation-data-type=uint8, invalid-value=Value:3
    IDTSCompFaultStat_800_EAC_STAT_800_Lin2: implementation-data-type=uint8, invalid-value=Value:15
    IDTSCompFaultStat_EAC_STAT_Lin2: implementation-data-type=uint8, invalid-value=Value:15
    IDTSCompHVInput_800_EAC_STAT_800_Lin2: implementation-data-type=uint8, invalid-value=Value:255
    IDTSCompHVInput_EAC_STAT_Lin2: implementation-data-type=uint8, invalid-value=Value:255
    IDTSCompIGBTTemp_800_EAC_STAT_800_Lin2: implementation-data-type=uint8, invalid-value=Value:255
    IDTSCompIGBTTemp_EAC_STAT_Lin2: implementation-data-type=uint8, invalid-value=Value:255
    IDTSCompSpdIncrReq_800_EAC_STAT_800_Lin2: implementation-data-type=boolean
    IDTSCompSpdIncrReq_EAC_STAT_Lin2: implementation-data-type=boolean
    IDTSCompStat_800_EAC_STAT_800_Lin2: implementation-data-type=uint8, invalid-value=Value:15
    IDTSCompStat_EAC_STAT_Lin2: implementation-data-type=uint8, invalid-value=Value:15
    IDTSCompressorSpdReq_COMP_REQ_Lin2: implementation-data-type=uint16, invalid-value=Value:4095
    IDTSCompressorSpd_800_EAC_STAT_800_Lin2: implementation-data-type=uint16, invalid-value=Value:4095
    IDTSCompressorSpd_EAC_STAT_Lin2: implementation-data-type=uint16, invalid-value=Value:4095
    IDTSDAY_LGT_MD_MASTER_ESBM_1_Lin2: implementation-data-type=boolean
    IDTSDAY_LGT_MD_PowerPanel_PowerPanel_REQ_Lin2: implementation-data-type=boolean
    IDTSDriveESaveLmp_MASTER_ESBM_1_Lin2: implementation-data-type=uint8, invalid-value=Value:3
    IDTSDriveEcohybridLmp_MASTER_ESBM_1_Lin2: implementation-data-type=uint8, invalid-value=Value:3
    IDTSDriveElectricLmp_MASTER_ESBM_1_Lin2: implementation-data-type=uint8, invalid-value=Value:3
    IDTSDriveMdReq_ESBM_1_Lin2: implementation-data-type=uint8, invalid-value=Value:3
    IDTSDriveSportHybridLmp_MASTER_ESBM_1_Lin2: implementation-data-type=uint8, invalid-value=Value:3
    IDTSESaveModeRq_LIN_ESBM_1_Lin2: implementation-data-type=uint8, invalid-value=Value:7
    IDTSElectricModeRq_LIN_ESBM_1_Lin2: implementation-data-type=uint8, invalid-value=Value:7
    IDTSHybridModeRq_LIN_ESBM_1_Lin2: implementation-data-type=uint8, invalid-value=Value:7
    IDTSM2SRes2Bit_AGS2_ECM_AGS2_DEMAND_Lin2: implementation-data-type=uint8
    IDTSM2SResByte{1..3}_AGS2_ECM_AGS2_DEMAND_Lin2: implementation-data-type=uint8
    IDTSOEXV_Board_Temp_OEXV_STAT_Lin2: implementation-data-type=uint8, invalid-value=Value:255
    IDTSOEXV_CalCmd_OEXV_REQ_Lin2: implementation-data-type=uint8
    IDTSOEXV_CalRq_OEXV_STAT_Lin2: implementation-data-type=boolean
    IDTSOEXV_CalStat_OEXV_STAT_Lin2: implementation-data-type=uint8, invalid-value=Value:3
    IDTSOEXV_ERR_OEXV_STAT_Lin2: implementation-data-type=uint8, invalid-value=Value:15
    IDTSOEXV_PosAct_OEXV_STAT_Lin2: implementation-data-type=uint16, invalid-value=Value:1023
    IDTSOEXV_PosRq_OEXV_REQ_Lin2: implementation-data-type=uint16, invalid-value=Value:1023
    IDTSOEXV_Refrigerant_Pressure_OEXV_STAT_Lin2: implementation-data-type=uint16, invalid-value=Value:16383
    IDTSOEXV_Refrigerant_Temp_OEXV_STAT_Lin2: implementation-data-type=uint16, invalid-value=Value:2047
    IDTSOEXV_Sts_OEXV_STAT_Lin2: implementation-data-type=uint8, invalid-value=Value:3
    IDTSOEXV_SupplyVolt_OEXV_STAT_Lin2: implementation-data-type=uint8, invalid-value=Value:255
    IDTSPECP_AIR_PRE_ERR_PECP_STAT_GLOBAL_Lin2: implementation-data-type=uint8, invalid-value=Value:3
    IDTSPECP_CURR_PECP_STAT_GLOBAL_Lin2: implementation-data-type=uint8, invalid-value=Value:255
    IDTSPECP_DBLK_ACTV_PECP_STAT_GLOBAL_Lin2: implementation-data-type=uint8, invalid-value=Value:3
    IDTSPECP_DR_RN_ERR_PECP_STAT_GLOBAL_Lin2: implementation-data-type=uint8, invalid-value=Value:3
    IDTSPECP_FL_SAFE_ACTVTD_PECP_STAT_GLOBAL_Lin2: implementation-data-type=uint8, invalid-value=Value:3
    IDTSPECP_FL_SAFE_ACTVT_PECP_REQ_GLOBAL_Lin2: implementation-data-type=uint8, invalid-value=Value:3
    IDTSPECP_LMP_HM_AN_ON_PECP_STAT_GLOBAL_Lin2: implementation-data-type=uint8, invalid-value=Value:3
    IDTSPECP_MONTRNG_RPM_PECP_STAT_GLOBAL_Lin2: implementation-data-type=uint8, invalid-value=Value:3
    IDTSPECP_NODE_ERR_PECP_STAT_GLOBAL_Lin2: implementation-data-type=uint8, invalid-value=Value:3
    IDTSPECP_OVR_CUR_ERR_PECP_STAT_GLOBAL_Lin2: implementation-data-type=uint8, invalid-value=Value:3
    IDTSPECP_OVR_TMP_ERR_PECP_STAT_GLOBAL_Lin2: implementation-data-type=uint8, invalid-value=Value:3
    IDTSPECP_POST_RUN_REQ_PECP_REQ_GLOBAL_Lin2: implementation-data-type=uint8, invalid-value=Value:7
    IDTSPECP_POST_RUN_STAT_PECP_STAT_GLOBAL_Lin2: implementation-data-type=uint8, invalid-value=Value:7
    IDTSPECP_RPM_ACTL_PERCT_PECP_STAT_GLOBAL_Lin2: implementation-data-type=uint8, invalid-value=Value:255
    IDTSPECP_RPM_REQ_PERCT_PECP_REQ_GLOBAL_Lin2: implementation-data-type=uint8, invalid-value=Value:255
    IDTSPECP_RPM_TGT_PERCT_PECP_STAT_GLOBAL_Lin2: implementation-data-type=uint8, invalid-value=Value:255
    IDTSPECP_SUPPLIER_PECP_VER_Lin2: implementation-data-type=uint8
    IDTSPECP_TEMP_PECP_STAT_GLOBAL_Lin2: implementation-data-type=uint8, invalid-value=Value:255
    IDTSPECP_VERSION_PECP_VER_Lin2: implementation-data-type=uint8, invalid-value=Value:255
    IDTSPECP_VLTG_ERR_PECP_STAT_GLOBAL_Lin2: implementation-data-type=uint8, invalid-value=Value:3
    IDTSPECP_VLTG_PECP_STAT_GLOBAL_Lin2: implementation-data-type=uint8, invalid-value=Value:255
    IDTSPanelIntensitySts_MASTER_ESBM_1_Lin2: implementation-data-type=uint8, invalid-value=Value:255
    IDTSPowerPanel_AC_Present_Sens1_PowerPanel_STAT_Lin2: implementation-data-type=boolean
    IDTSPowerPanel_AC_Present_Sens2_PowerPanel_STAT_Lin2: implementation-data-type=boolean
    IDTSPowerPanel_Button_State_PowerPanel_STAT_Lin2: implementation-data-type=boolean
    IDTSPowerPanel_Current_Draw_Sens1_PowerPanel_STAT_Lin2: implementation-data-type=uint16, invalid-value=Value:1023
    IDTSPowerPanel_Current_Draw_Sens2_PowerPanel_STAT_Lin2: implementation-data-type=uint16, invalid-value=Value:1023
    IDTSPowerPanel_Fault_PowerPanel_STAT_Lin2: implementation-data-type=uint8, invalid-value=Value:3
    IDTSPowerPanel_Fault_Reason_PowerPanel_STAT_Lin2: implementation-data-type=uint8, invalid-value=Value:15
    IDTSPowerPanel_Gnd_Fault_Detected_PowerPanel_STAT_Lin2: implementation-data-type=boolean
    IDTSPowerPanel_LED_A_Color_Command_PowerPanel_REQ_Lin2: implementation-data-type=uint8
    IDTSPowerPanel_LED_A_Color_Feedback_PowerPanel_STAT_Lin2: implementation-data-type=uint8
    IDTSPowerPanel_LED_A_Command_PowerPanel_REQ_Lin2: implementation-data-type=uint8, invalid-value=Value:3
    IDTSPowerPanel_LED_A_FailStatus_PowerPanel_STAT_Lin2: implementation-data-type=uint8
    IDTSPowerPanel_LED_A_Feedback_PowerPanel_STAT_Lin2: implementation-data-type=uint8, invalid-value=Value:3
    IDTSPowerPanel_LED_B_Color_Command_PowerPanel_REQ_Lin2: implementation-data-type=uint8
    IDTSPowerPanel_LED_B_Color_Feedback_PowerPanel_STAT_Lin2: implementation-data-type=uint8
    IDTSPowerPanel_LED_B_Command_PowerPanel_REQ_Lin2: implementation-data-type=uint8, invalid-value=Value:3
    IDTSPowerPanel_LED_B_FailStatus_PowerPanel_STAT_Lin2: implementation-data-type=uint8
    IDTSPowerPanel_LED_B_Feedback_PowerPanel_STAT_Lin2: implementation-data-type=uint8, invalid-value=Value:3
    IDTSPowerPanel_LED_C_Color_Command_PowerPanel_REQ_Lin2: implementation-data-type=uint8
    IDTSPowerPanel_LED_C_Color_Feedback_PowerPanel_STAT_Lin2: implementation-data-type=uint8
    IDTSPowerPanel_LED_C_Command_PowerPanel_REQ_Lin2: implementation-data-type=uint8, invalid-value=Value:3
    IDTSPowerPanel_LED_C_FailStatus_PowerPanel_STAT_Lin2: implementation-data-type=uint8
    IDTSPowerPanel_LED_C_Feedback_PowerPanel_STAT_Lin2: implementation-data-type=uint8, invalid-value=Value:3
    IDTSPowerPanel_LIN_Checksum_Error_PowerPanel_STAT_Lin2: implementation-data-type=boolean
    IDTSPowerPanel_LIN_Data_Error_PowerPanel_STAT_Lin2: implementation-data-type=boolean
    IDTSPowerPanel_LIN_Parity_Error_PowerPanel_STAT_Lin2: implementation-data-type=boolean
    IDTSPowerPanel_Lid_Switch_Sts_120A_PowerPanel_STAT_Lin2: implementation-data-type=boolean
    IDTSPowerPanel_Lid_Switch_Sts_120B_PowerPanel_STAT_Lin2: implementation-data-type=boolean
    IDTSPowerPanel_Lid_Switch_Sts_240_PowerPanel_STAT_Lin2: implementation-data-type=boolean
    IDTSPowerPanel_RatedPower_PowerPanel_STAT_Lin2: implementation-data-type=uint8
    IDTSRsErr_AGS2_AGS2_ECM_STATUS_Lin2: implementation-data-type=boolean
    IDTSRsErr_AHP_PUMP_AHP_STAT_GLOBAL_Lin2: implementation-data-type=boolean
    IDTSRsErr_BHV_BHV_STAT_V2_Lin2: implementation-data-type=boolean
    IDTSRsErr_EAC2_800_EAC_STAT_800_Lin2: implementation-data-type=boolean
    IDTSRsErr_EAC2_EAC_STAT_Lin2: implementation-data-type=boolean
    IDTSRsErr_ESBM_ESBM_1_Lin2: implementation-data-type=boolean
    IDTSRsErr_OEXV_OEXV_STAT_Lin2: implementation-data-type=boolean
    IDTSRsErr_PECP_PUMP_PECP_STAT_GLOBAL_Lin2: implementation-data-type=boolean
    IDTSRsErr_SPP_PowerPanel_STAT_Lin2: implementation-data-type=boolean
    IDTSS2MResBit1_AGS2_AGS2_ECM_STATUS_Lin2: implementation-data-type=boolean
    IDTSS2MResByte1_AGS2_AGS2_ECM_STATUS_Lin2: implementation-data-type=uint8
    IDTSS2MResByte2_AGS2_AGS2_ECM_STATUS_Lin2: implementation-data-type=uint8
package /STLASWCs/ComSwCpts/ComPrivateInterfaces
  sender receiver interface Lin2ComRxSignalsSR
    118 x data, all with category=TYPE_REFERENCE, sw-calibration-access=READ-ONLY:
      COMRXL_AGS2_CurrPos_AGS2_ECM_STATUS_Lin2: type=IDTSAGS2_CurrPos_AGS2_ECM_STATUS_Lin2
      COMRXL_AGS2_CalStat_AGS2_ECM_STATUS_Lin2: type=IDTSAGS2_CalStat_AGS2_ECM_STATUS_Lin2
      COMRXL_AGS2_CalActv_AGS2_ECM_STATUS_Lin2: type=IDTSAGS2_CalActv_AGS2_ECM_STATUS_Lin2
      COMRXL_AGS2_ErrUnVolt_AGS2_ECM_STATUS_Lin2: type=IDTSAGS2_ErrUnVolt_AGS2_ECM_STATUS_Lin2
      COMRXL_AGS2_ErrOvrVolt_AGS2_ECM_STATUS_Lin2: type=IDTSAGS2_ErrOvrVolt_AGS2_ECM_STATUS_Lin2
      COMRXL_AGS2_ErrOvrTemp_AGS2_ECM_STATUS_Lin2: type=IDTSAGS2_ErrOvrTemp_AGS2_ECM_STATUS_Lin2
      COMRXL_AGS2_ErrMechStuck_AGS2_ECM_STATUS_Lin2: type=IDTSAGS2_ErrMechStuck_AGS2_ECM_STATUS_Lin2
      COMRXL_AGS2_ErrMechBreak_AGS2_ECM_STATUS_Lin2: type=IDTSAGS2_ErrMechBreak_AGS2_ECM_STATUS_Lin2
      COMRXL_AGS2_ErrLIN_AGS2_ECM_STATUS_Lin2: type=IDTSAGS2_ErrLIN_AGS2_ECM_STATUS_Lin2
      COMRXL_RsErr_AGS2_AGS2_ECM_STATUS_Lin2: type=IDTSRsErr_AGS2_AGS2_ECM_STATUS_Lin2
      COMRXL_AGS2_BoostStat_AGS2_ECM_STATUS_Lin2: type=IDTSAGS2_BoostStat_AGS2_ECM_STATUS_Lin2
      COMRXL_S2MResBit1_AGS2_AGS2_ECM_STATUS_Lin2: type=IDTSS2MResBit1_AGS2_AGS2_ECM_STATUS_Lin2
      COMRXL_AHP_RPM_TGT_PERCT_AHP_STAT_GLOBAL_Lin2: type=IDTSAHP_RPM_TGT_PERCT_AHP_STAT_GLOBAL_Lin2
      COMRXL_AHP_RPM_ACTL_PERCT_AHP_STAT_GLOBAL_Lin2: type=IDTSAHP_RPM_ACTL_PERCT_AHP_STAT_GLOBAL_Lin2
      COMRXL_AHP_VLTG_AHP_STAT_GLOBAL_Lin2: type=IDTSAHP_VLTG_AHP_STAT_GLOBAL_Lin2
      COMRXL_AHP_TEMP_AHP_STAT_GLOBAL_Lin2: type=IDTSAHP_TEMP_AHP_STAT_GLOBAL_Lin2
      COMRXL_AHP_CURR_AHP_STAT_GLOBAL_Lin2: type=IDTSAHP_CURR_AHP_STAT_GLOBAL_Lin2
      COMRXL_AHP_FL_SAFE_ACTVTD_AHP_STAT_GLOBAL_Lin2: type=IDTSAHP_FL_SAFE_ACTVTD_AHP_STAT_GLOBAL_Lin2
      COMRXL_AHP_LMP_HM_AN_ON_AHP_STAT_GLOBAL_Lin2: type=IDTSAHP_LMP_HM_AN_ON_AHP_STAT_GLOBAL_Lin2
      COMRXL_AHP_AIR_PRE_ERR_AHP_STAT_GLOBAL_Lin2: type=IDTSAHP_AIR_PRE_ERR_AHP_STAT_GLOBAL_Lin2
      COMRXL_AHP_OVR_TMP_ERR_AHP_STAT_GLOBAL_Lin2: type=IDTSAHP_OVR_TMP_ERR_AHP_STAT_GLOBAL_Lin2
      COMRXL_AHP_OVR_CUR_ERR_AHP_STAT_GLOBAL_Lin2: type=IDTSAHP_OVR_CUR_ERR_AHP_STAT_GLOBAL_Lin2
      COMRXL_AHP_DR_RN_ERR_AHP_STAT_GLOBAL_Lin2: type=IDTSAHP_DR_RN_ERR_AHP_STAT_GLOBAL_Lin2
      COMRXL_AHP_VLTG_ERR_AHP_STAT_GLOBAL_Lin2: type=IDTSAHP_VLTG_ERR_AHP_STAT_GLOBAL_Lin2
      COMRXL_AHP_DBLK_ACTV_AHP_STAT_GLOBAL_Lin2: type=IDTSAHP_DBLK_ACTV_AHP_STAT_GLOBAL_Lin2
      COMRXL_AHP_MONTRNG_RPM_AHP_STAT_GLOBAL_Lin2: type=IDTSAHP_MONTRNG_RPM_AHP_STAT_GLOBAL_Lin2
      COMRXL_AHP_NODE_ERR_AHP_STAT_GLOBAL_Lin2: type=IDTSAHP_NODE_ERR_AHP_STAT_GLOBAL_Lin2
      COMRXL_AHP_POST_RUN_STAT_AHP_STAT_GLOBAL_Lin2: type=IDTSAHP_POST_RUN_STAT_AHP_STAT_GLOBAL_Lin2
      COMRXL_RsErr_AHP_PUMP_AHP_STAT_GLOBAL_Lin2: type=IDTSRsErr_AHP_PUMP_AHP_STAT_GLOBAL_Lin2
      COMRXL_AHP_SUPPLIER_AHP_VER_Lin2: type=IDTSAHP_SUPPLIER_AHP_VER_Lin2
      COMRXL_BHV_PosAct_BHV_STAT_V2_Lin2: type=IDTSBHV_PosAct_BHV_STAT_V2_Lin2
      COMRXL_BHV_ERR_BHV_STAT_V2_Lin2: type=IDTSBHV_ERR_BHV_STAT_V2_Lin2
      COMRXL_BHV_Sts_BHV_STAT_V2_Lin2: type=IDTSBHV_Sts_BHV_STAT_V2_Lin2
      COMRXL_RsErr_BHV_BHV_STAT_V2_Lin2: type=IDTSRsErr_BHV_BHV_STAT_V2_Lin2
      COMRXL_CompFaultStat_EAC_STAT_Lin2: type=IDTSCompFaultStat_EAC_STAT_Lin2
      COMRXL_CompStat_EAC_STAT_Lin2: type=IDTSCompStat_EAC_STAT_Lin2
      COMRXL_CompressorSpd_EAC_STAT_Lin2: type=IDTSCompressorSpd_EAC_STAT_Lin2
      COMRXL_CompSpdIncrReq_EAC_STAT_Lin2: type=IDTSCompSpdIncrReq_EAC_STAT_Lin2
      COMRXL_CompElecPwr_EAC_STAT_Lin2: type=IDTSCompElecPwr_EAC_STAT_Lin2
      COMRXL_CompBoardTemp_EAC_STAT_Lin2: type=IDTSCompBoardTemp_EAC_STAT_Lin2
      COMRXL_CompIGBTTemp_EAC_STAT_Lin2: type=IDTSCompIGBTTemp_EAC_STAT_Lin2
      COMRXL_CompElecCurr_EAC_STAT_Lin2: type=IDTSCompElecCurr_EAC_STAT_Lin2
      COMRXL_CompHVInput_EAC_STAT_Lin2: type=IDTSCompHVInput_EAC_STAT_Lin2
      COMRXL_DriveMdReq_ESBM_1_Lin2: type=IDTSDriveMdReq_ESBM_1_Lin2
      COMRXL_HybridModeRq_LIN_ESBM_1_Lin2: type=ADTSHybridModeRq_LIN
      COMRXL_ESaveModeRq_LIN_ESBM_1_Lin2: type=IDTSESaveModeRq_LIN_ESBM_1_Lin2
      COMRXL_ElectricModeRq_LIN_ESBM_1_Lin2: type=IDTSElectricModeRq_LIN_ESBM_1_Lin2
      COMRXL_RsErr_ESBM_ESBM_1_Lin2: type=IDTSRsErr_ESBM_ESBM_1_Lin2
      COMRXL_PECP_RPM_TGT_PERCT_PECP_STAT_GLOBAL_Lin2: type=IDTSPECP_RPM_TGT_PERCT_PECP_STAT_GLOBAL_Lin2
      COMRXL_PECP_RPM_ACTL_PERCT_PECP_STAT_GLOBAL_Lin2: type=IDTSPECP_RPM_ACTL_PERCT_PECP_STAT_GLOBAL_Lin2
      COMRXL_PECP_VLTG_PECP_STAT_GLOBAL_Lin2: type=IDTSPECP_VLTG_PECP_STAT_GLOBAL_Lin2
      COMRXL_PECP_TEMP_PECP_STAT_GLOBAL_Lin2: type=IDTSPECP_TEMP_PECP_STAT_GLOBAL_Lin2
      COMRXL_PECP_CURR_PECP_STAT_GLOBAL_Lin2: type=IDTSPECP_CURR_PECP_STAT_GLOBAL_Lin2
      COMRXL_PECP_FL_SAFE_ACTVTD_PECP_STAT_GLOBAL_Lin2: type=IDTSPECP_FL_SAFE_ACTVTD_PECP_STAT_GLOBAL_Lin2
      COMRXL_PECP_LMP_HM_AN_ON_PECP_STAT_GLOBAL_Lin2: type=IDTSPECP_LMP_HM_AN_ON_PECP_STAT_GLOBAL_Lin2
      COMRXL_PECP_AIR_PRE_ERR_PECP_STAT_GLOBAL_Lin2: type=IDTSPECP_AIR_PRE_ERR_PECP_STAT_GLOBAL_Lin2
      COMRXL_PECP_OVR_TMP_ERR_PECP_STAT_GLOBAL_Lin2: type=IDTSPECP_OVR_TMP_ERR_PECP_STAT_GLOBAL_Lin2
      COMRXL_PECP_OVR_CUR_ERR_PECP_STAT_GLOBAL_Lin2: type=IDTSPECP_OVR_CUR_ERR_PECP_STAT_GLOBAL_Lin2
      COMRXL_PECP_DR_RN_ERR_PECP_STAT_GLOBAL_Lin2: type=IDTSPECP_DR_RN_ERR_PECP_STAT_GLOBAL_Lin2
      COMRXL_PECP_VLTG_ERR_PECP_STAT_GLOBAL_Lin2: type=IDTSPECP_VLTG_ERR_PECP_STAT_GLOBAL_Lin2
      COMRXL_PECP_DBLK_ACTV_PECP_STAT_GLOBAL_Lin2: type=IDTSPECP_DBLK_ACTV_PECP_STAT_GLOBAL_Lin2
      COMRXL_PECP_MONTRNG_RPM_PECP_STAT_GLOBAL_Lin2: type=IDTSPECP_MONTRNG_RPM_PECP_STAT_GLOBAL_Lin2
      COMRXL_PECP_NODE_ERR_PECP_STAT_GLOBAL_Lin2: type=IDTSPECP_NODE_ERR_PECP_STAT_GLOBAL_Lin2
      COMRXL_PECP_POST_RUN_STAT_PECP_STAT_GLOBAL_Lin2: type=IDTSPECP_POST_RUN_STAT_PECP_STAT_GLOBAL_Lin2
      COMRXL_RsErr_PECP_PUMP_PECP_STAT_GLOBAL_Lin2: type=IDTSRsErr_PECP_PUMP_PECP_STAT_GLOBAL_Lin2
      COMRXL_PECP_SUPPLIER_PECP_VER_Lin2: type=IDTSPECP_SUPPLIER_PECP_VER_Lin2
      COMRXL_PowerPanel_Button_State_PowerPanel_STAT_Lin2: type=IDTSPowerPanel_Button_State_PowerPanel_STAT_Lin2
      COMRXL_PowerPanel_Lid_Switch_Sts_120A_PowerPanel_STAT_Lin2: type=IDTSPowerPanel_Lid_Switch_Sts_120A_PowerPanel_STAT_Lin2
      COMRXL_PowerPanel_Lid_Switch_Sts_120B_PowerPanel_STAT_Lin2: type=IDTSPowerPanel_Lid_Switch_Sts_120B_PowerPanel_STAT_Lin2
      COMRXL_PowerPanel_Lid_Switch_Sts_240_PowerPanel_STAT_Lin2: type=IDTSPowerPanel_Lid_Switch_Sts_240_PowerPanel_STAT_Lin2
      COMRXL_PowerPanel_AC_Present_Sens1_PowerPanel_STAT_Lin2: type=IDTSPowerPanel_AC_Present_Sens1_PowerPanel_STAT_Lin2
      COMRXL_PowerPanel_AC_Present_Sens2_PowerPanel_STAT_Lin2: type=IDTSPowerPanel_AC_Present_Sens2_PowerPanel_STAT_Lin2
      COMRXL_PowerPanel_Fault_Reason_PowerPanel_STAT_Lin2: type=IDTSPowerPanel_Fault_Reason_PowerPanel_STAT_Lin2
      COMRXL_RsErr_SPP_PowerPanel_STAT_Lin2: type=IDTSRsErr_SPP_PowerPanel_STAT_Lin2
      COMRXL_AHP_VERSION_AHP_VER_Lin2: type=IDTSAHP_VERSION_AHP_VER_Lin2
      COMRXL_PECP_VERSION_PECP_VER_Lin2: type=IDTSPECP_VERSION_PECP_VER_Lin2
      COMRXL_S2MResByte1_AGS2_AGS2_ECM_STATUS_Lin2: type=IDTSS2MResByte1_AGS2_AGS2_ECM_STATUS_Lin2
      COMRXL_S2MResByte2_AGS2_AGS2_ECM_STATUS_Lin2: type=IDTSS2MResByte2_AGS2_AGS2_ECM_STATUS_Lin2
      COMRXL_BHV_MotorVolt_BHV_STAT_V2_Lin2: type=IDTSBHV_MotorVolt_BHV_STAT_V2_Lin2
      COMRXL_BHV_CalStat_BHV_STAT_V2_Lin2: type=IDTSBHV_CalStat_BHV_STAT_V2_Lin2
      COMRXL_OEXV_PosAct_OEXV_STAT_Lin2: type=IDTSOEXV_PosAct_OEXV_STAT_Lin2
      COMRXL_OEXV_CalStat_OEXV_STAT_Lin2: type=IDTSOEXV_CalStat_OEXV_STAT_Lin2
      COMRXL_OEXV_CalRq_OEXV_STAT_Lin2: type=IDTSOEXV_CalRq_OEXV_STAT_Lin2
      COMRXL_RsErr_OEXV_OEXV_STAT_Lin2: type=IDTSRsErr_OEXV_OEXV_STAT_Lin2
      COMRXL_OEXV_Sts_OEXV_STAT_Lin2: type=IDTSOEXV_Sts_OEXV_STAT_Lin2
      COMRXL_OEXV_ERR_OEXV_STAT_Lin2: type=IDTSOEXV_ERR_OEXV_STAT_Lin2
      COMRXL_OEXV_SupplyVolt_OEXV_STAT_Lin2: type=IDTSOEXV_SupplyVolt_OEXV_STAT_Lin2
      COMRXL_OEXV_Refrigerant_Pressure_OEXV_STAT_Lin2: type=IDTSOEXV_Refrigerant_Pressure_OEXV_STAT_Lin2
      COMRXL_OEXV_Board_Temp_OEXV_STAT_Lin2: type=IDTSOEXV_Board_Temp_OEXV_STAT_Lin2
      COMRXL_OEXV_Refrigerant_Temp_OEXV_STAT_Lin2: type=IDTSOEXV_Refrigerant_Temp_OEXV_STAT_Lin2
      COMRXL_CompFaultStat_800_EAC_STAT_800_Lin2: type=IDTSCompFaultStat_800_EAC_STAT_800_Lin2
      COMRXL_CompStat_800_EAC_STAT_800_Lin2: type=IDTSCompStat_800_EAC_STAT_800_Lin2
      COMRXL_CompressorSpd_800_EAC_STAT_800_Lin2: type=IDTSCompressorSpd_800_EAC_STAT_800_Lin2
      COMRXL_CompSpdIncrReq_800_EAC_STAT_800_Lin2: type=IDTSCompSpdIncrReq_800_EAC_STAT_800_Lin2
      COMRXL_RsErr_EAC2_800_EAC_STAT_800_Lin2: type=IDTSRsErr_EAC2_800_EAC_STAT_800_Lin2
      COMRXL_CompElecPwr_800_EAC_STAT_800_Lin2: type=IDTSCompElecPwr_800_EAC_STAT_800_Lin2
      COMRXL_CompBoardTemp_800_EAC_STAT_800_Lin2: type=IDTSCompBoardTemp_800_EAC_STAT_800_Lin2
      COMRXL_CompIGBTTemp_800_EAC_STAT_800_Lin2: type=IDTSCompIGBTTemp_800_EAC_STAT_800_Lin2
      COMRXL_CompElecCurr_800_EAC_STAT_800_Lin2: type=IDTSCompElecCurr_800_EAC_STAT_800_Lin2
      COMRXL_CompHVInput_800_EAC_STAT_800_Lin2: type=IDTSCompHVInput_800_EAC_STAT_800_Lin2
      COMRXL_PowerPanel_LED_A_Feedback_PowerPanel_STAT_Lin2: type=IDTSPowerPanel_LED_A_Feedback_PowerPanel_STAT_Lin2
      COMRXL_PowerPanel_LED_B_Feedback_PowerPanel_STAT_Lin2: type=IDTSPowerPanel_LED_B_Feedback_PowerPanel_STAT_Lin2
      COMRXL_PowerPanel_LED_C_Feedback_PowerPanel_STAT_Lin2: type=IDTSPowerPanel_LED_C_Feedback_PowerPanel_STAT_Lin2
      COMRXL_PowerPanel_LED_A_FailStatus_PowerPanel_STAT_Lin2: type=IDTSPowerPanel_LED_A_FailStatus_PowerPanel_STAT_Lin2
      COMRXL_PowerPanel_LED_B_FailStatus_PowerPanel_STAT_Lin2: type=IDTSPowerPanel_LED_B_FailStatus_PowerPanel_STAT_Lin2
      COMRXL_PowerPanel_LED_C_FailStatus_PowerPanel_STAT_Lin2: type=IDTSPowerPanel_LED_C_FailStatus_PowerPanel_STAT_Lin2
      COMRXL_PowerPanel_LED_A_Color_Feedback_PowerPanel_STAT_Lin2: type=IDTSPowerPanel_LED_A_Color_Feedback_PowerPanel_STAT_Lin2
      COMRXL_PowerPanel_LED_B_Color_Feedback_PowerPanel_STAT_Lin2: type=IDTSPowerPanel_LED_B_Color_Feedback_PowerPanel_STAT_Lin2
      COMRXL_PowerPanel_LED_C_Color_Feedback_PowerPanel_STAT_Lin2: type=IDTSPowerPanel_LED_C_Color_Feedback_PowerPanel_STAT_Lin2
      COMRXL_PowerPanel_LIN_Checksum_Error_PowerPanel_STAT_Lin2: type=IDTSPowerPanel_LIN_Checksum_Error_PowerPanel_STAT_Lin2
      COMRXL_PowerPanel_LIN_Data_Error_PowerPanel_STAT_Lin2: type=IDTSPowerPanel_LIN_Data_Error_PowerPanel_STAT_Lin2
      COMRXL_PowerPanel_LIN_Parity_Error_PowerPanel_STAT_Lin2: type=IDTSPowerPanel_LIN_Parity_Error_PowerPanel_STAT_Lin2
      COMRXL_PowerPanel_Gnd_Fault_Detected_PowerPanel_STAT_Lin2: type=IDTSPowerPanel_Gnd_Fault_Detected_PowerPanel_STAT_Lin2
      COMRXL_RsErr_EAC2_EAC_STAT_Lin2: type=IDTSRsErr_EAC2_EAC_STAT_Lin2
      COMRXL_PowerPanel_Fault_PowerPanel_STAT_Lin2: type=IDTSPowerPanel_Fault_PowerPanel_STAT_Lin2
      COMRXL_PowerPanel_RatedPower_PowerPanel_STAT_Lin2: type=IDTSPowerPanel_RatedPower_PowerPanel_STAT_Lin2
      COMRXL_PowerPanel_Current_Draw_Sens1_PowerPanel_STAT_Lin2: type=IDTSPowerPanel_Current_Draw_Sens1_PowerPanel_STAT_Lin2
      COMRXL_PowerPanel_Current_Draw_Sens2_PowerPanel_STAT_Lin2: type=IDTSPowerPanel_Current_Draw_Sens2_PowerPanel_STAT_Lin2
    invalidation-policys:
      data-element=COMRXL_AGS2_CurrPos_AGS2_ECM_STATUS_Lin2, handle-invalid=KEEP
      data-element=COMRXL_AGS2_CalStat_AGS2_ECM_STATUS_Lin2, handle-invalid=DONT-INVALIDATE
      data-element=COMRXL_AGS2_CalActv_AGS2_ECM_STATUS_Lin2, handle-invalid=DONT-INVALIDATE
      data-element=COMRXL_AGS2_ErrUnVolt_AGS2_ECM_STATUS_Lin2, handle-invalid=DONT-INVALIDATE
      data-element=COMRXL_AGS2_ErrOvrVolt_AGS2_ECM_STATUS_Lin2, handle-invalid=DONT-INVALIDATE
      data-element=COMRXL_AGS2_ErrOvrTemp_AGS2_ECM_STATUS_Lin2, handle-invalid=DONT-INVALIDATE
      data-element=COMRXL_AGS2_ErrMechStuck_AGS2_ECM_STATUS_Lin2, handle-invalid=DONT-INVALIDATE
      data-element=COMRXL_AGS2_ErrMechBreak_AGS2_ECM_STATUS_Lin2, handle-invalid=DONT-INVALIDATE
      data-element=COMRXL_AGS2_ErrLIN_AGS2_ECM_STATUS_Lin2, handle-invalid=KEEP
      data-element=COMRXL_RsErr_AGS2_AGS2_ECM_STATUS_Lin2, handle-invalid=DONT-INVALIDATE
      data-element=COMRXL_AGS2_BoostStat_AGS2_ECM_STATUS_Lin2, handle-invalid=DONT-INVALIDATE
      data-element=COMRXL_S2MResBit1_AGS2_AGS2_ECM_STATUS_Lin2, handle-invalid=DONT-INVALIDATE
      data-element=COMRXL_AHP_RPM_TGT_PERCT_AHP_STAT_GLOBAL_Lin2, handle-invalid=KEEP
      data-element=COMRXL_AHP_RPM_ACTL_PERCT_AHP_STAT_GLOBAL_Lin2, handle-invalid=KEEP
      data-element=COMRXL_AHP_VLTG_AHP_STAT_GLOBAL_Lin2, handle-invalid=KEEP
      data-element=COMRXL_AHP_TEMP_AHP_STAT_GLOBAL_Lin2, handle-invalid=KEEP
      data-element=COMRXL_AHP_CURR_AHP_STAT_GLOBAL_Lin2, handle-invalid=KEEP
      data-element=COMRXL_AHP_FL_SAFE_ACTVTD_AHP_STAT_GLOBAL_Lin2, handle-invalid=KEEP
      data-element=COMRXL_AHP_LMP_HM_AN_ON_AHP_STAT_GLOBAL_Lin2, handle-invalid=KEEP
      data-element=COMRXL_AHP_AIR_PRE_ERR_AHP_STAT_GLOBAL_Lin2, handle-invalid=KEEP
      data-element=COMRXL_AHP_OVR_TMP_ERR_AHP_STAT_GLOBAL_Lin2, handle-invalid=KEEP
      data-element=COMRXL_AHP_OVR_CUR_ERR_AHP_STAT_GLOBAL_Lin2, handle-invalid=KEEP
      data-element=COMRXL_AHP_DR_RN_ERR_AHP_STAT_GLOBAL_Lin2, handle-invalid=KEEP
      data-element=COMRXL_AHP_VLTG_ERR_AHP_STAT_GLOBAL_Lin2, handle-invalid=KEEP
      data-element=COMRXL_AHP_DBLK_ACTV_AHP_STAT_GLOBAL_Lin2, handle-invalid=KEEP
      data-element=COMRXL_AHP_MONTRNG_RPM_AHP_STAT_GLOBAL_Lin2, handle-invalid=KEEP
      data-element=COMRXL_AHP_NODE_ERR_AHP_STAT_GLOBAL_Lin2, handle-invalid=KEEP
      data-element=COMRXL_AHP_POST_RUN_STAT_AHP_STAT_GLOBAL_Lin2, handle-invalid=KEEP
      data-element=COMRXL_RsErr_AHP_PUMP_AHP_STAT_GLOBAL_Lin2, handle-invalid=DONT-INVALIDATE
      data-element=COMRXL_AHP_SUPPLIER_AHP_VER_Lin2, handle-invalid=DONT-INVALIDATE
      data-element=COMRXL_BHV_PosAct_BHV_STAT_V2_Lin2, handle-invalid=KEEP
      data-element=COMRXL_BHV_ERR_BHV_STAT_V2_Lin2, handle-invalid=KEEP
      data-element=COMRXL_BHV_Sts_BHV_STAT_V2_Lin2, handle-invalid=KEEP
      data-element=COMRXL_RsErr_BHV_BHV_STAT_V2_Lin2, handle-invalid=DONT-INVALIDATE
      data-element=COMRXL_CompFaultStat_EAC_STAT_Lin2, handle-invalid=KEEP
      data-element=COMRXL_CompStat_EAC_STAT_Lin2, handle-invalid=KEEP
      data-element=COMRXL_CompressorSpd_EAC_STAT_Lin2, handle-invalid=KEEP
      data-element=COMRXL_CompSpdIncrReq_EAC_STAT_Lin2, handle-invalid=DONT-INVALIDATE
      data-element=COMRXL_CompElecPwr_EAC_STAT_Lin2, handle-invalid=KEEP
      data-element=COMRXL_CompBoardTemp_EAC_STAT_Lin2, handle-invalid=KEEP
      data-element=COMRXL_CompIGBTTemp_EAC_STAT_Lin2, handle-invalid=KEEP
      data-element=COMRXL_CompElecCurr_EAC_STAT_Lin2, handle-invalid=KEEP
      data-element=COMRXL_CompHVInput_EAC_STAT_Lin2, handle-invalid=KEEP
      data-element=COMRXL_DriveMdReq_ESBM_1_Lin2, handle-invalid=KEEP
      data-element=COMRXL_HybridModeRq_LIN_ESBM_1_Lin2, handle-invalid=KEEP
      data-element=COMRXL_ESaveModeRq_LIN_ESBM_1_Lin2, handle-invalid=KEEP
      data-element=COMRXL_ElectricModeRq_LIN_ESBM_1_Lin2, handle-invalid=KEEP
      data-element=COMRXL_RsErr_ESBM_ESBM_1_Lin2, handle-invalid=DONT-INVALIDATE
      data-element=COMRXL_PECP_RPM_TGT_PERCT_PECP_STAT_GLOBAL_Lin2, handle-invalid=KEEP
      data-element=COMRXL_PECP_RPM_ACTL_PERCT_PECP_STAT_GLOBAL_Lin2, handle-invalid=KEEP
      data-element=COMRXL_PECP_VLTG_PECP_STAT_GLOBAL_Lin2, handle-invalid=KEEP
      data-element=COMRXL_PECP_TEMP_PECP_STAT_GLOBAL_Lin2, handle-invalid=KEEP
      data-element=COMRXL_PECP_CURR_PECP_STAT_GLOBAL_Lin2, handle-invalid=KEEP
      data-element=COMRXL_PECP_FL_SAFE_ACTVTD_PECP_STAT_GLOBAL_Lin2, handle-invalid=KEEP
      data-element=COMRXL_PECP_LMP_HM_AN_ON_PECP_STAT_GLOBAL_Lin2, handle-invalid=KEEP
      data-element=COMRXL_PECP_AIR_PRE_ERR_PECP_STAT_GLOBAL_Lin2, handle-invalid=KEEP
      data-element=COMRXL_PECP_OVR_TMP_ERR_PECP_STAT_GLOBAL_Lin2, handle-invalid=KEEP
      data-element=COMRXL_PECP_OVR_CUR_ERR_PECP_STAT_GLOBAL_Lin2, handle-invalid=KEEP
      data-element=COMRXL_PECP_DR_RN_ERR_PECP_STAT_GLOBAL_Lin2, handle-invalid=KEEP
      data-element=COMRXL_PECP_VLTG_ERR_PECP_STAT_GLOBAL_Lin2, handle-invalid=KEEP
      data-element=COMRXL_PECP_DBLK_ACTV_PECP_STAT_GLOBAL_Lin2, handle-invalid=KEEP
      data-element=COMRXL_PECP_MONTRNG_RPM_PECP_STAT_GLOBAL_Lin2, handle-invalid=KEEP
      data-element=COMRXL_PECP_NODE_ERR_PECP_STAT_GLOBAL_Lin2, handle-invalid=KEEP
      data-element=COMRXL_PECP_POST_RUN_STAT_PECP_STAT_GLOBAL_Lin2, handle-invalid=KEEP
      data-element=COMRXL_RsErr_PECP_PUMP_PECP_STAT_GLOBAL_Lin2, handle-invalid=DONT-INVALIDATE
      data-element=COMRXL_PECP_SUPPLIER_PECP_VER_Lin2, handle-invalid=DONT-INVALIDATE
      data-element=COMRXL_PowerPanel_Button_State_PowerPanel_STAT_Lin2, handle-invalid=DONT-INVALIDATE
      data-element=COMRXL_PowerPanel_Lid_Switch_Sts_120A_PowerPanel_STAT_Lin2, handle-invalid=DONT-INVALIDATE
      data-element=COMRXL_PowerPanel_Lid_Switch_Sts_120B_PowerPanel_STAT_Lin2, handle-invalid=DONT-INVALIDATE
      data-element=COMRXL_PowerPanel_Lid_Switch_Sts_240_PowerPanel_STAT_Lin2, handle-invalid=DONT-INVALIDATE
      data-element=COMRXL_PowerPanel_Fault_Reason_PowerPanel_STAT_Lin2, handle-invalid=KEEP
      data-element=COMRXL_RsErr_SPP_PowerPanel_STAT_Lin2, handle-invalid=DONT-INVALIDATE
      data-element=COMRXL_AHP_VERSION_AHP_VER_Lin2, handle-invalid=KEEP
      data-element=COMRXL_PECP_VERSION_PECP_VER_Lin2, handle-invalid=KEEP
      data-element=COMRXL_S2MResByte1_AGS2_AGS2_ECM_STATUS_Lin2, handle-invalid=DONT-INVALIDATE
      data-element=COMRXL_S2MResByte2_AGS2_AGS2_ECM_STATUS_Lin2, handle-invalid=DONT-INVALIDATE
      data-element=COMRXL_BHV_MotorVolt_BHV_STAT_V2_Lin2, handle-invalid=DONT-INVALIDATE
      data-element=COMRXL_BHV_CalStat_BHV_STAT_V2_Lin2, handle-invalid=DONT-INVALIDATE
      data-element=COMRXL_OEXV_PosAct_OEXV_STAT_Lin2, handle-invalid=KEEP
      data-element=COMRXL_OEXV_CalStat_OEXV_STAT_Lin2, handle-invalid=KEEP
      data-element=COMRXL_OEXV_CalRq_OEXV_STAT_Lin2, handle-invalid=DONT-INVALIDATE
      data-element=COMRXL_RsErr_OEXV_OEXV_STAT_Lin2, handle-invalid=DONT-INVALIDATE
      data-element=COMRXL_OEXV_Sts_OEXV_STAT_Lin2, handle-invalid=KEEP
      data-element=COMRXL_OEXV_ERR_OEXV_STAT_Lin2, handle-invalid=KEEP
      data-element=COMRXL_OEXV_SupplyVolt_OEXV_STAT_Lin2, handle-invalid=KEEP
      data-element=COMRXL_OEXV_Refrigerant_Pressure_OEXV_STAT_Lin2, handle-invalid=KEEP
      data-element=COMRXL_OEXV_Board_Temp_OEXV_STAT_Lin2, handle-invalid=KEEP
      data-element=COMRXL_OEXV_Refrigerant_Temp_OEXV_STAT_Lin2, handle-invalid=KEEP
      data-element=COMRXL_CompFaultStat_800_EAC_STAT_800_Lin2, handle-invalid=KEEP
      data-element=COMRXL_CompStat_800_EAC_STAT_800_Lin2, handle-invalid=KEEP
      data-element=COMRXL_CompressorSpd_800_EAC_STAT_800_Lin2, handle-invalid=KEEP
      data-element=COMRXL_CompSpdIncrReq_800_EAC_STAT_800_Lin2, handle-invalid=DONT-INVALIDATE
      data-element=COMRXL_RsErr_EAC2_800_EAC_STAT_800_Lin2, handle-invalid=DONT-INVALIDATE
      data-element=COMRXL_CompElecPwr_800_EAC_STAT_800_Lin2, handle-invalid=KEEP
      data-element=COMRXL_CompBoardTemp_800_EAC_STAT_800_Lin2, handle-invalid=KEEP
      data-element=COMRXL_CompIGBTTemp_800_EAC_STAT_800_Lin2, handle-invalid=KEEP
      data-element=COMRXL_CompElecCurr_800_EAC_STAT_800_Lin2, handle-invalid=KEEP
      data-element=COMRXL_CompHVInput_800_EAC_STAT_800_Lin2, handle-invalid=KEEP
      data-element=COMRXL_PowerPanel_LED_A_Feedback_PowerPanel_STAT_Lin2, handle-invalid=KEEP
      data-element=COMRXL_PowerPanel_LED_B_Feedback_PowerPanel_STAT_Lin2, handle-invalid=KEEP
      data-element=COMRXL_PowerPanel_LED_C_Feedback_PowerPanel_STAT_Lin2, handle-invalid=KEEP
      data-element=COMRXL_PowerPanel_LED_A_FailStatus_PowerPanel_STAT_Lin2, handle-invalid=DONT-INVALIDATE
      data-element=COMRXL_PowerPanel_LED_B_FailStatus_PowerPanel_STAT_Lin2, handle-invalid=DONT-INVALIDATE
      data-element=COMRXL_PowerPanel_LED_C_FailStatus_PowerPanel_STAT_Lin2, handle-invalid=DONT-INVALIDATE
      data-element=COMRXL_PowerPanel_LED_A_Color_Feedback_PowerPanel_STAT_Lin2, handle-invalid=DONT-INVALIDATE
      data-element=COMRXL_PowerPanel_LED_B_Color_Feedback_PowerPanel_STAT_Lin2, handle-invalid=DONT-INVALIDATE
      data-element=COMRXL_PowerPanel_LED_C_Color_Feedback_PowerPanel_STAT_Lin2, handle-invalid=DONT-INVALIDATE
      data-element=COMRXL_PowerPanel_LIN_Checksum_Error_PowerPanel_STAT_Lin2, handle-invalid=DONT-INVALIDATE
      data-element=COMRXL_PowerPanel_LIN_Data_Error_PowerPanel_STAT_Lin2, handle-invalid=DONT-INVALIDATE
      data-element=COMRXL_PowerPanel_LIN_Parity_Error_PowerPanel_STAT_Lin2, handle-invalid=DONT-INVALIDATE
      data-element=COMRXL_PowerPanel_Gnd_Fault_Detected_PowerPanel_STAT_Lin2, handle-invalid=DONT-INVALIDATE
      data-element=COMRXL_RsErr_EAC2_EAC_STAT_Lin2, handle-invalid=DONT-INVALIDATE
      data-element=COMRXL_PowerPanel_Fault_PowerPanel_STAT_Lin2, handle-invalid=KEEP
      data-element=COMRXL_PowerPanel_RatedPower_PowerPanel_STAT_Lin2, handle-invalid=DONT-INVALIDATE
      data-element=COMRXL_PowerPanel_Current_Draw_Sens2_PowerPanel_STAT_Lin2, handle-invalid=KEEP
      data-element=COMRXL_PowerPanel_AC_Present_Sens1_PowerPanel_STAT_Lin2, handle-invalid=DONT-INVALIDATE
      data-element=COMRXL_PowerPanel_AC_Present_Sens2_PowerPanel_STAT_Lin2, handle-invalid=DONT-INVALIDATE
      data-element=COMRXL_PowerPanel_Current_Draw_Sens1_PowerPanel_STAT_Lin2, handle-invalid=KEEP
  sender receiver interface Lin2ComTxSignalsSR
    33 x data, all with category=TYPE_REFERENCE, sw-calibration-access=READ-ONLY:
      COMTXL_AGS2_PosRq_ECM_AGS2_DEMAND_Lin2: type=IDTSAGS2_PosRq_ECM_AGS2_DEMAND_Lin2, init-value=COMTXL_AGS2_PosRq_ECM_AGS2_DEMAND_Lin2Value:0  # Raw signal data to be transmitted over the LIN bus for the Signal AGS2_PosRq
      COMTXL_AGS2_CalRq_ECM_AGS2_DEMAND_Lin2: type=IDTSAGS2_CalRq_ECM_AGS2_DEMAND_Lin2, init-value=COMTXL_AGS2_CalRq_ECM_AGS2_DEMAND_Lin2Value:0  # Raw signal data to be transmitted over the LIN bus for the Signal AGS2_CalRq
      COMTXL_AGS2_BoostRq_ECM_AGS2_DEMAND_Lin2: type=IDTSAGS2_BoostRq_ECM_AGS2_DEMAND_Lin2, init-value=COMTXL_AGS2_BoostRq_ECM_AGS2_DEMAND_Lin2Value:0  # Raw signal data to be transmitted over the LIN bus for the Signal AGS2_BoostRq
      COMTXL_M2SRes2Bit_AGS2_ECM_AGS2_DEMAND_Lin2: type=IDTSM2SRes2Bit_AGS2_ECM_AGS2_DEMAND_Lin2, init-value=COMTXL_M2SRes2Bit_AGS2_ECM_AGS2_DEMAND_Lin2Value:0  # Raw signal data to be transmitted over the LIN bus for the Signal M2SRes2Bit_AGS2
      COMTXL_M2SResByte{1..3}_AGS2_ECM_AGS2_DEMAND_Lin2: type=IDTSM2SResByte{1..3}_AGS2_ECM_AGS2_DEMAND_Lin2, init-value=COMTXL_M2SResByte{1..3}_AGS2_ECM_AGS2_DEMAND_Lin2Value:0  # Raw signal data to be transmitted over the LIN bus for the Signal M2SResByte{1..3}_AGS2
      COMTXL_AHP_RPM_REQ_PERCT_AHP_REQ_GLOBAL_Lin2: type=IDTSAHP_RPM_REQ_PERCT_AHP_REQ_GLOBAL_Lin2, init-value=COMTXL_AHP_RPM_REQ_PERCT_AHP_REQ_GLOBAL_Lin2Value:255  # Raw signal data to be transmitted over the LIN bus for the Signal AHP_RPM_REQ_PERCT
      COMTXL_AHP_POST_RUN_REQ_AHP_REQ_GLOBAL_Lin2: type=IDTSAHP_POST_RUN_REQ_AHP_REQ_GLOBAL_Lin2, init-value=COMTXL_AHP_POST_RUN_REQ_AHP_REQ_GLOBAL_Lin2Value:7  # Raw signal data to be transmitted over the LIN bus for the Signal AHP_POST_RUN_REQ
      COMTXL_AHP_FL_SAFE_ACTVT_AHP_REQ_GLOBAL_Lin2: type=IDTSAHP_FL_SAFE_ACTVT_AHP_REQ_GLOBAL_Lin2, init-value=COMTXL_AHP_FL_SAFE_ACTVT_AHP_REQ_GLOBAL_Lin2Value:3  # Raw signal data to be transmitted over the LIN bus for the Signal AHP_FL_SAFE_ACTVT
      COMTXL_BHV_PosRq_BHV_REQ_Lin2: type=IDTSBHV_PosRq_BHV_REQ_Lin2, init-value=COMTXL_BHV_PosRq_BHV_REQ_Lin2Value:0  # Raw signal data to be transmitted over the LIN bus for the Signal BHV_PosRq
      COMTXL_BHV_PosSv_BHV_REQ_Lin2: type=IDTSBHV_PosSv_BHV_REQ_Lin2, init-value=COMTXL_BHV_PosSv_BHV_REQ_Lin2Value:0  # Raw signal data to be transmitted over the LIN bus for the Signal BHV_PosSv
      COMTXL_BHV_CalRq_BHV_REQ_Lin2: type=IDTSBHV_CalRq_BHV_REQ_Lin2, init-value=COMTXL_BHV_CalRq_BHV_REQ_Lin2Value:0  # Raw signal data to be transmitted over the LIN bus for the Signal BHV_CalRq
      COMTXL_CompressorSpdReq_COMP_REQ_Lin2: type=IDTSCompressorSpdReq_COMP_REQ_Lin2, init-value=COMTXL_CompressorSpdReq_COMP_REQ_Lin2Value:0  # Raw signal data to be transmitted over the LIN bus for the Signal CompressorSpdReq
      COMTXL_CompEnable_COMP_REQ_Lin2: type=IDTSCompEnable_COMP_REQ_Lin2, init-value=COMTXL_CompEnable_COMP_REQ_Lin2Value:3  # Raw signal data to be transmitted over the LIN bus for the Signal CompEnable
      COMTXL_DriveEcohybridLmp_MASTER_ESBM_1_Lin2: type=IDTSDriveEcohybridLmp_MASTER_ESBM_1_Lin2, init-value=COMTXL_DriveEcohybridLmp_MASTER_ESBM_1_Lin2Value:0  # Raw signal data to be transmitted over the LIN bus for the Signal DriveEcohybridLmp
      COMTXL_DriveElectricLmp_MASTER_ESBM_1_Lin2: type=IDTSDriveElectricLmp_MASTER_ESBM_1_Lin2, init-value=COMTXL_DriveElectricLmp_MASTER_ESBM_1_Lin2Value:0  # Raw signal data to be transmitted over the LIN bus for the Signal DriveElectricLmp
      COMTXL_DriveESaveLmp_MASTER_ESBM_1_Lin2: type=IDTSDriveESaveLmp_MASTER_ESBM_1_Lin2, init-value=COMTXL_DriveESaveLmp_MASTER_ESBM_1_Lin2Value:0  # Raw signal data to be transmitted over the LIN bus for the Signal DriveESaveLmp
      COMTXL_DriveSportHybridLmp_MASTER_ESBM_1_Lin2: type=IDTSDriveSportHybridLmp_MASTER_ESBM_1_Lin2, init-value=COMTXL_DriveSportHybridLmp_MASTER_ESBM_1_Lin2Value:0  # Raw signal data to be transmitted over the LIN bus for the Signal DriveSportHybridLmp
      COMTXL_PanelIntensitySts_MASTER_ESBM_1_Lin2: type=IDTSPanelIntensitySts_MASTER_ESBM_1_Lin2, init-value=COMTXL_PanelIntensitySts_MASTER_ESBM_1_Lin2Value:0  # Raw signal data to be transmitted over the LIN bus for the Signal PanelIntensitySts
      COMTXL_DAY_LGT_MD_MASTER_ESBM_1_Lin2: type=IDTSDAY_LGT_MD_MASTER_ESBM_1_Lin2, init-value=COMTXL_DAY_LGT_MD_MASTER_ESBM_1_Lin2Value:0  # Raw signal data to be transmitted over the LIN bus for the Signal DAY_LGT_MD
      COMTXL_PECP_RPM_REQ_PERCT_PECP_REQ_GLOBAL_Lin2: type=IDTSPECP_RPM_REQ_PERCT_PECP_REQ_GLOBAL_Lin2, init-value=COMTXL_PECP_RPM_REQ_PERCT_PECP_REQ_GLOBAL_Lin2Value:255  # Raw signal data to be transmitted over the LIN bus for the Signal PECP_RPM_REQ_PERCT
      COMTXL_PECP_POST_RUN_REQ_PECP_REQ_GLOBAL_Lin2: type=IDTSPECP_POST_RUN_REQ_PECP_REQ_GLOBAL_Lin2, init-value=COMTXL_PECP_POST_RUN_REQ_PECP_REQ_GLOBAL_Lin2Value:7  # Raw signal data to be transmitted over the LIN bus for the Signal PECP_POST_RUN_REQ
      COMTXL_PECP_FL_SAFE_ACTVT_PECP_REQ_GLOBAL_Lin2: type=IDTSPECP_FL_SAFE_ACTVT_PECP_REQ_GLOBAL_Lin2, init-value=COMTXL_PECP_FL_SAFE_ACTVT_PECP_REQ_GLOBAL_Lin2Value:3  # Raw signal data to be transmitted over the LIN bus for the Signal PECP_FL_SAFE_ACTVT
      COMTXL_PowerPanel_LED_A_Command_PowerPanel_REQ_Lin2: type=IDTSPowerPanel_LED_A_Command_PowerPanel_REQ_Lin2, init-value=COMTXL_PowerPanel_LED_A_Command_PowerPanel_REQ_Lin2Value:0  # Raw signal data to be transmitted over the LIN bus for the Signal PowerPanel_LED_A_Command
      COMTXL_PowerPanel_LED_B_Command_PowerPanel_REQ_Lin2: type=IDTSPowerPanel_LED_B_Command_PowerPanel_REQ_Lin2, init-value=COMTXL_PowerPanel_LED_B_Command_PowerPanel_REQ_Lin2Value:0  # Raw signal data to be transmitted over the LIN bus for the Signal PowerPanel_LED_B_Command
      COMTXL_DAY_LGT_MD_PowerPanel_PowerPanel_REQ_Lin2: type=IDTSDAY_LGT_MD_PowerPanel_PowerPanel_REQ_Lin2, init-value=COMTXL_DAY_LGT_MD_PowerPanel_PowerPanel_REQ_Lin2Value:0  # Raw signal data to be transmitted over the LIN bus for the Signal DAY_LGT_MD_PowerPanel
      COMTXL_OEXV_PosRq_OEXV_REQ_Lin2: type=IDTSOEXV_PosRq_OEXV_REQ_Lin2, init-value=COMTXL_OEXV_PosRq_OEXV_REQ_Lin2Value:0  # Raw signal data to be transmitted over the LIN bus for the Signal OEXV_PosRq
      COMTXL_OEXV_CalCmd_OEXV_REQ_Lin2: type=IDTSOEXV_CalCmd_OEXV_REQ_Lin2, init-value=COMTXL_OEXV_CalCmd_OEXV_REQ_Lin2Value:0  # Raw signal data to be transmitted over the LIN bus for the Signal OEXV_CalCmd
      COMTXL_PowerPanel_LED_C_Command_PowerPanel_REQ_Lin2: type=IDTSPowerPanel_LED_C_Command_PowerPanel_REQ_Lin2, init-value=COMTXL_PowerPanel_LED_C_Command_PowerPanel_REQ_Lin2Value:0  # Raw signal data to be transmitted over the LIN bus for the Signal PowerPanel_LED_C_Command
      COMTXL_PowerPanel_LED_A_Color_Command_PowerPanel_REQ_Lin2: type=IDTSPowerPanel_LED_A_Color_Command_PowerPanel_REQ_Lin2, init-value=COMTXL_PowerPanel_LED_A_Color_Command_PowerPanel_REQ_Lin2Value:0  # Raw signal data to be transmitted over the LIN bus for the Signal PowerPanel_LED_A_Color_Command
      COMTXL_PowerPanel_LED_B_Color_Command_PowerPanel_REQ_Lin2: type=IDTSPowerPanel_LED_B_Color_Command_PowerPanel_REQ_Lin2, init-value=COMTXL_PowerPanel_LED_B_Color_Command_PowerPanel_REQ_Lin2Value:0  # Raw signal data to be transmitted over the LIN bus for the Signal PowerPanel_LED_B_Color_Command
      COMTXL_PowerPanel_LED_C_Color_Command_PowerPanel_REQ_Lin2: type=IDTSPowerPanel_LED_C_Color_Command_PowerPanel_REQ_Lin2, init-value=COMTXL_PowerPanel_LED_C_Color_Command_PowerPanel_REQ_Lin2Value:0  # Raw signal data to be transmitted over the LIN bus for the Signal PowerPanel_LED_C_Color_Command
    invalidation-policys:
      data-element=COMTXL_AGS2_PosRq_ECM_AGS2_DEMAND_Lin2, handle-invalid=KEEP
      data-element=COMTXL_AGS2_CalRq_ECM_AGS2_DEMAND_Lin2, handle-invalid=DONT-INVALIDATE
      data-element=COMTXL_AGS2_BoostRq_ECM_AGS2_DEMAND_Lin2, handle-invalid=DONT-INVALIDATE
      data-element=COMTXL_M2SRes2Bit_AGS2_ECM_AGS2_DEMAND_Lin2, handle-invalid=DONT-INVALIDATE
      data-element=COMTXL_M2SResByte{1..3}_AGS2_ECM_AGS2_DEMAND_Lin2, handle-invalid=DONT-INVALIDATE
      data-element=COMTXL_AHP_RPM_REQ_PERCT_AHP_REQ_GLOBAL_Lin2, handle-invalid=KEEP
      data-element=COMTXL_AHP_POST_RUN_REQ_AHP_REQ_GLOBAL_Lin2, handle-invalid=KEEP
      data-element=COMTXL_AHP_FL_SAFE_ACTVT_AHP_REQ_GLOBAL_Lin2, handle-invalid=KEEP
      data-element=COMTXL_BHV_PosRq_BHV_REQ_Lin2, handle-invalid=DONT-INVALIDATE
      data-element=COMTXL_BHV_PosSv_BHV_REQ_Lin2, handle-invalid=DONT-INVALIDATE
      data-element=COMTXL_BHV_CalRq_BHV_REQ_Lin2, handle-invalid=DONT-INVALIDATE
      data-element=COMTXL_CompressorSpdReq_COMP_REQ_Lin2, handle-invalid=KEEP
      data-element=COMTXL_CompEnable_COMP_REQ_Lin2, handle-invalid=KEEP
      data-element=COMTXL_DriveEcohybridLmp_MASTER_ESBM_1_Lin2, handle-invalid=KEEP
      data-element=COMTXL_DriveElectricLmp_MASTER_ESBM_1_Lin2, handle-invalid=KEEP
      data-element=COMTXL_DriveESaveLmp_MASTER_ESBM_1_Lin2, handle-invalid=KEEP
      data-element=COMTXL_DriveSportHybridLmp_MASTER_ESBM_1_Lin2, handle-invalid=KEEP
      data-element=COMTXL_PanelIntensitySts_MASTER_ESBM_1_Lin2, handle-invalid=KEEP
      data-element=COMTXL_DAY_LGT_MD_MASTER_ESBM_1_Lin2, handle-invalid=DONT-INVALIDATE
      data-element=COMTXL_PECP_RPM_REQ_PERCT_PECP_REQ_GLOBAL_Lin2, handle-invalid=KEEP
      data-element=COMTXL_PECP_POST_RUN_REQ_PECP_REQ_GLOBAL_Lin2, handle-invalid=KEEP
      data-element=COMTXL_PECP_FL_SAFE_ACTVT_PECP_REQ_GLOBAL_Lin2, handle-invalid=KEEP
      data-element=COMTXL_PowerPanel_LED_A_Command_PowerPanel_REQ_Lin2, handle-invalid=KEEP
      data-element=COMTXL_PowerPanel_LED_B_Command_PowerPanel_REQ_Lin2, handle-invalid=KEEP
      data-element=COMTXL_DAY_LGT_MD_PowerPanel_PowerPanel_REQ_Lin2, handle-invalid=DONT-INVALIDATE
      data-element=COMTXL_OEXV_PosRq_OEXV_REQ_Lin2, handle-invalid=KEEP
      data-element=COMTXL_OEXV_CalCmd_OEXV_REQ_Lin2, handle-invalid=DONT-INVALIDATE
      data-element=COMTXL_PowerPanel_LED_C_Command_PowerPanel_REQ_Lin2, handle-invalid=KEEP
      data-element=COMTXL_PowerPanel_LED_A_Color_Command_PowerPanel_REQ_Lin2, handle-invalid=DONT-INVALIDATE
      data-element=COMTXL_PowerPanel_LED_B_Color_Command_PowerPanel_REQ_Lin2, handle-invalid=DONT-INVALIDATE
      data-element=COMTXL_PowerPanel_LED_C_Color_Command_PowerPanel_REQ_Lin2, handle-invalid=DONT-INVALIDATE
