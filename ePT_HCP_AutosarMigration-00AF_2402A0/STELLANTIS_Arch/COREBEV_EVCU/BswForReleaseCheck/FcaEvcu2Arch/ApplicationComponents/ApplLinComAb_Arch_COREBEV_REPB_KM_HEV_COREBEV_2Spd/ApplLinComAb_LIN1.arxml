[part 2 of 3: package /STLASWCs]
AUTOSAR XML (schema 00044)
package /STLASWCs  (continued)
  complex device driver sw component type ApplLinComAb_LIN1  (continued)
    behavior IBApplLinComAb_LIN1: data-type-mapping=[MG_LinEquid_Mapping, ADTtoIDTMapping, BswMMappingSet], handle-termination-and-restart=NO-SUPPORT  (continued)
      262 x runnable:
        ApplLinComAb_LIN1Inin: symbol=ApplLinComAb_LIN1_ApplLinComAb_LIN1Inin  # CAN SWC initialization runnable
          data-send-points:
            access DSP_VeLINR_b_LIN1_RequestsPostRun_VeSPLR_b_PostRunRqrdSt: accessed-variable=VeLINR_b_LIN1_RequestsPostRun.VeSPLR_b_PostRunRqrdSt
          mode switch point MSP_ApplLinComAbLin1EquidMN_MDGP_MSI_Lin1Equid: mode-group=ApplLinComAbLin1EquidMN.MDGP_MSI_Lin1Equid
          parameter access CPA_KeCFGR_b_LIN1_Equid_KeCFGR_b_LIN1_Equid: accessed-parameter=KeCFGR_b_LIN1_Equid.KeCFGR_b_LIN1_Equid
        LinsmComModNotifyRdyToPwrDwn: symbol=ApplLinComAb_LIN1_LinsmComModNotifyRdyToPwrDwn  # Runs when all slaves are ready for power down. Notifies AppModeIf LIN is ready for power down.
          data-send-points:
            access DSP_VeLINR_b_LIN1_RequestsPostRun_VeSPLR_b_PostRunRqrdSt: accessed-variable=VeLINR_b_LIN1_RequestsPostRun.VeSPLR_b_PostRunRqrdSt
          mode-access-point mode-group=MdulPwrMod.AppMode_MDGP_ESH_Mode:
            ident MAP_BswM_MSI_ESH_Mode_BswM_MDGP_ESH_Mode
        LinsmComModPostrun: symbol=ApplLinComAb_LIN1_LinsmComModPostrun  # Runs when ECU goes to POSTRUN state. If LIN is not running when POSTRUN is active, this will immediately notify AppModeIf to power down. Keeps LIN from hanging the power down sequence.
          data-send-points:
            access DSP_VeLINR_b_LIN1_RequestsPostRun_VeSPLR_b_PostRunRqrdSt: accessed-variable=VeLINR_b_LIN1_RequestsPostRun.VeSPLR_b_PostRunRqrdSt
          mode-access-point mode-group=MdulPwrMod.AppMode_MDGP_ESH_Mode:
            ident MAP_BswM_MSI_ESH_Mode_BswM_MDGP_ESH_Mode
          mode-access-point mode-group=PP_MS_LinSMComMod.MDGP_MSI_LinSMComMod:
            ident MAP_BswM_MSI_MDG_LinsmComMod_BswM_MDGP_MDG_LinsmComMod
          parameter access CPA_KeCFGR_b_LIN1_Equid_KeCFGR_b_LIN1_Equid: accessed-parameter=KeCFGR_b_LIN1_Equid.KeCFGR_b_LIN1_Equid
          read-local-variables:
            access IRVRA_VeLINR_d_LIN_SlavePrsnt_LIN1: accessed-variable=VeLINR_d_LIN_SlavePrsnt_LIN1
            access IRVRA_VeLINR_d_LIN_SysSts_LIN1: accessed-variable=VeLINR_d_LIN_SysSts_LIN1
        LinsmComModSetScheduleTbl: symbol=ApplLinComAb_LIN1_LinsmComModSetScheduleTbl  # Sets LIN schedule table based on slaves present (equipped or learned).
          data-send-points:
            access DSP_VeLINR_d_LIN_SlavePrsntSts_LIN1_VeLINR_d_LIN_SlavePrsntSts_LIN1: accessed-variable=VeLINR_d_LIN_SlavePrsntSts_LIN1.VeLINR_d_LIN_SlavePrsntSts_LIN1
          mode-access-point mode-group=PP_MS_LinSMComMod.MDGP_MSI_LinSMComMod:
            ident MAP_BswM_MSI_MDG_LinsmComMod_BswM_MDGP_MDG_LinsmComMod
          11 x parameter access:
            CPA_KeCFGR_b_AAD_Equid_KeCFGR_b_AAD_Equid: accessed-parameter=KeCFGR_b_AAD_Equid.KeCFGR_b_AAD_Equid
            CPA_KeCFGR_b_BCP_Equid_KeCFGR_b_BCP_Equid: accessed-parameter=KeCFGR_b_BCP_Equid.KeCFGR_b_BCP_Equid
            CPA_KeCFGR_b_CPV_Equid_KeCFGR_b_CPV_Equid: accessed-parameter=KeCFGR_b_CPV_Equid.KeCFGR_b_CPV_Equid
            CPA_KeCFGR_b_EAH_Equid_KeCFGR_b_EAH_Equid: accessed-parameter=KeCFGR_b_EAH_Equid.KeCFGR_b_EAH_Equid
            CPA_KeCFGR_b_EEXV_Equid_KeCFGR_b_EEXV_Equid: accessed-parameter=KeCFGR_b_EEXV_Equid.KeCFGR_b_EEXV_Equid
            CPA_KeCFGR_b_EOPA_Equid_KeCFGR_b_EOPA_Equid: accessed-parameter=KeCFGR_b_EOPA_Equid.KeCFGR_b_EOPA_Equid
            CPA_KeCFGR_b_EXVM_Equid_KeCFGR_b_EXVM_Equid: accessed-parameter=KeCFGR_b_EXVM_Equid.KeCFGR_b_EXVM_Equid
            CPA_KeCFGR_b_LIN1_Equid_KeCFGR_b_LIN1_Equid: accessed-parameter=KeCFGR_b_LIN1_Equid.KeCFGR_b_LIN1_Equid
            CPA_KeCFGR_b_LTRBV_Equid_KeCFGR_b_LTRBV_Equid: accessed-parameter=KeCFGR_b_LTRBV_Equid.KeCFGR_b_LTRBV_Equid
            CPA_KeLINR_y_LIN1SwtSchdTbl_KeLINR_y_LIN1SwtSchdTbl: accessed-parameter=KeLINR_y_LIN1SwtSchdTbl.KeLINR_y_LIN1SwtSchdTbl
            CPA_KeCFGR_b_HTRBV_Equid_KeCFGR_b_HTRBV_Equid: accessed-parameter=KeCFGR_b_HTRBV_Equid.KeCFGR_b_HTRBV_Equid
          read-local-variables:
            access IRVRA_VeLINR_d_LIN_SlavePrsnt_LIN1: accessed-variable=VeLINR_d_LIN_SlavePrsnt_LIN1
            access IRVRA_VeLINR_d_LIN_SysSts_LIN1: accessed-variable=VeLINR_d_LIN_SysSts_LIN1
          written-local-variables:
            access IRVWA_VeLINR_d_LIN_SlavePrsnt_LIN1: accessed-variable=VeLINR_d_LIN_SlavePrsnt_LIN1
            access IRVWA_VeLINR_d_LIN_SysSts_LIN1: accessed-variable=VeLINR_d_LIN_SysSts_LIN1
        SendLINR_AAD_PosRq: can-be-invoked-concurrently=true, symbol=ApplLinComAb_LIN1_SendLINR_AAD_PosRq  # Transmit
          data-receive-point-by-arguments:
            access DRP_SendLINR_AAD_PosRq_SendLINR_AAD_PosRq: accessed-variable=SendLINR_AAD_PosRq.SendLINR_AAD_PosRq
            access DRP_SendLINR_AAD_PosRqVld_SendLINR_AAD_PosRqVld: accessed-variable=SendLINR_AAD_PosRqVld.SendLINR_AAD_PosRqVld
          data-send-points:
            access DSP_Lin1ComTxSignalsSR_COMTXL_AAD_PosRq_ECM_AAD_DEMAND_Lin1: accessed-variable=Lin1ComTxSignalsSR.COMTXL_AAD_PosRq_ECM_AAD_DEMAND_Lin1
        SendLINR_AAD_CalRq: can-be-invoked-concurrently=true, symbol=ApplLinComAb_LIN1_SendLINR_AAD_CalRq  # Transmit
          data-receive-point-by-arguments:
            access DRP_SendLINR_AAD_CalRq_SendLINR_AAD_CalRq: accessed-variable=SendLINR_AAD_CalRq.SendLINR_AAD_CalRq
            access DRP_SendLINR_AAD_CalRqVld_SendLINR_AAD_CalRqVld: accessed-variable=SendLINR_AAD_CalRqVld.SendLINR_AAD_CalRqVld
          data-send-points:
            access DSP_Lin1ComTxSignalsSR_COMTXL_AAD_CalRq_ECM_AAD_DEMAND_Lin1: accessed-variable=Lin1ComTxSignalsSR.COMTXL_AAD_CalRq_ECM_AAD_DEMAND_Lin1
        SendLINR_AAD_InitialIP_CalRq: can-be-invoked-concurrently=true, symbol=ApplLinComAb_LIN1_SendLINR_AAD_InitialIP_CalRq  # Transmit
          data-receive-point-by-arguments:
            access DRP_SendLINR_AAD_InitialIP_CalRq_SendLINR_AAD_InitialIP_CalRq: accessed-variable=SendLINR_AAD_InitialIP_CalRq.SendLINR_AAD_InitialIP_CalRq
            access DRP_SendLINR_AAD_InitialIP_CalRqVld_SendLINR_AAD_InitialIP_CalRqVld: accessed-variable=SendLINR_AAD_InitialIP_CalRqVld.SendLINR_AAD_InitialIP_CalRqVld
          data-send-points:
            access DSP_Lin1ComTxSignalsSR_COMTXL_AAD_InitialIP_CalRq_ECM_AAD_DEMAND_Lin1: accessed-variable=Lin1ComTxSignalsSR.COMTXL_AAD_InitialIP_CalRq_ECM_AAD_DEMAND_Lin1
        SendLINR_BCP_RPM_REQ: can-be-invoked-concurrently=true, symbol=ApplLinComAb_LIN1_SendLINR_BCP_RPM_REQ  # Transmit
          data-receive-point-by-arguments:
            access DRP_SendLINR_BCP_RPM_REQ_SendLINR_BCP_RPM_REQ: accessed-variable=SendLINR_BCP_RPM_REQ.SendLINR_BCP_RPM_REQ
            access DRP_SendLINR_BCP_RPM_REQ_Vld_SendLINR_BCP_RPM_REQ_Vld: accessed-variable=SendLINR_BCP_RPM_REQ_Vld.SendLINR_BCP_RPM_REQ_Vld
          data-send-points:
            access DSP_Lin1ComTxSignalsSR_COMTXL_BCP_RPM_REQ_BCP_REQ_Lin1: accessed-variable=Lin1ComTxSignalsSR.COMTXL_BCP_RPM_REQ_BCP_REQ_Lin1
        SendLINR_BCP_POST_RUN_REQ: can-be-invoked-concurrently=true, symbol=ApplLinComAb_LIN1_SendLINR_BCP_POST_RUN_REQ  # Transmit
          data-receive-point-by-arguments:
            access DRP_SendLINR_BCP_POST_RUN_REQ_SendLINR_BCP_POST_RUN_REQ: accessed-variable=SendLINR_BCP_POST_RUN_REQ.SendLINR_BCP_POST_RUN_REQ
            access DRP_SendLINR_BCP_POST_RUN_REQ_Vld_SendLINR_BCP_POST_RUN_REQ_Vld: accessed-variable=SendLINR_BCP_POST_RUN_REQ_Vld.SendLINR_BCP_POST_RUN_REQ_Vld
          data-send-points:
            access DSP_Lin1ComTxSignalsSR_COMTXL_BCP_POST_RUN_REQ_BCP_REQ_Lin1: accessed-variable=Lin1ComTxSignalsSR.COMTXL_BCP_POST_RUN_REQ_BCP_REQ_Lin1
        SendLINR_BCP_FL_SAFE_ACTVT: can-be-invoked-concurrently=true, symbol=ApplLinComAb_LIN1_SendLINR_BCP_FL_SAFE_ACTVT  # Transmit
          data-receive-point-by-arguments:
            access DRP_SendLINR_BCP_FL_SAFE_ACTVT_SendLINR_BCP_FL_SAFE_ACTVT: accessed-variable=SendLINR_BCP_FL_SAFE_ACTVT.SendLINR_BCP_FL_SAFE_ACTVT
            access DRP_SendLINR_BCP_FL_SAFE_ACTVT_Vld_SendLINR_BCP_FL_SAFE_ACTVT_Vld: accessed-variable=SendLINR_BCP_FL_SAFE_ACTVT_Vld.SendLINR_BCP_FL_SAFE_ACTVT_Vld
          data-send-points:
            access DSP_Lin1ComTxSignalsSR_COMTXL_BCP_FL_SAFE_ACTVT_BCP_REQ_Lin1: accessed-variable=Lin1ComTxSignalsSR.COMTXL_BCP_FL_SAFE_ACTVT_BCP_REQ_Lin1
        SendLINR_CPV_PosRq: can-be-invoked-concurrently=true, symbol=ApplLinComAb_LIN1_SendLINR_CPV_PosRq  # Transmit
          data-receive-point-by-arguments:
            access DRP_SendLINR_CPV_PosRq_SendLINR_CPV_PosRq: accessed-variable=SendLINR_CPV_PosRq.SendLINR_CPV_PosRq
            access DRP_SendLINR_CPV_PosRqVld_SendLINR_CPV_PosRqVld: accessed-variable=SendLINR_CPV_PosRqVld.SendLINR_CPV_PosRqVld
          data-send-points:
            access DSP_Lin1ComTxSignalsSR_COMTXL_CPV_PosRq_CPV_REQ_Lin1: accessed-variable=Lin1ComTxSignalsSR.COMTXL_CPV_PosRq_CPV_REQ_Lin1
        SendLINR_CPV_PosSv: can-be-invoked-concurrently=true, symbol=ApplLinComAb_LIN1_SendLINR_CPV_PosSv  # Transmit
          data-receive-point-by-arguments:
            access DRP_SendLINR_CPV_PosSv_SendLINR_CPV_PosSv: accessed-variable=SendLINR_CPV_PosSv.SendLINR_CPV_PosSv
            access DRP_SendLINR_CPV_PosSvVld_SendLINR_CPV_PosSvVld: accessed-variable=SendLINR_CPV_PosSvVld.SendLINR_CPV_PosSvVld
          data-send-points:
            access DSP_Lin1ComTxSignalsSR_COMTXL_CPV_PosSv_CPV_REQ_Lin1: accessed-variable=Lin1ComTxSignalsSR.COMTXL_CPV_PosSv_CPV_REQ_Lin1
        SendLINR_CPV_CalRq: can-be-invoked-concurrently=true, symbol=ApplLinComAb_LIN1_SendLINR_CPV_CalRq  # Transmit
          data-receive-point-by-arguments:
            access DRP_SendLINR_CPV_CalRq_SendLINR_CPV_CalRq: accessed-variable=SendLINR_CPV_CalRq.SendLINR_CPV_CalRq
            access DRP_SendLINR_CPV_CalRqVld_SendLINR_CPV_CalRqVld: accessed-variable=SendLINR_CPV_CalRqVld.SendLINR_CPV_CalRqVld
          data-send-points:
            access DSP_Lin1ComTxSignalsSR_COMTXL_CPV_CalRq_CPV_REQ_Lin1: accessed-variable=Lin1ComTxSignalsSR.COMTXL_CPV_CalRq_CPV_REQ_Lin1
        SendLINR_AirHeatrPwrTgt: can-be-invoked-concurrently=true, symbol=ApplLinComAb_LIN1_SendLINR_AirHeatrPwrTgt  # Transmit
          data-receive-point-by-arguments:
            access DRP_SendLINR_AirHeatrPwrTgt_SendLINR_AirHeatrPwrTgt: accessed-variable=SendLINR_AirHeatrPwrTgt.SendLINR_AirHeatrPwrTgt
            access DRP_SendLINR_AirHeatrPwrTgtVld_SendLINR_AirHeatrPwrTgtVld: accessed-variable=SendLINR_AirHeatrPwrTgtVld.SendLINR_AirHeatrPwrTgtVld
          data-send-points:
            access DSP_Lin1ComTxSignalsSR_COMTXL_AirHeatrPwrTgt_HVEAHLIN18Fr03_Lin1: accessed-variable=Lin1ComTxSignalsSR.COMTXL_AirHeatrPwrTgt_HVEAHLIN18Fr03_Lin1
        SendLINR_AirHeatrEnad: can-be-invoked-concurrently=true, symbol=ApplLinComAb_LIN1_SendLINR_AirHeatrEnad  # Transmit
          data-receive-point-by-arguments:
            access DRP_SendLINR_AirHeatrEnad_SendLINR_AirHeatrEnad: accessed-variable=SendLINR_AirHeatrEnad.SendLINR_AirHeatrEnad
            access DRP_SendLINR_AirHeatrEnadVld_SendLINR_AirHeatrEnadVld: accessed-variable=SendLINR_AirHeatrEnadVld.SendLINR_AirHeatrEnadVld
          data-send-points:
            access DSP_Lin1ComTxSignalsSR_COMTXL_AirHeatrEnad_HVEAHLIN18Fr03_Lin1: accessed-variable=Lin1ComTxSignalsSR.COMTXL_AirHeatrEnad_HVEAHLIN18Fr03_Lin1
        SendLINR_EOPA_RPM_COM: can-be-invoked-concurrently=true, symbol=ApplLinComAb_LIN1_SendLINR_EOPA_RPM_COM  # Transmit
          data-receive-point-by-arguments:
            access DRP_SendLINR_EOPA_RPM_COM_SendLINR_EOPA_RPM_COM: accessed-variable=SendLINR_EOPA_RPM_COM.SendLINR_EOPA_RPM_COM
            access DRP_SendLINR_EOPA_RPM_COM_Vld_SendLINR_EOPA_RPM_COM_Vld: accessed-variable=SendLINR_EOPA_RPM_COM_Vld.SendLINR_EOPA_RPM_COM_Vld
          data-send-points:
            access DSP_Lin1ComTxSignalsSR_COMTXL_EOPA_RPM_COM_EOPA_REQ_Lin1: accessed-variable=Lin1ComTxSignalsSR.COMTXL_EOPA_RPM_COM_EOPA_REQ_Lin1
        SendLINR_EOPA_POST_RUN_COM: can-be-invoked-concurrently=true, symbol=ApplLinComAb_LIN1_SendLINR_EOPA_POST_RUN_COM  # Transmit
          data-receive-point-by-arguments:
            access DRP_SendLINR_EOPA_POST_RUN_COM_SendLINR_EOPA_POST_RUN_COM: accessed-variable=SendLINR_EOPA_POST_RUN_COM.SendLINR_EOPA_POST_RUN_COM
            access DRP_SendLINR_EOPA_POST_RUN_COM_Vld_SendLINR_EOPA_POST_RUN_COM_Vld: accessed-variable=SendLINR_EOPA_POST_RUN_COM_Vld.SendLINR_EOPA_POST_RUN_COM_Vld
          data-send-points:
            access DSP_Lin1ComTxSignalsSR_COMTXL_EOPA_POST_RUN_COM_EOPA_REQ_Lin1: accessed-variable=Lin1ComTxSignalsSR.COMTXL_EOPA_POST_RUN_COM_EOPA_REQ_Lin1
        SendLINR_LTRBV_PosRq: can-be-invoked-concurrently=true, symbol=ApplLinComAb_LIN1_SendLINR_LTRBV_PosRq  # Transmit
          data-receive-point-by-arguments:
            access DRP_SendLINR_LTRBV_PosRq_SendLINR_LTRBV_PosRq: accessed-variable=SendLINR_LTRBV_PosRq.SendLINR_LTRBV_PosRq
            access DRP_SendLINR_LTRBV_PosRqVld_SendLINR_LTRBV_PosRqVld: accessed-variable=SendLINR_LTRBV_PosRqVld.SendLINR_LTRBV_PosRqVld
          data-send-points:
            access DSP_Lin1ComTxSignalsSR_COMTXL_LTRBV_PosRq_LTRBV_REQ_Lin1: accessed-variable=Lin1ComTxSignalsSR.COMTXL_LTRBV_PosRq_LTRBV_REQ_Lin1
        SendLINR_LTRBV_PosSv: can-be-invoked-concurrently=true, symbol=ApplLinComAb_LIN1_SendLINR_LTRBV_PosSv  # Transmit
          data-receive-point-by-arguments:
            access DRP_SendLINR_LTRBV_PosSv_SendLINR_LTRBV_PosSv: accessed-variable=SendLINR_LTRBV_PosSv.SendLINR_LTRBV_PosSv
            access DRP_SendLINR_LTRBV_PosSvVld_SendLINR_LTRBV_PosSvVld: accessed-variable=SendLINR_LTRBV_PosSvVld.SendLINR_LTRBV_PosSvVld
          data-send-points:
            access DSP_Lin1ComTxSignalsSR_COMTXL_LTRBV_PosSv_LTRBV_REQ_Lin1: accessed-variable=Lin1ComTxSignalsSR.COMTXL_LTRBV_PosSv_LTRBV_REQ_Lin1
        SendLINR_LTRBV_CalRq: can-be-invoked-concurrently=true, symbol=ApplLinComAb_LIN1_SendLINR_LTRBV_CalRq  # Transmit
          data-receive-point-by-arguments:
            access DRP_SendLINR_LTRBV_CalRq_SendLINR_LTRBV_CalRq: accessed-variable=SendLINR_LTRBV_CalRq.SendLINR_LTRBV_CalRq
            access DRP_SendLINR_LTRBV_CalRqVld_SendLINR_LTRBV_CalRqVld: accessed-variable=SendLINR_LTRBV_CalRqVld.SendLINR_LTRBV_CalRqVld
          data-send-points:
            access DSP_Lin1ComTxSignalsSR_COMTXL_LTRBV_CalRq_LTRBV_REQ_Lin1: accessed-variable=Lin1ComTxSignalsSR.COMTXL_LTRBV_CalRq_LTRBV_REQ_Lin1
        SignalLINR_AAD_RdyForSleep: symbol=ApplLinComAb_LIN1_SignalLINR_AAD_RdyForSleep  # AAD is ready for sleep. Set it's bit in Lin slave ready to sleep.Transmit
          data-receive-point-by-arguments:
            access DRP_SignalLINR_AAD_RdyForSleep_SignalLINR_AAD_RdyForSleep: accessed-variable=SignalLINR_AAD_RdyForSleep.SignalLINR_AAD_RdyForSleep
          mode-access-point mode-group=MdulPwrMod.AppMode_MDGP_ESH_Mode:
            ident MAP_MdulPwrMod_AppMode_MDGP_ESH_Mode
          parameter access CPA_KeCFGR_b_LIN1_Equid: accessed-parameter=KeCFGR_b_LIN1_Equid.KeCFGR_b_LIN1_Equid
          read-local-variables:
            access IRVRA_VeLINR_d_LIN_SlavePrsnt_LIN1: accessed-variable=VeLINR_d_LIN_SlavePrsnt_LIN1
            access IRVRA_VeLINR_d_LIN_SlaveRdyToSleep_LIN1: accessed-variable=VeLINR_d_LIN_SlaveRdyToSleep_LIN1
          sync call SSCP_GetRteMode_GetMODR_b_InPostRunMode: operation=GetRteMode.GetMODR_b_InPostRunMode, timeout=0.01
          written-local-variables:
            access IRVWA_VeLINR_d_LIN_SlaveRdyToSleep_LIN1: accessed-variable=VeLINR_d_LIN_SlaveRdyToSleep_LIN1
        SignalLINR_BCP_RdyForSleep: symbol=ApplLinComAb_LIN1_SignalLINR_BCP_RdyForSleep  # BCP is ready for sleep. Set it's bit in Lin slave ready to sleep.Transmit
          data-receive-point-by-arguments:
            access DRP_SignalLINR_BCP_RdyForSleep_SignalLINR_BCP_RdyForSleep: accessed-variable=SignalLINR_BCP_RdyForSleep.SignalLINR_BCP_RdyForSleep
          mode-access-point mode-group=MdulPwrMod.AppMode_MDGP_ESH_Mode:
            ident MAP_MdulPwrMod_AppMode_MDGP_ESH_Mode
          parameter access CPA_KeCFGR_b_LIN1_Equid: accessed-parameter=KeCFGR_b_LIN1_Equid.KeCFGR_b_LIN1_Equid
          read-local-variables:
            access IRVRA_VeLINR_d_LIN_SlavePrsnt_LIN1: accessed-variable=VeLINR_d_LIN_SlavePrsnt_LIN1
            access IRVRA_VeLINR_d_LIN_SlaveRdyToSleep_LIN1: accessed-variable=VeLINR_d_LIN_SlaveRdyToSleep_LIN1
          sync call SSCP_GetRteMode_GetMODR_b_InPostRunMode: operation=GetRteMode.GetMODR_b_InPostRunMode, timeout=0.01
          written-local-variables:
            access IRVWA_VeLINR_d_LIN_SlaveRdyToSleep_LIN1: accessed-variable=VeLINR_d_LIN_SlaveRdyToSleep_LIN1
        SignalLINR_CPV_RdyForSleep: symbol=ApplLinComAb_LIN1_SignalLINR_CPV_RdyForSleep  # CPV is ready for sleep. Set it's bit in Lin slave ready to sleep.Transmit
          data-receive-point-by-arguments:
            access DRP_SignalLINR_CPV_RdyForSleep_SignalLINR_CPV_RdyForSleep: accessed-variable=SignalLINR_CPV_RdyForSleep.SignalLINR_CPV_RdyForSleep
          mode-access-point mode-group=MdulPwrMod.AppMode_MDGP_ESH_Mode:
            ident MAP_MdulPwrMod_AppMode_MDGP_ESH_Mode
          parameter access CPA_KeCFGR_b_LIN1_Equid: accessed-parameter=KeCFGR_b_LIN1_Equid.KeCFGR_b_LIN1_Equid
          read-local-variables:
            access IRVRA_VeLINR_d_LIN_SlavePrsnt_LIN1: accessed-variable=VeLINR_d_LIN_SlavePrsnt_LIN1
            access IRVRA_VeLINR_d_LIN_SlaveRdyToSleep_LIN1: accessed-variable=VeLINR_d_LIN_SlaveRdyToSleep_LIN1
          sync call SSCP_GetRteMode_GetMODR_b_InPostRunMode: operation=GetRteMode.GetMODR_b_InPostRunMode, timeout=0.01
          written-local-variables:
            access IRVWA_VeLINR_d_LIN_SlaveRdyToSleep_LIN1: accessed-variable=VeLINR_d_LIN_SlaveRdyToSleep_LIN1
        SignalLINR_EAH_RdyForSleep: symbol=ApplLinComAb_LIN1_SignalLINR_EAH_RdyForSleep  # EAH is ready for sleep. Set it's bit in Lin slave ready to sleep.Transmit
          data-receive-point-by-arguments:
            access DRP_SignalLINR_EAH_RdyForSleep_SignalLINR_EAH_RdyForSleep: accessed-variable=SignalLINR_EAH_RdyForSleep.SignalLINR_EAH_RdyForSleep
          mode-access-point mode-group=MdulPwrMod.AppMode_MDGP_ESH_Mode:
            ident MAP_MdulPwrMod_AppMode_MDGP_ESH_Mode
          parameter access CPA_KeCFGR_b_LIN1_Equid: accessed-parameter=KeCFGR_b_LIN1_Equid.KeCFGR_b_LIN1_Equid
          read-local-variables:
            access IRVRA_VeLINR_d_LIN_SlavePrsnt_LIN1: accessed-variable=VeLINR_d_LIN_SlavePrsnt_LIN1
            access IRVRA_VeLINR_d_LIN_SlaveRdyToSleep_LIN1: accessed-variable=VeLINR_d_LIN_SlaveRdyToSleep_LIN1
          sync call SSCP_GetRteMode_GetMODR_b_InPostRunMode: operation=GetRteMode.GetMODR_b_InPostRunMode, timeout=0.01
          written-local-variables:
            access IRVWA_VeLINR_d_LIN_SlaveRdyToSleep_LIN1: accessed-variable=VeLINR_d_LIN_SlaveRdyToSleep_LIN1
        SignalLINR_EEXV_RdyForSleep: symbol=ApplLinComAb_LIN1_SignalLINR_EEXV_RdyForSleep  # EEXV is ready for sleep. Set it's bit in Lin slave ready to sleep.Transmit
          data-receive-point-by-arguments:
            access DRP_SignalLINR_EEXV_RdyForSleep_SignalLINR_EEXV_RdyForSleep: accessed-variable=SignalLINR_EEXV_RdyForSleep.SignalLINR_EEXV_RdyForSleep
          mode-access-point mode-group=MdulPwrMod.AppMode_MDGP_ESH_Mode:
            ident MAP_MdulPwrMod_AppMode_MDGP_ESH_Mode
          parameter access CPA_KeCFGR_b_LIN1_Equid: accessed-parameter=KeCFGR_b_LIN1_Equid.KeCFGR_b_LIN1_Equid
          read-local-variables:
            access IRVRA_VeLINR_d_LIN_SlavePrsnt_LIN1: accessed-variable=VeLINR_d_LIN_SlavePrsnt_LIN1
            access IRVRA_VeLINR_d_LIN_SlaveRdyToSleep_LIN1: accessed-variable=VeLINR_d_LIN_SlaveRdyToSleep_LIN1
          sync call SSCP_GetRteMode_GetMODR_b_InPostRunMode: operation=GetRteMode.GetMODR_b_InPostRunMode, timeout=0.01
          written-local-variables:
            access IRVWA_VeLINR_d_LIN_SlaveRdyToSleep_LIN1: accessed-variable=VeLINR_d_LIN_SlaveRdyToSleep_LIN1
        SignalLINR_EOPA_RdyForSleep: symbol=ApplLinComAb_LIN1_SignalLINR_EOPA_RdyForSleep  # EOPA is ready for sleep. Set it's bit in Lin slave ready to sleep.Transmit
          data-receive-point-by-arguments:
            access DRP_SignalLINR_EOPA_RdyForSleep_SignalLINR_EOPA_RdyForSleep: accessed-variable=SignalLINR_EOPA_RdyForSleep.SignalLINR_EOPA_RdyForSleep
          mode-access-point mode-group=MdulPwrMod.AppMode_MDGP_ESH_Mode:
            ident MAP_MdulPwrMod_AppMode_MDGP_ESH_Mode
          parameter access CPA_KeCFGR_b_LIN1_Equid: accessed-parameter=KeCFGR_b_LIN1_Equid.KeCFGR_b_LIN1_Equid
          read-local-variables:
            access IRVRA_VeLINR_d_LIN_SlavePrsnt_LIN1: accessed-variable=VeLINR_d_LIN_SlavePrsnt_LIN1
            access IRVRA_VeLINR_d_LIN_SlaveRdyToSleep_LIN1: accessed-variable=VeLINR_d_LIN_SlaveRdyToSleep_LIN1
          sync call SSCP_GetRteMode_GetMODR_b_InPostRunMode: operation=GetRteMode.GetMODR_b_InPostRunMode, timeout=0.01
          written-local-variables:
            access IRVWA_VeLINR_d_LIN_SlaveRdyToSleep_LIN1: accessed-variable=VeLINR_d_LIN_SlaveRdyToSleep_LIN1
        SignalLINR_LTRBV_RdyForSleep: symbol=ApplLinComAb_LIN1_SignalLINR_LTRBV_RdyForSleep  # LTRBV is ready for sleep. Set it's bit in Lin slave ready to sleep.Transmit
          data-receive-point-by-arguments:
            access DRP_SignalLINR_LTRBV_RdyForSleep_SignalLINR_LTRBV_RdyForSleep: accessed-variable=SignalLINR_LTRBV_RdyForSleep.SignalLINR_LTRBV_RdyForSleep
          mode-access-point mode-group=MdulPwrMod.AppMode_MDGP_ESH_Mode:
            ident MAP_MdulPwrMod_AppMode_MDGP_ESH_Mode
          parameter access CPA_KeCFGR_b_LIN1_Equid: accessed-parameter=KeCFGR_b_LIN1_Equid.KeCFGR_b_LIN1_Equid
          read-local-variables:
            access IRVRA_VeLINR_d_LIN_SlavePrsnt_LIN1: accessed-variable=VeLINR_d_LIN_SlavePrsnt_LIN1
            access IRVRA_VeLINR_d_LIN_SlaveRdyToSleep_LIN1: accessed-variable=VeLINR_d_LIN_SlaveRdyToSleep_LIN1
          sync call SSCP_GetRteMode_GetMODR_b_InPostRunMode: operation=GetRteMode.GetMODR_b_InPostRunMode, timeout=0.01
          written-local-variables:
            access IRVWA_VeLINR_d_LIN_SlaveRdyToSleep_LIN1: accessed-variable=VeLINR_d_LIN_SlaveRdyToSleep_LIN1
        COMRXL_AAD_CurrPos_AAD_ECM_STATUS_Lin1_Received: symbol=ApplLinComAb_LIN1_COMRXL_AAD_CurrPos_AAD_ECM_STATUS_Lin1_Received  # Received -
          data-receive-point-by-arguments:
            access DRP_Lin1ComRxSignalsSR_COMRXL_AAD_CurrPos_AAD_ECM_STATUS_Lin1: accessed-variable=Lin1ComRxSignalsSR.COMRXL_AAD_CurrPos_AAD_ECM_STATUS_Lin1
          data-send-points:
            access DSP_VeLINR_e_AAD_CurrPos_VeLINR_e_AAD_CurrPos: accessed-variable=VeLINR_e_AAD_CurrPos.VeLINR_e_AAD_CurrPos
            access DSP_VeLINR_b_AAD_CurrPosTO_VeLINR_b_AAD_CurrPosTO: accessed-variable=VeLINR_b_AAD_CurrPosTO.VeLINR_b_AAD_CurrPosTO
        COMRXL_AAD_CurrPos_AAD_ECM_STATUS_Lin1_Error: symbol=ApplLinComAb_LIN1_COMRXL_AAD_CurrPos_AAD_ECM_STATUS_Lin1_Error  # Error -
          data-receive-point-by-arguments:
            access DRP_Lin1ComRxSignalsSR_COMRXL_AAD_CurrPos_AAD_ECM_STATUS_Lin1: accessed-variable=Lin1ComRxSignalsSR.COMRXL_AAD_CurrPos_AAD_ECM_STATUS_Lin1
          data-send-points:
            access DSP_VeLINR_e_AAD_CurrPos_VeLINR_e_AAD_CurrPos: accessed-variable=VeLINR_e_AAD_CurrPos.VeLINR_e_AAD_CurrPos
            access DSP_VeLINR_b_AAD_CurrPosTO_VeLINR_b_AAD_CurrPosTO: accessed-variable=VeLINR_b_AAD_CurrPosTO.VeLINR_b_AAD_CurrPosTO
          read-local-variables:
            access IRVRA_VeLINR_d_LIN_SlavePrsnt_LIN1: accessed-variable=VeLINR_d_LIN_SlavePrsnt_LIN1
        COMRXL_AAD_CalStat_AAD_ECM_STATUS_Lin1_Received: symbol=ApplLinComAb_LIN1_COMRXL_AAD_CalStat_AAD_ECM_STATUS_Lin1_Received  # Received -
          data-receive-point-by-arguments:
            access DRP_Lin1ComRxSignalsSR_COMRXL_AAD_CalStat_AAD_ECM_STATUS_Lin1: accessed-variable=Lin1ComRxSignalsSR.COMRXL_AAD_CalStat_AAD_ECM_STATUS_Lin1
          data-send-points:
            access DSP_VeLINR_b_AAD_CalStat_VeLINR_b_AAD_CalStat: accessed-variable=VeLINR_b_AAD_CalStat.VeLINR_b_AAD_CalStat
            access DSP_VeLINR_b_AAD_CalStatTO_VeLINR_b_AAD_CalStatTO: accessed-variable=VeLINR_b_AAD_CalStatTO.VeLINR_b_AAD_CalStatTO
        COMRXL_AAD_CalStat_AAD_ECM_STATUS_Lin1_Error: symbol=ApplLinComAb_LIN1_COMRXL_AAD_CalStat_AAD_ECM_STATUS_Lin1_Error  # Error -
          data-receive-point-by-arguments:
            access DRP_Lin1ComRxSignalsSR_COMRXL_AAD_CalStat_AAD_ECM_STATUS_Lin1: accessed-variable=Lin1ComRxSignalsSR.COMRXL_AAD_CalStat_AAD_ECM_STATUS_Lin1
          data-send-points:
            access DSP_VeLINR_b_AAD_CalStat_VeLINR_b_AAD_CalStat: accessed-variable=VeLINR_b_AAD_CalStat.VeLINR_b_AAD_CalStat
            access DSP_VeLINR_b_AAD_CalStatTO_VeLINR_b_AAD_CalStatTO: accessed-variable=VeLINR_b_AAD_CalStatTO.VeLINR_b_AAD_CalStatTO
          read-local-variables:
            access IRVRA_VeLINR_d_LIN_SlavePrsnt_LIN1: accessed-variable=VeLINR_d_LIN_SlavePrsnt_LIN1
        COMRXL_AAD_CalActv_AAD_ECM_STATUS_Lin1_Received: symbol=ApplLinComAb_LIN1_COMRXL_AAD_CalActv_AAD_ECM_STATUS_Lin1_Received  # Received -
          data-receive-point-by-arguments:
            access DRP_Lin1ComRxSignalsSR_COMRXL_AAD_CalActv_AAD_ECM_STATUS_Lin1: accessed-variable=Lin1ComRxSignalsSR.COMRXL_AAD_CalActv_AAD_ECM_STATUS_Lin1
          data-send-points:
            access DSP_VeLINR_b_AAD_CalActv_VeLINR_b_AAD_CalActv: accessed-variable=VeLINR_b_AAD_CalActv.VeLINR_b_AAD_CalActv
            access DSP_VeLINR_b_AAD_CalActvTO_VeLINR_b_AAD_CalActvTO: accessed-variable=VeLINR_b_AAD_CalActvTO.VeLINR_b_AAD_CalActvTO
        COMRXL_AAD_CalActv_AAD_ECM_STATUS_Lin1_Error: symbol=ApplLinComAb_LIN1_COMRXL_AAD_CalActv_AAD_ECM_STATUS_Lin1_Error  # Error -
          data-receive-point-by-arguments:
            access DRP_Lin1ComRxSignalsSR_COMRXL_AAD_CalActv_AAD_ECM_STATUS_Lin1: accessed-variable=Lin1ComRxSignalsSR.COMRXL_AAD_CalActv_AAD_ECM_STATUS_Lin1
          data-send-points:
            access DSP_VeLINR_b_AAD_CalActv_VeLINR_b_AAD_CalActv: accessed-variable=VeLINR_b_AAD_CalActv.VeLINR_b_AAD_CalActv
            access DSP_VeLINR_b_AAD_CalActvTO_VeLINR_b_AAD_CalActvTO: accessed-variable=VeLINR_b_AAD_CalActvTO.VeLINR_b_AAD_CalActvTO
          read-local-variables:
            access IRVRA_VeLINR_d_LIN_SlavePrsnt_LIN1: accessed-variable=VeLINR_d_LIN_SlavePrsnt_LIN1
        COMRXL_AAD_ErrUnVolt_AAD_ECM_STATUS_Lin1_Received: symbol=ApplLinComAb_LIN1_COMRXL_AAD_ErrUnVolt_AAD_ECM_STATUS_Lin1_Received  # Received -
          data-receive-point-by-arguments:
            access DRP_Lin1ComRxSignalsSR_COMRXL_AAD_ErrUnVolt_AAD_ECM_STATUS_Lin1: accessed-variable=Lin1ComRxSignalsSR.COMRXL_AAD_ErrUnVolt_AAD_ECM_STATUS_Lin1
          data-send-points:
            access DSP_VeLINR_b_AAD_ErrUnVolt_VeLINR_b_AAD_ErrUnVolt: accessed-variable=VeLINR_b_AAD_ErrUnVolt.VeLINR_b_AAD_ErrUnVolt
            access DSP_VeLINR_b_AAD_ErrUnVoltTO_VeLINR_b_AAD_ErrUnVoltTO: accessed-variable=VeLINR_b_AAD_ErrUnVoltTO.VeLINR_b_AAD_ErrUnVoltTO
        COMRXL_AAD_ErrUnVolt_AAD_ECM_STATUS_Lin1_Error: symbol=ApplLinComAb_LIN1_COMRXL_AAD_ErrUnVolt_AAD_ECM_STATUS_Lin1_Error  # Error -
          data-receive-point-by-arguments:
            access DRP_Lin1ComRxSignalsSR_COMRXL_AAD_ErrUnVolt_AAD_ECM_STATUS_Lin1: accessed-variable=Lin1ComRxSignalsSR.COMRXL_AAD_ErrUnVolt_AAD_ECM_STATUS_Lin1
          data-send-points:
            access DSP_VeLINR_b_AAD_ErrUnVolt_VeLINR_b_AAD_ErrUnVolt: accessed-variable=VeLINR_b_AAD_ErrUnVolt.VeLINR_b_AAD_ErrUnVolt
            access DSP_VeLINR_b_AAD_ErrUnVoltTO_VeLINR_b_AAD_ErrUnVoltTO: accessed-variable=VeLINR_b_AAD_ErrUnVoltTO.VeLINR_b_AAD_ErrUnVoltTO
          read-local-variables:
            access IRVRA_VeLINR_d_LIN_SlavePrsnt_LIN1: accessed-variable=VeLINR_d_LIN_SlavePrsnt_LIN1
        COMRXL_AAD_ErrOvrVolt_AAD_ECM_STATUS_Lin1_Received: symbol=ApplLinComAb_LIN1_COMRXL_AAD_ErrOvrVolt_AAD_ECM_STATUS_Lin1_Received  # Received -
          data-receive-point-by-arguments:
            access DRP_Lin1ComRxSignalsSR_COMRXL_AAD_ErrOvrVolt_AAD_ECM_STATUS_Lin1: accessed-variable=Lin1ComRxSignalsSR.COMRXL_AAD_ErrOvrVolt_AAD_ECM_STATUS_Lin1
          data-send-points:
            access DSP_VeLINR_b_AAD_ErrOvrVolt_VeLINR_b_AAD_ErrOvrVolt: accessed-variable=VeLINR_b_AAD_ErrOvrVolt.VeLINR_b_AAD_ErrOvrVolt
            access DSP_VeLINR_b_AAD_ErrOvrVoltTO_VeLINR_b_AAD_ErrOvrVoltTO: accessed-variable=VeLINR_b_AAD_ErrOvrVoltTO.VeLINR_b_AAD_ErrOvrVoltTO
        COMRXL_AAD_ErrOvrVolt_AAD_ECM_STATUS_Lin1_Error: symbol=ApplLinComAb_LIN1_COMRXL_AAD_ErrOvrVolt_AAD_ECM_STATUS_Lin1_Error  # Error -
          data-receive-point-by-arguments:
            access DRP_Lin1ComRxSignalsSR_COMRXL_AAD_ErrOvrVolt_AAD_ECM_STATUS_Lin1: accessed-variable=Lin1ComRxSignalsSR.COMRXL_AAD_ErrOvrVolt_AAD_ECM_STATUS_Lin1
          data-send-points:
            access DSP_VeLINR_b_AAD_ErrOvrVolt_VeLINR_b_AAD_ErrOvrVolt: accessed-variable=VeLINR_b_AAD_ErrOvrVolt.VeLINR_b_AAD_ErrOvrVolt
            access DSP_VeLINR_b_AAD_ErrOvrVoltTO_VeLINR_b_AAD_ErrOvrVoltTO: accessed-variable=VeLINR_b_AAD_ErrOvrVoltTO.VeLINR_b_AAD_ErrOvrVoltTO
          read-local-variables:
            access IRVRA_VeLINR_d_LIN_SlavePrsnt_LIN1: accessed-variable=VeLINR_d_LIN_SlavePrsnt_LIN1
        COMRXL_AAD_ErrOvrTemp_AAD_ECM_STATUS_Lin1_Received: symbol=ApplLinComAb_LIN1_COMRXL_AAD_ErrOvrTemp_AAD_ECM_STATUS_Lin1_Received  # Received -
          data-receive-point-by-arguments:
            access DRP_Lin1ComRxSignalsSR_COMRXL_AAD_ErrOvrTemp_AAD_ECM_STATUS_Lin1: accessed-variable=Lin1ComRxSignalsSR.COMRXL_AAD_ErrOvrTemp_AAD_ECM_STATUS_Lin1
          data-send-points:
            access DSP_VeLINR_b_AAD_ErrOvrTemp_VeLINR_b_AAD_ErrOvrTemp: accessed-variable=VeLINR_b_AAD_ErrOvrTemp.VeLINR_b_AAD_ErrOvrTemp
            access DSP_VeLINR_b_AAD_ErrOvrTempTO_VeLINR_b_AAD_ErrOvrTempTO: accessed-variable=VeLINR_b_AAD_ErrOvrTempTO.VeLINR_b_AAD_ErrOvrTempTO
        COMRXL_AAD_ErrOvrTemp_AAD_ECM_STATUS_Lin1_Error: symbol=ApplLinComAb_LIN1_COMRXL_AAD_ErrOvrTemp_AAD_ECM_STATUS_Lin1_Error  # Error -
          data-receive-point-by-arguments:
            access DRP_Lin1ComRxSignalsSR_COMRXL_AAD_ErrOvrTemp_AAD_ECM_STATUS_Lin1: accessed-variable=Lin1ComRxSignalsSR.COMRXL_AAD_ErrOvrTemp_AAD_ECM_STATUS_Lin1
          data-send-points:
            access DSP_VeLINR_b_AAD_ErrOvrTemp_VeLINR_b_AAD_ErrOvrTemp: accessed-variable=VeLINR_b_AAD_ErrOvrTemp.VeLINR_b_AAD_ErrOvrTemp
            access DSP_VeLINR_b_AAD_ErrOvrTempTO_VeLINR_b_AAD_ErrOvrTempTO: accessed-variable=VeLINR_b_AAD_ErrOvrTempTO.VeLINR_b_AAD_ErrOvrTempTO
          read-local-variables:
            access IRVRA_VeLINR_d_LIN_SlavePrsnt_LIN1: accessed-variable=VeLINR_d_LIN_SlavePrsnt_LIN1
        COMRXL_AAD_ErrMechStuck_AAD_ECM_STATUS_Lin1_Received: symbol=ApplLinComAb_LIN1_COMRXL_AAD_ErrMechStuck_AAD_ECM_STATUS_Lin1_Received  # Received -
          data-receive-point-by-arguments:
            access DRP_Lin1ComRxSignalsSR_COMRXL_AAD_ErrMechStuck_AAD_ECM_STATUS_Lin1: accessed-variable=Lin1ComRxSignalsSR.COMRXL_AAD_ErrMechStuck_AAD_ECM_STATUS_Lin1
          data-send-points:
            access DSP_VeLINR_b_AAD_ErrMechStuck_VeLINR_b_AAD_ErrMechStuck: accessed-variable=VeLINR_b_AAD_ErrMechStuck.VeLINR_b_AAD_ErrMechStuck
            access DSP_VeLINR_b_AAD_ErrMechStuckTO_VeLINR_b_AAD_ErrMechStuckTO: accessed-variable=VeLINR_b_AAD_ErrMechStuckTO.VeLINR_b_AAD_ErrMechStuckTO
        COMRXL_AAD_ErrMechStuck_AAD_ECM_STATUS_Lin1_Error: symbol=ApplLinComAb_LIN1_COMRXL_AAD_ErrMechStuck_AAD_ECM_STATUS_Lin1_Error  # Error -
          data-receive-point-by-arguments:
            access DRP_Lin1ComRxSignalsSR_COMRXL_AAD_ErrMechStuck_AAD_ECM_STATUS_Lin1: accessed-variable=Lin1ComRxSignalsSR.COMRXL_AAD_ErrMechStuck_AAD_ECM_STATUS_Lin1
          data-send-points:
            access DSP_VeLINR_b_AAD_ErrMechStuck_VeLINR_b_AAD_ErrMechStuck: accessed-variable=VeLINR_b_AAD_ErrMechStuck.VeLINR_b_AAD_ErrMechStuck
            access DSP_VeLINR_b_AAD_ErrMechStuckTO_VeLINR_b_AAD_ErrMechStuckTO: accessed-variable=VeLINR_b_AAD_ErrMechStuckTO.VeLINR_b_AAD_ErrMechStuckTO
          read-local-variables:
            access IRVRA_VeLINR_d_LIN_SlavePrsnt_LIN1: accessed-variable=VeLINR_d_LIN_SlavePrsnt_LIN1
        COMRXL_AAD_ErrMechBreak_AAD_ECM_STATUS_Lin1_Received: symbol=ApplLinComAb_LIN1_COMRXL_AAD_ErrMechBreak_AAD_ECM_STATUS_Lin1_Received  # Received -
          data-receive-point-by-arguments:
            access DRP_Lin1ComRxSignalsSR_COMRXL_AAD_ErrMechBreak_AAD_ECM_STATUS_Lin1: accessed-variable=Lin1ComRxSignalsSR.COMRXL_AAD_ErrMechBreak_AAD_ECM_STATUS_Lin1
          data-send-points:
            access DSP_VeLINR_b_AAD_ErrMechBreak_VeLINR_b_AAD_ErrMechBreak: accessed-variable=VeLINR_b_AAD_ErrMechBreak.VeLINR_b_AAD_ErrMechBreak
            access DSP_VeLINR_b_AAD_ErrMechBreakTO_VeLINR_b_AAD_ErrMechBreakTO: accessed-variable=VeLINR_b_AAD_ErrMechBreakTO.VeLINR_b_AAD_ErrMechBreakTO
        COMRXL_AAD_ErrMechBreak_AAD_ECM_STATUS_Lin1_Error: symbol=ApplLinComAb_LIN1_COMRXL_AAD_ErrMechBreak_AAD_ECM_STATUS_Lin1_Error  # Error -
          data-receive-point-by-arguments:
            access DRP_Lin1ComRxSignalsSR_COMRXL_AAD_ErrMechBreak_AAD_ECM_STATUS_Lin1: accessed-variable=Lin1ComRxSignalsSR.COMRXL_AAD_ErrMechBreak_AAD_ECM_STATUS_Lin1
          data-send-points:
            access DSP_VeLINR_b_AAD_ErrMechBreak_VeLINR_b_AAD_ErrMechBreak: accessed-variable=VeLINR_b_AAD_ErrMechBreak.VeLINR_b_AAD_ErrMechBreak
            access DSP_VeLINR_b_AAD_ErrMechBreakTO_VeLINR_b_AAD_ErrMechBreakTO: accessed-variable=VeLINR_b_AAD_ErrMechBreakTO.VeLINR_b_AAD_ErrMechBreakTO
          read-local-variables:
            access IRVRA_VeLINR_d_LIN_SlavePrsnt_LIN1: accessed-variable=VeLINR_d_LIN_SlavePrsnt_LIN1
        COMRXL_RsErr_AAD_AAD_ECM_STATUS_Lin1_Received: symbol=ApplLinComAb_LIN1_COMRXL_RsErr_AAD_AAD_ECM_STATUS_Lin1_Received  # Received -
          data-receive-point-by-arguments:
            access DRP_Lin1ComRxSignalsSR_COMRXL_RsErr_AAD_AAD_ECM_STATUS_Lin1: accessed-variable=Lin1ComRxSignalsSR.COMRXL_RsErr_AAD_AAD_ECM_STATUS_Lin1
          data-send-points:
            access DSP_VeLINR_b_RsErr_AAD_VeLINR_b_RsErr_AAD: accessed-variable=VeLINR_b_RsErr_AAD.VeLINR_b_RsErr_AAD
            access DSP_VeLINR_b_RsErr_AAD_TO_VeLINR_b_RsErr_AAD_TO: accessed-variable=VeLINR_b_RsErr_AAD_TO.VeLINR_b_RsErr_AAD_TO
        COMRXL_RsErr_AAD_AAD_ECM_STATUS_Lin1_Error: symbol=ApplLinComAb_LIN1_COMRXL_RsErr_AAD_AAD_ECM_STATUS_Lin1_Error  # Error -
          data-receive-point-by-arguments:
            access DRP_Lin1ComRxSignalsSR_COMRXL_RsErr_AAD_AAD_ECM_STATUS_Lin1: accessed-variable=Lin1ComRxSignalsSR.COMRXL_RsErr_AAD_AAD_ECM_STATUS_Lin1
          data-send-points:
            access DSP_VeLINR_b_RsErr_AAD_VeLINR_b_RsErr_AAD: accessed-variable=VeLINR_b_RsErr_AAD.VeLINR_b_RsErr_AAD
            access DSP_VeLINR_b_RsErr_AAD_TO_VeLINR_b_RsErr_AAD_TO: accessed-variable=VeLINR_b_RsErr_AAD_TO.VeLINR_b_RsErr_AAD_TO
          read-local-variables:
            access IRVRA_VeLINR_d_LIN_SlavePrsnt_LIN1: accessed-variable=VeLINR_d_LIN_SlavePrsnt_LIN1
        COMRXL_BCP_RPM_TARGET_BCP_STAT_Lin1_Received: symbol=ApplLinComAb_LIN1_COMRXL_BCP_RPM_TARGET_BCP_STAT_Lin1_Received  # Received -
          data-receive-point-by-arguments:
            access DRP_Lin1ComRxSignalsSR_COMRXL_BCP_RPM_TARGET_BCP_STAT_Lin1: accessed-variable=Lin1ComRxSignalsSR.COMRXL_BCP_RPM_TARGET_BCP_STAT_Lin1
          data-send-points:
            access DSP_VeLINR_Pct_BCP_RPM_TARGET_VeLINR_Pct_BCP_RPM_TARGET: accessed-variable=VeLINR_Pct_BCP_RPM_TARGET.VeLINR_Pct_BCP_RPM_TARGET
            access DSP_VeLINR_b_BCP_RPM_TARGET_TO_VeLINR_b_BCP_RPM_TARGET_TO: accessed-variable=VeLINR_b_BCP_RPM_TARGET_TO.VeLINR_b_BCP_RPM_TARGET_TO
        COMRXL_BCP_RPM_TARGET_BCP_STAT_Lin1_Error: symbol=ApplLinComAb_LIN1_COMRXL_BCP_RPM_TARGET_BCP_STAT_Lin1_Error  # Error -
          data-receive-point-by-arguments:
            access DRP_Lin1ComRxSignalsSR_COMRXL_BCP_RPM_TARGET_BCP_STAT_Lin1: accessed-variable=Lin1ComRxSignalsSR.COMRXL_BCP_RPM_TARGET_BCP_STAT_Lin1
          data-send-points:
            access DSP_VeLINR_Pct_BCP_RPM_TARGET_VeLINR_Pct_BCP_RPM_TARGET: accessed-variable=VeLINR_Pct_BCP_RPM_TARGET.VeLINR_Pct_BCP_RPM_TARGET
            access DSP_VeLINR_b_BCP_RPM_TARGET_TO_VeLINR_b_BCP_RPM_TARGET_TO: accessed-variable=VeLINR_b_BCP_RPM_TARGET_TO.VeLINR_b_BCP_RPM_TARGET_TO
          read-local-variables:
            access IRVRA_VeLINR_d_LIN_SlavePrsnt_LIN1: accessed-variable=VeLINR_d_LIN_SlavePrsnt_LIN1
        COMRXL_BCP_RPM_ACTUAL_BCP_STAT_Lin1_Received: symbol=ApplLinComAb_LIN1_COMRXL_BCP_RPM_ACTUAL_BCP_STAT_Lin1_Received  # Received -
          data-receive-point-by-arguments:
            access DRP_Lin1ComRxSignalsSR_COMRXL_BCP_RPM_ACTUAL_BCP_STAT_Lin1: accessed-variable=Lin1ComRxSignalsSR.COMRXL_BCP_RPM_ACTUAL_BCP_STAT_Lin1
          data-send-points:
            access DSP_VeLINR_Pct_BCP_RPM_ACTUAL_VeLINR_Pct_BCP_RPM_ACTUAL: accessed-variable=VeLINR_Pct_BCP_RPM_ACTUAL.VeLINR_Pct_BCP_RPM_ACTUAL
            access DSP_VeLINR_b_BCP_RPM_ACTUAL_TO_VeLINR_b_BCP_RPM_ACTUAL_TO: accessed-variable=VeLINR_b_BCP_RPM_ACTUAL_TO.VeLINR_b_BCP_RPM_ACTUAL_TO
        COMRXL_BCP_RPM_ACTUAL_BCP_STAT_Lin1_Error: symbol=ApplLinComAb_LIN1_COMRXL_BCP_RPM_ACTUAL_BCP_STAT_Lin1_Error  # Error -
          data-receive-point-by-arguments:
            access DRP_Lin1ComRxSignalsSR_COMRXL_BCP_RPM_ACTUAL_BCP_STAT_Lin1: accessed-variable=Lin1ComRxSignalsSR.COMRXL_BCP_RPM_ACTUAL_BCP_STAT_Lin1
          data-send-points:
            access DSP_VeLINR_Pct_BCP_RPM_ACTUAL_VeLINR_Pct_BCP_RPM_ACTUAL: accessed-variable=VeLINR_Pct_BCP_RPM_ACTUAL.VeLINR_Pct_BCP_RPM_ACTUAL
            access DSP_VeLINR_b_BCP_RPM_ACTUAL_TO_VeLINR_b_BCP_RPM_ACTUAL_TO: accessed-variable=VeLINR_b_BCP_RPM_ACTUAL_TO.VeLINR_b_BCP_RPM_ACTUAL_TO
          read-local-variables:
            access IRVRA_VeLINR_d_LIN_SlavePrsnt_LIN1: accessed-variable=VeLINR_d_LIN_SlavePrsnt_LIN1
        COMRXL_BCP_VLTG_BCP_STAT_Lin1_Received: symbol=ApplLinComAb_LIN1_COMRXL_BCP_VLTG_BCP_STAT_Lin1_Received  # Received -
          data-receive-point-by-arguments:
            access DRP_Lin1ComRxSignalsSR_COMRXL_BCP_VLTG_BCP_STAT_Lin1: accessed-variable=Lin1ComRxSignalsSR.COMRXL_BCP_VLTG_BCP_STAT_Lin1
          data-send-points:
            access DSP_VeLINR_U_BCP_VLTG_VeLINR_U_BCP_VLTG: accessed-variable=VeLINR_U_BCP_VLTG.VeLINR_U_BCP_VLTG
            access DSP_VeLINR_b_BCP_VLTG_TO_VeLINR_b_BCP_VLTG_TO: accessed-variable=VeLINR_b_BCP_VLTG_TO.VeLINR_b_BCP_VLTG_TO
        COMRXL_BCP_VLTG_BCP_STAT_Lin1_Error: symbol=ApplLinComAb_LIN1_COMRXL_BCP_VLTG_BCP_STAT_Lin1_Error  # Error -
          data-receive-point-by-arguments:
            access DRP_Lin1ComRxSignalsSR_COMRXL_BCP_VLTG_BCP_STAT_Lin1: accessed-variable=Lin1ComRxSignalsSR.COMRXL_BCP_VLTG_BCP_STAT_Lin1
          data-send-points:
            access DSP_VeLINR_U_BCP_VLTG_VeLINR_U_BCP_VLTG: accessed-variable=VeLINR_U_BCP_VLTG.VeLINR_U_BCP_VLTG
            access DSP_VeLINR_b_BCP_VLTG_TO_VeLINR_b_BCP_VLTG_TO: accessed-variable=VeLINR_b_BCP_VLTG_TO.VeLINR_b_BCP_VLTG_TO
          read-local-variables:
            access IRVRA_VeLINR_d_LIN_SlavePrsnt_LIN1: accessed-variable=VeLINR_d_LIN_SlavePrsnt_LIN1
        COMRXL_BCP_TEMP_BCP_STAT_Lin1_Received: symbol=ApplLinComAb_LIN1_COMRXL_BCP_TEMP_BCP_STAT_Lin1_Received  # Received -
          data-receive-point-by-arguments:
            access DRP_Lin1ComRxSignalsSR_COMRXL_BCP_TEMP_BCP_STAT_Lin1: accessed-variable=Lin1ComRxSignalsSR.COMRXL_BCP_TEMP_BCP_STAT_Lin1
          data-send-points:
            access DSP_VeLINR_T_BCP_TEMP_VeLINR_T_BCP_TEMP: accessed-variable=VeLINR_T_BCP_TEMP.VeLINR_T_BCP_TEMP
            access DSP_VeLINR_b_BCP_TEMP_TO_VeLINR_b_BCP_TEMP_TO: accessed-variable=VeLINR_b_BCP_TEMP_TO.VeLINR_b_BCP_TEMP_TO
        COMRXL_BCP_TEMP_BCP_STAT_Lin1_Error: symbol=ApplLinComAb_LIN1_COMRXL_BCP_TEMP_BCP_STAT_Lin1_Error  # Error -
          data-receive-point-by-arguments:
            access DRP_Lin1ComRxSignalsSR_COMRXL_BCP_TEMP_BCP_STAT_Lin1: accessed-variable=Lin1ComRxSignalsSR.COMRXL_BCP_TEMP_BCP_STAT_Lin1
          data-send-points:
            access DSP_VeLINR_T_BCP_TEMP_VeLINR_T_BCP_TEMP: accessed-variable=VeLINR_T_BCP_TEMP.VeLINR_T_BCP_TEMP
            access DSP_VeLINR_b_BCP_TEMP_TO_VeLINR_b_BCP_TEMP_TO: accessed-variable=VeLINR_b_BCP_TEMP_TO.VeLINR_b_BCP_TEMP_TO
          read-local-variables:
            access IRVRA_VeLINR_d_LIN_SlavePrsnt_LIN1: accessed-variable=VeLINR_d_LIN_SlavePrsnt_LIN1
        COMRXL_BCP_CURR_BCP_STAT_Lin1_Received: symbol=ApplLinComAb_LIN1_COMRXL_BCP_CURR_BCP_STAT_Lin1_Received  # Received -
          data-receive-point-by-arguments:
            access DRP_Lin1ComRxSignalsSR_COMRXL_BCP_CURR_BCP_STAT_Lin1: accessed-variable=Lin1ComRxSignalsSR.COMRXL_BCP_CURR_BCP_STAT_Lin1
          data-send-points:
            access DSP_VeLINR_I_BCP_CURR_VeLINR_I_BCP_CURR: accessed-variable=VeLINR_I_BCP_CURR.VeLINR_I_BCP_CURR
            access DSP_VeLINR_b_BCP_CURR_TO_VeLINR_b_BCP_CURR_TO: accessed-variable=VeLINR_b_BCP_CURR_TO.VeLINR_b_BCP_CURR_TO
        COMRXL_BCP_CURR_BCP_STAT_Lin1_Error: symbol=ApplLinComAb_LIN1_COMRXL_BCP_CURR_BCP_STAT_Lin1_Error  # Error -
          data-receive-point-by-arguments:
            access DRP_Lin1ComRxSignalsSR_COMRXL_BCP_CURR_BCP_STAT_Lin1: accessed-variable=Lin1ComRxSignalsSR.COMRXL_BCP_CURR_BCP_STAT_Lin1
          data-send-points:
            access DSP_VeLINR_I_BCP_CURR_VeLINR_I_BCP_CURR: accessed-variable=VeLINR_I_BCP_CURR.VeLINR_I_BCP_CURR
            access DSP_VeLINR_b_BCP_CURR_TO_VeLINR_b_BCP_CURR_TO: accessed-variable=VeLINR_b_BCP_CURR_TO.VeLINR_b_BCP_CURR_TO
          read-local-variables:
            access IRVRA_VeLINR_d_LIN_SlavePrsnt_LIN1: accessed-variable=VeLINR_d_LIN_SlavePrsnt_LIN1
        COMRXL_BCP_FL_SAFE_ACTVTD_BCP_STAT_Lin1_Received: symbol=ApplLinComAb_LIN1_COMRXL_BCP_FL_SAFE_ACTVTD_BCP_STAT_Lin1_Received  # Received -
          data-receive-point-by-arguments:
            access DRP_Lin1ComRxSignalsSR_COMRXL_BCP_FL_SAFE_ACTVTD_BCP_STAT_Lin1: accessed-variable=Lin1ComRxSignalsSR.COMRXL_BCP_FL_SAFE_ACTVTD_BCP_STAT_Lin1
          data-send-points:
            access DSP_VeLINR_e_BCP_FL_SAFE_ACTVTD_VeLINR_e_BCP_FL_SAFE_ACTVTD: accessed-variable=VeLINR_e_BCP_FL_SAFE_ACTVTD.VeLINR_e_BCP_FL_SAFE_ACTVTD
            access DSP_VeLINR_b_BCP_FL_SAFE_ACTVTD_TO_VeLINR_b_BCP_FL_SAFE_ACTVTD_TO: accessed-variable=VeLINR_b_BCP_FL_SAFE_ACTVTD_TO.VeLINR_b_BCP_FL_SAFE_ACTVTD_TO
        COMRXL_BCP_FL_SAFE_ACTVTD_BCP_STAT_Lin1_Error: symbol=ApplLinComAb_LIN1_COMRXL_BCP_FL_SAFE_ACTVTD_BCP_STAT_Lin1_Error  # Error -
          data-receive-point-by-arguments:
            access DRP_Lin1ComRxSignalsSR_COMRXL_BCP_FL_SAFE_ACTVTD_BCP_STAT_Lin1: accessed-variable=Lin1ComRxSignalsSR.COMRXL_BCP_FL_SAFE_ACTVTD_BCP_STAT_Lin1
          data-send-points:
            access DSP_VeLINR_e_BCP_FL_SAFE_ACTVTD_VeLINR_e_BCP_FL_SAFE_ACTVTD: accessed-variable=VeLINR_e_BCP_FL_SAFE_ACTVTD.VeLINR_e_BCP_FL_SAFE_ACTVTD
            access DSP_VeLINR_b_BCP_FL_SAFE_ACTVTD_TO_VeLINR_b_BCP_FL_SAFE_ACTVTD_TO: accessed-variable=VeLINR_b_BCP_FL_SAFE_ACTVTD_TO.VeLINR_b_BCP_FL_SAFE_ACTVTD_TO
          read-local-variables:
            access IRVRA_VeLINR_d_LIN_SlavePrsnt_LIN1: accessed-variable=VeLINR_d_LIN_SlavePrsnt_LIN1
        COMRXL_BCP_LMP_HM_AN_ON_BCP_STAT_Lin1_Received: symbol=ApplLinComAb_LIN1_COMRXL_BCP_LMP_HM_AN_ON_BCP_STAT_Lin1_Received  # Received -
          data-receive-point-by-arguments:
            access DRP_Lin1ComRxSignalsSR_COMRXL_BCP_LMP_HM_AN_ON_BCP_STAT_Lin1: accessed-variable=Lin1ComRxSignalsSR.COMRXL_BCP_LMP_HM_AN_ON_BCP_STAT_Lin1
          data-send-points:
            access DSP_VeLINR_e_BCP_LMP_HM_AN_ON_VeLINR_e_BCP_LMP_HM_AN_ON: accessed-variable=VeLINR_e_BCP_LMP_HM_AN_ON.VeLINR_e_BCP_LMP_HM_AN_ON
            access DSP_VeLINR_b_BCP_LMP_HM_AN_ON_TO_VeLINR_b_BCP_LMP_HM_AN_ON_TO: accessed-variable=VeLINR_b_BCP_LMP_HM_AN_ON_TO.VeLINR_b_BCP_LMP_HM_AN_ON_TO
        COMRXL_BCP_LMP_HM_AN_ON_BCP_STAT_Lin1_Error: symbol=ApplLinComAb_LIN1_COMRXL_BCP_LMP_HM_AN_ON_BCP_STAT_Lin1_Error  # Error -
          data-receive-point-by-arguments:
            access DRP_Lin1ComRxSignalsSR_COMRXL_BCP_LMP_HM_AN_ON_BCP_STAT_Lin1: accessed-variable=Lin1ComRxSignalsSR.COMRXL_BCP_LMP_HM_AN_ON_BCP_STAT_Lin1
          data-send-points:
            access DSP_VeLINR_e_BCP_LMP_HM_AN_ON_VeLINR_e_BCP_LMP_HM_AN_ON: accessed-variable=VeLINR_e_BCP_LMP_HM_AN_ON.VeLINR_e_BCP_LMP_HM_AN_ON
            access DSP_VeLINR_b_BCP_LMP_HM_AN_ON_TO_VeLINR_b_BCP_LMP_HM_AN_ON_TO: accessed-variable=VeLINR_b_BCP_LMP_HM_AN_ON_TO.VeLINR_b_BCP_LMP_HM_AN_ON_TO
          read-local-variables:
            access IRVRA_VeLINR_d_LIN_SlavePrsnt_LIN1: accessed-variable=VeLINR_d_LIN_SlavePrsnt_LIN1
        COMRXL_BCP_AIR_PRE_ERR_BCP_STAT_Lin1_Received: symbol=ApplLinComAb_LIN1_COMRXL_BCP_AIR_PRE_ERR_BCP_STAT_Lin1_Received  # Received -
          data-receive-point-by-arguments:
            access DRP_Lin1ComRxSignalsSR_COMRXL_BCP_AIR_PRE_ERR_BCP_STAT_Lin1: accessed-variable=Lin1ComRxSignalsSR.COMRXL_BCP_AIR_PRE_ERR_BCP_STAT_Lin1
          data-send-points:
            access DSP_VeLINR_e_BCP_AIR_PRE_ERR_VeLINR_e_BCP_AIR_PRE_ERR: accessed-variable=VeLINR_e_BCP_AIR_PRE_ERR.VeLINR_e_BCP_AIR_PRE_ERR
            access DSP_VeLINR_b_BCP_AIR_PRE_ERR_TO_VeLINR_b_BCP_AIR_PRE_ERR_TO: accessed-variable=VeLINR_b_BCP_AIR_PRE_ERR_TO.VeLINR_b_BCP_AIR_PRE_ERR_TO
        COMRXL_BCP_AIR_PRE_ERR_BCP_STAT_Lin1_Error: symbol=ApplLinComAb_LIN1_COMRXL_BCP_AIR_PRE_ERR_BCP_STAT_Lin1_Error  # Error -
          data-receive-point-by-arguments:
            access DRP_Lin1ComRxSignalsSR_COMRXL_BCP_AIR_PRE_ERR_BCP_STAT_Lin1: accessed-variable=Lin1ComRxSignalsSR.COMRXL_BCP_AIR_PRE_ERR_BCP_STAT_Lin1
          data-send-points:
            access DSP_VeLINR_e_BCP_AIR_PRE_ERR_VeLINR_e_BCP_AIR_PRE_ERR: accessed-variable=VeLINR_e_BCP_AIR_PRE_ERR.VeLINR_e_BCP_AIR_PRE_ERR
            access DSP_VeLINR_b_BCP_AIR_PRE_ERR_TO_VeLINR_b_BCP_AIR_PRE_ERR_TO: accessed-variable=VeLINR_b_BCP_AIR_PRE_ERR_TO.VeLINR_b_BCP_AIR_PRE_ERR_TO
          read-local-variables:
            access IRVRA_VeLINR_d_LIN_SlavePrsnt_LIN1: accessed-variable=VeLINR_d_LIN_SlavePrsnt_LIN1
        COMRXL_BCP_OVR_TMP_ERR_BCP_STAT_Lin1_Received: symbol=ApplLinComAb_LIN1_COMRXL_BCP_OVR_TMP_ERR_BCP_STAT_Lin1_Received  # Received -
          data-receive-point-by-arguments:
            access DRP_Lin1ComRxSignalsSR_COMRXL_BCP_OVR_TMP_ERR_BCP_STAT_Lin1: accessed-variable=Lin1ComRxSignalsSR.COMRXL_BCP_OVR_TMP_ERR_BCP_STAT_Lin1
          data-send-points:
            access DSP_VeLINR_e_BCP_OVR_TMP_ERR_VeLINR_e_BCP_OVR_TMP_ERR: accessed-variable=VeLINR_e_BCP_OVR_TMP_ERR.VeLINR_e_BCP_OVR_TMP_ERR
            access DSP_VeLINR_b_BCP_OVR_TMP_ERR_TO_VeLINR_b_BCP_OVR_TMP_ERR_TO: accessed-variable=VeLINR_b_BCP_OVR_TMP_ERR_TO.VeLINR_b_BCP_OVR_TMP_ERR_TO
        COMRXL_BCP_OVR_TMP_ERR_BCP_STAT_Lin1_Error: symbol=ApplLinComAb_LIN1_COMRXL_BCP_OVR_TMP_ERR_BCP_STAT_Lin1_Error  # Error -
          data-receive-point-by-arguments:
            access DRP_Lin1ComRxSignalsSR_COMRXL_BCP_OVR_TMP_ERR_BCP_STAT_Lin1: accessed-variable=Lin1ComRxSignalsSR.COMRXL_BCP_OVR_TMP_ERR_BCP_STAT_Lin1
          data-send-points:
            access DSP_VeLINR_e_BCP_OVR_TMP_ERR_VeLINR_e_BCP_OVR_TMP_ERR: accessed-variable=VeLINR_e_BCP_OVR_TMP_ERR.VeLINR_e_BCP_OVR_TMP_ERR
            access DSP_VeLINR_b_BCP_OVR_TMP_ERR_TO_VeLINR_b_BCP_OVR_TMP_ERR_TO: accessed-variable=VeLINR_b_BCP_OVR_TMP_ERR_TO.VeLINR_b_BCP_OVR_TMP_ERR_TO
          read-local-variables:
            access IRVRA_VeLINR_d_LIN_SlavePrsnt_LIN1: accessed-variable=VeLINR_d_LIN_SlavePrsnt_LIN1
        COMRXL_BCP_OVR_CUR_ERR_BCP_STAT_Lin1_Received: symbol=ApplLinComAb_LIN1_COMRXL_BCP_OVR_CUR_ERR_BCP_STAT_Lin1_Received  # Received -
          data-receive-point-by-arguments:
            access DRP_Lin1ComRxSignalsSR_COMRXL_BCP_OVR_CUR_ERR_BCP_STAT_Lin1: accessed-variable=Lin1ComRxSignalsSR.COMRXL_BCP_OVR_CUR_ERR_BCP_STAT_Lin1
          data-send-points:
            access DSP_VeLINR_e_BCP_OVR_CUR_ERR_VeLINR_e_BCP_OVR_CUR_ERR: accessed-variable=VeLINR_e_BCP_OVR_CUR_ERR.VeLINR_e_BCP_OVR_CUR_ERR
            access DSP_VeLINR_b_BCP_OVR_CUR_ERR_TO_VeLINR_b_BCP_OVR_CUR_ERR_TO: accessed-variable=VeLINR_b_BCP_OVR_CUR_ERR_TO.VeLINR_b_BCP_OVR_CUR_ERR_TO
        COMRXL_BCP_OVR_CUR_ERR_BCP_STAT_Lin1_Error: symbol=ApplLinComAb_LIN1_COMRXL_BCP_OVR_CUR_ERR_BCP_STAT_Lin1_Error  # Error -
          data-receive-point-by-arguments:
            access DRP_Lin1ComRxSignalsSR_COMRXL_BCP_OVR_CUR_ERR_BCP_STAT_Lin1: accessed-variable=Lin1ComRxSignalsSR.COMRXL_BCP_OVR_CUR_ERR_BCP_STAT_Lin1
          data-send-points:
            access DSP_VeLINR_e_BCP_OVR_CUR_ERR_VeLINR_e_BCP_OVR_CUR_ERR: accessed-variable=VeLINR_e_BCP_OVR_CUR_ERR.VeLINR_e_BCP_OVR_CUR_ERR
            access DSP_VeLINR_b_BCP_OVR_CUR_ERR_TO_VeLINR_b_BCP_OVR_CUR_ERR_TO: accessed-variable=VeLINR_b_BCP_OVR_CUR_ERR_TO.VeLINR_b_BCP_OVR_CUR_ERR_TO
          read-local-variables:
            access IRVRA_VeLINR_d_LIN_SlavePrsnt_LIN1: accessed-variable=VeLINR_d_LIN_SlavePrsnt_LIN1
        COMRXL_BCP_DR_RN_ERR_BCP_STAT_Lin1_Received: symbol=ApplLinComAb_LIN1_COMRXL_BCP_DR_RN_ERR_BCP_STAT_Lin1_Received  # Received -
          data-receive-point-by-arguments:
            access DRP_Lin1ComRxSignalsSR_COMRXL_BCP_DR_RN_ERR_BCP_STAT_Lin1: accessed-variable=Lin1ComRxSignalsSR.COMRXL_BCP_DR_RN_ERR_BCP_STAT_Lin1
          data-send-points:
            access DSP_VeLINR_e_BCP_DR_RN_ERR_VeLINR_e_BCP_DR_RN_ERR: accessed-variable=VeLINR_e_BCP_DR_RN_ERR.VeLINR_e_BCP_DR_RN_ERR
            access DSP_VeLINR_b_BCP_DR_RN_ERR_TO_VeLINR_b_BCP_DR_RN_ERR_TO: accessed-variable=VeLINR_b_BCP_DR_RN_ERR_TO.VeLINR_b_BCP_DR_RN_ERR_TO
        COMRXL_BCP_DR_RN_ERR_BCP_STAT_Lin1_Error: symbol=ApplLinComAb_LIN1_COMRXL_BCP_DR_RN_ERR_BCP_STAT_Lin1_Error  # Error -
          data-receive-point-by-arguments:
            access DRP_Lin1ComRxSignalsSR_COMRXL_BCP_DR_RN_ERR_BCP_STAT_Lin1: accessed-variable=Lin1ComRxSignalsSR.COMRXL_BCP_DR_RN_ERR_BCP_STAT_Lin1
          data-send-points:
            access DSP_VeLINR_e_BCP_DR_RN_ERR_VeLINR_e_BCP_DR_RN_ERR: accessed-variable=VeLINR_e_BCP_DR_RN_ERR.VeLINR_e_BCP_DR_RN_ERR
            access DSP_VeLINR_b_BCP_DR_RN_ERR_TO_VeLINR_b_BCP_DR_RN_ERR_TO: accessed-variable=VeLINR_b_BCP_DR_RN_ERR_TO.VeLINR_b_BCP_DR_RN_ERR_TO
          read-local-variables:
            access IRVRA_VeLINR_d_LIN_SlavePrsnt_LIN1: accessed-variable=VeLINR_d_LIN_SlavePrsnt_LIN1
        COMRXL_BCP_VLTG_ERR_BCP_STAT_Lin1_Received: symbol=ApplLinComAb_LIN1_COMRXL_BCP_VLTG_ERR_BCP_STAT_Lin1_Received  # Received -
          data-receive-point-by-arguments:
            access DRP_Lin1ComRxSignalsSR_COMRXL_BCP_VLTG_ERR_BCP_STAT_Lin1: accessed-variable=Lin1ComRxSignalsSR.COMRXL_BCP_VLTG_ERR_BCP_STAT_Lin1
          data-send-points:
            access DSP_VeLINR_e_BCP_VLTG_ERR_VeLINR_e_BCP_VLTG_ERR: accessed-variable=VeLINR_e_BCP_VLTG_ERR.VeLINR_e_BCP_VLTG_ERR
            access DSP_VeLINR_b_BCP_VLTG_ERR_TO_VeLINR_b_BCP_VLTG_ERR_TO: accessed-variable=VeLINR_b_BCP_VLTG_ERR_TO.VeLINR_b_BCP_VLTG_ERR_TO
        COMRXL_BCP_VLTG_ERR_BCP_STAT_Lin1_Error: symbol=ApplLinComAb_LIN1_COMRXL_BCP_VLTG_ERR_BCP_STAT_Lin1_Error  # Error -
          data-receive-point-by-arguments:
            access DRP_Lin1ComRxSignalsSR_COMRXL_BCP_VLTG_ERR_BCP_STAT_Lin1: accessed-variable=Lin1ComRxSignalsSR.COMRXL_BCP_VLTG_ERR_BCP_STAT_Lin1
          data-send-points:
            access DSP_VeLINR_e_BCP_VLTG_ERR_VeLINR_e_BCP_VLTG_ERR: accessed-variable=VeLINR_e_BCP_VLTG_ERR.VeLINR_e_BCP_VLTG_ERR
            access DSP_VeLINR_b_BCP_VLTG_ERR_TO_VeLINR_b_BCP_VLTG_ERR_TO: accessed-variable=VeLINR_b_BCP_VLTG_ERR_TO.VeLINR_b_BCP_VLTG_ERR_TO
          read-local-variables:
            access IRVRA_VeLINR_d_LIN_SlavePrsnt_LIN1: accessed-variable=VeLINR_d_LIN_SlavePrsnt_LIN1
        COMRXL_BCP_DBLK_ACTV_BCP_STAT_Lin1_Received: symbol=ApplLinComAb_LIN1_COMRXL_BCP_DBLK_ACTV_BCP_STAT_Lin1_Received  # Received -
          data-receive-point-by-arguments:
            access DRP_Lin1ComRxSignalsSR_COMRXL_BCP_DBLK_ACTV_BCP_STAT_Lin1: accessed-variable=Lin1ComRxSignalsSR.COMRXL_BCP_DBLK_ACTV_BCP_STAT_Lin1
          data-send-points:
            access DSP_VeLINR_e_BCP_DBLK_ACTV_VeLINR_e_BCP_DBLK_ACTV: accessed-variable=VeLINR_e_BCP_DBLK_ACTV.VeLINR_e_BCP_DBLK_ACTV
            access DSP_VeLINR_b_BCP_DBLK_ACTV_TO_VeLINR_b_BCP_DBLK_ACTV_TO: accessed-variable=VeLINR_b_BCP_DBLK_ACTV_TO.VeLINR_b_BCP_DBLK_ACTV_TO
        COMRXL_BCP_DBLK_ACTV_BCP_STAT_Lin1_Error: symbol=ApplLinComAb_LIN1_COMRXL_BCP_DBLK_ACTV_BCP_STAT_Lin1_Error  # Error -
          data-receive-point-by-arguments:
            access DRP_Lin1ComRxSignalsSR_COMRXL_BCP_DBLK_ACTV_BCP_STAT_Lin1: accessed-variable=Lin1ComRxSignalsSR.COMRXL_BCP_DBLK_ACTV_BCP_STAT_Lin1
          data-send-points:
            access DSP_VeLINR_e_BCP_DBLK_ACTV_VeLINR_e_BCP_DBLK_ACTV: accessed-variable=VeLINR_e_BCP_DBLK_ACTV.VeLINR_e_BCP_DBLK_ACTV
            access DSP_VeLINR_b_BCP_DBLK_ACTV_TO_VeLINR_b_BCP_DBLK_ACTV_TO: accessed-variable=VeLINR_b_BCP_DBLK_ACTV_TO.VeLINR_b_BCP_DBLK_ACTV_TO
          read-local-variables:
            access IRVRA_VeLINR_d_LIN_SlavePrsnt_LIN1: accessed-variable=VeLINR_d_LIN_SlavePrsnt_LIN1
        COMRXL_BCP_MONTRNG_RPM_BCP_STAT_Lin1_Received: symbol=ApplLinComAb_LIN1_COMRXL_BCP_MONTRNG_RPM_BCP_STAT_Lin1_Received  # Received -
          data-receive-point-by-arguments:
            access DRP_Lin1ComRxSignalsSR_COMRXL_BCP_MONTRNG_RPM_BCP_STAT_Lin1: accessed-variable=Lin1ComRxSignalsSR.COMRXL_BCP_MONTRNG_RPM_BCP_STAT_Lin1
          data-send-points:
            access DSP_VeLINR_e_BCP_MONTRNG_RPM_VeLINR_e_BCP_MONTRNG_RPM: accessed-variable=VeLINR_e_BCP_MONTRNG_RPM.VeLINR_e_BCP_MONTRNG_RPM
            access DSP_VeLINR_b_BCP_MONTRNG_RPM_TO_VeLINR_b_BCP_MONTRNG_RPM_TO: accessed-variable=VeLINR_b_BCP_MONTRNG_RPM_TO.VeLINR_b_BCP_MONTRNG_RPM_TO
        COMRXL_BCP_MONTRNG_RPM_BCP_STAT_Lin1_Error: symbol=ApplLinComAb_LIN1_COMRXL_BCP_MONTRNG_RPM_BCP_STAT_Lin1_Error  # Error -
          data-receive-point-by-arguments:
            access DRP_Lin1ComRxSignalsSR_COMRXL_BCP_MONTRNG_RPM_BCP_STAT_Lin1: accessed-variable=Lin1ComRxSignalsSR.COMRXL_BCP_MONTRNG_RPM_BCP_STAT_Lin1
          data-send-points:
            access DSP_VeLINR_e_BCP_MONTRNG_RPM_VeLINR_e_BCP_MONTRNG_RPM: accessed-variable=VeLINR_e_BCP_MONTRNG_RPM.VeLINR_e_BCP_MONTRNG_RPM
            access DSP_VeLINR_b_BCP_MONTRNG_RPM_TO_VeLINR_b_BCP_MONTRNG_RPM_TO: accessed-variable=VeLINR_b_BCP_MONTRNG_RPM_TO.VeLINR_b_BCP_MONTRNG_RPM_TO
          read-local-variables:
            access IRVRA_VeLINR_d_LIN_SlavePrsnt_LIN1: accessed-variable=VeLINR_d_LIN_SlavePrsnt_LIN1
        COMRXL_BCP_NODE_ERR_BCP_STAT_Lin1_Received: symbol=ApplLinComAb_LIN1_COMRXL_BCP_NODE_ERR_BCP_STAT_Lin1_Received  # Received -
          data-receive-point-by-arguments:
            access DRP_Lin1ComRxSignalsSR_COMRXL_BCP_NODE_ERR_BCP_STAT_Lin1: accessed-variable=Lin1ComRxSignalsSR.COMRXL_BCP_NODE_ERR_BCP_STAT_Lin1
          data-send-points:
            access DSP_VeLINR_e_BCP_NODE_ERR_VeLINR_e_BCP_NODE_ERR: accessed-variable=VeLINR_e_BCP_NODE_ERR.VeLINR_e_BCP_NODE_ERR
            access DSP_VeLINR_b_BCP_NODE_ERR_TO_VeLINR_b_BCP_NODE_ERR_TO: accessed-variable=VeLINR_b_BCP_NODE_ERR_TO.VeLINR_b_BCP_NODE_ERR_TO
        COMRXL_BCP_NODE_ERR_BCP_STAT_Lin1_Error: symbol=ApplLinComAb_LIN1_COMRXL_BCP_NODE_ERR_BCP_STAT_Lin1_Error  # Error -
          data-receive-point-by-arguments:
            access DRP_Lin1ComRxSignalsSR_COMRXL_BCP_NODE_ERR_BCP_STAT_Lin1: accessed-variable=Lin1ComRxSignalsSR.COMRXL_BCP_NODE_ERR_BCP_STAT_Lin1
          data-send-points:
            access DSP_VeLINR_e_BCP_NODE_ERR_VeLINR_e_BCP_NODE_ERR: accessed-variable=VeLINR_e_BCP_NODE_ERR.VeLINR_e_BCP_NODE_ERR
            access DSP_VeLINR_b_BCP_NODE_ERR_TO_VeLINR_b_BCP_NODE_ERR_TO: accessed-variable=VeLINR_b_BCP_NODE_ERR_TO.VeLINR_b_BCP_NODE_ERR_TO
          read-local-variables:
            access IRVRA_VeLINR_d_LIN_SlavePrsnt_LIN1: accessed-variable=VeLINR_d_LIN_SlavePrsnt_LIN1
        COMRXL_BCP_POST_RUN_STAT_BCP_STAT_Lin1_Received: symbol=ApplLinComAb_LIN1_COMRXL_BCP_POST_RUN_STAT_BCP_STAT_Lin1_Received  # Received -
          data-receive-point-by-arguments:
            access DRP_Lin1ComRxSignalsSR_COMRXL_BCP_POST_RUN_STAT_BCP_STAT_Lin1: accessed-variable=Lin1ComRxSignalsSR.COMRXL_BCP_POST_RUN_STAT_BCP_STAT_Lin1
          data-send-points:
            access DSP_VeLINR_e_BCP_POST_RUN_STAT_VeLINR_e_BCP_POST_RUN_STAT: accessed-variable=VeLINR_e_BCP_POST_RUN_STAT.VeLINR_e_BCP_POST_RUN_STAT
            access DSP_VeLINR_b_BCP_POST_RUN_STAT_TO_VeLINR_b_BCP_POST_RUN_STAT_TO: accessed-variable=VeLINR_b_BCP_POST_RUN_STAT_TO.VeLINR_b_BCP_POST_RUN_STAT_TO
        COMRXL_BCP_POST_RUN_STAT_BCP_STAT_Lin1_Error: symbol=ApplLinComAb_LIN1_COMRXL_BCP_POST_RUN_STAT_BCP_STAT_Lin1_Error  # Error -
          data-receive-point-by-arguments:
            access DRP_Lin1ComRxSignalsSR_COMRXL_BCP_POST_RUN_STAT_BCP_STAT_Lin1: accessed-variable=Lin1ComRxSignalsSR.COMRXL_BCP_POST_RUN_STAT_BCP_STAT_Lin1
          data-send-points:
            access DSP_VeLINR_e_BCP_POST_RUN_STAT_VeLINR_e_BCP_POST_RUN_STAT: accessed-variable=VeLINR_e_BCP_POST_RUN_STAT.VeLINR_e_BCP_POST_RUN_STAT
            access DSP_VeLINR_b_BCP_POST_RUN_STAT_TO_VeLINR_b_BCP_POST_RUN_STAT_TO: accessed-variable=VeLINR_b_BCP_POST_RUN_STAT_TO.VeLINR_b_BCP_POST_RUN_STAT_TO
          read-local-variables:
            access IRVRA_VeLINR_d_LIN_SlavePrsnt_LIN1: accessed-variable=VeLINR_d_LIN_SlavePrsnt_LIN1
        COMRXL_RsErr_BCP_PUMP_BCP_STAT_Lin1_Received: symbol=ApplLinComAb_LIN1_COMRXL_RsErr_BCP_PUMP_BCP_STAT_Lin1_Received  # Received -
          data-receive-point-by-arguments:
            access DRP_Lin1ComRxSignalsSR_COMRXL_RsErr_BCP_PUMP_BCP_STAT_Lin1: accessed-variable=Lin1ComRxSignalsSR.COMRXL_RsErr_BCP_PUMP_BCP_STAT_Lin1
          data-send-points:
            access DSP_VeLINR_b_RsErr_BCP_PUMP_VeLINR_b_RsErr_BCP_PUMP: accessed-variable=VeLINR_b_RsErr_BCP_PUMP.VeLINR_b_RsErr_BCP_PUMP
            access DSP_VeLINR_b_RsErr_BCP_PUMP_TO_VeLINR_b_RsErr_BCP_PUMP_TO: accessed-variable=VeLINR_b_RsErr_BCP_PUMP_TO.VeLINR_b_RsErr_BCP_PUMP_TO
        COMRXL_RsErr_BCP_PUMP_BCP_STAT_Lin1_Error: symbol=ApplLinComAb_LIN1_COMRXL_RsErr_BCP_PUMP_BCP_STAT_Lin1_Error  # Error -
          data-receive-point-by-arguments:
            access DRP_Lin1ComRxSignalsSR_COMRXL_RsErr_BCP_PUMP_BCP_STAT_Lin1: accessed-variable=Lin1ComRxSignalsSR.COMRXL_RsErr_BCP_PUMP_BCP_STAT_Lin1
          data-send-points:
            access DSP_VeLINR_b_RsErr_BCP_PUMP_VeLINR_b_RsErr_BCP_PUMP: accessed-variable=VeLINR_b_RsErr_BCP_PUMP.VeLINR_b_RsErr_BCP_PUMP
            access DSP_VeLINR_b_RsErr_BCP_PUMP_TO_VeLINR_b_RsErr_BCP_PUMP_TO: accessed-variable=VeLINR_b_RsErr_BCP_PUMP_TO.VeLINR_b_RsErr_BCP_PUMP_TO
          read-local-variables:
            access IRVRA_VeLINR_d_LIN_SlavePrsnt_LIN1: accessed-variable=VeLINR_d_LIN_SlavePrsnt_LIN1
        COMRXL_BCP_VERSION_BCP_VER_Lin1_Received: symbol=ApplLinComAb_LIN1_COMRXL_BCP_VERSION_BCP_VER_Lin1_Received  # Received -
          data-receive-point-by-arguments:
            access DRP_Lin1ComRxSignalsSR_COMRXL_BCP_VERSION_BCP_VER_Lin1: accessed-variable=Lin1ComRxSignalsSR.COMRXL_BCP_VERSION_BCP_VER_Lin1
          data-send-points:
            access DSP_VeLINR_y_BCP_VERSION_VeLINR_y_BCP_VERSION: accessed-variable=VeLINR_y_BCP_VERSION.VeLINR_y_BCP_VERSION
            access DSP_VeLINR_b_BCP_VERSION_TO_VeLINR_b_BCP_VERSION_TO: accessed-variable=VeLINR_b_BCP_VERSION_TO.VeLINR_b_BCP_VERSION_TO
        COMRXL_BCP_VERSION_BCP_VER_Lin1_Error: symbol=ApplLinComAb_LIN1_COMRXL_BCP_VERSION_BCP_VER_Lin1_Error  # Error -
          data-receive-point-by-arguments:
            access DRP_Lin1ComRxSignalsSR_COMRXL_BCP_VERSION_BCP_VER_Lin1: accessed-variable=Lin1ComRxSignalsSR.COMRXL_BCP_VERSION_BCP_VER_Lin1
          data-send-points:
            access DSP_VeLINR_y_BCP_VERSION_VeLINR_y_BCP_VERSION: accessed-variable=VeLINR_y_BCP_VERSION.VeLINR_y_BCP_VERSION
            access DSP_VeLINR_b_BCP_VERSION_TO_VeLINR_b_BCP_VERSION_TO: accessed-variable=VeLINR_b_BCP_VERSION_TO.VeLINR_b_BCP_VERSION_TO
          read-local-variables:
            access IRVRA_VeLINR_d_LIN_SlavePrsnt_LIN1: accessed-variable=VeLINR_d_LIN_SlavePrsnt_LIN1
        COMRXL_BCP_SUPPLIER_BCP_VER_Lin1_Received: symbol=ApplLinComAb_LIN1_COMRXL_BCP_SUPPLIER_BCP_VER_Lin1_Received  # Received -
          data-receive-point-by-arguments:
            access DRP_Lin1ComRxSignalsSR_COMRXL_BCP_SUPPLIER_BCP_VER_Lin1: accessed-variable=Lin1ComRxSignalsSR.COMRXL_BCP_SUPPLIER_BCP_VER_Lin1
          data-send-points:
            access DSP_VeLINR_e_BCP_SUPPLIER_VeLINR_e_BCP_SUPPLIER: accessed-variable=VeLINR_e_BCP_SUPPLIER.VeLINR_e_BCP_SUPPLIER
            access DSP_VeLINR_b_BCP_SUPPLIER_TO_VeLINR_b_BCP_SUPPLIER_TO: accessed-variable=VeLINR_b_BCP_SUPPLIER_TO.VeLINR_b_BCP_SUPPLIER_TO
        COMRXL_BCP_SUPPLIER_BCP_VER_Lin1_Error: symbol=ApplLinComAb_LIN1_COMRXL_BCP_SUPPLIER_BCP_VER_Lin1_Error  # Error -
          data-receive-point-by-arguments:
            access DRP_Lin1ComRxSignalsSR_COMRXL_BCP_SUPPLIER_BCP_VER_Lin1: accessed-variable=Lin1ComRxSignalsSR.COMRXL_BCP_SUPPLIER_BCP_VER_Lin1
          data-send-points:
            access DSP_VeLINR_e_BCP_SUPPLIER_VeLINR_e_BCP_SUPPLIER: accessed-variable=VeLINR_e_BCP_SUPPLIER.VeLINR_e_BCP_SUPPLIER
            access DSP_VeLINR_b_BCP_SUPPLIER_TO_VeLINR_b_BCP_SUPPLIER_TO: accessed-variable=VeLINR_b_BCP_SUPPLIER_TO.VeLINR_b_BCP_SUPPLIER_TO
          read-local-variables:
            access IRVRA_VeLINR_d_LIN_SlavePrsnt_LIN1: accessed-variable=VeLINR_d_LIN_SlavePrsnt_LIN1
        COMRXL_CPV_PosAct_CPV_STAT_V2_Lin1_Received: symbol=ApplLinComAb_LIN1_COMRXL_CPV_PosAct_CPV_STAT_V2_Lin1_Received  # Received -
          data-receive-point-by-arguments:
            access DRP_Lin1ComRxSignalsSR_COMRXL_CPV_PosAct_CPV_STAT_V2_Lin1: accessed-variable=Lin1ComRxSignalsSR.COMRXL_CPV_PosAct_CPV_STAT_V2_Lin1
          data-send-points:
            access DSP_VeLINR_Pct_CPV_PosAct_VeLINR_Pct_CPV_PosAct: accessed-variable=VeLINR_Pct_CPV_PosAct.VeLINR_Pct_CPV_PosAct
            access DSP_VeLINR_b_CPV_PosActTO_VeLINR_b_CPV_PosActTO: accessed-variable=VeLINR_b_CPV_PosActTO.VeLINR_b_CPV_PosActTO
        COMRXL_CPV_PosAct_CPV_STAT_V2_Lin1_Error: symbol=ApplLinComAb_LIN1_COMRXL_CPV_PosAct_CPV_STAT_V2_Lin1_Error  # Error -
          data-receive-point-by-arguments:
            access DRP_Lin1ComRxSignalsSR_COMRXL_CPV_PosAct_CPV_STAT_V2_Lin1: accessed-variable=Lin1ComRxSignalsSR.COMRXL_CPV_PosAct_CPV_STAT_V2_Lin1
          data-send-points:
            access DSP_VeLINR_Pct_CPV_PosAct_VeLINR_Pct_CPV_PosAct: accessed-variable=VeLINR_Pct_CPV_PosAct.VeLINR_Pct_CPV_PosAct
            access DSP_VeLINR_b_CPV_PosActTO_VeLINR_b_CPV_PosActTO: accessed-variable=VeLINR_b_CPV_PosActTO.VeLINR_b_CPV_PosActTO
          read-local-variables:
            access IRVRA_VeLINR_d_LIN_SlavePrsnt_LIN1: accessed-variable=VeLINR_d_LIN_SlavePrsnt_LIN1
        COMRXL_CPV_ERR_CPV_STAT_V2_Lin1_Received: symbol=ApplLinComAb_LIN1_COMRXL_CPV_ERR_CPV_STAT_V2_Lin1_Received  # Received -
          data-receive-point-by-arguments:
            access DRP_Lin1ComRxSignalsSR_COMRXL_CPV_ERR_CPV_STAT_V2_Lin1: accessed-variable=Lin1ComRxSignalsSR.COMRXL_CPV_ERR_CPV_STAT_V2_Lin1
          data-send-points:
            access DSP_VeLINR_e_CPV_ERR_VeLINR_e_CPV_ERR: accessed-variable=VeLINR_e_CPV_ERR.VeLINR_e_CPV_ERR
            access DSP_VeLINR_b_CPV_ERR_TO_VeLINR_b_CPV_ERR_TO: accessed-variable=VeLINR_b_CPV_ERR_TO.VeLINR_b_CPV_ERR_TO
        COMRXL_CPV_ERR_CPV_STAT_V2_Lin1_Error: symbol=ApplLinComAb_LIN1_COMRXL_CPV_ERR_CPV_STAT_V2_Lin1_Error  # Error -
          data-receive-point-by-arguments:
            access DRP_Lin1ComRxSignalsSR_COMRXL_CPV_ERR_CPV_STAT_V2_Lin1: accessed-variable=Lin1ComRxSignalsSR.COMRXL_CPV_ERR_CPV_STAT_V2_Lin1
          data-send-points:
            access DSP_VeLINR_e_CPV_ERR_VeLINR_e_CPV_ERR: accessed-variable=VeLINR_e_CPV_ERR.VeLINR_e_CPV_ERR
            access DSP_VeLINR_b_CPV_ERR_TO_VeLINR_b_CPV_ERR_TO: accessed-variable=VeLINR_b_CPV_ERR_TO.VeLINR_b_CPV_ERR_TO
          read-local-variables:
            access IRVRA_VeLINR_d_LIN_SlavePrsnt_LIN1: accessed-variable=VeLINR_d_LIN_SlavePrsnt_LIN1
        COMRXL_CPV_Sts_CPV_STAT_V2_Lin1_Received: symbol=ApplLinComAb_LIN1_COMRXL_CPV_Sts_CPV_STAT_V2_Lin1_Received  # Received -
          data-receive-point-by-arguments:
            access DRP_Lin1ComRxSignalsSR_COMRXL_CPV_Sts_CPV_STAT_V2_Lin1: accessed-variable=Lin1ComRxSignalsSR.COMRXL_CPV_Sts_CPV_STAT_V2_Lin1
          data-send-points:
            access DSP_VeLINR_e_CPV_Sts_VeLINR_e_CPV_Sts: accessed-variable=VeLINR_e_CPV_Sts.VeLINR_e_CPV_Sts
            access DSP_VeLINR_b_CPV_StsTO_VeLINR_b_CPV_StsTO: accessed-variable=VeLINR_b_CPV_StsTO.VeLINR_b_CPV_StsTO
        COMRXL_CPV_Sts_CPV_STAT_V2_Lin1_Error: symbol=ApplLinComAb_LIN1_COMRXL_CPV_Sts_CPV_STAT_V2_Lin1_Error  # Error -
          data-receive-point-by-arguments:
            access DRP_Lin1ComRxSignalsSR_COMRXL_CPV_Sts_CPV_STAT_V2_Lin1: accessed-variable=Lin1ComRxSignalsSR.COMRXL_CPV_Sts_CPV_STAT_V2_Lin1
          data-send-points:
            access DSP_VeLINR_e_CPV_Sts_VeLINR_e_CPV_Sts: accessed-variable=VeLINR_e_CPV_Sts.VeLINR_e_CPV_Sts
            access DSP_VeLINR_b_CPV_StsTO_VeLINR_b_CPV_StsTO: accessed-variable=VeLINR_b_CPV_StsTO.VeLINR_b_CPV_StsTO
          read-local-variables:
            access IRVRA_VeLINR_d_LIN_SlavePrsnt_LIN1: accessed-variable=VeLINR_d_LIN_SlavePrsnt_LIN1
        COMRXL_RsErr_CPV_CPV_STAT_V2_Lin1_Received: symbol=ApplLinComAb_LIN1_COMRXL_RsErr_CPV_CPV_STAT_V2_Lin1_Received  # Received -
          data-receive-point-by-arguments:
            access DRP_Lin1ComRxSignalsSR_COMRXL_RsErr_CPV_CPV_STAT_V2_Lin1: accessed-variable=Lin1ComRxSignalsSR.COMRXL_RsErr_CPV_CPV_STAT_V2_Lin1
          data-send-points:
            access DSP_VeLINR_b_RsErr_CPV_VeLINR_b_RsErr_CPV: accessed-variable=VeLINR_b_RsErr_CPV.VeLINR_b_RsErr_CPV
            access DSP_VeLINR_b_RsErr_CPV_TO_VeLINR_b_RsErr_CPV_TO: accessed-variable=VeLINR_b_RsErr_CPV_TO.VeLINR_b_RsErr_CPV_TO
        COMRXL_RsErr_CPV_CPV_STAT_V2_Lin1_Error: symbol=ApplLinComAb_LIN1_COMRXL_RsErr_CPV_CPV_STAT_V2_Lin1_Error  # Error -
          data-receive-point-by-arguments:
            access DRP_Lin1ComRxSignalsSR_COMRXL_RsErr_CPV_CPV_STAT_V2_Lin1: accessed-variable=Lin1ComRxSignalsSR.COMRXL_RsErr_CPV_CPV_STAT_V2_Lin1
          data-send-points:
            access DSP_VeLINR_b_RsErr_CPV_VeLINR_b_RsErr_CPV: accessed-variable=VeLINR_b_RsErr_CPV.VeLINR_b_RsErr_CPV
            access DSP_VeLINR_b_RsErr_CPV_TO_VeLINR_b_RsErr_CPV_TO: accessed-variable=VeLINR_b_RsErr_CPV_TO.VeLINR_b_RsErr_CPV_TO
          read-local-variables:
            access IRVRA_VeLINR_d_LIN_SlavePrsnt_LIN1: accessed-variable=VeLINR_d_LIN_SlavePrsnt_LIN1
        COMRXL_AirHeatrICns_HVEAHLIN18Fr01_Lin1_Received: symbol=ApplLinComAb_LIN1_COMRXL_AirHeatrICns_HVEAHLIN18Fr01_Lin1_Received  # Received -
          data-receive-point-by-arguments:
            access DRP_Lin1ComRxSignalsSR_COMRXL_AirHeatrICns_HVEAHLIN18Fr01_Lin1: accessed-variable=Lin1ComRxSignalsSR.COMRXL_AirHeatrICns_HVEAHLIN18Fr01_Lin1
          data-send-points:
            access DSP_VeLINR_I_AirHeatrICns_VeLINR_I_AirHeatrICns: accessed-variable=VeLINR_I_AirHeatrICns.VeLINR_I_AirHeatrICns
            access DSP_VeLINR_b_AirHeatrICnsTO_VeLINR_b_AirHeatrICnsTO: accessed-variable=VeLINR_b_AirHeatrICnsTO.VeLINR_b_AirHeatrICnsTO
        COMRXL_AirHeatrICns_HVEAHLIN18Fr01_Lin1_Error: symbol=ApplLinComAb_LIN1_COMRXL_AirHeatrICns_HVEAHLIN18Fr01_Lin1_Error  # Error -
          data-receive-point-by-arguments:
            access DRP_Lin1ComRxSignalsSR_COMRXL_AirHeatrICns_HVEAHLIN18Fr01_Lin1: accessed-variable=Lin1ComRxSignalsSR.COMRXL_AirHeatrICns_HVEAHLIN18Fr01_Lin1
          data-send-points:
            access DSP_VeLINR_I_AirHeatrICns_VeLINR_I_AirHeatrICns: accessed-variable=VeLINR_I_AirHeatrICns.VeLINR_I_AirHeatrICns
            access DSP_VeLINR_b_AirHeatrICnsTO_VeLINR_b_AirHeatrICnsTO: accessed-variable=VeLINR_b_AirHeatrICnsTO.VeLINR_b_AirHeatrICnsTO
          read-local-variables:
            access IRVRA_VeLINR_d_LIN_SlavePrsnt_LIN1: accessed-variable=VeLINR_d_LIN_SlavePrsnt_LIN1
        COMRXL_AirHeatrHVmeas_HVEAHLIN18Fr01_Lin1_Received: symbol=ApplLinComAb_LIN1_COMRXL_AirHeatrHVmeas_HVEAHLIN18Fr01_Lin1_Received  # Received -
          data-receive-point-by-arguments:
            access DRP_Lin1ComRxSignalsSR_COMRXL_AirHeatrHVmeas_HVEAHLIN18Fr01_Lin1: accessed-variable=Lin1ComRxSignalsSR.COMRXL_AirHeatrHVmeas_HVEAHLIN18Fr01_Lin1
          data-send-points:
            access DSP_VeLINR_U_AirHeatrHVmeas_VeLINR_U_AirHeatrHVmeas: accessed-variable=VeLINR_U_AirHeatrHVmeas.VeLINR_U_AirHeatrHVmeas
            access DSP_VeLINR_b_AirHeatrHVmeasTO_VeLINR_b_AirHeatrHVmeasTO: accessed-variable=VeLINR_b_AirHeatrHVmeasTO.VeLINR_b_AirHeatrHVmeasTO
        COMRXL_AirHeatrHVmeas_HVEAHLIN18Fr01_Lin1_Error: symbol=ApplLinComAb_LIN1_COMRXL_AirHeatrHVmeas_HVEAHLIN18Fr01_Lin1_Error  # Error -
          data-receive-point-by-arguments:
            access DRP_Lin1ComRxSignalsSR_COMRXL_AirHeatrHVmeas_HVEAHLIN18Fr01_Lin1: accessed-variable=Lin1ComRxSignalsSR.COMRXL_AirHeatrHVmeas_HVEAHLIN18Fr01_Lin1
          data-send-points:
            access DSP_VeLINR_U_AirHeatrHVmeas_VeLINR_U_AirHeatrHVmeas: accessed-variable=VeLINR_U_AirHeatrHVmeas.VeLINR_U_AirHeatrHVmeas
            access DSP_VeLINR_b_AirHeatrHVmeasTO_VeLINR_b_AirHeatrHVmeasTO: accessed-variable=VeLINR_b_AirHeatrHVmeasTO.VeLINR_b_AirHeatrHVmeasTO
          read-local-variables:
            access IRVRA_VeLINR_d_LIN_SlavePrsnt_LIN1: accessed-variable=VeLINR_d_LIN_SlavePrsnt_LIN1
        COMRXL_AirHeatrPCBTemp_HVEAHLIN18Fr01_Lin1_Received: symbol=ApplLinComAb_LIN1_COMRXL_AirHeatrPCBTemp_HVEAHLIN18Fr01_Lin1_Received  # Received -
          data-receive-point-by-arguments:
            access DRP_Lin1ComRxSignalsSR_COMRXL_AirHeatrPCBTemp_HVEAHLIN18Fr01_Lin1: accessed-variable=Lin1ComRxSignalsSR.COMRXL_AirHeatrPCBTemp_HVEAHLIN18Fr01_Lin1
          data-send-points:
            access DSP_VeLINR_T_AirHeatrPCBTemp_VeLINR_T_AirHeatrPCBTemp: accessed-variable=VeLINR_T_AirHeatrPCBTemp.VeLINR_T_AirHeatrPCBTemp
            access DSP_VeLINR_b_AirHeatrPCBTempTO_VeLINR_b_AirHeatrPCBTempTO: accessed-variable=VeLINR_b_AirHeatrPCBTempTO.VeLINR_b_AirHeatrPCBTempTO
        COMRXL_AirHeatrPCBTemp_HVEAHLIN18Fr01_Lin1_Error: symbol=ApplLinComAb_LIN1_COMRXL_AirHeatrPCBTemp_HVEAHLIN18Fr01_Lin1_Error  # Error -
          data-receive-point-by-arguments:
            access DRP_Lin1ComRxSignalsSR_COMRXL_AirHeatrPCBTemp_HVEAHLIN18Fr01_Lin1: accessed-variable=Lin1ComRxSignalsSR.COMRXL_AirHeatrPCBTemp_HVEAHLIN18Fr01_Lin1
          data-send-points:
            access DSP_VeLINR_T_AirHeatrPCBTemp_VeLINR_T_AirHeatrPCBTemp: accessed-variable=VeLINR_T_AirHeatrPCBTemp.VeLINR_T_AirHeatrPCBTemp
            access DSP_VeLINR_b_AirHeatrPCBTempTO_VeLINR_b_AirHeatrPCBTempTO: accessed-variable=VeLINR_b_AirHeatrPCBTempTO.VeLINR_b_AirHeatrPCBTempTO
          read-local-variables:
            access IRVRA_VeLINR_d_LIN_SlavePrsnt_LIN1: accessed-variable=VeLINR_d_LIN_SlavePrsnt_LIN1
        COMRXL_AirHeatrCoreTemp_HVEAHLIN18Fr01_Lin1_Received: symbol=ApplLinComAb_LIN1_COMRXL_AirHeatrCoreTemp_HVEAHLIN18Fr01_Lin1_Received  # Received -
          data-receive-point-by-arguments:
            access DRP_Lin1ComRxSignalsSR_COMRXL_AirHeatrCoreTemp_HVEAHLIN18Fr01_Lin1: accessed-variable=Lin1ComRxSignalsSR.COMRXL_AirHeatrCoreTemp_HVEAHLIN18Fr01_Lin1
          data-send-points:
            access DSP_VeLINR_T_AirHeatrCoreTemp_VeLINR_T_AirHeatrCoreTemp: accessed-variable=VeLINR_T_AirHeatrCoreTemp.VeLINR_T_AirHeatrCoreTemp
            access DSP_VeLINR_b_AirHeatrCoreTempTO_VeLINR_b_AirHeatrCoreTempTO: accessed-variable=VeLINR_b_AirHeatrCoreTempTO.VeLINR_b_AirHeatrCoreTempTO
        COMRXL_AirHeatrCoreTemp_HVEAHLIN18Fr01_Lin1_Error: symbol=ApplLinComAb_LIN1_COMRXL_AirHeatrCoreTemp_HVEAHLIN18Fr01_Lin1_Error  # Error -
          data-receive-point-by-arguments:
            access DRP_Lin1ComRxSignalsSR_COMRXL_AirHeatrCoreTemp_HVEAHLIN18Fr01_Lin1: accessed-variable=Lin1ComRxSignalsSR.COMRXL_AirHeatrCoreTemp_HVEAHLIN18Fr01_Lin1
          data-send-points:
            access DSP_VeLINR_T_AirHeatrCoreTemp_VeLINR_T_AirHeatrCoreTemp: accessed-variable=VeLINR_T_AirHeatrCoreTemp.VeLINR_T_AirHeatrCoreTemp
            access DSP_VeLINR_b_AirHeatrCoreTempTO_VeLINR_b_AirHeatrCoreTempTO: accessed-variable=VeLINR_b_AirHeatrCoreTempTO.VeLINR_b_AirHeatrCoreTempTO
          read-local-variables:
            access IRVRA_VeLINR_d_LIN_SlavePrsnt_LIN1: accessed-variable=VeLINR_d_LIN_SlavePrsnt_LIN1
        COMRXL_RsErr_EAH_HVEAHLIN18Fr02_Lin1_Received: symbol=ApplLinComAb_LIN1_COMRXL_RsErr_EAH_HVEAHLIN18Fr02_Lin1_Received  # Received -
          data-receive-point-by-arguments:
            access DRP_Lin1ComRxSignalsSR_COMRXL_RsErr_EAH_HVEAHLIN18Fr02_Lin1: accessed-variable=Lin1ComRxSignalsSR.COMRXL_RsErr_EAH_HVEAHLIN18Fr02_Lin1
          data-send-points:
            access DSP_VeLINR_b_RsErr_EAH_VeLINR_b_RsErr_EAH: accessed-variable=VeLINR_b_RsErr_EAH.VeLINR_b_RsErr_EAH
            access DSP_VeLINR_b_RsErr_EAH_TO_VeLINR_b_RsErr_EAH_TO: accessed-variable=VeLINR_b_RsErr_EAH_TO.VeLINR_b_RsErr_EAH_TO
        COMRXL_RsErr_EAH_HVEAHLIN18Fr02_Lin1_Error: symbol=ApplLinComAb_LIN1_COMRXL_RsErr_EAH_HVEAHLIN18Fr02_Lin1_Error  # Error -
          data-receive-point-by-arguments:
            access DRP_Lin1ComRxSignalsSR_COMRXL_RsErr_EAH_HVEAHLIN18Fr02_Lin1: accessed-variable=Lin1ComRxSignalsSR.COMRXL_RsErr_EAH_HVEAHLIN18Fr02_Lin1
          data-send-points:
            access DSP_VeLINR_b_RsErr_EAH_VeLINR_b_RsErr_EAH: accessed-variable=VeLINR_b_RsErr_EAH.VeLINR_b_RsErr_EAH
            access DSP_VeLINR_b_RsErr_EAH_TO_VeLINR_b_RsErr_EAH_TO: accessed-variable=VeLINR_b_RsErr_EAH_TO.VeLINR_b_RsErr_EAH_TO
          read-local-variables:
            access IRVRA_VeLINR_d_LIN_SlavePrsnt_LIN1: accessed-variable=VeLINR_d_LIN_SlavePrsnt_LIN1
        COMRXL_AirHeatrWarnFltInCom_HVEAHLIN18Fr02_Lin1_Received: symbol=ApplLinComAb_LIN1_COMRXL_AirHeatrWarnFltInCom_HVEAHLIN18Fr02_Lin1_Received  # Received -
          data-receive-point-by-arguments:
            access DRP_Lin1ComRxSignalsSR_COMRXL_AirHeatrWarnFltInCom_HVEAHLIN18Fr02_Lin1: accessed-variable=Lin1ComRxSignalsSR.COMRXL_AirHeatrWarnFltInCom_HVEAHLIN18Fr02_Lin1
          data-send-points:
            access DSP_VeLINR_e_AirHeatrWarnFltInCom_VeLINR_e_AirHeatrWarnFltInCom: accessed-variable=VeLINR_e_AirHeatrWarnFltInCom.VeLINR_e_AirHeatrWarnFltInCom
            access DSP_VeLINR_b_AirHeatrWarnFltInComTO_VeLINR_b_AirHeatrWarnFltInComTO: accessed-variable=VeLINR_b_AirHeatrWarnFltInComTO.VeLINR_b_AirHeatrWarnFltInComTO
        COMRXL_AirHeatrWarnFltInCom_HVEAHLIN18Fr02_Lin1_Error: symbol=ApplLinComAb_LIN1_COMRXL_AirHeatrWarnFltInCom_HVEAHLIN18Fr02_Lin1_Error  # Error -
          data-receive-point-by-arguments:
            access DRP_Lin1ComRxSignalsSR_COMRXL_AirHeatrWarnFltInCom_HVEAHLIN18Fr02_Lin1: accessed-variable=Lin1ComRxSignalsSR.COMRXL_AirHeatrWarnFltInCom_HVEAHLIN18Fr02_Lin1
          data-send-points:
            access DSP_VeLINR_e_AirHeatrWarnFltInCom_VeLINR_e_AirHeatrWarnFltInCom: accessed-variable=VeLINR_e_AirHeatrWarnFltInCom.VeLINR_e_AirHeatrWarnFltInCom
            access DSP_VeLINR_b_AirHeatrWarnFltInComTO_VeLINR_b_AirHeatrWarnFltInComTO: accessed-variable=VeLINR_b_AirHeatrWarnFltInComTO.VeLINR_b_AirHeatrWarnFltInComTO
          read-local-variables:
            access IRVRA_VeLINR_d_LIN_SlavePrsnt_LIN1: accessed-variable=VeLINR_d_LIN_SlavePrsnt_LIN1
        COMRXL_AirHeatrWarnHvOutOfRng_HVEAHLIN18Fr02_Lin1_Received: symbol=ApplLinComAb_LIN1_COMRXL_AirHeatrWarnHvOutOfRng_HVEAHLIN18Fr02_Lin1_Received  # Received -
          data-receive-point-by-arguments:
            access DRP_Lin1ComRxSignalsSR_COMRXL_AirHeatrWarnHvOutOfRng_HVEAHLIN18Fr02_Lin1: accessed-variable=Lin1ComRxSignalsSR.COMRXL_AirHeatrWarnHvOutOfRng_HVEAHLIN18Fr02_Lin1
          data-send-points:
            access DSP_VeLINR_e_AirHeatrWarnHvOutOfRng_VeLINR_e_AirHeatrWarnHvOutOfRng: accessed-variable=VeLINR_e_AirHeatrWarnHvOutOfRng.VeLINR_e_AirHeatrWarnHvOutOfRng
            access DSP_VeLINR_b_AirHeatrWarnHvOutOfRngTO_VeLINR_b_AirHeatrWarnHvOutOfRngTO: accessed-variable=VeLINR_b_AirHeatrWarnHvOutOfRngTO.VeLINR_b_AirHeatrWarnHvOutOfRngTO
        COMRXL_AirHeatrWarnHvOutOfRng_HVEAHLIN18Fr02_Lin1_Error: symbol=ApplLinComAb_LIN1_COMRXL_AirHeatrWarnHvOutOfRng_HVEAHLIN18Fr02_Lin1_Error  # Error -
          data-receive-point-by-arguments:
            access DRP_Lin1ComRxSignalsSR_COMRXL_AirHeatrWarnHvOutOfRng_HVEAHLIN18Fr02_Lin1: accessed-variable=Lin1ComRxSignalsSR.COMRXL_AirHeatrWarnHvOutOfRng_HVEAHLIN18Fr02_Lin1
          data-send-points:
            access DSP_VeLINR_e_AirHeatrWarnHvOutOfRng_VeLINR_e_AirHeatrWarnHvOutOfRng: accessed-variable=VeLINR_e_AirHeatrWarnHvOutOfRng.VeLINR_e_AirHeatrWarnHvOutOfRng
            access DSP_VeLINR_b_AirHeatrWarnHvOutOfRngTO_VeLINR_b_AirHeatrWarnHvOutOfRngTO: accessed-variable=VeLINR_b_AirHeatrWarnHvOutOfRngTO.VeLINR_b_AirHeatrWarnHvOutOfRngTO
          read-local-variables:
            access IRVRA_VeLINR_d_LIN_SlavePrsnt_LIN1: accessed-variable=VeLINR_d_LIN_SlavePrsnt_LIN1
        COMRXL_AirHeatrWarnULoOutOfRng_HVEAHLIN18Fr02_Lin1_Received: symbol=ApplLinComAb_LIN1_COMRXL_AirHeatrWarnULoOutOfRng_HVEAHLIN18Fr02_Lin1_Received  # Received -
          data-receive-point-by-arguments:
            access DRP_Lin1ComRxSignalsSR_COMRXL_AirHeatrWarnULoOutOfRng_HVEAHLIN18Fr02_Lin1: accessed-variable=Lin1ComRxSignalsSR.COMRXL_AirHeatrWarnULoOutOfRng_HVEAHLIN18Fr02_Lin1
          data-send-points:
            access DSP_VeLINR_e_AirHtrWarnULoOutOfRng_VeLINR_e_AirHtrWarnULoOutOfRng: accessed-variable=VeLINR_e_AirHtrWarnULoOutOfRng.VeLINR_e_AirHtrWarnULoOutOfRng
            access DSP_VeLINR_b_AirHtrWarnULoOutOfRngTO_VeLINR_b_AirHtrWarnULoOutOfRngTO: accessed-variable=VeLINR_b_AirHtrWarnULoOutOfRngTO.VeLINR_b_AirHtrWarnULoOutOfRngTO
        COMRXL_AirHeatrWarnULoOutOfRng_HVEAHLIN18Fr02_Lin1_Error: symbol=ApplLinComAb_LIN1_COMRXL_AirHeatrWarnULoOutOfRng_HVEAHLIN18Fr02_Lin1_Error  # Error -
          data-receive-point-by-arguments:
            access DRP_Lin1ComRxSignalsSR_COMRXL_AirHeatrWarnULoOutOfRng_HVEAHLIN18Fr02_Lin1: accessed-variable=Lin1ComRxSignalsSR.COMRXL_AirHeatrWarnULoOutOfRng_HVEAHLIN18Fr02_Lin1
          data-send-points:
            access DSP_VeLINR_e_AirHtrWarnULoOutOfRng_VeLINR_e_AirHtrWarnULoOutOfRng: accessed-variable=VeLINR_e_AirHtrWarnULoOutOfRng.VeLINR_e_AirHtrWarnULoOutOfRng
            access DSP_VeLINR_b_AirHtrWarnULoOutOfRngTO_VeLINR_b_AirHtrWarnULoOutOfRngTO: accessed-variable=VeLINR_b_AirHtrWarnULoOutOfRngTO.VeLINR_b_AirHtrWarnULoOutOfRngTO
          read-local-variables:
            access IRVRA_VeLINR_d_LIN_SlavePrsnt_LIN1: accessed-variable=VeLINR_d_LIN_SlavePrsnt_LIN1
        COMRXL_AirHeatrWarnTmpOvrheatg_HVEAHLIN18Fr02_Lin1_Received: symbol=ApplLinComAb_LIN1_COMRXL_AirHeatrWarnTmpOvrheatg_HVEAHLIN18Fr02_Lin1_Received  # Received -
          data-receive-point-by-arguments:
            access DRP_Lin1ComRxSignalsSR_COMRXL_AirHeatrWarnTmpOvrheatg_HVEAHLIN18Fr02_Lin1: accessed-variable=Lin1ComRxSignalsSR.COMRXL_AirHeatrWarnTmpOvrheatg_HVEAHLIN18Fr02_Lin1
          data-send-points:
            access DSP_VeLINR_e_AirHtrWarnTmpOvrheatg_VeLINR_e_AirHtrWarnTmpOvrheatg: accessed-variable=VeLINR_e_AirHtrWarnTmpOvrheatg.VeLINR_e_AirHtrWarnTmpOvrheatg
            access DSP_VeLINR_b_AirHtrWarnTmpOvrheatgTO_VeLINR_b_AirHtrWarnTmpOvrheatgTO: accessed-variable=VeLINR_b_AirHtrWarnTmpOvrheatgTO.VeLINR_b_AirHtrWarnTmpOvrheatgTO
        COMRXL_AirHeatrWarnTmpOvrheatg_HVEAHLIN18Fr02_Lin1_Error: symbol=ApplLinComAb_LIN1_COMRXL_AirHeatrWarnTmpOvrheatg_HVEAHLIN18Fr02_Lin1_Error  # Error -
          data-receive-point-by-arguments:
            access DRP_Lin1ComRxSignalsSR_COMRXL_AirHeatrWarnTmpOvrheatg_HVEAHLIN18Fr02_Lin1: accessed-variable=Lin1ComRxSignalsSR.COMRXL_AirHeatrWarnTmpOvrheatg_HVEAHLIN18Fr02_Lin1
          data-send-points:
            access DSP_VeLINR_e_AirHtrWarnTmpOvrheatg_VeLINR_e_AirHtrWarnTmpOvrheatg: accessed-variable=VeLINR_e_AirHtrWarnTmpOvrheatg.VeLINR_e_AirHtrWarnTmpOvrheatg
            access DSP_VeLINR_b_AirHtrWarnTmpOvrheatgTO_VeLINR_b_AirHtrWarnTmpOvrheatgTO: accessed-variable=VeLINR_b_AirHtrWarnTmpOvrheatgTO.VeLINR_b_AirHtrWarnTmpOvrheatgTO
          read-local-variables:
            access IRVRA_VeLINR_d_LIN_SlavePrsnt_LIN1: accessed-variable=VeLINR_d_LIN_SlavePrsnt_LIN1
        COMRXL_AirHeatrWarnICnsOutOfRng_HVEAHLIN18Fr02_Lin1_Received: symbol=ApplLinComAb_LIN1_COMRXL_AirHeatrWarnICnsOutOfRng_HVEAHLIN18Fr02_Lin1_Received  # Received -
          data-receive-point-by-arguments:
            access DRP_Lin1ComRxSignalsSR_COMRXL_AirHeatrWarnICnsOutOfRng_HVEAHLIN18Fr02_Lin1: accessed-variable=Lin1ComRxSignalsSR.COMRXL_AirHeatrWarnICnsOutOfRng_HVEAHLIN18Fr02_Lin1
          data-send-points:
            access DSP_VeLINR_e_AirHtrWarnICnsOutOfRng_VeLINR_e_AirHtrWarnICnsOutOfRng: accessed-variable=VeLINR_e_AirHtrWarnICnsOutOfRng.VeLINR_e_AirHtrWarnICnsOutOfRng
            access DSP_VeLINR_b_AirHtrWarnICnsOutOfRngTO_VeLINR_b_AirHtrWarnICnsOutOfRngTO: accessed-variable=VeLINR_b_AirHtrWarnICnsOutOfRngTO.VeLINR_b_AirHtrWarnICnsOutOfRngTO
        COMRXL_AirHeatrWarnICnsOutOfRng_HVEAHLIN18Fr02_Lin1_Error: symbol=ApplLinComAb_LIN1_COMRXL_AirHeatrWarnICnsOutOfRng_HVEAHLIN18Fr02_Lin1_Error  # Error -
          data-receive-point-by-arguments:
            access DRP_Lin1ComRxSignalsSR_COMRXL_AirHeatrWarnICnsOutOfRng_HVEAHLIN18Fr02_Lin1: accessed-variable=Lin1ComRxSignalsSR.COMRXL_AirHeatrWarnICnsOutOfRng_HVEAHLIN18Fr02_Lin1
          data-send-points:
            access DSP_VeLINR_e_AirHtrWarnICnsOutOfRng_VeLINR_e_AirHtrWarnICnsOutOfRng: accessed-variable=VeLINR_e_AirHtrWarnICnsOutOfRng.VeLINR_e_AirHtrWarnICnsOutOfRng
            access DSP_VeLINR_b_AirHtrWarnICnsOutOfRngTO_VeLINR_b_AirHtrWarnICnsOutOfRngTO: accessed-variable=VeLINR_b_AirHtrWarnICnsOutOfRngTO.VeLINR_b_AirHtrWarnICnsOutOfRngTO
          read-local-variables:
            access IRVRA_VeLINR_d_LIN_SlavePrsnt_LIN1: accessed-variable=VeLINR_d_LIN_SlavePrsnt_LIN1
        COMRXL_AirHeatrDmgIntHwProtn_HVEAHLIN18Fr02_Lin1_Received: symbol=ApplLinComAb_LIN1_COMRXL_AirHeatrDmgIntHwProtn_HVEAHLIN18Fr02_Lin1_Received  # Received -
          data-receive-point-by-arguments:
            access DRP_Lin1ComRxSignalsSR_COMRXL_AirHeatrDmgIntHwProtn_HVEAHLIN18Fr02_Lin1: accessed-variable=Lin1ComRxSignalsSR.COMRXL_AirHeatrDmgIntHwProtn_HVEAHLIN18Fr02_Lin1
          data-send-points:
            access DSP_VeLINR_e_AirHeatrDmgIntHwProtn_VeLINR_e_AirHeatrDmgIntHwProtn: accessed-variable=VeLINR_e_AirHeatrDmgIntHwProtn.VeLINR_e_AirHeatrDmgIntHwProtn
            access DSP_VeLINR_b_AirHeatrDmgIntHwProtnTO_VeLINR_b_AirHeatrDmgIntHwProtnTO: accessed-variable=VeLINR_b_AirHeatrDmgIntHwProtnTO.VeLINR_b_AirHeatrDmgIntHwProtnTO
        COMRXL_AirHeatrDmgIntHwProtn_HVEAHLIN18Fr02_Lin1_Error: symbol=ApplLinComAb_LIN1_COMRXL_AirHeatrDmgIntHwProtn_HVEAHLIN18Fr02_Lin1_Error  # Error -
          data-receive-point-by-arguments:
            access DRP_Lin1ComRxSignalsSR_COMRXL_AirHeatrDmgIntHwProtn_HVEAHLIN18Fr02_Lin1: accessed-variable=Lin1ComRxSignalsSR.COMRXL_AirHeatrDmgIntHwProtn_HVEAHLIN18Fr02_Lin1
          data-send-points:
            access DSP_VeLINR_e_AirHeatrDmgIntHwProtn_VeLINR_e_AirHeatrDmgIntHwProtn: accessed-variable=VeLINR_e_AirHeatrDmgIntHwProtn.VeLINR_e_AirHeatrDmgIntHwProtn
            access DSP_VeLINR_b_AirHeatrDmgIntHwProtnTO_VeLINR_b_AirHeatrDmgIntHwProtnTO: accessed-variable=VeLINR_b_AirHeatrDmgIntHwProtnTO.VeLINR_b_AirHeatrDmgIntHwProtnTO
          read-local-variables:
            access IRVRA_VeLINR_d_LIN_SlavePrsnt_LIN1: accessed-variable=VeLINR_d_LIN_SlavePrsnt_LIN1
        COMRXL_AirHeatrDmgPCBTmpSnsrFlt_HVEAHLIN18Fr02_Lin1_Received: symbol=ApplLinComAb_LIN1_COMRXL_AirHeatrDmgPCBTmpSnsrFlt_HVEAHLIN18Fr02_Lin1_Received  # Received -
          data-receive-point-by-arguments:
            access DRP_Lin1ComRxSignalsSR_COMRXL_AirHeatrDmgPCBTmpSnsrFlt_HVEAHLIN18Fr02_Lin1: accessed-variable=Lin1ComRxSignalsSR.COMRXL_AirHeatrDmgPCBTmpSnsrFlt_HVEAHLIN18Fr02_Lin1
          data-send-points:
            access DSP_VeLINR_e_AirHtrDmgPCBTmpSnsrFlt_VeLINR_e_AirHtrDmgPCBTmpSnsrFlt: accessed-variable=VeLINR_e_AirHtrDmgPCBTmpSnsrFlt.VeLINR_e_AirHtrDmgPCBTmpSnsrFlt
            access DSP_VeLINR_b_AirHtrDmgPCBTmpSnsrFltTO_VeLINR_b_AirHtrDmgPCBTmpSnsrFltTO: accessed-variable=VeLINR_b_AirHtrDmgPCBTmpSnsrFltTO.VeLINR_b_AirHtrDmgPCBTmpSnsrFltTO
        COMRXL_AirHeatrDmgPCBTmpSnsrFlt_HVEAHLIN18Fr02_Lin1_Error: symbol=ApplLinComAb_LIN1_COMRXL_AirHeatrDmgPCBTmpSnsrFlt_HVEAHLIN18Fr02_Lin1_Error  # Error -
          data-receive-point-by-arguments:
            access DRP_Lin1ComRxSignalsSR_COMRXL_AirHeatrDmgPCBTmpSnsrFlt_HVEAHLIN18Fr02_Lin1: accessed-variable=Lin1ComRxSignalsSR.COMRXL_AirHeatrDmgPCBTmpSnsrFlt_HVEAHLIN18Fr02_Lin1
          data-send-points:
            access DSP_VeLINR_e_AirHtrDmgPCBTmpSnsrFlt_VeLINR_e_AirHtrDmgPCBTmpSnsrFlt: accessed-variable=VeLINR_e_AirHtrDmgPCBTmpSnsrFlt.VeLINR_e_AirHtrDmgPCBTmpSnsrFlt
            access DSP_VeLINR_b_AirHtrDmgPCBTmpSnsrFltTO_VeLINR_b_AirHtrDmgPCBTmpSnsrFltTO: accessed-variable=VeLINR_b_AirHtrDmgPCBTmpSnsrFltTO.VeLINR_b_AirHtrDmgPCBTmpSnsrFltTO
          read-local-variables:
            access IRVRA_VeLINR_d_LIN_SlavePrsnt_LIN1: accessed-variable=VeLINR_d_LIN_SlavePrsnt_LIN1
        COMRXL_AirHeatrDmgCircForDrvrShoOrOpen_HVEAHLIN18Fr02_Lin1_Received: symbol=ApplLinComAb_LIN1_COMRXL_AirHeatrDmgCircForDrvrShoOrOpen_HVEAHLIN18Fr02_Lin1_Received  # Received -
          data-receive-point-by-arguments:
            access DRP_Lin1ComRxSignalsSR_COMRXL_AirHeatrDmgCircForDrvrShoOrOpen_HVEAHLIN18Fr02_Lin1: accessed-variable=Lin1ComRxSignalsSR.COMRXL_AirHeatrDmgCircForDrvrShoOrOpen_HVEAHLIN18Fr02_Lin1
          data-send-points:
            access DSP_VeLINR_e_AirHtrDmgCirDrvrShoOpn_VeLINR_e_AirHtrDmgCirDrvrShoOpn: accessed-variable=VeLINR_e_AirHtrDmgCirDrvrShoOpn.VeLINR_e_AirHtrDmgCirDrvrShoOpn
            access DSP_VeLINR_b_AirHtrDmgCirDrvrShoOpnTO_VeLINR_b_AirHtrDmgCirDrvrShoOpnTO: accessed-variable=VeLINR_b_AirHtrDmgCirDrvrShoOpnTO.VeLINR_b_AirHtrDmgCirDrvrShoOpnTO
        COMRXL_AirHeatrDmgCircForDrvrShoOrOpen_HVEAHLIN18Fr02_Lin1_Error: symbol=ApplLinComAb_LIN1_COMRXL_AirHeatrDmgCircForDrvrShoOrOpen_HVEAHLIN18Fr02_Lin1_Error  # Error -
          data-receive-point-by-arguments:
            access DRP_Lin1ComRxSignalsSR_COMRXL_AirHeatrDmgCircForDrvrShoOrOpen_HVEAHLIN18Fr02_Lin1: accessed-variable=Lin1ComRxSignalsSR.COMRXL_AirHeatrDmgCircForDrvrShoOrOpen_HVEAHLIN18Fr02_Lin1
          data-send-points:
            access DSP_VeLINR_e_AirHtrDmgCirDrvrShoOpn_VeLINR_e_AirHtrDmgCirDrvrShoOpn: accessed-variable=VeLINR_e_AirHtrDmgCirDrvrShoOpn.VeLINR_e_AirHtrDmgCirDrvrShoOpn
            access DSP_VeLINR_b_AirHtrDmgCirDrvrShoOpnTO_VeLINR_b_AirHtrDmgCirDrvrShoOpnTO: accessed-variable=VeLINR_b_AirHtrDmgCirDrvrShoOpnTO.VeLINR_b_AirHtrDmgCirDrvrShoOpnTO
          read-local-variables:
            access IRVRA_VeLINR_d_LIN_SlavePrsnt_LIN1: accessed-variable=VeLINR_d_LIN_SlavePrsnt_LIN1
        COMRXL_AirHeatrDmgHVISnsrFlt_HVEAHLIN18Fr02_Lin1_Received: symbol=ApplLinComAb_LIN1_COMRXL_AirHeatrDmgHVISnsrFlt_HVEAHLIN18Fr02_Lin1_Received  # Received -
          data-receive-point-by-arguments:
            access DRP_Lin1ComRxSignalsSR_COMRXL_AirHeatrDmgHVISnsrFlt_HVEAHLIN18Fr02_Lin1: accessed-variable=Lin1ComRxSignalsSR.COMRXL_AirHeatrDmgHVISnsrFlt_HVEAHLIN18Fr02_Lin1
          data-send-points:
            access DSP_VeLINR_e_AirHeatrDmgHVISnsrFlt_VeLINR_e_AirHeatrDmgHVISnsrFlt: accessed-variable=VeLINR_e_AirHeatrDmgHVISnsrFlt.VeLINR_e_AirHeatrDmgHVISnsrFlt
            access DSP_VeLINR_b_AirHeatrDmgHVISnsrFltTO_VeLINR_b_AirHeatrDmgHVISnsrFltTO: accessed-variable=VeLINR_b_AirHeatrDmgHVISnsrFltTO.VeLINR_b_AirHeatrDmgHVISnsrFltTO
        COMRXL_AirHeatrDmgHVISnsrFlt_HVEAHLIN18Fr02_Lin1_Error: symbol=ApplLinComAb_LIN1_COMRXL_AirHeatrDmgHVISnsrFlt_HVEAHLIN18Fr02_Lin1_Error  # Error -
          data-receive-point-by-arguments:
            access DRP_Lin1ComRxSignalsSR_COMRXL_AirHeatrDmgHVISnsrFlt_HVEAHLIN18Fr02_Lin1: accessed-variable=Lin1ComRxSignalsSR.COMRXL_AirHeatrDmgHVISnsrFlt_HVEAHLIN18Fr02_Lin1
          data-send-points:
            access DSP_VeLINR_e_AirHeatrDmgHVISnsrFlt_VeLINR_e_AirHeatrDmgHVISnsrFlt: accessed-variable=VeLINR_e_AirHeatrDmgHVISnsrFlt.VeLINR_e_AirHeatrDmgHVISnsrFlt
            access DSP_VeLINR_b_AirHeatrDmgHVISnsrFltTO_VeLINR_b_AirHeatrDmgHVISnsrFltTO: accessed-variable=VeLINR_b_AirHeatrDmgHVISnsrFltTO.VeLINR_b_AirHeatrDmgHVISnsrFltTO
          read-local-variables:
            access IRVRA_VeLINR_d_LIN_SlavePrsnt_LIN1: accessed-variable=VeLINR_d_LIN_SlavePrsnt_LIN1
        COMRXL_AirHeatrDmgMemErr_HVEAHLIN18Fr02_Lin1_Received: symbol=ApplLinComAb_LIN1_COMRXL_AirHeatrDmgMemErr_HVEAHLIN18Fr02_Lin1_Received  # Received -
          data-receive-point-by-arguments:
            access DRP_Lin1ComRxSignalsSR_COMRXL_AirHeatrDmgMemErr_HVEAHLIN18Fr02_Lin1: accessed-variable=Lin1ComRxSignalsSR.COMRXL_AirHeatrDmgMemErr_HVEAHLIN18Fr02_Lin1
          data-send-points:
            access DSP_VeLINR_e_AirHeatrDmgMemErr_VeLINR_e_AirHeatrDmgMemErr: accessed-variable=VeLINR_e_AirHeatrDmgMemErr.VeLINR_e_AirHeatrDmgMemErr
            access DSP_VeLINR_b_AirHeatrDmgMemErrTO_VeLINR_b_AirHeatrDmgMemErrTO: accessed-variable=VeLINR_b_AirHeatrDmgMemErrTO.VeLINR_b_AirHeatrDmgMemErrTO
        COMRXL_AirHeatrDmgMemErr_HVEAHLIN18Fr02_Lin1_Error: symbol=ApplLinComAb_LIN1_COMRXL_AirHeatrDmgMemErr_HVEAHLIN18Fr02_Lin1_Error  # Error -
          data-receive-point-by-arguments:
            access DRP_Lin1ComRxSignalsSR_COMRXL_AirHeatrDmgMemErr_HVEAHLIN18Fr02_Lin1: accessed-variable=Lin1ComRxSignalsSR.COMRXL_AirHeatrDmgMemErr_HVEAHLIN18Fr02_Lin1
          data-send-points:
            access DSP_VeLINR_e_AirHeatrDmgMemErr_VeLINR_e_AirHeatrDmgMemErr: accessed-variable=VeLINR_e_AirHeatrDmgMemErr.VeLINR_e_AirHeatrDmgMemErr
            access DSP_VeLINR_b_AirHeatrDmgMemErrTO_VeLINR_b_AirHeatrDmgMemErrTO: accessed-variable=VeLINR_b_AirHeatrDmgMemErrTO.VeLINR_b_AirHeatrDmgMemErrTO
          read-local-variables:
            access IRVRA_VeLINR_d_LIN_SlavePrsnt_LIN1: accessed-variable=VeLINR_d_LIN_SlavePrsnt_LIN1
        COMRXL_AirHeatrDmgHtrCoreTmpSnsrFlt_HVEAHLIN18Fr02_Lin1_Received: symbol=ApplLinComAb_LIN1_COMRXL_AirHeatrDmgHtrCoreTmpSnsrFlt_HVEAHLIN18Fr02_Lin1_Received  # Received -
          data-receive-point-by-arguments:
            access DRP_Lin1ComRxSignalsSR_COMRXL_AirHeatrDmgHtrCoreTmpSnsrFlt_HVEAHLIN18Fr02_Lin1: accessed-variable=Lin1ComRxSignalsSR.COMRXL_AirHeatrDmgHtrCoreTmpSnsrFlt_HVEAHLIN18Fr02_Lin1
          data-send-points:
            access DSP_VeLINR_e_AirHtrDmgHtrCorTS_Flt_VeLINR_e_AirHtrDmgHtrCorTS_Flt: accessed-variable=VeLINR_e_AirHtrDmgHtrCorTS_Flt.VeLINR_e_AirHtrDmgHtrCorTS_Flt
            access DSP_VeLINR_b_AirHtrDmgHtrCorTS_FltTO_VeLINR_b_AirHtrDmgHtrCorTS_FltTO: accessed-variable=VeLINR_b_AirHtrDmgHtrCorTS_FltTO.VeLINR_b_AirHtrDmgHtrCorTS_FltTO
        COMRXL_AirHeatrDmgHtrCoreTmpSnsrFlt_HVEAHLIN18Fr02_Lin1_Error: symbol=ApplLinComAb_LIN1_COMRXL_AirHeatrDmgHtrCoreTmpSnsrFlt_HVEAHLIN18Fr02_Lin1_Error  # Error -
          data-receive-point-by-arguments:
            access DRP_Lin1ComRxSignalsSR_COMRXL_AirHeatrDmgHtrCoreTmpSnsrFlt_HVEAHLIN18Fr02_Lin1: accessed-variable=Lin1ComRxSignalsSR.COMRXL_AirHeatrDmgHtrCoreTmpSnsrFlt_HVEAHLIN18Fr02_Lin1
          data-send-points:
            access DSP_VeLINR_e_AirHtrDmgHtrCorTS_Flt_VeLINR_e_AirHtrDmgHtrCorTS_Flt: accessed-variable=VeLINR_e_AirHtrDmgHtrCorTS_Flt.VeLINR_e_AirHtrDmgHtrCorTS_Flt
            access DSP_VeLINR_b_AirHtrDmgHtrCorTS_FltTO_VeLINR_b_AirHtrDmgHtrCorTS_FltTO: accessed-variable=VeLINR_b_AirHtrDmgHtrCorTS_FltTO.VeLINR_b_AirHtrDmgHtrCorTS_FltTO
          read-local-variables:
            access IRVRA_VeLINR_d_LIN_SlavePrsnt_LIN1: accessed-variable=VeLINR_d_LIN_SlavePrsnt_LIN1
        COMRXL_AirHeatrWarnPCBOvrTmp_HVEAHLIN18Fr02_Lin1_Received: symbol=ApplLinComAb_LIN1_COMRXL_AirHeatrWarnPCBOvrTmp_HVEAHLIN18Fr02_Lin1_Received  # Received -
          data-receive-point-by-arguments:
            access DRP_Lin1ComRxSignalsSR_COMRXL_AirHeatrWarnPCBOvrTmp_HVEAHLIN18Fr02_Lin1: accessed-variable=Lin1ComRxSignalsSR.COMRXL_AirHeatrWarnPCBOvrTmp_HVEAHLIN18Fr02_Lin1
          data-send-points:
            access DSP_VeLINR_e_AirHeatrWarnPCBOvrTmp_VeLINR_e_AirHeatrWarnPCBOvrTmp: accessed-variable=VeLINR_e_AirHeatrWarnPCBOvrTmp.VeLINR_e_AirHeatrWarnPCBOvrTmp
            access DSP_VeLINR_b_AirHeatrWarnPCBOvrTmpTO_VeLINR_b_AirHeatrWarnPCBOvrTmpTO: accessed-variable=VeLINR_b_AirHeatrWarnPCBOvrTmpTO.VeLINR_b_AirHeatrWarnPCBOvrTmpTO
        COMRXL_AirHeatrWarnPCBOvrTmp_HVEAHLIN18Fr02_Lin1_Error: symbol=ApplLinComAb_LIN1_COMRXL_AirHeatrWarnPCBOvrTmp_HVEAHLIN18Fr02_Lin1_Error  # Error -
          data-receive-point-by-arguments:
            access DRP_Lin1ComRxSignalsSR_COMRXL_AirHeatrWarnPCBOvrTmp_HVEAHLIN18Fr02_Lin1: accessed-variable=Lin1ComRxSignalsSR.COMRXL_AirHeatrWarnPCBOvrTmp_HVEAHLIN18Fr02_Lin1
          data-send-points:
            access DSP_VeLINR_e_AirHeatrWarnPCBOvrTmp_VeLINR_e_AirHeatrWarnPCBOvrTmp: accessed-variable=VeLINR_e_AirHeatrWarnPCBOvrTmp.VeLINR_e_AirHeatrWarnPCBOvrTmp
            access DSP_VeLINR_b_AirHeatrWarnPCBOvrTmpTO_VeLINR_b_AirHeatrWarnPCBOvrTmpTO: accessed-variable=VeLINR_b_AirHeatrWarnPCBOvrTmpTO.VeLINR_b_AirHeatrWarnPCBOvrTmpTO
          read-local-variables:
            access IRVRA_VeLINR_d_LIN_SlavePrsnt_LIN1: accessed-variable=VeLINR_d_LIN_SlavePrsnt_LIN1
        COMRXL_AirHeatrWarnHtrCoreOvrTmp_HVEAHLIN18Fr02_Lin1_Received: symbol=ApplLinComAb_LIN1_COMRXL_AirHeatrWarnHtrCoreOvrTmp_HVEAHLIN18Fr02_Lin1_Received  # Received -
          data-receive-point-by-arguments:
            access DRP_Lin1ComRxSignalsSR_COMRXL_AirHeatrWarnHtrCoreOvrTmp_HVEAHLIN18Fr02_Lin1: accessed-variable=Lin1ComRxSignalsSR.COMRXL_AirHeatrWarnHtrCoreOvrTmp_HVEAHLIN18Fr02_Lin1
          data-send-points:
            access DSP_VeLINR_e_AirHtrWrnHtrCorOvrTmp_VeLINR_e_AirHtrWrnHtrCorOvrTmp: accessed-variable=VeLINR_e_AirHtrWrnHtrCorOvrTmp.VeLINR_e_AirHtrWrnHtrCorOvrTmp
            access DSP_VeLINR_b_AirHtrWrnHtrCorOvrTmpTO_VeLINR_b_AirHtrWrnHtrCorOvrTmpTO: accessed-variable=VeLINR_b_AirHtrWrnHtrCorOvrTmpTO.VeLINR_b_AirHtrWrnHtrCorOvrTmpTO
        COMRXL_AirHeatrWarnHtrCoreOvrTmp_HVEAHLIN18Fr02_Lin1_Error: symbol=ApplLinComAb_LIN1_COMRXL_AirHeatrWarnHtrCoreOvrTmp_HVEAHLIN18Fr02_Lin1_Error  # Error -
          data-receive-point-by-arguments:
            access DRP_Lin1ComRxSignalsSR_COMRXL_AirHeatrWarnHtrCoreOvrTmp_HVEAHLIN18Fr02_Lin1: accessed-variable=Lin1ComRxSignalsSR.COMRXL_AirHeatrWarnHtrCoreOvrTmp_HVEAHLIN18Fr02_Lin1
          data-send-points:
            access DSP_VeLINR_e_AirHtrWrnHtrCorOvrTmp_VeLINR_e_AirHtrWrnHtrCorOvrTmp: accessed-variable=VeLINR_e_AirHtrWrnHtrCorOvrTmp.VeLINR_e_AirHtrWrnHtrCorOvrTmp
            access DSP_VeLINR_b_AirHtrWrnHtrCorOvrTmpTO_VeLINR_b_AirHtrWrnHtrCorOvrTmpTO: accessed-variable=VeLINR_b_AirHtrWrnHtrCorOvrTmpTO.VeLINR_b_AirHtrWrnHtrCorOvrTmpTO
          read-local-variables:
            access IRVRA_VeLINR_d_LIN_SlavePrsnt_LIN1: accessed-variable=VeLINR_d_LIN_SlavePrsnt_LIN1
        COMRXL_EOPA_RPM_TGT_EOPA_STAT_Lin1_Received: symbol=ApplLinComAb_LIN1_COMRXL_EOPA_RPM_TGT_EOPA_STAT_Lin1_Received  # Received -
          data-receive-point-by-arguments:
            access DRP_Lin1ComRxSignalsSR_COMRXL_EOPA_RPM_TGT_EOPA_STAT_Lin1: accessed-variable=Lin1ComRxSignalsSR.COMRXL_EOPA_RPM_TGT_EOPA_STAT_Lin1
          data-send-points:
            access DSP_VeLINR_e_EOPA_RPM_TGT_VeLINR_e_EOPA_RPM_TGT: accessed-variable=VeLINR_e_EOPA_RPM_TGT.VeLINR_e_EOPA_RPM_TGT
            access DSP_VeLINR_b_EOPA_RPM_TGT_TO_VeLINR_b_EOPA_RPM_TGT_TO: accessed-variable=VeLINR_b_EOPA_RPM_TGT_TO.VeLINR_b_EOPA_RPM_TGT_TO
        COMRXL_EOPA_RPM_TGT_EOPA_STAT_Lin1_Error: symbol=ApplLinComAb_LIN1_COMRXL_EOPA_RPM_TGT_EOPA_STAT_Lin1_Error  # Error -
          data-receive-point-by-arguments:
            access DRP_Lin1ComRxSignalsSR_COMRXL_EOPA_RPM_TGT_EOPA_STAT_Lin1: accessed-variable=Lin1ComRxSignalsSR.COMRXL_EOPA_RPM_TGT_EOPA_STAT_Lin1
          data-send-points:
            access DSP_VeLINR_e_EOPA_RPM_TGT_VeLINR_e_EOPA_RPM_TGT: accessed-variable=VeLINR_e_EOPA_RPM_TGT.VeLINR_e_EOPA_RPM_TGT
            access DSP_VeLINR_b_EOPA_RPM_TGT_TO_VeLINR_b_EOPA_RPM_TGT_TO: accessed-variable=VeLINR_b_EOPA_RPM_TGT_TO.VeLINR_b_EOPA_RPM_TGT_TO
          read-local-variables:
            access IRVRA_VeLINR_d_LIN_SlavePrsnt_LIN1: accessed-variable=VeLINR_d_LIN_SlavePrsnt_LIN1
        COMRXL_EOPA_RPM_ACTL_EOPA_STAT_Lin1_Received: symbol=ApplLinComAb_LIN1_COMRXL_EOPA_RPM_ACTL_EOPA_STAT_Lin1_Received  # Received -
          data-receive-point-by-arguments:
            access DRP_Lin1ComRxSignalsSR_COMRXL_EOPA_RPM_ACTL_EOPA_STAT_Lin1: accessed-variable=Lin1ComRxSignalsSR.COMRXL_EOPA_RPM_ACTL_EOPA_STAT_Lin1
          data-send-points:
            access DSP_VeLINR_e_EOPA_RPM_ACTL_VeLINR_e_EOPA_RPM_ACTL: accessed-variable=VeLINR_e_EOPA_RPM_ACTL.VeLINR_e_EOPA_RPM_ACTL
            access DSP_VeLINR_b_EOPA_RPM_ACTL_TO_VeLINR_b_EOPA_RPM_ACTL_TO: accessed-variable=VeLINR_b_EOPA_RPM_ACTL_TO.VeLINR_b_EOPA_RPM_ACTL_TO
        COMRXL_EOPA_RPM_ACTL_EOPA_STAT_Lin1_Error: symbol=ApplLinComAb_LIN1_COMRXL_EOPA_RPM_ACTL_EOPA_STAT_Lin1_Error  # Error -
          data-receive-point-by-arguments:
            access DRP_Lin1ComRxSignalsSR_COMRXL_EOPA_RPM_ACTL_EOPA_STAT_Lin1: accessed-variable=Lin1ComRxSignalsSR.COMRXL_EOPA_RPM_ACTL_EOPA_STAT_Lin1
          data-send-points:
            access DSP_VeLINR_e_EOPA_RPM_ACTL_VeLINR_e_EOPA_RPM_ACTL: accessed-variable=VeLINR_e_EOPA_RPM_ACTL.VeLINR_e_EOPA_RPM_ACTL
            access DSP_VeLINR_b_EOPA_RPM_ACTL_TO_VeLINR_b_EOPA_RPM_ACTL_TO: accessed-variable=VeLINR_b_EOPA_RPM_ACTL_TO.VeLINR_b_EOPA_RPM_ACTL_TO
          read-local-variables:
            access IRVRA_VeLINR_d_LIN_SlavePrsnt_LIN1: accessed-variable=VeLINR_d_LIN_SlavePrsnt_LIN1
        COMRXL_EOPA_VLTG_EOPA_STAT_Lin1_Received: symbol=ApplLinComAb_LIN1_COMRXL_EOPA_VLTG_EOPA_STAT_Lin1_Received  # Received -
          data-receive-point-by-arguments:
            access DRP_Lin1ComRxSignalsSR_COMRXL_EOPA_VLTG_EOPA_STAT_Lin1: accessed-variable=Lin1ComRxSignalsSR.COMRXL_EOPA_VLTG_EOPA_STAT_Lin1
          data-send-points:
            access DSP_VeLINR_U_EOPA_VLTG_VeLINR_U_EOPA_VLTG: accessed-variable=VeLINR_U_EOPA_VLTG.VeLINR_U_EOPA_VLTG
            access DSP_VeLINR_b_EOPA_VLTG_TO_VeLINR_b_EOPA_VLTG_TO: accessed-variable=VeLINR_b_EOPA_VLTG_TO.VeLINR_b_EOPA_VLTG_TO
        COMRXL_EOPA_VLTG_EOPA_STAT_Lin1_Error: symbol=ApplLinComAb_LIN1_COMRXL_EOPA_VLTG_EOPA_STAT_Lin1_Error  # Error -
          data-receive-point-by-arguments:
            access DRP_Lin1ComRxSignalsSR_COMRXL_EOPA_VLTG_EOPA_STAT_Lin1: accessed-variable=Lin1ComRxSignalsSR.COMRXL_EOPA_VLTG_EOPA_STAT_Lin1
          data-send-points:
            access DSP_VeLINR_U_EOPA_VLTG_VeLINR_U_EOPA_VLTG: accessed-variable=VeLINR_U_EOPA_VLTG.VeLINR_U_EOPA_VLTG
            access DSP_VeLINR_b_EOPA_VLTG_TO_VeLINR_b_EOPA_VLTG_TO: accessed-variable=VeLINR_b_EOPA_VLTG_TO.VeLINR_b_EOPA_VLTG_TO
          read-local-variables:
            access IRVRA_VeLINR_d_LIN_SlavePrsnt_LIN1: accessed-variable=VeLINR_d_LIN_SlavePrsnt_LIN1
        COMRXL_EOPA_TEMP_EOPA_STAT_Lin1_Received: symbol=ApplLinComAb_LIN1_COMRXL_EOPA_TEMP_EOPA_STAT_Lin1_Received  # Received -
          data-receive-point-by-arguments:
            access DRP_Lin1ComRxSignalsSR_COMRXL_EOPA_TEMP_EOPA_STAT_Lin1: accessed-variable=Lin1ComRxSignalsSR.COMRXL_EOPA_TEMP_EOPA_STAT_Lin1
          data-send-points:
            access DSP_VeLINR_T_EOPA_TEMP_VeLINR_T_EOPA_TEMP: accessed-variable=VeLINR_T_EOPA_TEMP.VeLINR_T_EOPA_TEMP
            access DSP_VeLINR_b_EOPA_TEMP_TO_VeLINR_b_EOPA_TEMP_TO: accessed-variable=VeLINR_b_EOPA_TEMP_TO.VeLINR_b_EOPA_TEMP_TO
        COMRXL_EOPA_TEMP_EOPA_STAT_Lin1_Error: symbol=ApplLinComAb_LIN1_COMRXL_EOPA_TEMP_EOPA_STAT_Lin1_Error  # Error -
          data-receive-point-by-arguments:
            access DRP_Lin1ComRxSignalsSR_COMRXL_EOPA_TEMP_EOPA_STAT_Lin1: accessed-variable=Lin1ComRxSignalsSR.COMRXL_EOPA_TEMP_EOPA_STAT_Lin1
          data-send-points:
            access DSP_VeLINR_T_EOPA_TEMP_VeLINR_T_EOPA_TEMP: accessed-variable=VeLINR_T_EOPA_TEMP.VeLINR_T_EOPA_TEMP
            access DSP_VeLINR_b_EOPA_TEMP_TO_VeLINR_b_EOPA_TEMP_TO: accessed-variable=VeLINR_b_EOPA_TEMP_TO.VeLINR_b_EOPA_TEMP_TO
          read-local-variables:
            access IRVRA_VeLINR_d_LIN_SlavePrsnt_LIN1: accessed-variable=VeLINR_d_LIN_SlavePrsnt_LIN1
        COMRXL_EOPA_CURR_EOPA_STAT_Lin1_Received: symbol=ApplLinComAb_LIN1_COMRXL_EOPA_CURR_EOPA_STAT_Lin1_Received  # Received -
          data-receive-point-by-arguments:
            access DRP_Lin1ComRxSignalsSR_COMRXL_EOPA_CURR_EOPA_STAT_Lin1: accessed-variable=Lin1ComRxSignalsSR.COMRXL_EOPA_CURR_EOPA_STAT_Lin1
          data-send-points:
            access DSP_VeLINR_I_EOPA_CURR_VeLINR_I_EOPA_CURR: accessed-variable=VeLINR_I_EOPA_CURR.VeLINR_I_EOPA_CURR
            access DSP_VeLINR_b_EOPA_CURR_TO_VeLINR_b_EOPA_CURR_TO: accessed-variable=VeLINR_b_EOPA_CURR_TO.VeLINR_b_EOPA_CURR_TO
        COMRXL_EOPA_CURR_EOPA_STAT_Lin1_Error: symbol=ApplLinComAb_LIN1_COMRXL_EOPA_CURR_EOPA_STAT_Lin1_Error  # Error -
          data-receive-point-by-arguments:
            access DRP_Lin1ComRxSignalsSR_COMRXL_EOPA_CURR_EOPA_STAT_Lin1: accessed-variable=Lin1ComRxSignalsSR.COMRXL_EOPA_CURR_EOPA_STAT_Lin1
          data-send-points:
            access DSP_VeLINR_I_EOPA_CURR_VeLINR_I_EOPA_CURR: accessed-variable=VeLINR_I_EOPA_CURR.VeLINR_I_EOPA_CURR
            access DSP_VeLINR_b_EOPA_CURR_TO_VeLINR_b_EOPA_CURR_TO: accessed-variable=VeLINR_b_EOPA_CURR_TO.VeLINR_b_EOPA_CURR_TO
          read-local-variables:
            access IRVRA_VeLINR_d_LIN_SlavePrsnt_LIN1: accessed-variable=VeLINR_d_LIN_SlavePrsnt_LIN1
        COMRXL_EOPA_LOW_TMP_STAT_EOPA_STAT_Lin1_Received: symbol=ApplLinComAb_LIN1_COMRXL_EOPA_LOW_TMP_STAT_EOPA_STAT_Lin1_Received  # Received -
          data-receive-point-by-arguments:
            access DRP_Lin1ComRxSignalsSR_COMRXL_EOPA_LOW_TMP_STAT_EOPA_STAT_Lin1: accessed-variable=Lin1ComRxSignalsSR.COMRXL_EOPA_LOW_TMP_STAT_EOPA_STAT_Lin1
          data-send-points:
            access DSP_VeLINR_e_EOPA_LOW_TMP_STAT_VeLINR_e_EOPA_LOW_TMP_STAT: accessed-variable=VeLINR_e_EOPA_LOW_TMP_STAT.VeLINR_e_EOPA_LOW_TMP_STAT
            access DSP_VeLINR_b_EOPA_LOW_TMP_STAT_TO_VeLINR_b_EOPA_LOW_TMP_STAT_TO: accessed-variable=VeLINR_b_EOPA_LOW_TMP_STAT_TO.VeLINR_b_EOPA_LOW_TMP_STAT_TO
        COMRXL_EOPA_LOW_TMP_STAT_EOPA_STAT_Lin1_Error: symbol=ApplLinComAb_LIN1_COMRXL_EOPA_LOW_TMP_STAT_EOPA_STAT_Lin1_Error  # Error -
          data-receive-point-by-arguments:
            access DRP_Lin1ComRxSignalsSR_COMRXL_EOPA_LOW_TMP_STAT_EOPA_STAT_Lin1: accessed-variable=Lin1ComRxSignalsSR.COMRXL_EOPA_LOW_TMP_STAT_EOPA_STAT_Lin1
          data-send-points:
            access DSP_VeLINR_e_EOPA_LOW_TMP_STAT_VeLINR_e_EOPA_LOW_TMP_STAT: accessed-variable=VeLINR_e_EOPA_LOW_TMP_STAT.VeLINR_e_EOPA_LOW_TMP_STAT
            access DSP_VeLINR_b_EOPA_LOW_TMP_STAT_TO_VeLINR_b_EOPA_LOW_TMP_STAT_TO: accessed-variable=VeLINR_b_EOPA_LOW_TMP_STAT_TO.VeLINR_b_EOPA_LOW_TMP_STAT_TO
          read-local-variables:
            access IRVRA_VeLINR_d_LIN_SlavePrsnt_LIN1: accessed-variable=VeLINR_d_LIN_SlavePrsnt_LIN1
        COMRXL_EOPA_MONTRNG_RPM_EOPA_STAT_Lin1_Received: symbol=ApplLinComAb_LIN1_COMRXL_EOPA_MONTRNG_RPM_EOPA_STAT_Lin1_Received  # Received -
          data-receive-point-by-arguments:
            access DRP_Lin1ComRxSignalsSR_COMRXL_EOPA_MONTRNG_RPM_EOPA_STAT_Lin1: accessed-variable=Lin1ComRxSignalsSR.COMRXL_EOPA_MONTRNG_RPM_EOPA_STAT_Lin1
          data-send-points:
            access DSP_VeLINR_e_EOPA_MONTRNG_RPM_VeLINR_e_EOPA_MONTRNG_RPM: accessed-variable=VeLINR_e_EOPA_MONTRNG_RPM.VeLINR_e_EOPA_MONTRNG_RPM
            access DSP_VeLINR_b_EOPA_MONTRNG_RPM_TO_VeLINR_b_EOPA_MONTRNG_RPM_TO: accessed-variable=VeLINR_b_EOPA_MONTRNG_RPM_TO.VeLINR_b_EOPA_MONTRNG_RPM_TO
        COMRXL_EOPA_MONTRNG_RPM_EOPA_STAT_Lin1_Error: symbol=ApplLinComAb_LIN1_COMRXL_EOPA_MONTRNG_RPM_EOPA_STAT_Lin1_Error  # Error -
          data-receive-point-by-arguments:
            access DRP_Lin1ComRxSignalsSR_COMRXL_EOPA_MONTRNG_RPM_EOPA_STAT_Lin1: accessed-variable=Lin1ComRxSignalsSR.COMRXL_EOPA_MONTRNG_RPM_EOPA_STAT_Lin1
          data-send-points:
            access DSP_VeLINR_e_EOPA_MONTRNG_RPM_VeLINR_e_EOPA_MONTRNG_RPM: accessed-variable=VeLINR_e_EOPA_MONTRNG_RPM.VeLINR_e_EOPA_MONTRNG_RPM
            access DSP_VeLINR_b_EOPA_MONTRNG_RPM_TO_VeLINR_b_EOPA_MONTRNG_RPM_TO: accessed-variable=VeLINR_b_EOPA_MONTRNG_RPM_TO.VeLINR_b_EOPA_MONTRNG_RPM_TO
          read-local-variables:
            access IRVRA_VeLINR_d_LIN_SlavePrsnt_LIN1: accessed-variable=VeLINR_d_LIN_SlavePrsnt_LIN1
        COMRXL_EOPA_LMP_HM_AN_ON_EOPA_STAT_Lin1_Received: symbol=ApplLinComAb_LIN1_COMRXL_EOPA_LMP_HM_AN_ON_EOPA_STAT_Lin1_Received  # Received -
          data-receive-point-by-arguments:
            access DRP_Lin1ComRxSignalsSR_COMRXL_EOPA_LMP_HM_AN_ON_EOPA_STAT_Lin1: accessed-variable=Lin1ComRxSignalsSR.COMRXL_EOPA_LMP_HM_AN_ON_EOPA_STAT_Lin1
          data-send-points:
            access DSP_VeLINR_e_EOPA_LMP_HM_AN_ON_VeLINR_e_EOPA_LMP_HM_AN_ON: accessed-variable=VeLINR_e_EOPA_LMP_HM_AN_ON.VeLINR_e_EOPA_LMP_HM_AN_ON
            access DSP_VeLINR_b_EOPA_LMP_HM_AN_ON_TO_VeLINR_b_EOPA_LMP_HM_AN_ON_TO: accessed-variable=VeLINR_b_EOPA_LMP_HM_AN_ON_TO.VeLINR_b_EOPA_LMP_HM_AN_ON_TO
        COMRXL_EOPA_LMP_HM_AN_ON_EOPA_STAT_Lin1_Error: symbol=ApplLinComAb_LIN1_COMRXL_EOPA_LMP_HM_AN_ON_EOPA_STAT_Lin1_Error  # Error -
          data-receive-point-by-arguments:
            access DRP_Lin1ComRxSignalsSR_COMRXL_EOPA_LMP_HM_AN_ON_EOPA_STAT_Lin1: accessed-variable=Lin1ComRxSignalsSR.COMRXL_EOPA_LMP_HM_AN_ON_EOPA_STAT_Lin1
          data-send-points:
            access DSP_VeLINR_e_EOPA_LMP_HM_AN_ON_VeLINR_e_EOPA_LMP_HM_AN_ON: accessed-variable=VeLINR_e_EOPA_LMP_HM_AN_ON.VeLINR_e_EOPA_LMP_HM_AN_ON
            access DSP_VeLINR_b_EOPA_LMP_HM_AN_ON_TO_VeLINR_b_EOPA_LMP_HM_AN_ON_TO: accessed-variable=VeLINR_b_EOPA_LMP_HM_AN_ON_TO.VeLINR_b_EOPA_LMP_HM_AN_ON_TO
          read-local-variables:
            access IRVRA_VeLINR_d_LIN_SlavePrsnt_LIN1: accessed-variable=VeLINR_d_LIN_SlavePrsnt_LIN1
        COMRXL_EOPA_OV_TMP_ER_EOPA_STAT_Lin1_Received: symbol=ApplLinComAb_LIN1_COMRXL_EOPA_OV_TMP_ER_EOPA_STAT_Lin1_Received  # Received -
          data-receive-point-by-arguments:
            access DRP_Lin1ComRxSignalsSR_COMRXL_EOPA_OV_TMP_ER_EOPA_STAT_Lin1: accessed-variable=Lin1ComRxSignalsSR.COMRXL_EOPA_OV_TMP_ER_EOPA_STAT_Lin1
          data-send-points:
            access DSP_VeLINR_e_EOPA_OV_TMP_ER_VeLINR_e_EOPA_OV_TMP_ER: accessed-variable=VeLINR_e_EOPA_OV_TMP_ER.VeLINR_e_EOPA_OV_TMP_ER
            access DSP_VeLINR_b_EOPA_OV_TMP_ER_TO_VeLINR_b_EOPA_OV_TMP_ER_TO: accessed-variable=VeLINR_b_EOPA_OV_TMP_ER_TO.VeLINR_b_EOPA_OV_TMP_ER_TO
        COMRXL_EOPA_OV_TMP_ER_EOPA_STAT_Lin1_Error: symbol=ApplLinComAb_LIN1_COMRXL_EOPA_OV_TMP_ER_EOPA_STAT_Lin1_Error  # Error -
          data-receive-point-by-arguments:
            access DRP_Lin1ComRxSignalsSR_COMRXL_EOPA_OV_TMP_ER_EOPA_STAT_Lin1: accessed-variable=Lin1ComRxSignalsSR.COMRXL_EOPA_OV_TMP_ER_EOPA_STAT_Lin1
          data-send-points:
            access DSP_VeLINR_e_EOPA_OV_TMP_ER_VeLINR_e_EOPA_OV_TMP_ER: accessed-variable=VeLINR_e_EOPA_OV_TMP_ER.VeLINR_e_EOPA_OV_TMP_ER
            access DSP_VeLINR_b_EOPA_OV_TMP_ER_TO_VeLINR_b_EOPA_OV_TMP_ER_TO: accessed-variable=VeLINR_b_EOPA_OV_TMP_ER_TO.VeLINR_b_EOPA_OV_TMP_ER_TO
          read-local-variables:
            access IRVRA_VeLINR_d_LIN_SlavePrsnt_LIN1: accessed-variable=VeLINR_d_LIN_SlavePrsnt_LIN1
        COMRXL_EOPA_OV_CUR_ER_EOPA_STAT_Lin1_Received: symbol=ApplLinComAb_LIN1_COMRXL_EOPA_OV_CUR_ER_EOPA_STAT_Lin1_Received  # Received -
          data-receive-point-by-arguments:
            access DRP_Lin1ComRxSignalsSR_COMRXL_EOPA_OV_CUR_ER_EOPA_STAT_Lin1: accessed-variable=Lin1ComRxSignalsSR.COMRXL_EOPA_OV_CUR_ER_EOPA_STAT_Lin1
          data-send-points:
            access DSP_VeLINR_e_EOPA_OV_CUR_ER_VeLINR_e_EOPA_OV_CUR_ER: accessed-variable=VeLINR_e_EOPA_OV_CUR_ER.VeLINR_e_EOPA_OV_CUR_ER
            access DSP_VeLINR_b_EOPA_OV_CUR_ER_TO_VeLINR_b_EOPA_OV_CUR_ER_TO: accessed-variable=VeLINR_b_EOPA_OV_CUR_ER_TO.VeLINR_b_EOPA_OV_CUR_ER_TO
        COMRXL_EOPA_OV_CUR_ER_EOPA_STAT_Lin1_Error: symbol=ApplLinComAb_LIN1_COMRXL_EOPA_OV_CUR_ER_EOPA_STAT_Lin1_Error  # Error -
          data-receive-point-by-arguments:
            access DRP_Lin1ComRxSignalsSR_COMRXL_EOPA_OV_CUR_ER_EOPA_STAT_Lin1: accessed-variable=Lin1ComRxSignalsSR.COMRXL_EOPA_OV_CUR_ER_EOPA_STAT_Lin1
          data-send-points:
            access DSP_VeLINR_e_EOPA_OV_CUR_ER_VeLINR_e_EOPA_OV_CUR_ER: accessed-variable=VeLINR_e_EOPA_OV_CUR_ER.VeLINR_e_EOPA_OV_CUR_ER
            access DSP_VeLINR_b_EOPA_OV_CUR_ER_TO_VeLINR_b_EOPA_OV_CUR_ER_TO: accessed-variable=VeLINR_b_EOPA_OV_CUR_ER_TO.VeLINR_b_EOPA_OV_CUR_ER_TO
          read-local-variables:
            access IRVRA_VeLINR_d_LIN_SlavePrsnt_LIN1: accessed-variable=VeLINR_d_LIN_SlavePrsnt_LIN1
        COMRXL_EOPA_DR_RN_ER_EOPA_STAT_Lin1_Received: symbol=ApplLinComAb_LIN1_COMRXL_EOPA_DR_RN_ER_EOPA_STAT_Lin1_Received  # Received -
          data-receive-point-by-arguments:
            access DRP_Lin1ComRxSignalsSR_COMRXL_EOPA_DR_RN_ER_EOPA_STAT_Lin1: accessed-variable=Lin1ComRxSignalsSR.COMRXL_EOPA_DR_RN_ER_EOPA_STAT_Lin1
          data-send-points:
            access DSP_VeLINR_e_EOPA_DR_RN_ER_VeLINR_e_EOPA_DR_RN_ER: accessed-variable=VeLINR_e_EOPA_DR_RN_ER.VeLINR_e_EOPA_DR_RN_ER
            access DSP_VeLINR_b_EOPA_DR_RN_ER_TO_VeLINR_b_EOPA_DR_RN_ER_TO: accessed-variable=VeLINR_b_EOPA_DR_RN_ER_TO.VeLINR_b_EOPA_DR_RN_ER_TO
        COMRXL_EOPA_DR_RN_ER_EOPA_STAT_Lin1_Error: symbol=ApplLinComAb_LIN1_COMRXL_EOPA_DR_RN_ER_EOPA_STAT_Lin1_Error  # Error -
          data-receive-point-by-arguments:
            access DRP_Lin1ComRxSignalsSR_COMRXL_EOPA_DR_RN_ER_EOPA_STAT_Lin1: accessed-variable=Lin1ComRxSignalsSR.COMRXL_EOPA_DR_RN_ER_EOPA_STAT_Lin1
          data-send-points:
            access DSP_VeLINR_e_EOPA_DR_RN_ER_VeLINR_e_EOPA_DR_RN_ER: accessed-variable=VeLINR_e_EOPA_DR_RN_ER.VeLINR_e_EOPA_DR_RN_ER
            access DSP_VeLINR_b_EOPA_DR_RN_ER_TO_VeLINR_b_EOPA_DR_RN_ER_TO: accessed-variable=VeLINR_b_EOPA_DR_RN_ER_TO.VeLINR_b_EOPA_DR_RN_ER_TO
          read-local-variables:
            access IRVRA_VeLINR_d_LIN_SlavePrsnt_LIN1: accessed-variable=VeLINR_d_LIN_SlavePrsnt_LIN1
        COMRXL_EOPA_VLTG_ER_EOPA_STAT_Lin1_Received: symbol=ApplLinComAb_LIN1_COMRXL_EOPA_VLTG_ER_EOPA_STAT_Lin1_Received  # Received -
          data-receive-point-by-arguments:
            access DRP_Lin1ComRxSignalsSR_COMRXL_EOPA_VLTG_ER_EOPA_STAT_Lin1: accessed-variable=Lin1ComRxSignalsSR.COMRXL_EOPA_VLTG_ER_EOPA_STAT_Lin1
          data-send-points:
            access DSP_VeLINR_e_EOPA_VLTG_ER_VeLINR_e_EOPA_VLTG_ER: accessed-variable=VeLINR_e_EOPA_VLTG_ER.VeLINR_e_EOPA_VLTG_ER
            access DSP_VeLINR_b_EOPA_VLTG_ER_TO_VeLINR_b_EOPA_VLTG_ER_TO: accessed-variable=VeLINR_b_EOPA_VLTG_ER_TO.VeLINR_b_EOPA_VLTG_ER_TO
        COMRXL_EOPA_VLTG_ER_EOPA_STAT_Lin1_Error: symbol=ApplLinComAb_LIN1_COMRXL_EOPA_VLTG_ER_EOPA_STAT_Lin1_Error  # Error -
          data-receive-point-by-arguments:
            access DRP_Lin1ComRxSignalsSR_COMRXL_EOPA_VLTG_ER_EOPA_STAT_Lin1: accessed-variable=Lin1ComRxSignalsSR.COMRXL_EOPA_VLTG_ER_EOPA_STAT_Lin1
          data-send-points:
            access DSP_VeLINR_e_EOPA_VLTG_ER_VeLINR_e_EOPA_VLTG_ER: accessed-variable=VeLINR_e_EOPA_VLTG_ER.VeLINR_e_EOPA_VLTG_ER
            access DSP_VeLINR_b_EOPA_VLTG_ER_TO_VeLINR_b_EOPA_VLTG_ER_TO: accessed-variable=VeLINR_b_EOPA_VLTG_ER_TO.VeLINR_b_EOPA_VLTG_ER_TO
          read-local-variables:
            access IRVRA_VeLINR_d_LIN_SlavePrsnt_LIN1: accessed-variable=VeLINR_d_LIN_SlavePrsnt_LIN1
        COMRXL_EOPA_Stall_Event_EOPA_STAT_Lin1_Received: symbol=ApplLinComAb_LIN1_COMRXL_EOPA_Stall_Event_EOPA_STAT_Lin1_Received  # Received -
          data-receive-point-by-arguments:
            access DRP_Lin1ComRxSignalsSR_COMRXL_EOPA_Stall_Event_EOPA_STAT_Lin1: accessed-variable=Lin1ComRxSignalsSR.COMRXL_EOPA_Stall_Event_EOPA_STAT_Lin1
          data-send-points:
            access DSP_VeLINR_e_EOPA_Stall_Event_VeLINR_e_EOPA_Stall_Event: accessed-variable=VeLINR_e_EOPA_Stall_Event.VeLINR_e_EOPA_Stall_Event
            access DSP_VeLINR_b_EOPA_Stall_EventTO_VeLINR_b_EOPA_Stall_EventTO: accessed-variable=VeLINR_b_EOPA_Stall_EventTO.VeLINR_b_EOPA_Stall_EventTO
        COMRXL_EOPA_Stall_Event_EOPA_STAT_Lin1_Error: symbol=ApplLinComAb_LIN1_COMRXL_EOPA_Stall_Event_EOPA_STAT_Lin1_Error  # Error -
          data-receive-point-by-arguments:
            access DRP_Lin1ComRxSignalsSR_COMRXL_EOPA_Stall_Event_EOPA_STAT_Lin1: accessed-variable=Lin1ComRxSignalsSR.COMRXL_EOPA_Stall_Event_EOPA_STAT_Lin1
          data-send-points:
            access DSP_VeLINR_e_EOPA_Stall_Event_VeLINR_e_EOPA_Stall_Event: accessed-variable=VeLINR_e_EOPA_Stall_Event.VeLINR_e_EOPA_Stall_Event
            access DSP_VeLINR_b_EOPA_Stall_EventTO_VeLINR_b_EOPA_Stall_EventTO: accessed-variable=VeLINR_b_EOPA_Stall_EventTO.VeLINR_b_EOPA_Stall_EventTO
          read-local-variables:
            access IRVRA_VeLINR_d_LIN_SlavePrsnt_LIN1: accessed-variable=VeLINR_d_LIN_SlavePrsnt_LIN1
        COMRXL_EOPA_POST_RUN_STAT_EOPA_STAT_Lin1_Received: symbol=ApplLinComAb_LIN1_COMRXL_EOPA_POST_RUN_STAT_EOPA_STAT_Lin1_Received  # Received -
          data-receive-point-by-arguments:
            access DRP_Lin1ComRxSignalsSR_COMRXL_EOPA_POST_RUN_STAT_EOPA_STAT_Lin1: accessed-variable=Lin1ComRxSignalsSR.COMRXL_EOPA_POST_RUN_STAT_EOPA_STAT_Lin1
          data-send-points:
            access DSP_VeLINR_e_EOPA_POST_RUN_STAT_VeLINR_e_EOPA_POST_RUN_STAT: accessed-variable=VeLINR_e_EOPA_POST_RUN_STAT.VeLINR_e_EOPA_POST_RUN_STAT
            access DSP_VeLINR_b_EOPA_POST_RUN_STAT_TO_VeLINR_b_EOPA_POST_RUN_STAT_TO: accessed-variable=VeLINR_b_EOPA_POST_RUN_STAT_TO.VeLINR_b_EOPA_POST_RUN_STAT_TO
        COMRXL_EOPA_POST_RUN_STAT_EOPA_STAT_Lin1_Error: symbol=ApplLinComAb_LIN1_COMRXL_EOPA_POST_RUN_STAT_EOPA_STAT_Lin1_Error  # Error -
          data-receive-point-by-arguments:
            access DRP_Lin1ComRxSignalsSR_COMRXL_EOPA_POST_RUN_STAT_EOPA_STAT_Lin1: accessed-variable=Lin1ComRxSignalsSR.COMRXL_EOPA_POST_RUN_STAT_EOPA_STAT_Lin1
          data-send-points:
            access DSP_VeLINR_e_EOPA_POST_RUN_STAT_VeLINR_e_EOPA_POST_RUN_STAT: accessed-variable=VeLINR_e_EOPA_POST_RUN_STAT.VeLINR_e_EOPA_POST_RUN_STAT
            access DSP_VeLINR_b_EOPA_POST_RUN_STAT_TO_VeLINR_b_EOPA_POST_RUN_STAT_TO: accessed-variable=VeLINR_b_EOPA_POST_RUN_STAT_TO.VeLINR_b_EOPA_POST_RUN_STAT_TO
          read-local-variables:
            access IRVRA_VeLINR_d_LIN_SlavePrsnt_LIN1: accessed-variable=VeLINR_d_LIN_SlavePrsnt_LIN1
        COMRXL_RsErr_EOPA_EOPA_STAT_Lin1_Received: symbol=ApplLinComAb_LIN1_COMRXL_RsErr_EOPA_EOPA_STAT_Lin1_Received  # Received -
          data-receive-point-by-arguments:
            access DRP_Lin1ComRxSignalsSR_COMRXL_RsErr_EOPA_EOPA_STAT_Lin1: accessed-variable=Lin1ComRxSignalsSR.COMRXL_RsErr_EOPA_EOPA_STAT_Lin1
          data-send-points:
            access DSP_VeLINR_b_RsErr_EOPA_VeLINR_b_RsErr_EOPA: accessed-variable=VeLINR_b_RsErr_EOPA.VeLINR_b_RsErr_EOPA
            access DSP_VeLINR_b_RsErr_EOPA_TO_VeLINR_b_RsErr_EOPA_TO: accessed-variable=VeLINR_b_RsErr_EOPA_TO.VeLINR_b_RsErr_EOPA_TO
        COMRXL_RsErr_EOPA_EOPA_STAT_Lin1_Error: symbol=ApplLinComAb_LIN1_COMRXL_RsErr_EOPA_EOPA_STAT_Lin1_Error  # Error -
          data-receive-point-by-arguments:
            access DRP_Lin1ComRxSignalsSR_COMRXL_RsErr_EOPA_EOPA_STAT_Lin1: accessed-variable=Lin1ComRxSignalsSR.COMRXL_RsErr_EOPA_EOPA_STAT_Lin1
          data-send-points:
            access DSP_VeLINR_b_RsErr_EOPA_VeLINR_b_RsErr_EOPA: accessed-variable=VeLINR_b_RsErr_EOPA.VeLINR_b_RsErr_EOPA
            access DSP_VeLINR_b_RsErr_EOPA_TO_VeLINR_b_RsErr_EOPA_TO: accessed-variable=VeLINR_b_RsErr_EOPA_TO.VeLINR_b_RsErr_EOPA_TO
          read-local-variables:
            access IRVRA_VeLINR_d_LIN_SlavePrsnt_LIN1: accessed-variable=VeLINR_d_LIN_SlavePrsnt_LIN1
        COMRXL_EOPA_OIL_TEMP_EOPA_STAT2_Lin1_Received: symbol=ApplLinComAb_LIN1_COMRXL_EOPA_OIL_TEMP_EOPA_STAT2_Lin1_Received  # Received -
          data-receive-point-by-arguments:
            access DRP_Lin1ComRxSignalsSR_COMRXL_EOPA_OIL_TEMP_EOPA_STAT2_Lin1: accessed-variable=Lin1ComRxSignalsSR.COMRXL_EOPA_OIL_TEMP_EOPA_STAT2_Lin1
          data-send-points:
            access DSP_VeLINR_T_EOPA_OIL_TEMP_VeLINR_T_EOPA_OIL_TEMP: accessed-variable=VeLINR_T_EOPA_OIL_TEMP.VeLINR_T_EOPA_OIL_TEMP
            access DSP_VeLINR_b_EOPA_OIL_TEMP_TO_VeLINR_b_EOPA_OIL_TEMP_TO: accessed-variable=VeLINR_b_EOPA_OIL_TEMP_TO.VeLINR_b_EOPA_OIL_TEMP_TO
        COMRXL_EOPA_OIL_TEMP_EOPA_STAT2_Lin1_Error: symbol=ApplLinComAb_LIN1_COMRXL_EOPA_OIL_TEMP_EOPA_STAT2_Lin1_Error  # Error -
          data-receive-point-by-arguments:
            access DRP_Lin1ComRxSignalsSR_COMRXL_EOPA_OIL_TEMP_EOPA_STAT2_Lin1: accessed-variable=Lin1ComRxSignalsSR.COMRXL_EOPA_OIL_TEMP_EOPA_STAT2_Lin1
          data-send-points:
            access DSP_VeLINR_T_EOPA_OIL_TEMP_VeLINR_T_EOPA_OIL_TEMP: accessed-variable=VeLINR_T_EOPA_OIL_TEMP.VeLINR_T_EOPA_OIL_TEMP
            access DSP_VeLINR_b_EOPA_OIL_TEMP_TO_VeLINR_b_EOPA_OIL_TEMP_TO: accessed-variable=VeLINR_b_EOPA_OIL_TEMP_TO.VeLINR_b_EOPA_OIL_TEMP_TO
          read-local-variables:
            access IRVRA_VeLINR_d_LIN_SlavePrsnt_LIN1: accessed-variable=VeLINR_d_LIN_SlavePrsnt_LIN1
        COMRXL_EOPA_HW_VER_EOPA_VER_Lin1_Received: symbol=ApplLinComAb_LIN1_COMRXL_EOPA_HW_VER_EOPA_VER_Lin1_Received  # Received -
          data-receive-point-by-arguments:
            access DRP_Lin1ComRxSignalsSR_COMRXL_EOPA_HW_VER_EOPA_VER_Lin1: accessed-variable=Lin1ComRxSignalsSR.COMRXL_EOPA_HW_VER_EOPA_VER_Lin1
          data-send-points:
            access DSP_VeLINR_y_EOPA_HW_VER_VeLINR_y_EOPA_HW_VER: accessed-variable=VeLINR_y_EOPA_HW_VER.VeLINR_y_EOPA_HW_VER
            access DSP_VeLINR_b_EOPA_HW_VER_TO_VeLINR_b_EOPA_HW_VER_TO: accessed-variable=VeLINR_b_EOPA_HW_VER_TO.VeLINR_b_EOPA_HW_VER_TO
        COMRXL_EOPA_HW_VER_EOPA_VER_Lin1_Error: symbol=ApplLinComAb_LIN1_COMRXL_EOPA_HW_VER_EOPA_VER_Lin1_Error  # Error -
          data-receive-point-by-arguments:
            access DRP_Lin1ComRxSignalsSR_COMRXL_EOPA_HW_VER_EOPA_VER_Lin1: accessed-variable=Lin1ComRxSignalsSR.COMRXL_EOPA_HW_VER_EOPA_VER_Lin1
          data-send-points:
            access DSP_VeLINR_y_EOPA_HW_VER_VeLINR_y_EOPA_HW_VER: accessed-variable=VeLINR_y_EOPA_HW_VER.VeLINR_y_EOPA_HW_VER
            access DSP_VeLINR_b_EOPA_HW_VER_TO_VeLINR_b_EOPA_HW_VER_TO: accessed-variable=VeLINR_b_EOPA_HW_VER_TO.VeLINR_b_EOPA_HW_VER_TO
          read-local-variables:
            access IRVRA_VeLINR_d_LIN_SlavePrsnt_LIN1: accessed-variable=VeLINR_d_LIN_SlavePrsnt_LIN1
        COMRXL_EOPA_SW_VER_EOPA_VER_Lin1_Received: symbol=ApplLinComAb_LIN1_COMRXL_EOPA_SW_VER_EOPA_VER_Lin1_Received  # Received -
          data-receive-point-by-arguments:
            access DRP_Lin1ComRxSignalsSR_COMRXL_EOPA_SW_VER_EOPA_VER_Lin1: accessed-variable=Lin1ComRxSignalsSR.COMRXL_EOPA_SW_VER_EOPA_VER_Lin1
          data-send-points:
            access DSP_VeLINR_y_EOPA_SW_VER_VeLINR_y_EOPA_SW_VER: accessed-variable=VeLINR_y_EOPA_SW_VER.VeLINR_y_EOPA_SW_VER
            access DSP_VeLINR_b_EOPA_SW_VER_TO_VeLINR_b_EOPA_SW_VER_TO: accessed-variable=VeLINR_b_EOPA_SW_VER_TO.VeLINR_b_EOPA_SW_VER_TO
        COMRXL_EOPA_SW_VER_EOPA_VER_Lin1_Error: symbol=ApplLinComAb_LIN1_COMRXL_EOPA_SW_VER_EOPA_VER_Lin1_Error  # Error -
          data-receive-point-by-arguments:
            access DRP_Lin1ComRxSignalsSR_COMRXL_EOPA_SW_VER_EOPA_VER_Lin1: accessed-variable=Lin1ComRxSignalsSR.COMRXL_EOPA_SW_VER_EOPA_VER_Lin1
          data-send-points:
            access DSP_VeLINR_y_EOPA_SW_VER_VeLINR_y_EOPA_SW_VER: accessed-variable=VeLINR_y_EOPA_SW_VER.VeLINR_y_EOPA_SW_VER
            access DSP_VeLINR_b_EOPA_SW_VER_TO_VeLINR_b_EOPA_SW_VER_TO: accessed-variable=VeLINR_b_EOPA_SW_VER_TO.VeLINR_b_EOPA_SW_VER_TO
          read-local-variables:
            access IRVRA_VeLINR_d_LIN_SlavePrsnt_LIN1: accessed-variable=VeLINR_d_LIN_SlavePrsnt_LIN1
        COMRXL_LTRBV_PosAct_LTRBV_STAT_Lin1_Received: symbol=ApplLinComAb_LIN1_COMRXL_LTRBV_PosAct_LTRBV_STAT_Lin1_Received  # Received -
          data-receive-point-by-arguments:
            access DRP_Lin1ComRxSignalsSR_COMRXL_LTRBV_PosAct_LTRBV_STAT_Lin1: accessed-variable=Lin1ComRxSignalsSR.COMRXL_LTRBV_PosAct_LTRBV_STAT_Lin1
          data-send-points:
            access DSP_VeLINR_Pct_LTRBV_PosAct_VeLINR_Pct_LTRBV_PosAct: accessed-variable=VeLINR_Pct_LTRBV_PosAct.VeLINR_Pct_LTRBV_PosAct
            access DSP_VeLINR_b_LTRBV_PosActTO_VeLINR_b_LTRBV_PosActTO: accessed-variable=VeLINR_b_LTRBV_PosActTO.VeLINR_b_LTRBV_PosActTO
        COMRXL_LTRBV_PosAct_LTRBV_STAT_Lin1_Error: symbol=ApplLinComAb_LIN1_COMRXL_LTRBV_PosAct_LTRBV_STAT_Lin1_Error  # Error -
          data-receive-point-by-arguments:
            access DRP_Lin1ComRxSignalsSR_COMRXL_LTRBV_PosAct_LTRBV_STAT_Lin1: accessed-variable=Lin1ComRxSignalsSR.COMRXL_LTRBV_PosAct_LTRBV_STAT_Lin1
          data-send-points:
            access DSP_VeLINR_Pct_LTRBV_PosAct_VeLINR_Pct_LTRBV_PosAct: accessed-variable=VeLINR_Pct_LTRBV_PosAct.VeLINR_Pct_LTRBV_PosAct
            access DSP_VeLINR_b_LTRBV_PosActTO_VeLINR_b_LTRBV_PosActTO: accessed-variable=VeLINR_b_LTRBV_PosActTO.VeLINR_b_LTRBV_PosActTO
          read-local-variables:
            access IRVRA_VeLINR_d_LIN_SlavePrsnt_LIN1: accessed-variable=VeLINR_d_LIN_SlavePrsnt_LIN1
        COMRXL_LTRBV_ERR_LTRBV_STAT_Lin1_Received: symbol=ApplLinComAb_LIN1_COMRXL_LTRBV_ERR_LTRBV_STAT_Lin1_Received  # Received -
          data-receive-point-by-arguments:
            access DRP_Lin1ComRxSignalsSR_COMRXL_LTRBV_ERR_LTRBV_STAT_Lin1: accessed-variable=Lin1ComRxSignalsSR.COMRXL_LTRBV_ERR_LTRBV_STAT_Lin1
          data-send-points:
            access DSP_VeLINR_e_LTRBV_ERR_VeLINR_e_LTRBV_ERR: accessed-variable=VeLINR_e_LTRBV_ERR.VeLINR_e_LTRBV_ERR
            access DSP_VeLINR_b_LTRBV_ERR_TO_VeLINR_b_LTRBV_ERR_TO: accessed-variable=VeLINR_b_LTRBV_ERR_TO.VeLINR_b_LTRBV_ERR_TO
        COMRXL_LTRBV_ERR_LTRBV_STAT_Lin1_Error: symbol=ApplLinComAb_LIN1_COMRXL_LTRBV_ERR_LTRBV_STAT_Lin1_Error  # Error -
          data-receive-point-by-arguments:
            access DRP_Lin1ComRxSignalsSR_COMRXL_LTRBV_ERR_LTRBV_STAT_Lin1: accessed-variable=Lin1ComRxSignalsSR.COMRXL_LTRBV_ERR_LTRBV_STAT_Lin1
          data-send-points:
            access DSP_VeLINR_e_LTRBV_ERR_VeLINR_e_LTRBV_ERR: accessed-variable=VeLINR_e_LTRBV_ERR.VeLINR_e_LTRBV_ERR
            access DSP_VeLINR_b_LTRBV_ERR_TO_VeLINR_b_LTRBV_ERR_TO: accessed-variable=VeLINR_b_LTRBV_ERR_TO.VeLINR_b_LTRBV_ERR_TO
          read-local-variables:
            access IRVRA_VeLINR_d_LIN_SlavePrsnt_LIN1: accessed-variable=VeLINR_d_LIN_SlavePrsnt_LIN1
        COMRXL_LTRBV_MotorVolt_LTRBV_STAT_Lin1_Received: symbol=ApplLinComAb_LIN1_COMRXL_LTRBV_MotorVolt_LTRBV_STAT_Lin1_Received  # Received -
          data-receive-point-by-arguments:
            access DRP_Lin1ComRxSignalsSR_COMRXL_LTRBV_MotorVolt_LTRBV_STAT_Lin1: accessed-variable=Lin1ComRxSignalsSR.COMRXL_LTRBV_MotorVolt_LTRBV_STAT_Lin1
          data-send-points:
            access DSP_VeLINR_U_LTRBV_MotorVolt_VeLINR_U_LTRBV_MotorVolt: accessed-variable=VeLINR_U_LTRBV_MotorVolt.VeLINR_U_LTRBV_MotorVolt
            access DSP_VeLINR_b_LTRBV_MotorVoltTO_VeLINR_b_LTRBV_MotorVoltTO: accessed-variable=VeLINR_b_LTRBV_MotorVoltTO.VeLINR_b_LTRBV_MotorVoltTO
        COMRXL_LTRBV_MotorVolt_LTRBV_STAT_Lin1_Error: symbol=ApplLinComAb_LIN1_COMRXL_LTRBV_MotorVolt_LTRBV_STAT_Lin1_Error  # Error -
          data-receive-point-by-arguments:
            access DRP_Lin1ComRxSignalsSR_COMRXL_LTRBV_MotorVolt_LTRBV_STAT_Lin1: accessed-variable=Lin1ComRxSignalsSR.COMRXL_LTRBV_MotorVolt_LTRBV_STAT_Lin1
          data-send-points:
            access DSP_VeLINR_U_LTRBV_MotorVolt_VeLINR_U_LTRBV_MotorVolt: accessed-variable=VeLINR_U_LTRBV_MotorVolt.VeLINR_U_LTRBV_MotorVolt
            access DSP_VeLINR_b_LTRBV_MotorVoltTO_VeLINR_b_LTRBV_MotorVoltTO: accessed-variable=VeLINR_b_LTRBV_MotorVoltTO.VeLINR_b_LTRBV_MotorVoltTO
          read-local-variables:
            access IRVRA_VeLINR_d_LIN_SlavePrsnt_LIN1: accessed-variable=VeLINR_d_LIN_SlavePrsnt_LIN1
        COMRXL_LTRBV_Sts_LTRBV_STAT_Lin1_Received: symbol=ApplLinComAb_LIN1_COMRXL_LTRBV_Sts_LTRBV_STAT_Lin1_Received  # Received -
          data-receive-point-by-arguments:
            access DRP_Lin1ComRxSignalsSR_COMRXL_LTRBV_Sts_LTRBV_STAT_Lin1: accessed-variable=Lin1ComRxSignalsSR.COMRXL_LTRBV_Sts_LTRBV_STAT_Lin1
          data-send-points:
            access DSP_VeLINR_e_LTRBV_Sts_VeLINR_e_LTRBV_Sts: accessed-variable=VeLINR_e_LTRBV_Sts.VeLINR_e_LTRBV_Sts
            access DSP_VeLINR_b_LTRBV_StsTO_VeLINR_b_LTRBV_StsTO: accessed-variable=VeLINR_b_LTRBV_StsTO.VeLINR_b_LTRBV_StsTO
        COMRXL_LTRBV_Sts_LTRBV_STAT_Lin1_Error: symbol=ApplLinComAb_LIN1_COMRXL_LTRBV_Sts_LTRBV_STAT_Lin1_Error  # Error -
          data-receive-point-by-arguments:
            access DRP_Lin1ComRxSignalsSR_COMRXL_LTRBV_Sts_LTRBV_STAT_Lin1: accessed-variable=Lin1ComRxSignalsSR.COMRXL_LTRBV_Sts_LTRBV_STAT_Lin1
          data-send-points:
            access DSP_VeLINR_e_LTRBV_Sts_VeLINR_e_LTRBV_Sts: accessed-variable=VeLINR_e_LTRBV_Sts.VeLINR_e_LTRBV_Sts
            access DSP_VeLINR_b_LTRBV_StsTO_VeLINR_b_LTRBV_StsTO: accessed-variable=VeLINR_b_LTRBV_StsTO.VeLINR_b_LTRBV_StsTO
          read-local-variables:
            access IRVRA_VeLINR_d_LIN_SlavePrsnt_LIN1: accessed-variable=VeLINR_d_LIN_SlavePrsnt_LIN1
        COMRXL_RsErr_LTRBV_LTRBV_STAT_Lin1_Received: symbol=ApplLinComAb_LIN1_COMRXL_RsErr_LTRBV_LTRBV_STAT_Lin1_Received  # Received -
          data-receive-point-by-arguments:
            access DRP_Lin1ComRxSignalsSR_COMRXL_RsErr_LTRBV_LTRBV_STAT_Lin1: accessed-variable=Lin1ComRxSignalsSR.COMRXL_RsErr_LTRBV_LTRBV_STAT_Lin1
          data-send-points:
            access DSP_VeLINR_b_RsErr_LTRBV_VeLINR_b_RsErr_LTRBV: accessed-variable=VeLINR_b_RsErr_LTRBV.VeLINR_b_RsErr_LTRBV
            access DSP_VeLINR_b_RsErr_LTRBV_TO_VeLINR_b_RsErr_LTRBV_TO: accessed-variable=VeLINR_b_RsErr_LTRBV_TO.VeLINR_b_RsErr_LTRBV_TO
        COMRXL_RsErr_LTRBV_LTRBV_STAT_Lin1_Error: symbol=ApplLinComAb_LIN1_COMRXL_RsErr_LTRBV_LTRBV_STAT_Lin1_Error  # Error -
          data-receive-point-by-arguments:
            access DRP_Lin1ComRxSignalsSR_COMRXL_RsErr_LTRBV_LTRBV_STAT_Lin1: accessed-variable=Lin1ComRxSignalsSR.COMRXL_RsErr_LTRBV_LTRBV_STAT_Lin1
          data-send-points:
            access DSP_VeLINR_b_RsErr_LTRBV_VeLINR_b_RsErr_LTRBV: accessed-variable=VeLINR_b_RsErr_LTRBV.VeLINR_b_RsErr_LTRBV
            access DSP_VeLINR_b_RsErr_LTRBV_TO_VeLINR_b_RsErr_LTRBV_TO: accessed-variable=VeLINR_b_RsErr_LTRBV_TO.VeLINR_b_RsErr_LTRBV_TO
          read-local-variables:
            access IRVRA_VeLINR_d_LIN_SlavePrsnt_LIN1: accessed-variable=VeLINR_d_LIN_SlavePrsnt_LIN1
        COMRXL_CPV_MotorVolt_CPV_STAT_V2_Lin1_Received: symbol=ApplLinComAb_LIN1_COMRXL_CPV_MotorVolt_CPV_STAT_V2_Lin1_Received  # Received -
          data-receive-point-by-arguments:
            access DRP_Lin1ComRxSignalsSR_COMRXL_CPV_MotorVolt_CPV_STAT_V2_Lin1: accessed-variable=Lin1ComRxSignalsSR.COMRXL_CPV_MotorVolt_CPV_STAT_V2_Lin1
          data-send-points:
            access DSP_VeLINR_U_CPV_MotorVolt_VeLINR_U_CPV_MotorVolt: accessed-variable=VeLINR_U_CPV_MotorVolt.VeLINR_U_CPV_MotorVolt
            access DSP_VeLINR_b_CPV_MotorVoltTO_VeLINR_b_CPV_MotorVoltTO: accessed-variable=VeLINR_b_CPV_MotorVoltTO.VeLINR_b_CPV_MotorVoltTO
        COMRXL_CPV_MotorVolt_CPV_STAT_V2_Lin1_Error: symbol=ApplLinComAb_LIN1_COMRXL_CPV_MotorVolt_CPV_STAT_V2_Lin1_Error  # Error -
          data-receive-point-by-arguments:
            access DRP_Lin1ComRxSignalsSR_COMRXL_CPV_MotorVolt_CPV_STAT_V2_Lin1: accessed-variable=Lin1ComRxSignalsSR.COMRXL_CPV_MotorVolt_CPV_STAT_V2_Lin1
          data-send-points:
            access DSP_VeLINR_U_CPV_MotorVolt_VeLINR_U_CPV_MotorVolt: accessed-variable=VeLINR_U_CPV_MotorVolt.VeLINR_U_CPV_MotorVolt
            access DSP_VeLINR_b_CPV_MotorVoltTO_VeLINR_b_CPV_MotorVoltTO: accessed-variable=VeLINR_b_CPV_MotorVoltTO.VeLINR_b_CPV_MotorVoltTO
          read-local-variables:
            access IRVRA_VeLINR_d_LIN_SlavePrsnt_LIN1: accessed-variable=VeLINR_d_LIN_SlavePrsnt_LIN1
        COMRXL_CPV_CalStat_CPV_STAT_V2_Lin1_Received: symbol=ApplLinComAb_LIN1_COMRXL_CPV_CalStat_CPV_STAT_V2_Lin1_Received  # Received -
          data-receive-point-by-arguments:
            access DRP_Lin1ComRxSignalsSR_COMRXL_CPV_CalStat_CPV_STAT_V2_Lin1: accessed-variable=Lin1ComRxSignalsSR.COMRXL_CPV_CalStat_CPV_STAT_V2_Lin1
          data-send-points:
            access DSP_VeLINR_e_CPV_CalStat_VeLINR_e_CPV_CalStat: accessed-variable=VeLINR_e_CPV_CalStat.VeLINR_e_CPV_CalStat
            access DSP_VeLINR_b_CPV_CalStatTO_VeLINR_b_CPV_CalStatTO: accessed-variable=VeLINR_b_CPV_CalStatTO.VeLINR_b_CPV_CalStatTO
        COMRXL_CPV_CalStat_CPV_STAT_V2_Lin1_Error: symbol=ApplLinComAb_LIN1_COMRXL_CPV_CalStat_CPV_STAT_V2_Lin1_Error  # Error -
          data-receive-point-by-arguments:
            access DRP_Lin1ComRxSignalsSR_COMRXL_CPV_CalStat_CPV_STAT_V2_Lin1: accessed-variable=Lin1ComRxSignalsSR.COMRXL_CPV_CalStat_CPV_STAT_V2_Lin1
          data-send-points:
            access DSP_VeLINR_e_CPV_CalStat_VeLINR_e_CPV_CalStat: accessed-variable=VeLINR_e_CPV_CalStat.VeLINR_e_CPV_CalStat
            access DSP_VeLINR_b_CPV_CalStatTO_VeLINR_b_CPV_CalStatTO: accessed-variable=VeLINR_b_CPV_CalStatTO.VeLINR_b_CPV_CalStatTO
          read-local-variables:
            access IRVRA_VeLINR_d_LIN_SlavePrsnt_LIN1: accessed-variable=VeLINR_d_LIN_SlavePrsnt_LIN1
        COMRXL_AirHeatrSts_HVEAHLIN18Fr01_Lin1_Received: symbol=ApplLinComAb_LIN1_COMRXL_AirHeatrSts_HVEAHLIN18Fr01_Lin1_Received  # Received -
          data-receive-point-by-arguments:
            access DRP_Lin1ComRxSignalsSR_COMRXL_AirHeatrSts_HVEAHLIN18Fr01_Lin1: accessed-variable=Lin1ComRxSignalsSR.COMRXL_AirHeatrSts_HVEAHLIN18Fr01_Lin1
          data-send-points:
            access DSP_VeLINR_e_AirHeatrSts_VeLINR_e_AirHeatrSts: accessed-variable=VeLINR_e_AirHeatrSts.VeLINR_e_AirHeatrSts
            access DSP_VeLINR_b_AirHeatrStsTO_VeLINR_b_AirHeatrStsTO: accessed-variable=VeLINR_b_AirHeatrStsTO.VeLINR_b_AirHeatrStsTO
        COMRXL_AirHeatrSts_HVEAHLIN18Fr01_Lin1_Error: symbol=ApplLinComAb_LIN1_COMRXL_AirHeatrSts_HVEAHLIN18Fr01_Lin1_Error  # Error -
          data-receive-point-by-arguments:
            access DRP_Lin1ComRxSignalsSR_COMRXL_AirHeatrSts_HVEAHLIN18Fr01_Lin1: accessed-variable=Lin1ComRxSignalsSR.COMRXL_AirHeatrSts_HVEAHLIN18Fr01_Lin1
          data-send-points:
            access DSP_VeLINR_e_AirHeatrSts_VeLINR_e_AirHeatrSts: accessed-variable=VeLINR_e_AirHeatrSts.VeLINR_e_AirHeatrSts
            access DSP_VeLINR_b_AirHeatrStsTO_VeLINR_b_AirHeatrStsTO: accessed-variable=VeLINR_b_AirHeatrStsTO.VeLINR_b_AirHeatrStsTO
          read-local-variables:
            access IRVRA_VeLINR_d_LIN_SlavePrsnt_LIN1: accessed-variable=VeLINR_d_LIN_SlavePrsnt_LIN1
        COMRXL_AirHeatrPwrCns_HVEAHLIN18Fr01_Lin1_Received: symbol=ApplLinComAb_LIN1_COMRXL_AirHeatrPwrCns_HVEAHLIN18Fr01_Lin1_Received  # Received -
          data-receive-point-by-arguments:
            access DRP_Lin1ComRxSignalsSR_COMRXL_AirHeatrPwrCns_HVEAHLIN18Fr01_Lin1: accessed-variable=Lin1ComRxSignalsSR.COMRXL_AirHeatrPwrCns_HVEAHLIN18Fr01_Lin1
          data-send-points:
            access DSP_VeLINR_Pct_AirHeatrPwrCns_VeLINR_Pct_AirHeatrPwrCns: accessed-variable=VeLINR_Pct_AirHeatrPwrCns.VeLINR_Pct_AirHeatrPwrCns
            access DSP_VeLINR_b_AirHeatrPwrCnsTO_VeLINR_b_AirHeatrPwrCnsTO: accessed-variable=VeLINR_b_AirHeatrPwrCnsTO.VeLINR_b_AirHeatrPwrCnsTO
        COMRXL_AirHeatrPwrCns_HVEAHLIN18Fr01_Lin1_Error: symbol=ApplLinComAb_LIN1_COMRXL_AirHeatrPwrCns_HVEAHLIN18Fr01_Lin1_Error  # Error -
          data-receive-point-by-arguments:
            access DRP_Lin1ComRxSignalsSR_COMRXL_AirHeatrPwrCns_HVEAHLIN18Fr01_Lin1: accessed-variable=Lin1ComRxSignalsSR.COMRXL_AirHeatrPwrCns_HVEAHLIN18Fr01_Lin1
          data-send-points:
            access DSP_VeLINR_Pct_AirHeatrPwrCns_VeLINR_Pct_AirHeatrPwrCns: accessed-variable=VeLINR_Pct_AirHeatrPwrCns.VeLINR_Pct_AirHeatrPwrCns
            access DSP_VeLINR_b_AirHeatrPwrCnsTO_VeLINR_b_AirHeatrPwrCnsTO: accessed-variable=VeLINR_b_AirHeatrPwrCnsTO.VeLINR_b_AirHeatrPwrCnsTO
          read-local-variables:
            access IRVRA_VeLINR_d_LIN_SlavePrsnt_LIN1: accessed-variable=VeLINR_d_LIN_SlavePrsnt_LIN1
        COMRXL_EEXV_PosAct_EEXV_STAT_Lin1_Received: symbol=ApplLinComAb_LIN1_COMRXL_EEXV_PosAct_EEXV_STAT_Lin1_Received  # Received -
          data-receive-point-by-arguments:
            access DRP_Lin1ComRxSignalsSR_COMRXL_EEXV_PosAct_EEXV_STAT_Lin1: accessed-variable=Lin1ComRxSignalsSR.COMRXL_EEXV_PosAct_EEXV_STAT_Lin1
          data-send-points:
            access DSP_VeLINR_Pct_EEXV_PosAct_VeLINR_Pct_EEXV_PosAct: accessed-variable=VeLINR_Pct_EEXV_PosAct.VeLINR_Pct_EEXV_PosAct
            access DSP_VeLINR_b_EEXV_PosActTO_VeLINR_b_EEXV_PosActTO: accessed-variable=VeLINR_b_EEXV_PosActTO.VeLINR_b_EEXV_PosActTO
        COMRXL_EEXV_PosAct_EEXV_STAT_Lin1_Error: symbol=ApplLinComAb_LIN1_COMRXL_EEXV_PosAct_EEXV_STAT_Lin1_Error  # Error -
          data-receive-point-by-arguments:
            access DRP_Lin1ComRxSignalsSR_COMRXL_EEXV_PosAct_EEXV_STAT_Lin1: accessed-variable=Lin1ComRxSignalsSR.COMRXL_EEXV_PosAct_EEXV_STAT_Lin1
          data-send-points:
            access DSP_VeLINR_Pct_EEXV_PosAct_VeLINR_Pct_EEXV_PosAct: accessed-variable=VeLINR_Pct_EEXV_PosAct.VeLINR_Pct_EEXV_PosAct
            access DSP_VeLINR_b_EEXV_PosActTO_VeLINR_b_EEXV_PosActTO: accessed-variable=VeLINR_b_EEXV_PosActTO.VeLINR_b_EEXV_PosActTO
          read-local-variables:
            access IRVRA_VeLINR_d_LIN_SlavePrsnt_LIN1: accessed-variable=VeLINR_d_LIN_SlavePrsnt_LIN1
        COMRXL_EEXV_CalStat_EEXV_STAT_Lin1_Received: symbol=ApplLinComAb_LIN1_COMRXL_EEXV_CalStat_EEXV_STAT_Lin1_Received  # Received -
          data-receive-point-by-arguments:
            access DRP_Lin1ComRxSignalsSR_COMRXL_EEXV_CalStat_EEXV_STAT_Lin1: accessed-variable=Lin1ComRxSignalsSR.COMRXL_EEXV_CalStat_EEXV_STAT_Lin1
          data-send-points:
            access DSP_VeLINR_e_EEXV_CalStat_VeLINR_e_EEXV_CalStat: accessed-variable=VeLINR_e_EEXV_CalStat.VeLINR_e_EEXV_CalStat
            access DSP_VeLINR_b_EEXV_CalStatTO_VeLINR_b_EEXV_CalStatTO: accessed-variable=VeLINR_b_EEXV_CalStatTO.VeLINR_b_EEXV_CalStatTO
        COMRXL_EEXV_CalStat_EEXV_STAT_Lin1_Error: symbol=ApplLinComAb_LIN1_COMRXL_EEXV_CalStat_EEXV_STAT_Lin1_Error  # Error -
          data-receive-point-by-arguments:
            access DRP_Lin1ComRxSignalsSR_COMRXL_EEXV_CalStat_EEXV_STAT_Lin1: accessed-variable=Lin1ComRxSignalsSR.COMRXL_EEXV_CalStat_EEXV_STAT_Lin1
          data-send-points:
            access DSP_VeLINR_e_EEXV_CalStat_VeLINR_e_EEXV_CalStat: accessed-variable=VeLINR_e_EEXV_CalStat.VeLINR_e_EEXV_CalStat
            access DSP_VeLINR_b_EEXV_CalStatTO_VeLINR_b_EEXV_CalStatTO: accessed-variable=VeLINR_b_EEXV_CalStatTO.VeLINR_b_EEXV_CalStatTO
          read-local-variables:
            access IRVRA_VeLINR_d_LIN_SlavePrsnt_LIN1: accessed-variable=VeLINR_d_LIN_SlavePrsnt_LIN1
        COMRXL_EEXV_CalRq_EEXV_STAT_Lin1_Received: symbol=ApplLinComAb_LIN1_COMRXL_EEXV_CalRq_EEXV_STAT_Lin1_Received  # Received -
          data-receive-point-by-arguments:
            access DRP_Lin1ComRxSignalsSR_COMRXL_EEXV_CalRq_EEXV_STAT_Lin1: accessed-variable=Lin1ComRxSignalsSR.COMRXL_EEXV_CalRq_EEXV_STAT_Lin1
          data-send-points:
            access DSP_VeLINR_b_EEXV_CalRq_VeLINR_b_EEXV_CalRq: accessed-variable=VeLINR_b_EEXV_CalRq.VeLINR_b_EEXV_CalRq
            access DSP_VeLINR_b_EEXV_CalRqTO_VeLINR_b_EEXV_CalRqTO: accessed-variable=VeLINR_b_EEXV_CalRqTO.VeLINR_b_EEXV_CalRqTO
        COMRXL_EEXV_CalRq_EEXV_STAT_Lin1_Error: symbol=ApplLinComAb_LIN1_COMRXL_EEXV_CalRq_EEXV_STAT_Lin1_Error  # Error -
          data-receive-point-by-arguments:
            access DRP_Lin1ComRxSignalsSR_COMRXL_EEXV_CalRq_EEXV_STAT_Lin1: accessed-variable=Lin1ComRxSignalsSR.COMRXL_EEXV_CalRq_EEXV_STAT_Lin1
          data-send-points:
            access DSP_VeLINR_b_EEXV_CalRq_VeLINR_b_EEXV_CalRq: accessed-variable=VeLINR_b_EEXV_CalRq.VeLINR_b_EEXV_CalRq
            access DSP_VeLINR_b_EEXV_CalRqTO_VeLINR_b_EEXV_CalRqTO: accessed-variable=VeLINR_b_EEXV_CalRqTO.VeLINR_b_EEXV_CalRqTO
          read-local-variables:
            access IRVRA_VeLINR_d_LIN_SlavePrsnt_LIN1: accessed-variable=VeLINR_d_LIN_SlavePrsnt_LIN1
        COMRXL_RsErr_EEXV_EEXV_STAT_Lin1_Received: symbol=ApplLinComAb_LIN1_COMRXL_RsErr_EEXV_EEXV_STAT_Lin1_Received  # Received -
          data-receive-point-by-arguments:
            access DRP_Lin1ComRxSignalsSR_COMRXL_RsErr_EEXV_EEXV_STAT_Lin1: accessed-variable=Lin1ComRxSignalsSR.COMRXL_RsErr_EEXV_EEXV_STAT_Lin1
          data-send-points:
            access DSP_VeLINR_b_RsErr_EEXV_VeLINR_b_RsErr_EEXV: accessed-variable=VeLINR_b_RsErr_EEXV.VeLINR_b_RsErr_EEXV
            access DSP_VeLINR_b_RsErr_EEXV_TO_VeLINR_b_RsErr_EEXV_TO: accessed-variable=VeLINR_b_RsErr_EEXV_TO.VeLINR_b_RsErr_EEXV_TO
        COMRXL_RsErr_EEXV_EEXV_STAT_Lin1_Error: symbol=ApplLinComAb_LIN1_COMRXL_RsErr_EEXV_EEXV_STAT_Lin1_Error  # Error -
          data-receive-point-by-arguments:
            access DRP_Lin1ComRxSignalsSR_COMRXL_RsErr_EEXV_EEXV_STAT_Lin1: accessed-variable=Lin1ComRxSignalsSR.COMRXL_RsErr_EEXV_EEXV_STAT_Lin1
          data-send-points:
            access DSP_VeLINR_b_RsErr_EEXV_VeLINR_b_RsErr_EEXV: accessed-variable=VeLINR_b_RsErr_EEXV.VeLINR_b_RsErr_EEXV
            access DSP_VeLINR_b_RsErr_EEXV_TO_VeLINR_b_RsErr_EEXV_TO: accessed-variable=VeLINR_b_RsErr_EEXV_TO.VeLINR_b_RsErr_EEXV_TO
          read-local-variables:
            access IRVRA_VeLINR_d_LIN_SlavePrsnt_LIN1: accessed-variable=VeLINR_d_LIN_SlavePrsnt_LIN1
        COMRXL_EEXV_Sts_EEXV_STAT_Lin1_Received: symbol=ApplLinComAb_LIN1_COMRXL_EEXV_Sts_EEXV_STAT_Lin1_Received  # Received -
          data-receive-point-by-arguments:
            access DRP_Lin1ComRxSignalsSR_COMRXL_EEXV_Sts_EEXV_STAT_Lin1: accessed-variable=Lin1ComRxSignalsSR.COMRXL_EEXV_Sts_EEXV_STAT_Lin1
          data-send-points:
            access DSP_VeLINR_e_EEXV_Sts_VeLINR_e_EEXV_Sts: accessed-variable=VeLINR_e_EEXV_Sts.VeLINR_e_EEXV_Sts
            access DSP_VeLINR_b_EEXV_StsTO_VeLINR_b_EEXV_StsTO: accessed-variable=VeLINR_b_EEXV_StsTO.VeLINR_b_EEXV_StsTO
        COMRXL_EEXV_Sts_EEXV_STAT_Lin1_Error: symbol=ApplLinComAb_LIN1_COMRXL_EEXV_Sts_EEXV_STAT_Lin1_Error  # Error -
          data-receive-point-by-arguments:
            access DRP_Lin1ComRxSignalsSR_COMRXL_EEXV_Sts_EEXV_STAT_Lin1: accessed-variable=Lin1ComRxSignalsSR.COMRXL_EEXV_Sts_EEXV_STAT_Lin1
          data-send-points:
            access DSP_VeLINR_e_EEXV_Sts_VeLINR_e_EEXV_Sts: accessed-variable=VeLINR_e_EEXV_Sts.VeLINR_e_EEXV_Sts
            access DSP_VeLINR_b_EEXV_StsTO_VeLINR_b_EEXV_StsTO: accessed-variable=VeLINR_b_EEXV_StsTO.VeLINR_b_EEXV_StsTO
          read-local-variables:
            access IRVRA_VeLINR_d_LIN_SlavePrsnt_LIN1: accessed-variable=VeLINR_d_LIN_SlavePrsnt_LIN1
        COMRXL_EEXV_ERR_EEXV_STAT_Lin1_Received: symbol=ApplLinComAb_LIN1_COMRXL_EEXV_ERR_EEXV_STAT_Lin1_Received  # Received -
          data-receive-point-by-arguments:
            access DRP_Lin1ComRxSignalsSR_COMRXL_EEXV_ERR_EEXV_STAT_Lin1: accessed-variable=Lin1ComRxSignalsSR.COMRXL_EEXV_ERR_EEXV_STAT_Lin1
          data-send-points:
            access DSP_VeLINR_e_EEXV_ERR_VeLINR_e_EEXV_ERR: accessed-variable=VeLINR_e_EEXV_ERR.VeLINR_e_EEXV_ERR
            access DSP_VeLINR_b_EEXV_ERR_TO_VeLINR_b_EEXV_ERR_TO: accessed-variable=VeLINR_b_EEXV_ERR_TO.VeLINR_b_EEXV_ERR_TO
        COMRXL_EEXV_ERR_EEXV_STAT_Lin1_Error: symbol=ApplLinComAb_LIN1_COMRXL_EEXV_ERR_EEXV_STAT_Lin1_Error  # Error -
          data-receive-point-by-arguments:
            access DRP_Lin1ComRxSignalsSR_COMRXL_EEXV_ERR_EEXV_STAT_Lin1: accessed-variable=Lin1ComRxSignalsSR.COMRXL_EEXV_ERR_EEXV_STAT_Lin1
          data-send-points:
            access DSP_VeLINR_e_EEXV_ERR_VeLINR_e_EEXV_ERR: accessed-variable=VeLINR_e_EEXV_ERR.VeLINR_e_EEXV_ERR
            access DSP_VeLINR_b_EEXV_ERR_TO_VeLINR_b_EEXV_ERR_TO: accessed-variable=VeLINR_b_EEXV_ERR_TO.VeLINR_b_EEXV_ERR_TO
          read-local-variables:
            access IRVRA_VeLINR_d_LIN_SlavePrsnt_LIN1: accessed-variable=VeLINR_d_LIN_SlavePrsnt_LIN1
        COMRXL_EEXV_SupplyVolt_EEXV_STAT_Lin1_Received: symbol=ApplLinComAb_LIN1_COMRXL_EEXV_SupplyVolt_EEXV_STAT_Lin1_Received  # Received -
          data-receive-point-by-arguments:
            access DRP_Lin1ComRxSignalsSR_COMRXL_EEXV_SupplyVolt_EEXV_STAT_Lin1: accessed-variable=Lin1ComRxSignalsSR.COMRXL_EEXV_SupplyVolt_EEXV_STAT_Lin1
          data-send-points:
            access DSP_VeLINR_U_EEXV_SupplyVolt_VeLINR_U_EEXV_SupplyVolt: accessed-variable=VeLINR_U_EEXV_SupplyVolt.VeLINR_U_EEXV_SupplyVolt
            access DSP_VeLINR_b_EEXV_SupplyVoltTO_VeLINR_b_EEXV_SupplyVoltTO: accessed-variable=VeLINR_b_EEXV_SupplyVoltTO.VeLINR_b_EEXV_SupplyVoltTO
        COMRXL_EEXV_SupplyVolt_EEXV_STAT_Lin1_Error: symbol=ApplLinComAb_LIN1_COMRXL_EEXV_SupplyVolt_EEXV_STAT_Lin1_Error  # Error -
          data-receive-point-by-arguments:
            access DRP_Lin1ComRxSignalsSR_COMRXL_EEXV_SupplyVolt_EEXV_STAT_Lin1: accessed-variable=Lin1ComRxSignalsSR.COMRXL_EEXV_SupplyVolt_EEXV_STAT_Lin1
          data-send-points:
            access DSP_VeLINR_U_EEXV_SupplyVolt_VeLINR_U_EEXV_SupplyVolt: accessed-variable=VeLINR_U_EEXV_SupplyVolt.VeLINR_U_EEXV_SupplyVolt
            access DSP_VeLINR_b_EEXV_SupplyVoltTO_VeLINR_b_EEXV_SupplyVoltTO: accessed-variable=VeLINR_b_EEXV_SupplyVoltTO.VeLINR_b_EEXV_SupplyVoltTO
          read-local-variables:
            access IRVRA_VeLINR_d_LIN_SlavePrsnt_LIN1: accessed-variable=VeLINR_d_LIN_SlavePrsnt_LIN1
        COMRXL_EEXV_Refrigerant_Pressure_EEXV_STAT_Lin1_Received: symbol=ApplLinComAb_LIN1_COMRXL_EEXV_Refrigerant_Pressure_EEXV_STAT_Lin1_Received  # Received -
          data-receive-point-by-arguments:
            access DRP_Lin1ComRxSignalsSR_COMRXL_EEXV_Refrigerant_Pressure_EEXV_STAT_Lin1: accessed-variable=Lin1ComRxSignalsSR.COMRXL_EEXV_Refrigerant_Pressure_EEXV_STAT_Lin1
          data-send-points:
            access DSP_VeLINR_e_EEXV_Refrig_Pressure_VeLINR_e_EEXV_Refrig_Pressure: accessed-variable=VeLINR_e_EEXV_Refrig_Pressure.VeLINR_e_EEXV_Refrig_Pressure
            access DSP_VeLINR_b_EEXV_Refrig_PressureTO_VeLINR_b_EEXV_Refrig_PressureTO: accessed-variable=VeLINR_b_EEXV_Refrig_PressureTO.VeLINR_b_EEXV_Refrig_PressureTO
        COMRXL_EEXV_Refrigerant_Pressure_EEXV_STAT_Lin1_Error: symbol=ApplLinComAb_LIN1_COMRXL_EEXV_Refrigerant_Pressure_EEXV_STAT_Lin1_Error  # Error -
          data-receive-point-by-arguments:
            access DRP_Lin1ComRxSignalsSR_COMRXL_EEXV_Refrigerant_Pressure_EEXV_STAT_Lin1: accessed-variable=Lin1ComRxSignalsSR.COMRXL_EEXV_Refrigerant_Pressure_EEXV_STAT_Lin1
          data-send-points:
            access DSP_VeLINR_e_EEXV_Refrig_Pressure_VeLINR_e_EEXV_Refrig_Pressure: accessed-variable=VeLINR_e_EEXV_Refrig_Pressure.VeLINR_e_EEXV_Refrig_Pressure
            access DSP_VeLINR_b_EEXV_Refrig_PressureTO_VeLINR_b_EEXV_Refrig_PressureTO: accessed-variable=VeLINR_b_EEXV_Refrig_PressureTO.VeLINR_b_EEXV_Refrig_PressureTO
          read-local-variables:
            access IRVRA_VeLINR_d_LIN_SlavePrsnt_LIN1: accessed-variable=VeLINR_d_LIN_SlavePrsnt_LIN1
        COMRXL_EEXV_Board_Temp_EEXV_STAT_Lin1_Received: symbol=ApplLinComAb_LIN1_COMRXL_EEXV_Board_Temp_EEXV_STAT_Lin1_Received  # Received -
          data-receive-point-by-arguments:
            access DRP_Lin1ComRxSignalsSR_COMRXL_EEXV_Board_Temp_EEXV_STAT_Lin1: accessed-variable=Lin1ComRxSignalsSR.COMRXL_EEXV_Board_Temp_EEXV_STAT_Lin1
          data-send-points:
            access DSP_VeLINR_T_EEXV_Board_Temp_VeLINR_T_EEXV_Board_Temp: accessed-variable=VeLINR_T_EEXV_Board_Temp.VeLINR_T_EEXV_Board_Temp
            access DSP_VeLINR_b_EEXV_Board_TempTO_VeLINR_b_EEXV_Board_TempTO: accessed-variable=VeLINR_b_EEXV_Board_TempTO.VeLINR_b_EEXV_Board_TempTO
        COMRXL_EEXV_Board_Temp_EEXV_STAT_Lin1_Error: symbol=ApplLinComAb_LIN1_COMRXL_EEXV_Board_Temp_EEXV_STAT_Lin1_Error  # Error -
          data-receive-point-by-arguments:
            access DRP_Lin1ComRxSignalsSR_COMRXL_EEXV_Board_Temp_EEXV_STAT_Lin1: accessed-variable=Lin1ComRxSignalsSR.COMRXL_EEXV_Board_Temp_EEXV_STAT_Lin1
          data-send-points:
            access DSP_VeLINR_T_EEXV_Board_Temp_VeLINR_T_EEXV_Board_Temp: accessed-variable=VeLINR_T_EEXV_Board_Temp.VeLINR_T_EEXV_Board_Temp
            access DSP_VeLINR_b_EEXV_Board_TempTO_VeLINR_b_EEXV_Board_TempTO: accessed-variable=VeLINR_b_EEXV_Board_TempTO.VeLINR_b_EEXV_Board_TempTO
          read-local-variables:
            access IRVRA_VeLINR_d_LIN_SlavePrsnt_LIN1: accessed-variable=VeLINR_d_LIN_SlavePrsnt_LIN1
        COMRXL_EEXV_Refrigerant_Temp_EEXV_STAT_Lin1_Received: symbol=ApplLinComAb_LIN1_COMRXL_EEXV_Refrigerant_Temp_EEXV_STAT_Lin1_Received  # Received -
          data-receive-point-by-arguments:
            access DRP_Lin1ComRxSignalsSR_COMRXL_EEXV_Refrigerant_Temp_EEXV_STAT_Lin1: accessed-variable=Lin1ComRxSignalsSR.COMRXL_EEXV_Refrigerant_Temp_EEXV_STAT_Lin1
          data-send-points:
            access DSP_VeLINR_e_EEXV_Refrigerant_Temp_VeLINR_e_EEXV_Refrigerant_Temp: accessed-variable=VeLINR_e_EEXV_Refrigerant_Temp.VeLINR_e_EEXV_Refrigerant_Temp
            access DSP_VeLINR_b_EEXV_Refrigerant_TempTO_VeLINR_b_EEXV_Refrigerant_TempTO: accessed-variable=VeLINR_b_EEXV_Refrigerant_TempTO.VeLINR_b_EEXV_Refrigerant_TempTO
        COMRXL_EEXV_Refrigerant_Temp_EEXV_STAT_Lin1_Error: symbol=ApplLinComAb_LIN1_COMRXL_EEXV_Refrigerant_Temp_EEXV_STAT_Lin1_Error  # Error -
          data-receive-point-by-arguments:
            access DRP_Lin1ComRxSignalsSR_COMRXL_EEXV_Refrigerant_Temp_EEXV_STAT_Lin1: accessed-variable=Lin1ComRxSignalsSR.COMRXL_EEXV_Refrigerant_Temp_EEXV_STAT_Lin1
          data-send-points:
            access DSP_VeLINR_e_EEXV_Refrigerant_Temp_VeLINR_e_EEXV_Refrigerant_Temp: accessed-variable=VeLINR_e_EEXV_Refrigerant_Temp.VeLINR_e_EEXV_Refrigerant_Temp
            access DSP_VeLINR_b_EEXV_Refrigerant_TempTO_VeLINR_b_EEXV_Refrigerant_TempTO: accessed-variable=VeLINR_b_EEXV_Refrigerant_TempTO.VeLINR_b_EEXV_Refrigerant_TempTO
          read-local-variables:
            access IRVRA_VeLINR_d_LIN_SlavePrsnt_LIN1: accessed-variable=VeLINR_d_LIN_SlavePrsnt_LIN1
        COMRXL_EXVM_PosAct_EXVM_STAT_Lin1_Received: symbol=ApplLinComAb_LIN1_COMRXL_EXVM_PosAct_EXVM_STAT_Lin1_Received  # Received -
          data-receive-point-by-arguments:
            access DRP_Lin1ComRxSignalsSR_COMRXL_EXVM_PosAct_EXVM_STAT_Lin1: accessed-variable=Lin1ComRxSignalsSR.COMRXL_EXVM_PosAct_EXVM_STAT_Lin1
          data-send-points:
            access DSP_VeLINR_Pct_EXVM_PosAct_VeLINR_Pct_EXVM_PosAct: accessed-variable=VeLINR_Pct_EXVM_PosAct.VeLINR_Pct_EXVM_PosAct
            access DSP_VeLINR_b_EXVM_PosActTO_VeLINR_b_EXVM_PosActTO: accessed-variable=VeLINR_b_EXVM_PosActTO.VeLINR_b_EXVM_PosActTO
        COMRXL_EXVM_PosAct_EXVM_STAT_Lin1_Error: symbol=ApplLinComAb_LIN1_COMRXL_EXVM_PosAct_EXVM_STAT_Lin1_Error  # Error -
          data-receive-point-by-arguments:
            access DRP_Lin1ComRxSignalsSR_COMRXL_EXVM_PosAct_EXVM_STAT_Lin1: accessed-variable=Lin1ComRxSignalsSR.COMRXL_EXVM_PosAct_EXVM_STAT_Lin1
          data-send-points:
            access DSP_VeLINR_Pct_EXVM_PosAct_VeLINR_Pct_EXVM_PosAct: accessed-variable=VeLINR_Pct_EXVM_PosAct.VeLINR_Pct_EXVM_PosAct
            access DSP_VeLINR_b_EXVM_PosActTO_VeLINR_b_EXVM_PosActTO: accessed-variable=VeLINR_b_EXVM_PosActTO.VeLINR_b_EXVM_PosActTO
          read-local-variables:
            access IRVRA_VeLINR_d_LIN_SlavePrsnt_LIN1: accessed-variable=VeLINR_d_LIN_SlavePrsnt_LIN1
        COMRXL_EXVM_CalStat_EXVM_STAT_Lin1_Received: symbol=ApplLinComAb_LIN1_COMRXL_EXVM_CalStat_EXVM_STAT_Lin1_Received  # Received -
          data-receive-point-by-arguments:
            access DRP_Lin1ComRxSignalsSR_COMRXL_EXVM_CalStat_EXVM_STAT_Lin1: accessed-variable=Lin1ComRxSignalsSR.COMRXL_EXVM_CalStat_EXVM_STAT_Lin1
          data-send-points:
            access DSP_VeLINR_e_EXVM_CalStat_VeLINR_e_EXVM_CalStat: accessed-variable=VeLINR_e_EXVM_CalStat.VeLINR_e_EXVM_CalStat
            access DSP_VeLINR_b_EXVM_CalStatTO_VeLINR_b_EXVM_CalStatTO: accessed-variable=VeLINR_b_EXVM_CalStatTO.VeLINR_b_EXVM_CalStatTO
        COMRXL_EXVM_CalStat_EXVM_STAT_Lin1_Error: symbol=ApplLinComAb_LIN1_COMRXL_EXVM_CalStat_EXVM_STAT_Lin1_Error  # Error -
          data-receive-point-by-arguments:
            access DRP_Lin1ComRxSignalsSR_COMRXL_EXVM_CalStat_EXVM_STAT_Lin1: accessed-variable=Lin1ComRxSignalsSR.COMRXL_EXVM_CalStat_EXVM_STAT_Lin1
          data-send-points:
            access DSP_VeLINR_e_EXVM_CalStat_VeLINR_e_EXVM_CalStat: accessed-variable=VeLINR_e_EXVM_CalStat.VeLINR_e_EXVM_CalStat
            access DSP_VeLINR_b_EXVM_CalStatTO_VeLINR_b_EXVM_CalStatTO: accessed-variable=VeLINR_b_EXVM_CalStatTO.VeLINR_b_EXVM_CalStatTO
          read-local-variables:
            access IRVRA_VeLINR_d_LIN_SlavePrsnt_LIN1: accessed-variable=VeLINR_d_LIN_SlavePrsnt_LIN1
        COMRXL_EXVM_CalRq_EXVM_STAT_Lin1_Received: symbol=ApplLinComAb_LIN1_COMRXL_EXVM_CalRq_EXVM_STAT_Lin1_Received  # Received -
          data-receive-point-by-arguments:
            access DRP_Lin1ComRxSignalsSR_COMRXL_EXVM_CalRq_EXVM_STAT_Lin1: accessed-variable=Lin1ComRxSignalsSR.COMRXL_EXVM_CalRq_EXVM_STAT_Lin1
          data-send-points:
            access DSP_VeLINR_b_EXVM_CalRq_VeLINR_b_EXVM_CalRq: accessed-variable=VeLINR_b_EXVM_CalRq.VeLINR_b_EXVM_CalRq
            access DSP_VeLINR_b_EXVM_CalRqTO_VeLINR_b_EXVM_CalRqTO: accessed-variable=VeLINR_b_EXVM_CalRqTO.VeLINR_b_EXVM_CalRqTO
        COMRXL_EXVM_CalRq_EXVM_STAT_Lin1_Error: symbol=ApplLinComAb_LIN1_COMRXL_EXVM_CalRq_EXVM_STAT_Lin1_Error  # Error -
          data-receive-point-by-arguments:
            access DRP_Lin1ComRxSignalsSR_COMRXL_EXVM_CalRq_EXVM_STAT_Lin1: accessed-variable=Lin1ComRxSignalsSR.COMRXL_EXVM_CalRq_EXVM_STAT_Lin1
          data-send-points:
            access DSP_VeLINR_b_EXVM_CalRq_VeLINR_b_EXVM_CalRq: accessed-variable=VeLINR_b_EXVM_CalRq.VeLINR_b_EXVM_CalRq
            access DSP_VeLINR_b_EXVM_CalRqTO_VeLINR_b_EXVM_CalRqTO: accessed-variable=VeLINR_b_EXVM_CalRqTO.VeLINR_b_EXVM_CalRqTO
          read-local-variables:
            access IRVRA_VeLINR_d_LIN_SlavePrsnt_LIN1: accessed-variable=VeLINR_d_LIN_SlavePrsnt_LIN1
        COMRXL_RsErr_EXVM_EXVM_STAT_Lin1_Received: symbol=ApplLinComAb_LIN1_COMRXL_RsErr_EXVM_EXVM_STAT_Lin1_Received  # Received -
          data-receive-point-by-arguments:
            access DRP_Lin1ComRxSignalsSR_COMRXL_RsErr_EXVM_EXVM_STAT_Lin1: accessed-variable=Lin1ComRxSignalsSR.COMRXL_RsErr_EXVM_EXVM_STAT_Lin1
          data-send-points:
            access DSP_VeLINR_b_RsErr_EXVM_VeLINR_b_RsErr_EXVM: accessed-variable=VeLINR_b_RsErr_EXVM.VeLINR_b_RsErr_EXVM
            access DSP_VeLINR_b_RsErr_EXVM_TO_VeLINR_b_RsErr_EXVM_TO: accessed-variable=VeLINR_b_RsErr_EXVM_TO.VeLINR_b_RsErr_EXVM_TO
        COMRXL_RsErr_EXVM_EXVM_STAT_Lin1_Error: symbol=ApplLinComAb_LIN1_COMRXL_RsErr_EXVM_EXVM_STAT_Lin1_Error  # Error -
          data-receive-point-by-arguments:
            access DRP_Lin1ComRxSignalsSR_COMRXL_RsErr_EXVM_EXVM_STAT_Lin1: accessed-variable=Lin1ComRxSignalsSR.COMRXL_RsErr_EXVM_EXVM_STAT_Lin1
          data-send-points:
            access DSP_VeLINR_b_RsErr_EXVM_VeLINR_b_RsErr_EXVM: accessed-variable=VeLINR_b_RsErr_EXVM.VeLINR_b_RsErr_EXVM
            access DSP_VeLINR_b_RsErr_EXVM_TO_VeLINR_b_RsErr_EXVM_TO: accessed-variable=VeLINR_b_RsErr_EXVM_TO.VeLINR_b_RsErr_EXVM_TO
          read-local-variables:
            access IRVRA_VeLINR_d_LIN_SlavePrsnt_LIN1: accessed-variable=VeLINR_d_LIN_SlavePrsnt_LIN1
        COMRXL_EXVM_Sts_EXVM_STAT_Lin1_Received: symbol=ApplLinComAb_LIN1_COMRXL_EXVM_Sts_EXVM_STAT_Lin1_Received  # Received -
          data-receive-point-by-arguments:
            access DRP_Lin1ComRxSignalsSR_COMRXL_EXVM_Sts_EXVM_STAT_Lin1: accessed-variable=Lin1ComRxSignalsSR.COMRXL_EXVM_Sts_EXVM_STAT_Lin1
          data-send-points:
            access DSP_VeLINR_e_EXVM_Sts_VeLINR_e_EXVM_Sts: accessed-variable=VeLINR_e_EXVM_Sts.VeLINR_e_EXVM_Sts
            access DSP_VeLINR_b_EXVM_StsTO_VeLINR_b_EXVM_StsTO: accessed-variable=VeLINR_b_EXVM_StsTO.VeLINR_b_EXVM_StsTO
        COMRXL_EXVM_Sts_EXVM_STAT_Lin1_Error: symbol=ApplLinComAb_LIN1_COMRXL_EXVM_Sts_EXVM_STAT_Lin1_Error  # Error -
          data-receive-point-by-arguments:
            access DRP_Lin1ComRxSignalsSR_COMRXL_EXVM_Sts_EXVM_STAT_Lin1: accessed-variable=Lin1ComRxSignalsSR.COMRXL_EXVM_Sts_EXVM_STAT_Lin1
          data-send-points:
            access DSP_VeLINR_e_EXVM_Sts_VeLINR_e_EXVM_Sts: accessed-variable=VeLINR_e_EXVM_Sts.VeLINR_e_EXVM_Sts
            access DSP_VeLINR_b_EXVM_StsTO_VeLINR_b_EXVM_StsTO: accessed-variable=VeLINR_b_EXVM_StsTO.VeLINR_b_EXVM_StsTO
          read-local-variables:
            access IRVRA_VeLINR_d_LIN_SlavePrsnt_LIN1: accessed-variable=VeLINR_d_LIN_SlavePrsnt_LIN1
        COMRXL_EXVM_ERR_EXVM_STAT_Lin1_Received: symbol=ApplLinComAb_LIN1_COMRXL_EXVM_ERR_EXVM_STAT_Lin1_Received  # Received -
          data-receive-point-by-arguments:
            access DRP_Lin1ComRxSignalsSR_COMRXL_EXVM_ERR_EXVM_STAT_Lin1: accessed-variable=Lin1ComRxSignalsSR.COMRXL_EXVM_ERR_EXVM_STAT_Lin1
          data-send-points:
            access DSP_VeLINR_e_EXVM_ERR_VeLINR_e_EXVM_ERR: accessed-variable=VeLINR_e_EXVM_ERR.VeLINR_e_EXVM_ERR
            access DSP_VeLINR_b_EXVM_ERR_TO_VeLINR_b_EXVM_ERR_TO: accessed-variable=VeLINR_b_EXVM_ERR_TO.VeLINR_b_EXVM_ERR_TO
        COMRXL_EXVM_ERR_EXVM_STAT_Lin1_Error: symbol=ApplLinComAb_LIN1_COMRXL_EXVM_ERR_EXVM_STAT_Lin1_Error  # Error -
          data-receive-point-by-arguments:
            access DRP_Lin1ComRxSignalsSR_COMRXL_EXVM_ERR_EXVM_STAT_Lin1: accessed-variable=Lin1ComRxSignalsSR.COMRXL_EXVM_ERR_EXVM_STAT_Lin1
          data-send-points:
            access DSP_VeLINR_e_EXVM_ERR_VeLINR_e_EXVM_ERR: accessed-variable=VeLINR_e_EXVM_ERR.VeLINR_e_EXVM_ERR
            access DSP_VeLINR_b_EXVM_ERR_TO_VeLINR_b_EXVM_ERR_TO: accessed-variable=VeLINR_b_EXVM_ERR_TO.VeLINR_b_EXVM_ERR_TO
          read-local-variables:
            access IRVRA_VeLINR_d_LIN_SlavePrsnt_LIN1: accessed-variable=VeLINR_d_LIN_SlavePrsnt_LIN1
        COMRXL_EXVM_SupplyVolt_EXVM_STAT_Lin1_Received: symbol=ApplLinComAb_LIN1_COMRXL_EXVM_SupplyVolt_EXVM_STAT_Lin1_Received  # Received -
          data-receive-point-by-arguments:
            access DRP_Lin1ComRxSignalsSR_COMRXL_EXVM_SupplyVolt_EXVM_STAT_Lin1: accessed-variable=Lin1ComRxSignalsSR.COMRXL_EXVM_SupplyVolt_EXVM_STAT_Lin1
          data-send-points:
            access DSP_VeLINR_U_EXVM_SupplyVolt_VeLINR_U_EXVM_SupplyVolt: accessed-variable=VeLINR_U_EXVM_SupplyVolt.VeLINR_U_EXVM_SupplyVolt
            access DSP_VeLINR_b_EXVM_SupplyVoltTO_VeLINR_b_EXVM_SupplyVoltTO: accessed-variable=VeLINR_b_EXVM_SupplyVoltTO.VeLINR_b_EXVM_SupplyVoltTO
        COMRXL_EXVM_SupplyVolt_EXVM_STAT_Lin1_Error: symbol=ApplLinComAb_LIN1_COMRXL_EXVM_SupplyVolt_EXVM_STAT_Lin1_Error  # Error -
          data-receive-point-by-arguments:
            access DRP_Lin1ComRxSignalsSR_COMRXL_EXVM_SupplyVolt_EXVM_STAT_Lin1: accessed-variable=Lin1ComRxSignalsSR.COMRXL_EXVM_SupplyVolt_EXVM_STAT_Lin1
          data-send-points:
            access DSP_VeLINR_U_EXVM_SupplyVolt_VeLINR_U_EXVM_SupplyVolt: accessed-variable=VeLINR_U_EXVM_SupplyVolt.VeLINR_U_EXVM_SupplyVolt
            access DSP_VeLINR_b_EXVM_SupplyVoltTO_VeLINR_b_EXVM_SupplyVoltTO: accessed-variable=VeLINR_b_EXVM_SupplyVoltTO.VeLINR_b_EXVM_SupplyVoltTO
          read-local-variables:
            access IRVRA_VeLINR_d_LIN_SlavePrsnt_LIN1: accessed-variable=VeLINR_d_LIN_SlavePrsnt_LIN1
        COMRXL_EXVM_Refrigerant_Pressure_EXVM_STAT_Lin1_Received: symbol=ApplLinComAb_LIN1_COMRXL_EXVM_Refrigerant_Pressure_EXVM_STAT_Lin1_Received  # Received -
          data-receive-point-by-arguments:
            access DRP_Lin1ComRxSignalsSR_COMRXL_EXVM_Refrigerant_Pressure_EXVM_STAT_Lin1: accessed-variable=Lin1ComRxSignalsSR.COMRXL_EXVM_Refrigerant_Pressure_EXVM_STAT_Lin1
          data-send-points:
            access DSP_VeLINR_e_EXVM_Refrig_Pressure_VeLINR_e_EXVM_Refrig_Pressure: accessed-variable=VeLINR_e_EXVM_Refrig_Pressure.VeLINR_e_EXVM_Refrig_Pressure
            access DSP_VeLINR_b_EXVM_Refrig_PressureTO_VeLINR_b_EXVM_Refrig_PressureTO: accessed-variable=VeLINR_b_EXVM_Refrig_PressureTO.VeLINR_b_EXVM_Refrig_PressureTO
        COMRXL_EXVM_Refrigerant_Pressure_EXVM_STAT_Lin1_Error: symbol=ApplLinComAb_LIN1_COMRXL_EXVM_Refrigerant_Pressure_EXVM_STAT_Lin1_Error  # Error -
          data-receive-point-by-arguments:
            access DRP_Lin1ComRxSignalsSR_COMRXL_EXVM_Refrigerant_Pressure_EXVM_STAT_Lin1: accessed-variable=Lin1ComRxSignalsSR.COMRXL_EXVM_Refrigerant_Pressure_EXVM_STAT_Lin1
          data-send-points:
            access DSP_VeLINR_e_EXVM_Refrig_Pressure_VeLINR_e_EXVM_Refrig_Pressure: accessed-variable=VeLINR_e_EXVM_Refrig_Pressure.VeLINR_e_EXVM_Refrig_Pressure
            access DSP_VeLINR_b_EXVM_Refrig_PressureTO_VeLINR_b_EXVM_Refrig_PressureTO: accessed-variable=VeLINR_b_EXVM_Refrig_PressureTO.VeLINR_b_EXVM_Refrig_PressureTO
          read-local-variables:
            access IRVRA_VeLINR_d_LIN_SlavePrsnt_LIN1: accessed-variable=VeLINR_d_LIN_SlavePrsnt_LIN1
        COMRXL_EXVM_Board_Temp_EXVM_STAT_Lin1_Received: symbol=ApplLinComAb_LIN1_COMRXL_EXVM_Board_Temp_EXVM_STAT_Lin1_Received  # Received -
          data-receive-point-by-arguments:
            access DRP_Lin1ComRxSignalsSR_COMRXL_EXVM_Board_Temp_EXVM_STAT_Lin1: accessed-variable=Lin1ComRxSignalsSR.COMRXL_EXVM_Board_Temp_EXVM_STAT_Lin1
          data-send-points:
            access DSP_VeLINR_T_EXVM_Board_Temp_VeLINR_T_EXVM_Board_Temp: accessed-variable=VeLINR_T_EXVM_Board_Temp.VeLINR_T_EXVM_Board_Temp
            access DSP_VeLINR_b_EXVM_Board_TempTO_VeLINR_b_EXVM_Board_TempTO: accessed-variable=VeLINR_b_EXVM_Board_TempTO.VeLINR_b_EXVM_Board_TempTO
        COMRXL_EXVM_Board_Temp_EXVM_STAT_Lin1_Error: symbol=ApplLinComAb_LIN1_COMRXL_EXVM_Board_Temp_EXVM_STAT_Lin1_Error  # Error -
          data-receive-point-by-arguments:
            access DRP_Lin1ComRxSignalsSR_COMRXL_EXVM_Board_Temp_EXVM_STAT_Lin1: accessed-variable=Lin1ComRxSignalsSR.COMRXL_EXVM_Board_Temp_EXVM_STAT_Lin1
          data-send-points:
            access DSP_VeLINR_T_EXVM_Board_Temp_VeLINR_T_EXVM_Board_Temp: accessed-variable=VeLINR_T_EXVM_Board_Temp.VeLINR_T_EXVM_Board_Temp
            access DSP_VeLINR_b_EXVM_Board_TempTO_VeLINR_b_EXVM_Board_TempTO: accessed-variable=VeLINR_b_EXVM_Board_TempTO.VeLINR_b_EXVM_Board_TempTO
          read-local-variables:
            access IRVRA_VeLINR_d_LIN_SlavePrsnt_LIN1: accessed-variable=VeLINR_d_LIN_SlavePrsnt_LIN1
        COMRXL_EXVM_Refrigerant_Temp_EXVM_STAT_Lin1_Received: symbol=ApplLinComAb_LIN1_COMRXL_EXVM_Refrigerant_Temp_EXVM_STAT_Lin1_Received  # Received -
          data-receive-point-by-arguments:
            access DRP_Lin1ComRxSignalsSR_COMRXL_EXVM_Refrigerant_Temp_EXVM_STAT_Lin1: accessed-variable=Lin1ComRxSignalsSR.COMRXL_EXVM_Refrigerant_Temp_EXVM_STAT_Lin1
          data-send-points:
            access DSP_VeLINR_e_EXVM_Refrigerant_Temp_VeLINR_e_EXVM_Refrigerant_Temp: accessed-variable=VeLINR_e_EXVM_Refrigerant_Temp.VeLINR_e_EXVM_Refrigerant_Temp
            access DSP_VeLINR_b_EXVM_Refrigerant_TempTO_VeLINR_b_EXVM_Refrigerant_TempTO: accessed-variable=VeLINR_b_EXVM_Refrigerant_TempTO.VeLINR_b_EXVM_Refrigerant_TempTO
        COMRXL_EXVM_Refrigerant_Temp_EXVM_STAT_Lin1_Error: symbol=ApplLinComAb_LIN1_COMRXL_EXVM_Refrigerant_Temp_EXVM_STAT_Lin1_Error  # Error -
          data-receive-point-by-arguments:
            access DRP_Lin1ComRxSignalsSR_COMRXL_EXVM_Refrigerant_Temp_EXVM_STAT_Lin1: accessed-variable=Lin1ComRxSignalsSR.COMRXL_EXVM_Refrigerant_Temp_EXVM_STAT_Lin1
          data-send-points:
            access DSP_VeLINR_e_EXVM_Refrigerant_Temp_VeLINR_e_EXVM_Refrigerant_Temp: accessed-variable=VeLINR_e_EXVM_Refrigerant_Temp.VeLINR_e_EXVM_Refrigerant_Temp
            access DSP_VeLINR_b_EXVM_Refrigerant_TempTO_VeLINR_b_EXVM_Refrigerant_TempTO: accessed-variable=VeLINR_b_EXVM_Refrigerant_TempTO.VeLINR_b_EXVM_Refrigerant_TempTO
          read-local-variables:
            access IRVRA_VeLINR_d_LIN_SlavePrsnt_LIN1: accessed-variable=VeLINR_d_LIN_SlavePrsnt_LIN1
        COMRXL_LTRBV_CalStat_LTRBV_STAT_Lin1_Received: symbol=ApplLinComAb_LIN1_COMRXL_LTRBV_CalStat_LTRBV_STAT_Lin1_Received  # Received -
          data-receive-point-by-arguments:
            access DRP_Lin1ComRxSignalsSR_COMRXL_LTRBV_CalStat_LTRBV_STAT_Lin1: accessed-variable=Lin1ComRxSignalsSR.COMRXL_LTRBV_CalStat_LTRBV_STAT_Lin1
          data-send-points:
            access DSP_VeLINR_e_LTRBV_CalStat_VeLINR_e_LTRBV_CalStat: accessed-variable=VeLINR_e_LTRBV_CalStat.VeLINR_e_LTRBV_CalStat
            access DSP_VeLINR_b_LTRBV_CalStatTO_VeLINR_b_LTRBV_CalStatTO: accessed-variable=VeLINR_b_LTRBV_CalStatTO.VeLINR_b_LTRBV_CalStatTO
        COMRXL_LTRBV_CalStat_LTRBV_STAT_Lin1_Error: symbol=ApplLinComAb_LIN1_COMRXL_LTRBV_CalStat_LTRBV_STAT_Lin1_Error  # Error -
          data-receive-point-by-arguments:
            access DRP_Lin1ComRxSignalsSR_COMRXL_LTRBV_CalStat_LTRBV_STAT_Lin1: accessed-variable=Lin1ComRxSignalsSR.COMRXL_LTRBV_CalStat_LTRBV_STAT_Lin1
          data-send-points:
            access DSP_VeLINR_e_LTRBV_CalStat_VeLINR_e_LTRBV_CalStat: accessed-variable=VeLINR_e_LTRBV_CalStat.VeLINR_e_LTRBV_CalStat
            access DSP_VeLINR_b_LTRBV_CalStatTO_VeLINR_b_LTRBV_CalStatTO: accessed-variable=VeLINR_b_LTRBV_CalStatTO.VeLINR_b_LTRBV_CalStatTO
          read-local-variables:
            access IRVRA_VeLINR_d_LIN_SlavePrsnt_LIN1: accessed-variable=VeLINR_d_LIN_SlavePrsnt_LIN1
        SendLINR_EEXV_PosRq: can-be-invoked-concurrently=true, symbol=ApplLinComAb_LIN1_SendLINR_EEXV_PosRq  # Transmit
          data-receive-point-by-arguments:
            access DRP_SendLINR_EEXV_PosRq_SendLINR_EEXV_PosRq: accessed-variable=SendLINR_EEXV_PosRq.SendLINR_EEXV_PosRq
            access DRP_SendLINR_EEXV_PosRqVld_SendLINR_EEXV_PosRqVld: accessed-variable=SendLINR_EEXV_PosRqVld.SendLINR_EEXV_PosRqVld
          data-send-points:
            access DSP_Lin1ComTxSignalsSR_COMTXL_EEXV_PosRq_EEXV_REQ_Lin1: accessed-variable=Lin1ComTxSignalsSR.COMTXL_EEXV_PosRq_EEXV_REQ_Lin1
        SendLINR_EEXV_CalCmd: can-be-invoked-concurrently=true, symbol=ApplLinComAb_LIN1_SendLINR_EEXV_CalCmd  # Transmit
          data-receive-point-by-arguments:
            access DRP_SendLINR_EEXV_CalCmd_SendLINR_EEXV_CalCmd: accessed-variable=SendLINR_EEXV_CalCmd.SendLINR_EEXV_CalCmd
            access DRP_SendLINR_EEXV_CalCmdVld_SendLINR_EEXV_CalCmdVld: accessed-variable=SendLINR_EEXV_CalCmdVld.SendLINR_EEXV_CalCmdVld
          data-send-points:
            access DSP_Lin1ComTxSignalsSR_COMTXL_EEXV_CalCmd_EEXV_REQ_Lin1: accessed-variable=Lin1ComTxSignalsSR.COMTXL_EEXV_CalCmd_EEXV_REQ_Lin1
        SendLINR_EXVM_PosRq: can-be-invoked-concurrently=true, symbol=ApplLinComAb_LIN1_SendLINR_EXVM_PosRq  # Transmit
          data-receive-point-by-arguments:
            access DRP_SendLINR_EXVM_PosRq_SendLINR_EXVM_PosRq: accessed-variable=SendLINR_EXVM_PosRq.SendLINR_EXVM_PosRq
            access DRP_SendLINR_EXVM_PosRqVld_SendLINR_EXVM_PosRqVld: accessed-variable=SendLINR_EXVM_PosRqVld.SendLINR_EXVM_PosRqVld
          data-send-points:
            access DSP_Lin1ComTxSignalsSR_COMTXL_EXVM_PosRq_EXVM_REQ_Lin1: accessed-variable=Lin1ComTxSignalsSR.COMTXL_EXVM_PosRq_EXVM_REQ_Lin1
        SendLINR_EXVM_CalCmd: can-be-invoked-concurrently=true, symbol=ApplLinComAb_LIN1_SendLINR_EXVM_CalCmd  # Transmit
          data-receive-point-by-arguments:
            access DRP_SendLINR_EXVM_CalCmd_SendLINR_EXVM_CalCmd: accessed-variable=SendLINR_EXVM_CalCmd.SendLINR_EXVM_CalCmd
            access DRP_SendLINR_EXVM_CalCmdVld_SendLINR_EXVM_CalCmdVld: accessed-variable=SendLINR_EXVM_CalCmdVld.SendLINR_EXVM_CalCmdVld
          data-send-points:
            access DSP_Lin1ComTxSignalsSR_COMTXL_EXVM_CalCmd_EXVM_REQ_Lin1: accessed-variable=Lin1ComTxSignalsSR.COMTXL_EXVM_CalCmd_EXVM_REQ_Lin1
        SignalLINR_EXVM_RdyForSleep: symbol=ApplLinComAb_LIN1_SignalLINR_EXVM_RdyForSleep  # EXVM is ready for sleep. Set it's bit in Lin slave ready to sleep.Transmit
          data-receive-point-by-arguments:
            access DRP_SignalLINR_EXVM_RdyForSleep_SignalLINR_EXVM_RdyForSleep: accessed-variable=SignalLINR_EXVM_RdyForSleep.SignalLINR_EXVM_RdyForSleep
          mode-access-point mode-group=MdulPwrMod.AppMode_MDGP_ESH_Mode:
            ident MAP_MdulPwrMod_AppMode_MDGP_ESH_Mode
          parameter access CPA_KeCFGR_b_LIN1_Equid: accessed-parameter=KeCFGR_b_LIN1_Equid.KeCFGR_b_LIN1_Equid
          read-local-variables:
            access IRVRA_VeLINR_d_LIN_SlavePrsnt_LIN1: accessed-variable=VeLINR_d_LIN_SlavePrsnt_LIN1
            access IRVRA_VeLINR_d_LIN_SlaveRdyToSleep_LIN1: accessed-variable=VeLINR_d_LIN_SlaveRdyToSleep_LIN1
          sync call SSCP_GetRteMode_GetMODR_b_InPostRunMode: operation=GetRteMode.GetMODR_b_InPostRunMode, timeout=0.01
          written-local-variables:
            access IRVWA_VeLINR_d_LIN_SlaveRdyToSleep_LIN1: accessed-variable=VeLINR_d_LIN_SlaveRdyToSleep_LIN1
        COMRXL_CoolantValve_ErrLinCom_CoolantValve_Com_Lin1_Received: symbol=ApplLinComAb_LIN1_COMRXL_CoolantValve_ErrLinCom_CoolantValve_Com_Lin1_Received  # Received -
          data-receive-point-by-arguments:
            access DRP_Lin1ComRxSignalsSR_COMRXL_CoolantValve_ErrLinCom_CoolantValve_Com_Lin1: accessed-variable=Lin1ComRxSignalsSR.COMRXL_CoolantValve_ErrLinCom_CoolantValve_Com_Lin1
          data-send-points:
            access DSP_VeLINR_e_CoolantValve_ErrLinCom_VeLINR_e_CoolantValve_ErrLinCom: accessed-variable=VeLINR_e_CoolantValve_ErrLinCom.VeLINR_e_CoolantValve_ErrLinCom
            access DSP_VeLINR_b_CoolantValve_ErrLinComTO_VeLINR_b_CoolantValve_ErrLinComTO: accessed-variable=VeLINR_b_CoolantValve_ErrLinComTO.VeLINR_b_CoolantValve_ErrLinComTO
        COMRXL_CoolantValve_ErrLinCom_CoolantValve_Com_Lin1_Error: symbol=ApplLinComAb_LIN1_COMRXL_CoolantValve_ErrLinCom_CoolantValve_Com_Lin1_Error  # Error -
          data-receive-point-by-arguments:
            access DRP_Lin1ComRxSignalsSR_COMRXL_CoolantValve_ErrLinCom_CoolantValve_Com_Lin1: accessed-variable=Lin1ComRxSignalsSR.COMRXL_CoolantValve_ErrLinCom_CoolantValve_Com_Lin1
          data-send-points:
            access DSP_VeLINR_e_CoolantValve_ErrLinCom_VeLINR_e_CoolantValve_ErrLinCom: accessed-variable=VeLINR_e_CoolantValve_ErrLinCom.VeLINR_e_CoolantValve_ErrLinCom
            access DSP_VeLINR_b_CoolantValve_ErrLinComTO_VeLINR_b_CoolantValve_ErrLinComTO: accessed-variable=VeLINR_b_CoolantValve_ErrLinComTO.VeLINR_b_CoolantValve_ErrLinComTO
          read-local-variables:
            access IRVRA_VeLINR_d_LIN_SlavePrsnt_LIN1: accessed-variable=VeLINR_d_LIN_SlavePrsnt_LIN1
        COMRXL_CoolantValve_ErrPosition_CoolantValve_Com_Lin1_Received: symbol=ApplLinComAb_LIN1_COMRXL_CoolantValve_ErrPosition_CoolantValve_Com_Lin1_Received  # Received -
          data-receive-point-by-arguments:
            access DRP_Lin1ComRxSignalsSR_COMRXL_CoolantValve_ErrPosition_CoolantValve_Com_Lin1: accessed-variable=Lin1ComRxSignalsSR.COMRXL_CoolantValve_ErrPosition_CoolantValve_Com_Lin1
          data-send-points:
            access DSP_VeLINR_e_CoolantValve_ErrPos_VeLINR_e_CoolantValve_ErrPos: accessed-variable=VeLINR_e_CoolantValve_ErrPos.VeLINR_e_CoolantValve_ErrPos
            access DSP_VeLINR_b_CoolantValve_ErrPosTO_VeLINR_b_CoolantValve_ErrPosTO: accessed-variable=VeLINR_b_CoolantValve_ErrPosTO.VeLINR_b_CoolantValve_ErrPosTO
        COMRXL_CoolantValve_ErrPosition_CoolantValve_Com_Lin1_Error: symbol=ApplLinComAb_LIN1_COMRXL_CoolantValve_ErrPosition_CoolantValve_Com_Lin1_Error  # Error -
          data-receive-point-by-arguments:
            access DRP_Lin1ComRxSignalsSR_COMRXL_CoolantValve_ErrPosition_CoolantValve_Com_Lin1: accessed-variable=Lin1ComRxSignalsSR.COMRXL_CoolantValve_ErrPosition_CoolantValve_Com_Lin1
          data-send-points:
            access DSP_VeLINR_e_CoolantValve_ErrPos_VeLINR_e_CoolantValve_ErrPos: accessed-variable=VeLINR_e_CoolantValve_ErrPos.VeLINR_e_CoolantValve_ErrPos
            access DSP_VeLINR_b_CoolantValve_ErrPosTO_VeLINR_b_CoolantValve_ErrPosTO: accessed-variable=VeLINR_b_CoolantValve_ErrPosTO.VeLINR_b_CoolantValve_ErrPosTO
          read-local-variables:
            access IRVRA_VeLINR_d_LIN_SlavePrsnt_LIN1: accessed-variable=VeLINR_d_LIN_SlavePrsnt_LIN1
        COMRXL_CoolantValve_SelfCalReq_CoolantValve_Com_Lin1_Received: symbol=ApplLinComAb_LIN1_COMRXL_CoolantValve_SelfCalReq_CoolantValve_Com_Lin1_Received  # Received -
          data-receive-point-by-arguments:
            access DRP_Lin1ComRxSignalsSR_COMRXL_CoolantValve_SelfCalReq_CoolantValve_Com_Lin1: accessed-variable=Lin1ComRxSignalsSR.COMRXL_CoolantValve_SelfCalReq_CoolantValve_Com_Lin1
          data-send-points:
            access DSP_VeLINR_b_CoolantVal_SelfCalReq_VeLINR_b_CoolantVal_SelfCalReq: accessed-variable=VeLINR_b_CoolantVal_SelfCalReq.VeLINR_b_CoolantVal_SelfCalReq
            access DSP_VeLINR_b_CoolantVal_SelfCalReqTO_VeLINR_b_CoolantVal_SelfCalReqTO: accessed-variable=VeLINR_b_CoolantVal_SelfCalReqTO.VeLINR_b_CoolantVal_SelfCalReqTO
        COMRXL_CoolantValve_SelfCalReq_CoolantValve_Com_Lin1_Error: symbol=ApplLinComAb_LIN1_COMRXL_CoolantValve_SelfCalReq_CoolantValve_Com_Lin1_Error  # Error -
          data-receive-point-by-arguments:
            access DRP_Lin1ComRxSignalsSR_COMRXL_CoolantValve_SelfCalReq_CoolantValve_Com_Lin1: accessed-variable=Lin1ComRxSignalsSR.COMRXL_CoolantValve_SelfCalReq_CoolantValve_Com_Lin1
          data-send-points:
            access DSP_VeLINR_b_CoolantVal_SelfCalReq_VeLINR_b_CoolantVal_SelfCalReq: accessed-variable=VeLINR_b_CoolantVal_SelfCalReq.VeLINR_b_CoolantVal_SelfCalReq
            access DSP_VeLINR_b_CoolantVal_SelfCalReqTO_VeLINR_b_CoolantVal_SelfCalReqTO: accessed-variable=VeLINR_b_CoolantVal_SelfCalReqTO.VeLINR_b_CoolantVal_SelfCalReqTO
          read-local-variables:
            access IRVRA_VeLINR_d_LIN_SlavePrsnt_LIN1: accessed-variable=VeLINR_d_LIN_SlavePrsnt_LIN1
        COMRXL_CoolantValve_SystemState_CoolantValve_Com_Lin1_Received: symbol=ApplLinComAb_LIN1_COMRXL_CoolantValve_SystemState_CoolantValve_Com_Lin1_Received  # Received -
          data-receive-point-by-arguments:
            access DRP_Lin1ComRxSignalsSR_COMRXL_CoolantValve_SystemState_CoolantValve_Com_Lin1: accessed-variable=Lin1ComRxSignalsSR.COMRXL_CoolantValve_SystemState_CoolantValve_Com_Lin1
          data-send-points:
            access DSP_VeLINR_e_CoolantVal_SystemState_VeLINR_e_CoolantVal_SystemState: accessed-variable=VeLINR_e_CoolantVal_SystemState.VeLINR_e_CoolantVal_SystemState
            access DSP_VeLINR_b_CoolantVal_SystemStateTO_VeLINR_b_CoolantVal_SystemStateTO: accessed-variable=VeLINR_b_CoolantVal_SystemStateTO.VeLINR_b_CoolantVal_SystemStateTO
        COMRXL_CoolantValve_SystemState_CoolantValve_Com_Lin1_Error: symbol=ApplLinComAb_LIN1_COMRXL_CoolantValve_SystemState_CoolantValve_Com_Lin1_Error  # Error -
          data-receive-point-by-arguments:
            access DRP_Lin1ComRxSignalsSR_COMRXL_CoolantValve_SystemState_CoolantValve_Com_Lin1: accessed-variable=Lin1ComRxSignalsSR.COMRXL_CoolantValve_SystemState_CoolantValve_Com_Lin1
          data-send-points:
            access DSP_VeLINR_e_CoolantVal_SystemState_VeLINR_e_CoolantVal_SystemState: accessed-variable=VeLINR_e_CoolantVal_SystemState.VeLINR_e_CoolantVal_SystemState
            access DSP_VeLINR_b_CoolantVal_SystemStateTO_VeLINR_b_CoolantVal_SystemStateTO: accessed-variable=VeLINR_b_CoolantVal_SystemStateTO.VeLINR_b_CoolantVal_SystemStateTO
          read-local-variables:
            access IRVRA_VeLINR_d_LIN_SlavePrsnt_LIN1: accessed-variable=VeLINR_d_LIN_SlavePrsnt_LIN1
        COMRXL_CoolantValve_EcuVoltage_CoolantValve_Com_Lin1_Received: symbol=ApplLinComAb_LIN1_COMRXL_CoolantValve_EcuVoltage_CoolantValve_Com_Lin1_Received  # Received -
          data-receive-point-by-arguments:
            access DRP_Lin1ComRxSignalsSR_COMRXL_CoolantValve_EcuVoltage_CoolantValve_Com_Lin1: accessed-variable=Lin1ComRxSignalsSR.COMRXL_CoolantValve_EcuVoltage_CoolantValve_Com_Lin1
          data-send-points:
            access DSP_VeLINR_y_CoolantVal_EcuVoltage_VeLINR_y_CoolantVal_EcuVoltage: accessed-variable=VeLINR_y_CoolantVal_EcuVoltage.VeLINR_y_CoolantVal_EcuVoltage
            access DSP_VeLINR_b_CoolantVal_EcuVoltageTO_VeLINR_b_CoolantVal_EcuVoltageTO: accessed-variable=VeLINR_b_CoolantVal_EcuVoltageTO.VeLINR_b_CoolantVal_EcuVoltageTO
        COMRXL_CoolantValve_EcuVoltage_CoolantValve_Com_Lin1_Error: symbol=ApplLinComAb_LIN1_COMRXL_CoolantValve_EcuVoltage_CoolantValve_Com_Lin1_Error  # Error -
          data-receive-point-by-arguments:
            access DRP_Lin1ComRxSignalsSR_COMRXL_CoolantValve_EcuVoltage_CoolantValve_Com_Lin1: accessed-variable=Lin1ComRxSignalsSR.COMRXL_CoolantValve_EcuVoltage_CoolantValve_Com_Lin1
          data-send-points:
            access DSP_VeLINR_y_CoolantVal_EcuVoltage_VeLINR_y_CoolantVal_EcuVoltage: accessed-variable=VeLINR_y_CoolantVal_EcuVoltage.VeLINR_y_CoolantVal_EcuVoltage
            access DSP_VeLINR_b_CoolantVal_EcuVoltageTO_VeLINR_b_CoolantVal_EcuVoltageTO: accessed-variable=VeLINR_b_CoolantVal_EcuVoltageTO.VeLINR_b_CoolantVal_EcuVoltageTO
          read-local-variables:
            access IRVRA_VeLINR_d_LIN_SlavePrsnt_LIN1: accessed-variable=VeLINR_d_LIN_SlavePrsnt_LIN1
        COMRXL_CoolantValve_ActuatorPositionTrgt_CoolantValve_Com_Lin1_Received: symbol=ApplLinComAb_LIN1_COMRXL_CoolantValve_ActuatorPositionTrgt_CoolantValve_Com_Lin1_Received  # Received -
          data-receive-point-by-arguments:
            access DRP_Lin1ComRxSignalsSR_COMRXL_CoolantValve_ActuatorPositionTrgt_CoolantValve_Com_Lin1: accessed-variable=Lin1ComRxSignalsSR.COMRXL_CoolantValve_ActuatorPositionTrgt_CoolantValve_Com_Lin1
          data-send-points:
            access DSP_VeLINR_d_CoolVal_ActuatPosTrgt_VeLINR_d_CoolVal_ActuatPosTrgt: accessed-variable=VeLINR_d_CoolVal_ActuatPosTrgt.VeLINR_d_CoolVal_ActuatPosTrgt
            access DSP_VeLINR_b_CoolVal_ActuatPosTrgtTO_VeLINR_b_CoolVal_ActuatPosTrgtTO: accessed-variable=VeLINR_b_CoolVal_ActuatPosTrgtTO.VeLINR_b_CoolVal_ActuatPosTrgtTO
        COMRXL_CoolantValve_ActuatorPositionTrgt_CoolantValve_Com_Lin1_Error: symbol=ApplLinComAb_LIN1_COMRXL_CoolantValve_ActuatorPositionTrgt_CoolantValve_Com_Lin1_Error  # Error -
          data-receive-point-by-arguments:
            access DRP_Lin1ComRxSignalsSR_COMRXL_CoolantValve_ActuatorPositionTrgt_CoolantValve_Com_Lin1: accessed-variable=Lin1ComRxSignalsSR.COMRXL_CoolantValve_ActuatorPositionTrgt_CoolantValve_Com_Lin1
          data-send-points:
            access DSP_VeLINR_d_CoolVal_ActuatPosTrgt_VeLINR_d_CoolVal_ActuatPosTrgt: accessed-variable=VeLINR_d_CoolVal_ActuatPosTrgt.VeLINR_d_CoolVal_ActuatPosTrgt
            access DSP_VeLINR_b_CoolVal_ActuatPosTrgtTO_VeLINR_b_CoolVal_ActuatPosTrgtTO: accessed-variable=VeLINR_b_CoolVal_ActuatPosTrgtTO.VeLINR_b_CoolVal_ActuatPosTrgtTO
          read-local-variables:
            access IRVRA_VeLINR_d_LIN_SlavePrsnt_LIN1: accessed-variable=VeLINR_d_LIN_SlavePrsnt_LIN1
        COMRXL_CoolantValve_ActuatorPositionAct_CoolantValve_Com_Lin1_Received: symbol=ApplLinComAb_LIN1_COMRXL_CoolantValve_ActuatorPositionAct_CoolantValve_Com_Lin1_Received  # Received -
          data-receive-point-by-arguments:
            access DRP_Lin1ComRxSignalsSR_COMRXL_CoolantValve_ActuatorPositionAct_CoolantValve_Com_Lin1: accessed-variable=Lin1ComRxSignalsSR.COMRXL_CoolantValve_ActuatorPositionAct_CoolantValve_Com_Lin1
          data-send-points:
            access DSP_VeLINR_d_CoolantVal_ActuPosAct_VeLINR_d_CoolantVal_ActuPosAct: accessed-variable=VeLINR_d_CoolantVal_ActuPosAct.VeLINR_d_CoolantVal_ActuPosAct
            access DSP_VeLINR_b_CoolantVal_ActuPosActTO_VeLINR_b_CoolantVal_ActuPosActTO: accessed-variable=VeLINR_b_CoolantVal_ActuPosActTO.VeLINR_b_CoolantVal_ActuPosActTO
        COMRXL_CoolantValve_ActuatorPositionAct_CoolantValve_Com_Lin1_Error: symbol=ApplLinComAb_LIN1_COMRXL_CoolantValve_ActuatorPositionAct_CoolantValve_Com_Lin1_Error  # Error -
          data-receive-point-by-arguments:
            access DRP_Lin1ComRxSignalsSR_COMRXL_CoolantValve_ActuatorPositionAct_CoolantValve_Com_Lin1: accessed-variable=Lin1ComRxSignalsSR.COMRXL_CoolantValve_ActuatorPositionAct_CoolantValve_Com_Lin1
          data-send-points:
            access DSP_VeLINR_d_CoolantVal_ActuPosAct_VeLINR_d_CoolantVal_ActuPosAct: accessed-variable=VeLINR_d_CoolantVal_ActuPosAct.VeLINR_d_CoolantVal_ActuPosAct
            access DSP_VeLINR_b_CoolantVal_ActuPosActTO_VeLINR_b_CoolantVal_ActuPosActTO: accessed-variable=VeLINR_b_CoolantVal_ActuPosActTO.VeLINR_b_CoolantVal_ActuPosActTO
          read-local-variables:
            access IRVRA_VeLINR_d_LIN_SlavePrsnt_LIN1: accessed-variable=VeLINR_d_LIN_SlavePrsnt_LIN1
        COMRXL_CoolantValve_EcuTemperatur_CoolantValve_Com_Lin1_Received: symbol=ApplLinComAb_LIN1_COMRXL_CoolantValve_EcuTemperatur_CoolantValve_Com_Lin1_Received  # Received -
          data-receive-point-by-arguments:
            access DRP_Lin1ComRxSignalsSR_COMRXL_CoolantValve_EcuTemperatur_CoolantValve_Com_Lin1: accessed-variable=Lin1ComRxSignalsSR.COMRXL_CoolantValve_EcuTemperatur_CoolantValve_Com_Lin1
          data-send-points:
            access DSP_VeLINR_y_CoolantValve_EcuTemp_VeLINR_y_CoolantValve_EcuTemp: accessed-variable=VeLINR_y_CoolantValve_EcuTemp.VeLINR_y_CoolantValve_EcuTemp
            access DSP_VeLINR_b_CoolantValve_EcuTempTO_VeLINR_b_CoolantValve_EcuTempTO: accessed-variable=VeLINR_b_CoolantValve_EcuTempTO.VeLINR_b_CoolantValve_EcuTempTO
        COMRXL_CoolantValve_EcuTemperatur_CoolantValve_Com_Lin1_Error: symbol=ApplLinComAb_LIN1_COMRXL_CoolantValve_EcuTemperatur_CoolantValve_Com_Lin1_Error  # Error -
          data-receive-point-by-arguments:
            access DRP_Lin1ComRxSignalsSR_COMRXL_CoolantValve_EcuTemperatur_CoolantValve_Com_Lin1: accessed-variable=Lin1ComRxSignalsSR.COMRXL_CoolantValve_EcuTemperatur_CoolantValve_Com_Lin1
          data-send-points:
            access DSP_VeLINR_y_CoolantValve_EcuTemp_VeLINR_y_CoolantValve_EcuTemp: accessed-variable=VeLINR_y_CoolantValve_EcuTemp.VeLINR_y_CoolantValve_EcuTemp
            access DSP_VeLINR_b_CoolantValve_EcuTempTO_VeLINR_b_CoolantValve_EcuTempTO: accessed-variable=VeLINR_b_CoolantValve_EcuTempTO.VeLINR_b_CoolantValve_EcuTempTO
          read-local-variables:
            access IRVRA_VeLINR_d_LIN_SlavePrsnt_LIN1: accessed-variable=VeLINR_d_LIN_SlavePrsnt_LIN1
        COMRXL_CoolantValve_Err_Motor_CoolantValve_Com_Lin1_Received: symbol=ApplLinComAb_LIN1_COMRXL_CoolantValve_Err_Motor_CoolantValve_Com_Lin1_Received  # Received -
          data-receive-point-by-arguments:
            access DRP_Lin1ComRxSignalsSR_COMRXL_CoolantValve_Err_Motor_CoolantValve_Com_Lin1: accessed-variable=Lin1ComRxSignalsSR.COMRXL_CoolantValve_Err_Motor_CoolantValve_Com_Lin1
          data-send-points:
            access DSP_VeLINR_e_CoolantValve_Err_Motor_VeLINR_e_CoolantValve_Err_Motor: accessed-variable=VeLINR_e_CoolantValve_Err_Motor.VeLINR_e_CoolantValve_Err_Motor
            access DSP_VeLINR_b_CoolantValve_Err_MotorTO_VeLINR_b_CoolantValve_Err_MotorTO: accessed-variable=VeLINR_b_CoolantValve_Err_MotorTO.VeLINR_b_CoolantValve_Err_MotorTO
        COMRXL_CoolantValve_Err_Motor_CoolantValve_Com_Lin1_Error: symbol=ApplLinComAb_LIN1_COMRXL_CoolantValve_Err_Motor_CoolantValve_Com_Lin1_Error  # Error -
          data-receive-point-by-arguments:
            access DRP_Lin1ComRxSignalsSR_COMRXL_CoolantValve_Err_Motor_CoolantValve_Com_Lin1: accessed-variable=Lin1ComRxSignalsSR.COMRXL_CoolantValve_Err_Motor_CoolantValve_Com_Lin1
          data-send-points:
            access DSP_VeLINR_e_CoolantValve_Err_Motor_VeLINR_e_CoolantValve_Err_Motor: accessed-variable=VeLINR_e_CoolantValve_Err_Motor.VeLINR_e_CoolantValve_Err_Motor
            access DSP_VeLINR_b_CoolantValve_Err_MotorTO_VeLINR_b_CoolantValve_Err_MotorTO: accessed-variable=VeLINR_b_CoolantValve_Err_MotorTO.VeLINR_b_CoolantValve_Err_MotorTO
          read-local-variables:
            access IRVRA_VeLINR_d_LIN_SlavePrsnt_LIN1: accessed-variable=VeLINR_d_LIN_SlavePrsnt_LIN1
        COMRXL_CoolantValve_Err_Voltage_CoolantValve_Com_Lin1_Received: symbol=ApplLinComAb_LIN1_COMRXL_CoolantValve_Err_Voltage_CoolantValve_Com_Lin1_Received  # Received -
          data-receive-point-by-arguments:
            access DRP_Lin1ComRxSignalsSR_COMRXL_CoolantValve_Err_Voltage_CoolantValve_Com_Lin1: accessed-variable=Lin1ComRxSignalsSR.COMRXL_CoolantValve_Err_Voltage_CoolantValve_Com_Lin1
          data-send-points:
            access DSP_VeLINR_e_CoolantValve_Err_Volt_VeLINR_e_CoolantValve_Err_Volt: accessed-variable=VeLINR_e_CoolantValve_Err_Volt.VeLINR_e_CoolantValve_Err_Volt
            access DSP_VeLINR_b_CoolantValve_Err_VoltTO_VeLINR_b_CoolantValve_Err_VoltTO: accessed-variable=VeLINR_b_CoolantValve_Err_VoltTO.VeLINR_b_CoolantValve_Err_VoltTO
        COMRXL_CoolantValve_Err_Voltage_CoolantValve_Com_Lin1_Error: symbol=ApplLinComAb_LIN1_COMRXL_CoolantValve_Err_Voltage_CoolantValve_Com_Lin1_Error  # Error -
          data-receive-point-by-arguments:
            access DRP_Lin1ComRxSignalsSR_COMRXL_CoolantValve_Err_Voltage_CoolantValve_Com_Lin1: accessed-variable=Lin1ComRxSignalsSR.COMRXL_CoolantValve_Err_Voltage_CoolantValve_Com_Lin1
          data-send-points:
            access DSP_VeLINR_e_CoolantValve_Err_Volt_VeLINR_e_CoolantValve_Err_Volt: accessed-variable=VeLINR_e_CoolantValve_Err_Volt.VeLINR_e_CoolantValve_Err_Volt
            access DSP_VeLINR_b_CoolantValve_Err_VoltTO_VeLINR_b_CoolantValve_Err_VoltTO: accessed-variable=VeLINR_b_CoolantValve_Err_VoltTO.VeLINR_b_CoolantValve_Err_VoltTO
          read-local-variables:
            access IRVRA_VeLINR_d_LIN_SlavePrsnt_LIN1: accessed-variable=VeLINR_d_LIN_SlavePrsnt_LIN1
        COMRXL_CoolantValve_Err_Ecu_CoolantValve_Com_Lin1_Received: symbol=ApplLinComAb_LIN1_COMRXL_CoolantValve_Err_Ecu_CoolantValve_Com_Lin1_Received  # Received -
          data-receive-point-by-arguments:
            access DRP_Lin1ComRxSignalsSR_COMRXL_CoolantValve_Err_Ecu_CoolantValve_Com_Lin1: accessed-variable=Lin1ComRxSignalsSR.COMRXL_CoolantValve_Err_Ecu_CoolantValve_Com_Lin1
          data-send-points:
            access DSP_VeLINR_e_CoolantValve_Err_Ecu_VeLINR_e_CoolantValve_Err_Ecu: accessed-variable=VeLINR_e_CoolantValve_Err_Ecu.VeLINR_e_CoolantValve_Err_Ecu
            access DSP_VeLINR_b_CoolantValve_Err_EcuTO_VeLINR_b_CoolantValve_Err_EcuTO: accessed-variable=VeLINR_b_CoolantValve_Err_EcuTO.VeLINR_b_CoolantValve_Err_EcuTO
        COMRXL_CoolantValve_Err_Ecu_CoolantValve_Com_Lin1_Error: symbol=ApplLinComAb_LIN1_COMRXL_CoolantValve_Err_Ecu_CoolantValve_Com_Lin1_Error  # Error -
          data-receive-point-by-arguments:
            access DRP_Lin1ComRxSignalsSR_COMRXL_CoolantValve_Err_Ecu_CoolantValve_Com_Lin1: accessed-variable=Lin1ComRxSignalsSR.COMRXL_CoolantValve_Err_Ecu_CoolantValve_Com_Lin1
          data-send-points:
            access DSP_VeLINR_e_CoolantValve_Err_Ecu_VeLINR_e_CoolantValve_Err_Ecu: accessed-variable=VeLINR_e_CoolantValve_Err_Ecu.VeLINR_e_CoolantValve_Err_Ecu
            access DSP_VeLINR_b_CoolantValve_Err_EcuTO_VeLINR_b_CoolantValve_Err_EcuTO: accessed-variable=VeLINR_b_CoolantValve_Err_EcuTO.VeLINR_b_CoolantValve_Err_EcuTO
          read-local-variables:
            access IRVRA_VeLINR_d_LIN_SlavePrsnt_LIN1: accessed-variable=VeLINR_d_LIN_SlavePrsnt_LIN1
        COMRXL_CoolantValve_ResponseError_CoolantValve_Com_Lin1_Received: symbol=ApplLinComAb_LIN1_COMRXL_CoolantValve_ResponseError_CoolantValve_Com_Lin1_Received  # Received -
          data-receive-point-by-arguments:
            access DRP_Lin1ComRxSignalsSR_COMRXL_CoolantValve_ResponseError_CoolantValve_Com_Lin1: accessed-variable=Lin1ComRxSignalsSR.COMRXL_CoolantValve_ResponseError_CoolantValve_Com_Lin1
          data-send-points:
            access DSP_VeLINR_b_CoolantVal_ResponseErr_VeLINR_b_CoolantVal_ResponseErr: accessed-variable=VeLINR_b_CoolantVal_ResponseErr.VeLINR_b_CoolantVal_ResponseErr
            access DSP_VeLINR_b_CoolantVal_ResponseErrTO_VeLINR_b_CoolantVal_ResponseErrTO: accessed-variable=VeLINR_b_CoolantVal_ResponseErrTO.VeLINR_b_CoolantVal_ResponseErrTO
        COMRXL_CoolantValve_ResponseError_CoolantValve_Com_Lin1_Error: symbol=ApplLinComAb_LIN1_COMRXL_CoolantValve_ResponseError_CoolantValve_Com_Lin1_Error  # Error -
          data-receive-point-by-arguments:
            access DRP_Lin1ComRxSignalsSR_COMRXL_CoolantValve_ResponseError_CoolantValve_Com_Lin1: accessed-variable=Lin1ComRxSignalsSR.COMRXL_CoolantValve_ResponseError_CoolantValve_Com_Lin1
          data-send-points:
            access DSP_VeLINR_b_CoolantVal_ResponseErr_VeLINR_b_CoolantVal_ResponseErr: accessed-variable=VeLINR_b_CoolantVal_ResponseErr.VeLINR_b_CoolantVal_ResponseErr
            access DSP_VeLINR_b_CoolantVal_ResponseErrTO_VeLINR_b_CoolantVal_ResponseErrTO: accessed-variable=VeLINR_b_CoolantVal_ResponseErrTO.VeLINR_b_CoolantVal_ResponseErrTO
          read-local-variables:
            access IRVRA_VeLINR_d_LIN_SlavePrsnt_LIN1: accessed-variable=VeLINR_d_LIN_SlavePrsnt_LIN1
        SendLINR_Control_TargetPos: can-be-invoked-concurrently=true, symbol=ApplLinComAb_LIN1_SendLINR_Control_TargetPos  # Transmit
          data-receive-point-by-arguments:
            access DRP_SendLINR_Control_TargetPos_SendLINR_Control_TargetPos: accessed-variable=SendLINR_Control_TargetPos.SendLINR_Control_TargetPos
            access DRP_SendLINR_Control_TargetPosVld_SendLINR_Control_TargetPosVld: accessed-variable=SendLINR_Control_TargetPosVld.SendLINR_Control_TargetPosVld
          data-send-points:
            access DSP_Lin1ComTxSignalsSR_COMTXL_Control_TargetPos_FCPS_CoolantValve_Control_Lin1: accessed-variable=Lin1ComTxSignalsSR.COMTXL_Control_TargetPos_FCPS_CoolantValve_Control_Lin1
        SendLINR_Control_Reserved1: can-be-invoked-concurrently=true, symbol=ApplLinComAb_LIN1_SendLINR_Control_Reserved1  # Transmit
          data-receive-point-by-arguments:
            access DRP_SendLINR_Control_Reserved1_SendLINR_Control_Reserved1: accessed-variable=SendLINR_Control_Reserved1.SendLINR_Control_Reserved1
            access DRP_SendLINR_Control_Reserved1Vld_SendLINR_Control_Reserved1Vld: accessed-variable=SendLINR_Control_Reserved1Vld.SendLINR_Control_Reserved1Vld
          data-send-points:
            access DSP_Lin1ComTxSignalsSR_COMTXL_Control_Reserved1_FCPS_CoolantValve_Control_Lin1: accessed-variable=Lin1ComTxSignalsSR.COMTXL_Control_Reserved1_FCPS_CoolantValve_Control_Lin1
        SendLINR_Control_BlockDetEnbl: can-be-invoked-concurrently=true, symbol=ApplLinComAb_LIN1_SendLINR_Control_BlockDetEnbl  # Transmit
          data-receive-point-by-arguments:
            access DRP_SendLINR_Control_BlockDetEnbl_SendLINR_Control_BlockDetEnbl: accessed-variable=SendLINR_Control_BlockDetEnbl.SendLINR_Control_BlockDetEnbl
            access DRP_SendLINR_Control_BlockDetEnblVld_SendLINR_Control_BlockDetEnblVld: accessed-variable=SendLINR_Control_BlockDetEnblVld.SendLINR_Control_BlockDetEnblVld
          data-send-points:
            access DSP_Lin1ComTxSignalsSR_COMTXL_Control_BlockDetEnbl_FCPS_CoolantValve_Control_Lin1: accessed-variable=Lin1ComTxSignalsSR.COMTXL_Control_BlockDetEnbl_FCPS_CoolantValve_Control_Lin1
        SendLINR_Control_DiagFunctnVal: can-be-invoked-concurrently=true, symbol=ApplLinComAb_LIN1_SendLINR_Control_DiagFunctnVal  # Transmit
          data-receive-point-by-arguments:
            access DRP_SendLINR_Control_DiagFunctnVal_SendLINR_Control_DiagFunctnVal: accessed-variable=SendLINR_Control_DiagFunctnVal.SendLINR_Control_DiagFunctnVal
            access DRP_SendLINR_Control_DiagFunctnValVld_SendLINR_Control_DiagFunctnValVld: accessed-variable=SendLINR_Control_DiagFunctnValVld.SendLINR_Control_DiagFunctnValVld
          data-send-points:
            access DSP_Lin1ComTxSignalsSR_COMTXL_Control_DiagFunctnValue_FCPS_CoolantValve_Control_Lin1: accessed-variable=Lin1ComTxSignalsSR.COMTXL_Control_DiagFunctnValue_FCPS_CoolantValve_Control_Lin1
        SendLINR_Control_Reserved2: can-be-invoked-concurrently=true, symbol=ApplLinComAb_LIN1_SendLINR_Control_Reserved2  # Transmit
          data-receive-point-by-arguments:
            access DRP_SendLINR_Control_Reserved2_SendLINR_Control_Reserved2: accessed-variable=SendLINR_Control_Reserved2.SendLINR_Control_Reserved2
            access DRP_SendLINR_Control_Reserved2Vld_SendLINR_Control_Reserved2Vld: accessed-variable=SendLINR_Control_Reserved2Vld.SendLINR_Control_Reserved2Vld
          data-send-points:
            access DSP_Lin1ComTxSignalsSR_COMTXL_Control_Reserved2_FCPS_CoolantValve_Control_Lin1: accessed-variable=Lin1ComTxSignalsSR.COMTXL_Control_Reserved2_FCPS_CoolantValve_Control_Lin1
        SendLINR_Control_Reserved3: can-be-invoked-concurrently=true, symbol=ApplLinComAb_LIN1_SendLINR_Control_Reserved3  # Transmit
          data-receive-point-by-arguments:
            access DRP_SendLINR_Control_Reserved3_SendLINR_Control_Reserved3: accessed-variable=SendLINR_Control_Reserved3.SendLINR_Control_Reserved3
            access DRP_SendLINR_Control_Reserved3Vld_SendLINR_Control_Reserved3Vld: accessed-variable=SendLINR_Control_Reserved3Vld.SendLINR_Control_Reserved3Vld
          data-send-points:
            access DSP_Lin1ComTxSignalsSR_COMTXL_Control_Reserved3_FCPS_CoolantValve_Control_Lin1: accessed-variable=Lin1ComTxSignalsSR.COMTXL_Control_Reserved3_FCPS_CoolantValve_Control_Lin1
        SendLINR_Control_Reserved4: can-be-invoked-concurrently=true, symbol=ApplLinComAb_LIN1_SendLINR_Control_Reserved4  # Transmit
          data-receive-point-by-arguments:
            access DRP_SendLINR_Control_Reserved4_SendLINR_Control_Reserved4: accessed-variable=SendLINR_Control_Reserved4.SendLINR_Control_Reserved4
            access DRP_SendLINR_Control_Reserved4Vld_SendLINR_Control_Reserved4Vld: accessed-variable=SendLINR_Control_Reserved4Vld.SendLINR_Control_Reserved4Vld
          data-send-points:
            access DSP_Lin1ComTxSignalsSR_COMTXL_Control_Reserved4_FCPS_CoolantValve_Control_Lin1: accessed-variable=Lin1ComTxSignalsSR.COMTXL_Control_Reserved4_FCPS_CoolantValve_Control_Lin1
        SendLINR_Control_Reserved5: can-be-invoked-concurrently=true, symbol=ApplLinComAb_LIN1_SendLINR_Control_Reserved5  # Transmit
          data-receive-point-by-arguments:
            access DRP_SendLINR_Control_Reserved5_SendLINR_Control_Reserved5: accessed-variable=SendLINR_Control_Reserved5.SendLINR_Control_Reserved5
            access DRP_SendLINR_Control_Reserved5Vld_SendLINR_Control_Reserved5Vld: accessed-variable=SendLINR_Control_Reserved5Vld.SendLINR_Control_Reserved5Vld
          data-send-points:
            access DSP_Lin1ComTxSignalsSR_COMTXL_Control_Reserved5_FCPS_CoolantValve_Control_Lin1: accessed-variable=Lin1ComTxSignalsSR.COMTXL_Control_Reserved5_FCPS_CoolantValve_Control_Lin1
        SendLINR_Control_Reserved6: can-be-invoked-concurrently=true, symbol=ApplLinComAb_LIN1_SendLINR_Control_Reserved6  # Transmit
          data-receive-point-by-arguments:
            access DRP_SendLINR_Control_Reserved6_SendLINR_Control_Reserved6: accessed-variable=SendLINR_Control_Reserved6.SendLINR_Control_Reserved6
            access DRP_SendLINR_Control_Reserved6Vld_SendLINR_Control_Reserved6Vld: accessed-variable=SendLINR_Control_Reserved6Vld.SendLINR_Control_Reserved6Vld
          data-send-points:
            access DSP_Lin1ComTxSignalsSR_COMTXL_Control_Reserved6_FCPS_CoolantValve_Control_Lin1: accessed-variable=Lin1ComTxSignalsSR.COMTXL_Control_Reserved6_FCPS_CoolantValve_Control_Lin1
        SignalLINR_HTRBV_RdyForSleep: symbol=ApplLinComAb_LIN1_SignalLINR_HTRBV_RdyForSleep  # HTRBV is ready for sleep. Set it's bit in Lin slave ready to sleep.Transmit
          data-receive-point-by-arguments:
            access DRP_SignalLINR_HTRBV_RdyForSleep_SignalLINR_HTRBV_RdyForSleep: accessed-variable=SignalLINR_HTRBV_RdyForSleep.SignalLINR_HTRBV_RdyForSleep
          mode-access-point mode-group=MdulPwrMod.AppMode_MDGP_ESH_Mode:
            ident MAP_MdulPwrMod_AppMode_MDGP_ESH_Mode
          parameter access CPA_KeCFGR_b_LIN1_Equid: accessed-parameter=KeCFGR_b_LIN1_Equid.KeCFGR_b_LIN1_Equid
          read-local-variables:
            access IRVRA_VeLINR_d_LIN_SlavePrsnt_LIN1: accessed-variable=VeLINR_d_LIN_SlavePrsnt_LIN1
            access IRVRA_VeLINR_d_LIN_SlaveRdyToSleep_LIN1: accessed-variable=VeLINR_d_LIN_SlaveRdyToSleep_LIN1
          sync call SSCP_GetRteMode_GetMODR_b_InPostRunMode: operation=GetRteMode.GetMODR_b_InPostRunMode, timeout=0.01
          written-local-variables:
            access IRVWA_VeLINR_d_LIN_SlaveRdyToSleep_LIN1: accessed-variable=VeLINR_d_LIN_SlaveRdyToSleep_LIN1
