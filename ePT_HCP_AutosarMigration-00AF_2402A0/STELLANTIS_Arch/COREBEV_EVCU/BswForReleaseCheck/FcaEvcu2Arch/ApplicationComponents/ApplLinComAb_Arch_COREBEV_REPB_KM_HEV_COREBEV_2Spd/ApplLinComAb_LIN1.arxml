[part 3 of 3: packages /STLASWCs/ComSwCpts/ComDataDefinition/ComConstSpec to /STLASWCs/ComSwCpts/ComPrivateInterfaces]
AUTOSAR XML (schema 00044)
package /STLASWCs/ComSwCpts/ComDataDefinition/ComConstSpec
  139 x constant specification:
    COMRXL_AAD_CalActv_AAD_ECM_STATUS_Lin1_Init: value-spec=Value:0
    COMRXL_AAD_CalStat_AAD_ECM_STATUS_Lin1_Init: value-spec=Value:0
    COMRXL_AAD_CurrPos_AAD_ECM_STATUS_Lin1_Init: value-spec=Value:15
    COMRXL_AAD_ErrMechBreak_AAD_ECM_STATUS_Lin1_Init: value-spec=Value:0
    COMRXL_AAD_ErrMechStuck_AAD_ECM_STATUS_Lin1_Init: value-spec=Value:0
    COMRXL_AAD_ErrOvrTemp_AAD_ECM_STATUS_Lin1_Init: value-spec=Value:0
    COMRXL_AAD_ErrOvrVolt_AAD_ECM_STATUS_Lin1_Init: value-spec=Value:0
    COMRXL_AAD_ErrUnVolt_AAD_ECM_STATUS_Lin1_Init: value-spec=Value:0
    COMRXL_AirHeatrCoreTemp_HVEAHLIN18Fr01_Lin1_Init: value-spec=Value:255
    COMRXL_AirHeatrDmgCircForDrvrShoOrOpen_HVEAHLIN18Fr02_Lin1_Init: value-spec=Value:3
    COMRXL_AirHeatrDmgHVISnsrFlt_HVEAHLIN18Fr02_Lin1_Init: value-spec=Value:3
    COMRXL_AirHeatrDmgHtrCoreTmpSnsrFlt_HVEAHLIN18Fr02_Lin1_Init: value-spec=Value:3
    COMRXL_AirHeatrDmgIntHwProtn_HVEAHLIN18Fr02_Lin1_Init: value-spec=Value:3
    COMRXL_AirHeatrDmgMemErr_HVEAHLIN18Fr02_Lin1_Init: value-spec=Value:3
    COMRXL_AirHeatrDmgPCBTmpSnsrFlt_HVEAHLIN18Fr02_Lin1_Init: value-spec=Value:3
    COMRXL_AirHeatrHVmeas_HVEAHLIN18Fr01_Lin1_Init: value-spec=Value:1023
    COMRXL_AirHeatrICns_HVEAHLIN18Fr01_Lin1_Init: value-spec=Value:255
    COMRXL_AirHeatrPCBTemp_HVEAHLIN18Fr01_Lin1_Init: value-spec=Value:255
    COMRXL_AirHeatrPwrCns_HVEAHLIN18Fr01_Lin1_Init: value-spec=Value:255
    COMRXL_AirHeatrSts_HVEAHLIN18Fr01_Lin1_Init: value-spec=Value:0
    COMRXL_AirHeatrWarnFltInCom_HVEAHLIN18Fr02_Lin1_Init: value-spec=Value:3
    COMRXL_AirHeatrWarnHtrCoreOvrTmp_HVEAHLIN18Fr02_Lin1_Init: value-spec=Value:3
    COMRXL_AirHeatrWarnHvOutOfRng_HVEAHLIN18Fr02_Lin1_Init: value-spec=Value:3
    COMRXL_AirHeatrWarnICnsOutOfRng_HVEAHLIN18Fr02_Lin1_Init: value-spec=Value:3
    COMRXL_AirHeatrWarnPCBOvrTmp_HVEAHLIN18Fr02_Lin1_Init: value-spec=Value:3
    COMRXL_AirHeatrWarnTmpOvrheatg_HVEAHLIN18Fr02_Lin1_Init: value-spec=Value:3
    COMRXL_AirHeatrWarnULoOutOfRng_HVEAHLIN18Fr02_Lin1_Init: value-spec=Value:3
    COMRXL_BCP_AIR_PRE_ERR_BCP_STAT_Lin1_Init: value-spec=Value:3
    COMRXL_BCP_CURR_BCP_STAT_Lin1_Init: value-spec=Value:255
    COMRXL_BCP_DBLK_ACTV_BCP_STAT_Lin1_Init: value-spec=Value:3
    COMRXL_BCP_DR_RN_ERR_BCP_STAT_Lin1_Init: value-spec=Value:3
    COMRXL_BCP_FL_SAFE_ACTVTD_BCP_STAT_Lin1_Init: value-spec=Value:3
    COMRXL_BCP_LMP_HM_AN_ON_BCP_STAT_Lin1_Init: value-spec=Value:3
    COMRXL_BCP_MONTRNG_RPM_BCP_STAT_Lin1_Init: value-spec=Value:3
    COMRXL_BCP_NODE_ERR_BCP_STAT_Lin1_Init: value-spec=Value:3
    COMRXL_BCP_OVR_CUR_ERR_BCP_STAT_Lin1_Init: value-spec=Value:3
    COMRXL_BCP_OVR_TMP_ERR_BCP_STAT_Lin1_Init: value-spec=Value:3
    COMRXL_BCP_POST_RUN_STAT_BCP_STAT_Lin1_Init: value-spec=Value:7
    COMRXL_BCP_RPM_ACTUAL_BCP_STAT_Lin1_Init: value-spec=Value:255
    COMRXL_BCP_RPM_TARGET_BCP_STAT_Lin1_Init: value-spec=Value:255
    COMRXL_BCP_SUPPLIER_BCP_VER_Lin1_Init: value-spec=Value:0
    COMRXL_BCP_TEMP_BCP_STAT_Lin1_Init: value-spec=Value:255
    COMRXL_BCP_VERSION_BCP_VER_Lin1_Init: value-spec=Value:255
    COMRXL_BCP_VLTG_BCP_STAT_Lin1_Init: value-spec=Value:255
    COMRXL_BCP_VLTG_ERR_BCP_STAT_Lin1_Init: value-spec=Value:3
    COMRXL_CPV_CalStat_CPV_STAT_V2_Lin1_Init: value-spec=Value:0
    COMRXL_CPV_ERR_CPV_STAT_V2_Lin1_Init: value-spec=Value:0
    COMRXL_CPV_MotorVolt_CPV_STAT_V2_Lin1_Init: value-spec=Value:0
    COMRXL_CPV_PosAct_CPV_STAT_V2_Lin1_Init: value-spec=Value:0
    COMRXL_CPV_Sts_CPV_STAT_V2_Lin1_Init: value-spec=Value:0
    COMRXL_CoolantValve_ActuatorPositionAct_CoolantValve_Com_Lin1_Init: value-spec=Value:0
    COMRXL_CoolantValve_ActuatorPositionTrgt_CoolantValve_Com_Lin1_Init: value-spec=Value:0
    COMRXL_CoolantValve_EcuTemperatur_CoolantValve_Com_Lin1_Init: value-spec=Value:0
    COMRXL_CoolantValve_EcuVoltage_CoolantValve_Com_Lin1_Init: value-spec=Value:0
    COMRXL_CoolantValve_ErrLinCom_CoolantValve_Com_Lin1_Init: value-spec=Value:0
    COMRXL_CoolantValve_ErrPosition_CoolantValve_Com_Lin1_Init: value-spec=Value:0
    COMRXL_CoolantValve_Err_Ecu_CoolantValve_Com_Lin1_Init: value-spec=Value:0
    COMRXL_CoolantValve_Err_Motor_CoolantValve_Com_Lin1_Init: value-spec=Value:0
    COMRXL_CoolantValve_Err_Voltage_CoolantValve_Com_Lin1_Init: value-spec=Value:0
    COMRXL_CoolantValve_ResponseError_CoolantValve_Com_Lin1_Init: value-spec=Value:0
    COMRXL_CoolantValve_SelfCalReq_CoolantValve_Com_Lin1_Init: value-spec=Value:0
    COMRXL_CoolantValve_SystemState_CoolantValve_Com_Lin1_Init: value-spec=Value:0
    COMRXL_EEXV_Board_Temp_EEXV_STAT_Lin1_Init: value-spec=Value:0
    COMRXL_EEXV_CalRq_EEXV_STAT_Lin1_Init: value-spec=Value:0
    COMRXL_EEXV_CalStat_EEXV_STAT_Lin1_Init: value-spec=Value:0
    COMRXL_EEXV_ERR_EEXV_STAT_Lin1_Init: value-spec=Value:0
    COMRXL_EEXV_PosAct_EEXV_STAT_Lin1_Init: value-spec=Value:0
    COMRXL_EEXV_Refrigerant_Pressure_EEXV_STAT_Lin1_Init: value-spec=Value:16383
    COMRXL_EEXV_Refrigerant_Temp_EEXV_STAT_Lin1_Init: value-spec=Value:0
    COMRXL_EEXV_Sts_EEXV_STAT_Lin1_Init: value-spec=Value:0
    COMRXL_EEXV_SupplyVolt_EEXV_STAT_Lin1_Init: value-spec=Value:0
    COMRXL_EOPA_CURR_EOPA_STAT_Lin1_Init: value-spec=Value:255
    COMRXL_EOPA_DR_RN_ER_EOPA_STAT_Lin1_Init: value-spec=Value:3
    COMRXL_EOPA_HW_VER_EOPA_VER_Lin1_Init: value-spec=Value:255
    COMRXL_EOPA_LMP_HM_AN_ON_EOPA_STAT_Lin1_Init: value-spec=Value:3
    COMRXL_EOPA_LOW_TMP_STAT_EOPA_STAT_Lin1_Init: value-spec=Value:3
    COMRXL_EOPA_MONTRNG_RPM_EOPA_STAT_Lin1_Init: value-spec=Value:3
    COMRXL_EOPA_OIL_TEMP_EOPA_STAT2_Lin1_Init: value-spec=Value:255
    COMRXL_EOPA_OV_CUR_ER_EOPA_STAT_Lin1_Init: value-spec=Value:3
    COMRXL_EOPA_OV_TMP_ER_EOPA_STAT_Lin1_Init: value-spec=Value:3
    COMRXL_EOPA_POST_RUN_STAT_EOPA_STAT_Lin1_Init: value-spec=Value:7
    COMRXL_EOPA_RPM_ACTL_EOPA_STAT_Lin1_Init: value-spec=Value:255
    COMRXL_EOPA_RPM_TGT_EOPA_STAT_Lin1_Init: value-spec=Value:255
    COMRXL_EOPA_SW_VER_EOPA_VER_Lin1_Init: value-spec=Value:255
    COMRXL_EOPA_Stall_Event_EOPA_STAT_Lin1_Init: value-spec=Value:3
    COMRXL_EOPA_TEMP_EOPA_STAT_Lin1_Init: value-spec=Value:255
    COMRXL_EOPA_VLTG_EOPA_STAT_Lin1_Init: value-spec=Value:255
    COMRXL_EOPA_VLTG_ER_EOPA_STAT_Lin1_Init: value-spec=Value:3
    COMRXL_EXVM_Board_Temp_EXVM_STAT_Lin1_Init: value-spec=Value:0
    COMRXL_EXVM_CalRq_EXVM_STAT_Lin1_Init: value-spec=Value:0
    COMRXL_EXVM_CalStat_EXVM_STAT_Lin1_Init: value-spec=Value:0
    COMRXL_EXVM_ERR_EXVM_STAT_Lin1_Init: value-spec=Value:0
    COMRXL_EXVM_PosAct_EXVM_STAT_Lin1_Init: value-spec=Value:0
    COMRXL_EXVM_Refrigerant_Pressure_EXVM_STAT_Lin1_Init: value-spec=Value:16383
    COMRXL_EXVM_Refrigerant_Temp_EXVM_STAT_Lin1_Init: value-spec=Value:0
    COMRXL_EXVM_Sts_EXVM_STAT_Lin1_Init: value-spec=Value:0
    COMRXL_EXVM_SupplyVolt_EXVM_STAT_Lin1_Init: value-spec=Value:0
    COMRXL_LTRBV_CalStat_LTRBV_STAT_Lin1_Init: value-spec=Value:0
    COMRXL_LTRBV_ERR_LTRBV_STAT_Lin1_Init: value-spec=Value:0
    COMRXL_LTRBV_MotorVolt_LTRBV_STAT_Lin1_Init: value-spec=Value:0
    COMRXL_LTRBV_PosAct_LTRBV_STAT_Lin1_Init: value-spec=Value:0
    COMRXL_LTRBV_Sts_LTRBV_STAT_Lin1_Init: value-spec=Value:0
    COMRXL_RsErr_AAD_AAD_ECM_STATUS_Lin1_Init: value-spec=Value:0
    COMRXL_RsErr_BCP_PUMP_BCP_STAT_Lin1_Init: value-spec=Value:0
    COMRXL_RsErr_CPV_CPV_STAT_V2_Lin1_Init: value-spec=Value:0
    COMRXL_RsErr_EAH_HVEAHLIN18Fr02_Lin1_Init: value-spec=Value:0
    COMRXL_RsErr_EEXV_EEXV_STAT_Lin1_Init: value-spec=Value:0
    COMRXL_RsErr_EOPA_EOPA_STAT_Lin1_Init: value-spec=Value:0
    COMRXL_RsErr_EXVM_EXVM_STAT_Lin1_Init: value-spec=Value:0
    COMRXL_RsErr_LTRBV_LTRBV_STAT_Lin1_Init: value-spec=Value:0
    COMTXL_AAD_CalRq_ECM_AAD_DEMAND_Lin1_Init: value-spec=0
    COMTXL_AAD_InitialIP_CalRq_ECM_AAD_DEMAND_Lin1_Init: value-spec=0
    COMTXL_AAD_PosRq_ECM_AAD_DEMAND_Lin1_Init: value-spec=15
    COMTXL_AirHeatrEnad_HVEAHLIN18Fr03_Lin1_Init: value-spec=0
    COMTXL_AirHeatrPwrTgt_HVEAHLIN18Fr03_Lin1_Init: value-spec=255
    COMTXL_BCP_FL_SAFE_ACTVT_BCP_REQ_Lin1_Init: value-spec=3
    COMTXL_BCP_POST_RUN_REQ_BCP_REQ_Lin1_Init: value-spec=7
    COMTXL_BCP_RPM_REQ_BCP_REQ_Lin1_Init: value-spec=255
    COMTXL_CPV_CalRq_CPV_REQ_Lin1_Init: value-spec=0
    COMTXL_CPV_PosRq_CPV_REQ_Lin1_Init: value-spec=0
    COMTXL_CPV_PosSv_CPV_REQ_Lin1_Init: value-spec=0
    COMTXL_Control_BlockDetEnbl_FCPS_CoolantValve_Control_Lin1_Init: value-spec=0
    COMTXL_Control_DiagFunctnValue_FCPS_CoolantValve_Control_Lin1_Init: value-spec=0
    COMTXL_Control_Reserved{1..6}_FCPS_CoolantValve_Control_Lin1_Init: value-spec=0
    COMTXL_Control_TargetPos_FCPS_CoolantValve_Control_Lin1_Init: value-spec=0
    COMTXL_EEXV_CalCmd_EEXV_REQ_Lin1_Init: value-spec=0
    COMTXL_EEXV_PosRq_EEXV_REQ_Lin1_Init: value-spec=0
    COMTXL_EOPA_POST_RUN_COM_EOPA_REQ_Lin1_Init: value-spec=7
    COMTXL_EOPA_RPM_COM_EOPA_REQ_Lin1_Init: value-spec=255
    COMTXL_EXVM_CalCmd_EXVM_REQ_Lin1_Init: value-spec=0
    COMTXL_EXVM_PosRq_EXVM_REQ_Lin1_Init: value-spec=0
    COMTXL_LTRBV_CalRq_LTRBV_REQ_Lin1_Init: value-spec=0
    COMTXL_LTRBV_PosRq_LTRBV_REQ_Lin1_Init: value-spec=0
    COMTXL_LTRBV_PosSv_LTRBV_REQ_Lin1_Init: value-spec=0
package /STLASWCs/ComSwCpts/ComDataDefinition/ComImpDataType
  139 x impl type, all with category=TYPE_REFERENCE:
    IDTSAAD_CalActv_AAD_ECM_STATUS_Lin1: implementation-data-type=boolean
    IDTSAAD_CalRq_ECM_AAD_DEMAND_Lin1: implementation-data-type=boolean
    IDTSAAD_CalStat_AAD_ECM_STATUS_Lin1: implementation-data-type=boolean
    IDTSAAD_CurrPos_AAD_ECM_STATUS_Lin1: implementation-data-type=uint8, invalid-value=Value:15
    IDTSAAD_ErrMechBreak_AAD_ECM_STATUS_Lin1: implementation-data-type=boolean
    IDTSAAD_ErrMechStuck_AAD_ECM_STATUS_Lin1: implementation-data-type=boolean
    IDTSAAD_ErrOvrTemp_AAD_ECM_STATUS_Lin1: implementation-data-type=boolean
    IDTSAAD_ErrOvrVolt_AAD_ECM_STATUS_Lin1: implementation-data-type=boolean
    IDTSAAD_ErrUnVolt_AAD_ECM_STATUS_Lin1: implementation-data-type=boolean
    IDTSAAD_InitialIP_CalRq_ECM_AAD_DEMAND_Lin1: implementation-data-type=boolean
    IDTSAAD_PosRq_ECM_AAD_DEMAND_Lin1: implementation-data-type=uint8, invalid-value=Value:15
    IDTSAirHeatrCoreTemp_HVEAHLIN18Fr01_Lin1: implementation-data-type=uint8, invalid-value=Value:255
    IDTSAirHeatrDmgCircForDrvrShoOrOpen_HVEAHLIN18Fr02_Lin1: implementation-data-type=uint8, invalid-value=Value:3
    IDTSAirHeatrDmgHVISnsrFlt_HVEAHLIN18Fr02_Lin1: implementation-data-type=uint8, invalid-value=Value:3
    IDTSAirHeatrDmgHtrCoreTmpSnsrFlt_HVEAHLIN18Fr02_Lin1: implementation-data-type=uint8, invalid-value=Value:3
    IDTSAirHeatrDmgIntHwProtn_HVEAHLIN18Fr02_Lin1: implementation-data-type=uint8, invalid-value=Value:3
    IDTSAirHeatrDmgMemErr_HVEAHLIN18Fr02_Lin1: implementation-data-type=uint8, invalid-value=Value:3
    IDTSAirHeatrDmgPCBTmpSnsrFlt_HVEAHLIN18Fr02_Lin1: implementation-data-type=uint8, invalid-value=Value:3
    IDTSAirHeatrEnad_HVEAHLIN18Fr03_Lin1: implementation-data-type=boolean
    IDTSAirHeatrHVmeas_HVEAHLIN18Fr01_Lin1: implementation-data-type=uint16, invalid-value=Value:1023
    IDTSAirHeatrICns_HVEAHLIN18Fr01_Lin1: implementation-data-type=uint8, invalid-value=Value:255
    IDTSAirHeatrPCBTemp_HVEAHLIN18Fr01_Lin1: implementation-data-type=uint8, invalid-value=Value:255
    IDTSAirHeatrPwrCns_HVEAHLIN18Fr01_Lin1: implementation-data-type=uint8, invalid-value=Value:255
    IDTSAirHeatrPwrTgt_HVEAHLIN18Fr03_Lin1: implementation-data-type=uint8, invalid-value=Value:255
    IDTSAirHeatrSts_HVEAHLIN18Fr01_Lin1: implementation-data-type=uint8
    IDTSAirHeatrWarnFltInCom_HVEAHLIN18Fr02_Lin1: implementation-data-type=uint8, invalid-value=Value:3
    IDTSAirHeatrWarnHtrCoreOvrTmp_HVEAHLIN18Fr02_Lin1: implementation-data-type=uint8, invalid-value=Value:3
    IDTSAirHeatrWarnHvOutOfRng_HVEAHLIN18Fr02_Lin1: implementation-data-type=uint8, invalid-value=Value:3
    IDTSAirHeatrWarnICnsOutOfRng_HVEAHLIN18Fr02_Lin1: implementation-data-type=uint8, invalid-value=Value:3
    IDTSAirHeatrWarnPCBOvrTmp_HVEAHLIN18Fr02_Lin1: implementation-data-type=uint8, invalid-value=Value:3
    IDTSAirHeatrWarnTmpOvrheatg_HVEAHLIN18Fr02_Lin1: implementation-data-type=uint8, invalid-value=Value:3
    IDTSAirHeatrWarnULoOutOfRng_HVEAHLIN18Fr02_Lin1: implementation-data-type=uint8, invalid-value=Value:3
    IDTSBCP_AIR_PRE_ERR_BCP_STAT_Lin1: implementation-data-type=uint8, invalid-value=Value:3
    IDTSBCP_CURR_BCP_STAT_Lin1: implementation-data-type=uint8, invalid-value=Value:255
    IDTSBCP_DBLK_ACTV_BCP_STAT_Lin1: implementation-data-type=uint8, invalid-value=Value:3
    IDTSBCP_DR_RN_ERR_BCP_STAT_Lin1: implementation-data-type=uint8, invalid-value=Value:3
    IDTSBCP_FL_SAFE_ACTVTD_BCP_STAT_Lin1: implementation-data-type=uint8, invalid-value=Value:3
    IDTSBCP_FL_SAFE_ACTVT_BCP_REQ_Lin1: implementation-data-type=uint8, invalid-value=Value:3
    IDTSBCP_LMP_HM_AN_ON_BCP_STAT_Lin1: implementation-data-type=uint8, invalid-value=Value:3
    IDTSBCP_MONTRNG_RPM_BCP_STAT_Lin1: implementation-data-type=uint8, invalid-value=Value:3
    IDTSBCP_NODE_ERR_BCP_STAT_Lin1: implementation-data-type=uint8, invalid-value=Value:3
    IDTSBCP_OVR_CUR_ERR_BCP_STAT_Lin1: implementation-data-type=uint8, invalid-value=Value:3
    IDTSBCP_OVR_TMP_ERR_BCP_STAT_Lin1: implementation-data-type=uint8, invalid-value=Value:3
    IDTSBCP_POST_RUN_REQ_BCP_REQ_Lin1: implementation-data-type=uint8, invalid-value=Value:7
    IDTSBCP_POST_RUN_STAT_BCP_STAT_Lin1: implementation-data-type=uint8, invalid-value=Value:7
    IDTSBCP_RPM_ACTUAL_BCP_STAT_Lin1: implementation-data-type=uint8, invalid-value=Value:255
    IDTSBCP_RPM_REQ_BCP_REQ_Lin1: implementation-data-type=uint8, invalid-value=Value:255
    IDTSBCP_RPM_TARGET_BCP_STAT_Lin1: implementation-data-type=uint8, invalid-value=Value:255
    IDTSBCP_SUPPLIER_BCP_VER_Lin1: implementation-data-type=uint8
    IDTSBCP_TEMP_BCP_STAT_Lin1: implementation-data-type=uint8, invalid-value=Value:255
    IDTSBCP_VERSION_BCP_VER_Lin1: implementation-data-type=uint8, invalid-value=Value:255
    IDTSBCP_VLTG_BCP_STAT_Lin1: implementation-data-type=uint8, invalid-value=Value:255
    IDTSBCP_VLTG_ERR_BCP_STAT_Lin1: implementation-data-type=uint8, invalid-value=Value:3
    IDTSCPV_CalRq_CPV_REQ_Lin1: implementation-data-type=uint8
    IDTSCPV_CalStat_CPV_STAT_V2_Lin1: implementation-data-type=uint8
    IDTSCPV_ERR_CPV_STAT_V2_Lin1: implementation-data-type=uint8, invalid-value=Value:128
    IDTSCPV_MotorVolt_CPV_STAT_V2_Lin1: implementation-data-type=uint8
    IDTSCPV_PosAct_CPV_STAT_V2_Lin1: implementation-data-type=uint8, invalid-value=Value:255
    IDTSCPV_PosRq_CPV_REQ_Lin1: implementation-data-type=uint8
    IDTSCPV_PosSv_CPV_REQ_Lin1: implementation-data-type=boolean
    IDTSCPV_Sts_CPV_STAT_V2_Lin1: implementation-data-type=uint8, invalid-value=Value:3
    IDTSControl_BlockDetEnbl_FCPS_CoolantValve_Control_Lin1: implementation-data-type=uint8
    IDTSControl_DiagFunctnValue_FCPS_CoolantValve_Control_Lin1: implementation-data-type=uint8
    IDTSControl_Reserved{1..6}_FCPS_CoolantValve_Control_Lin1: implementation-data-type=uint8
    IDTSControl_TargetPos_FCPS_CoolantValve_Control_Lin1: implementation-data-type=uint16
    IDTSCoolantValve_ActuatorPositionAct_CoolantValve_Com_Lin1: implementation-data-type=uint16
    IDTSCoolantValve_ActuatorPositionTrgt_CoolantValve_Com_Lin1: implementation-data-type=uint16
    IDTSCoolantValve_EcuTemperatur_CoolantValve_Com_Lin1: implementation-data-type=uint8
    IDTSCoolantValve_EcuVoltage_CoolantValve_Com_Lin1: implementation-data-type=uint8
    IDTSCoolantValve_ErrLinCom_CoolantValve_Com_Lin1: implementation-data-type=uint8
    IDTSCoolantValve_ErrPosition_CoolantValve_Com_Lin1: implementation-data-type=uint8
    IDTSCoolantValve_Err_Ecu_CoolantValve_Com_Lin1: implementation-data-type=uint8
    IDTSCoolantValve_Err_Motor_CoolantValve_Com_Lin1: implementation-data-type=uint8
    IDTSCoolantValve_Err_Voltage_CoolantValve_Com_Lin1: implementation-data-type=uint8
    IDTSCoolantValve_ResponseError_CoolantValve_Com_Lin1: implementation-data-type=boolean
    IDTSCoolantValve_SelfCalReq_CoolantValve_Com_Lin1: implementation-data-type=boolean
    IDTSCoolantValve_SystemState_CoolantValve_Com_Lin1: implementation-data-type=uint8
    IDTSEEXV_Board_Temp_EEXV_STAT_Lin1: implementation-data-type=uint8, invalid-value=Value:255
    IDTSEEXV_CalCmd_EEXV_REQ_Lin1: implementation-data-type=uint8
    IDTSEEXV_CalRq_EEXV_STAT_Lin1: implementation-data-type=boolean
    IDTSEEXV_CalStat_EEXV_STAT_Lin1: implementation-data-type=uint8, invalid-value=Value:3
    IDTSEEXV_ERR_EEXV_STAT_Lin1: implementation-data-type=uint8, invalid-value=Value:15
    IDTSEEXV_PosAct_EEXV_STAT_Lin1: implementation-data-type=uint16, invalid-value=Value:1023
    IDTSEEXV_PosRq_EEXV_REQ_Lin1: implementation-data-type=uint16, invalid-value=Value:1023
    IDTSEEXV_Refrigerant_Pressure_EEXV_STAT_Lin1: implementation-data-type=uint16, invalid-value=Value:16383
    IDTSEEXV_Refrigerant_Temp_EEXV_STAT_Lin1: implementation-data-type=uint16, invalid-value=Value:2047
    IDTSEEXV_Sts_EEXV_STAT_Lin1: implementation-data-type=uint8, invalid-value=Value:3
    IDTSEEXV_SupplyVolt_EEXV_STAT_Lin1: implementation-data-type=uint8, invalid-value=Value:255
    IDTSEOPA_CURR_EOPA_STAT_Lin1: implementation-data-type=uint8, invalid-value=Value:255
    IDTSEOPA_DR_RN_ER_EOPA_STAT_Lin1: implementation-data-type=uint8, invalid-value=Value:3
    IDTSEOPA_HW_VER_EOPA_VER_Lin1: implementation-data-type=uint8, invalid-value=Value:255
    IDTSEOPA_LMP_HM_AN_ON_EOPA_STAT_Lin1: implementation-data-type=uint8, invalid-value=Value:3
    IDTSEOPA_LOW_TMP_STAT_EOPA_STAT_Lin1: implementation-data-type=uint8, invalid-value=Value:3
    IDTSEOPA_MONTRNG_RPM_EOPA_STAT_Lin1: implementation-data-type=uint8, invalid-value=Value:3
    IDTSEOPA_OIL_TEMP_EOPA_STAT2_Lin1: implementation-data-type=uint8, invalid-value=Value:255
    IDTSEOPA_OV_CUR_ER_EOPA_STAT_Lin1: implementation-data-type=uint8, invalid-value=Value:3
    IDTSEOPA_OV_TMP_ER_EOPA_STAT_Lin1: implementation-data-type=uint8, invalid-value=Value:3
    IDTSEOPA_POST_RUN_COM_EOPA_REQ_Lin1: implementation-data-type=uint8, invalid-value=Value:7
    IDTSEOPA_POST_RUN_STAT_EOPA_STAT_Lin1: implementation-data-type=uint8, invalid-value=Value:7
    IDTSEOPA_RPM_ACTL_EOPA_STAT_Lin1: implementation-data-type=uint8, invalid-value=Value:255
    IDTSEOPA_RPM_COM_EOPA_REQ_Lin1: implementation-data-type=uint8, invalid-value=Value:255
    IDTSEOPA_RPM_TGT_EOPA_STAT_Lin1: implementation-data-type=uint8, invalid-value=Value:255
    IDTSEOPA_SW_VER_EOPA_VER_Lin1: implementation-data-type=uint8, invalid-value=Value:255
    IDTSEOPA_Stall_Event_EOPA_STAT_Lin1: implementation-data-type=uint8, invalid-value=Value:3
    IDTSEOPA_TEMP_EOPA_STAT_Lin1: implementation-data-type=uint8, invalid-value=Value:255
    IDTSEOPA_VLTG_EOPA_STAT_Lin1: implementation-data-type=uint8, invalid-value=Value:255
    IDTSEOPA_VLTG_ER_EOPA_STAT_Lin1: implementation-data-type=uint8, invalid-value=Value:3
    IDTSEXVM_Board_Temp_EXVM_STAT_Lin1: implementation-data-type=uint8, invalid-value=Value:255
    IDTSEXVM_CalCmd_EXVM_REQ_Lin1: implementation-data-type=uint8
    IDTSEXVM_CalRq_EXVM_STAT_Lin1: implementation-data-type=boolean
    IDTSEXVM_CalStat_EXVM_STAT_Lin1: implementation-data-type=uint8, invalid-value=Value:3
    IDTSEXVM_ERR_EXVM_STAT_Lin1: implementation-data-type=uint8, invalid-value=Value:15
    IDTSEXVM_PosAct_EXVM_STAT_Lin1: implementation-data-type=uint16, invalid-value=Value:1023
    IDTSEXVM_PosRq_EXVM_REQ_Lin1: implementation-data-type=uint16, invalid-value=Value:1023
    IDTSEXVM_Refrigerant_Pressure_EXVM_STAT_Lin1: implementation-data-type=uint16, invalid-value=Value:16383
    IDTSEXVM_Refrigerant_Temp_EXVM_STAT_Lin1: implementation-data-type=uint16, invalid-value=Value:2047
    IDTSEXVM_Sts_EXVM_STAT_Lin1: implementation-data-type=uint8, invalid-value=Value:3
    IDTSEXVM_SupplyVolt_EXVM_STAT_Lin1: implementation-data-type=uint8, invalid-value=Value:255
    IDTSLTRBV_CalRq_LTRBV_REQ_Lin1: implementation-data-type=uint8
    IDTSLTRBV_CalStat_LTRBV_STAT_Lin1: implementation-data-type=uint8
    IDTSLTRBV_ERR_LTRBV_STAT_Lin1: implementation-data-type=uint8, invalid-value=Value:128
    IDTSLTRBV_MotorVolt_LTRBV_STAT_Lin1: implementation-data-type=uint8, invalid-value=Value:255
    IDTSLTRBV_PosAct_LTRBV_STAT_Lin1: implementation-data-type=uint8, invalid-value=Value:255
    IDTSLTRBV_PosRq_LTRBV_REQ_Lin1: implementation-data-type=uint8, invalid-value=Value:255
    IDTSLTRBV_PosSv_LTRBV_REQ_Lin1: implementation-data-type=boolean
    IDTSLTRBV_Sts_LTRBV_STAT_Lin1: implementation-data-type=uint8, invalid-value=Value:3
    IDTSRsErr_AAD_AAD_ECM_STATUS_Lin1: implementation-data-type=boolean
    IDTSRsErr_BCP_PUMP_BCP_STAT_Lin1: implementation-data-type=boolean
    IDTSRsErr_CPV_CPV_STAT_V2_Lin1: implementation-data-type=boolean
    IDTSRsErr_EAH_HVEAHLIN18Fr02_Lin1: implementation-data-type=boolean
    IDTSRsErr_EEXV_EEXV_STAT_Lin1: implementation-data-type=boolean
    IDTSRsErr_EOPA_EOPA_STAT_Lin1: implementation-data-type=boolean
    IDTSRsErr_EXVM_EXVM_STAT_Lin1: implementation-data-type=boolean
    IDTSRsErr_LTRBV_LTRBV_STAT_Lin1: implementation-data-type=boolean
package /STLASWCs/ComSwCpts/ComPrivateInterfaces
  sender receiver interface Lin1ComRxSignalsSR
    110 x data, all with category=TYPE_REFERENCE, sw-calibration-access=READ-ONLY:
      COMRXL_AAD_CurrPos_AAD_ECM_STATUS_Lin1: type=IDTSAAD_CurrPos_AAD_ECM_STATUS_Lin1
      COMRXL_AAD_CalStat_AAD_ECM_STATUS_Lin1: type=IDTSAAD_CalStat_AAD_ECM_STATUS_Lin1
      COMRXL_AAD_CalActv_AAD_ECM_STATUS_Lin1: type=IDTSAAD_CalActv_AAD_ECM_STATUS_Lin1
      COMRXL_AAD_ErrUnVolt_AAD_ECM_STATUS_Lin1: type=IDTSAAD_ErrUnVolt_AAD_ECM_STATUS_Lin1
      COMRXL_AAD_ErrOvrVolt_AAD_ECM_STATUS_Lin1: type=IDTSAAD_ErrOvrVolt_AAD_ECM_STATUS_Lin1
      COMRXL_AAD_ErrOvrTemp_AAD_ECM_STATUS_Lin1: type=IDTSAAD_ErrOvrTemp_AAD_ECM_STATUS_Lin1
      COMRXL_AAD_ErrMechStuck_AAD_ECM_STATUS_Lin1: type=IDTSAAD_ErrMechStuck_AAD_ECM_STATUS_Lin1
      COMRXL_AAD_ErrMechBreak_AAD_ECM_STATUS_Lin1: type=IDTSAAD_ErrMechBreak_AAD_ECM_STATUS_Lin1
      COMRXL_RsErr_AAD_AAD_ECM_STATUS_Lin1: type=IDTSRsErr_AAD_AAD_ECM_STATUS_Lin1
      COMRXL_BCP_RPM_TARGET_BCP_STAT_Lin1: type=IDTSBCP_RPM_TARGET_BCP_STAT_Lin1
      COMRXL_BCP_RPM_ACTUAL_BCP_STAT_Lin1: type=IDTSBCP_RPM_ACTUAL_BCP_STAT_Lin1
      COMRXL_BCP_VLTG_BCP_STAT_Lin1: type=IDTSBCP_VLTG_BCP_STAT_Lin1
      COMRXL_BCP_TEMP_BCP_STAT_Lin1: type=IDTSBCP_TEMP_BCP_STAT_Lin1
      COMRXL_BCP_CURR_BCP_STAT_Lin1: type=IDTSBCP_CURR_BCP_STAT_Lin1
      COMRXL_BCP_FL_SAFE_ACTVTD_BCP_STAT_Lin1: type=IDTSBCP_FL_SAFE_ACTVTD_BCP_STAT_Lin1
      COMRXL_BCP_LMP_HM_AN_ON_BCP_STAT_Lin1: type=IDTSBCP_LMP_HM_AN_ON_BCP_STAT_Lin1
      COMRXL_BCP_AIR_PRE_ERR_BCP_STAT_Lin1: type=IDTSBCP_AIR_PRE_ERR_BCP_STAT_Lin1
      COMRXL_BCP_OVR_TMP_ERR_BCP_STAT_Lin1: type=IDTSBCP_OVR_TMP_ERR_BCP_STAT_Lin1
      COMRXL_BCP_OVR_CUR_ERR_BCP_STAT_Lin1: type=IDTSBCP_OVR_CUR_ERR_BCP_STAT_Lin1
      COMRXL_BCP_DR_RN_ERR_BCP_STAT_Lin1: type=IDTSBCP_DR_RN_ERR_BCP_STAT_Lin1
      COMRXL_BCP_VLTG_ERR_BCP_STAT_Lin1: type=IDTSBCP_VLTG_ERR_BCP_STAT_Lin1
      COMRXL_BCP_DBLK_ACTV_BCP_STAT_Lin1: type=IDTSBCP_DBLK_ACTV_BCP_STAT_Lin1
      COMRXL_BCP_MONTRNG_RPM_BCP_STAT_Lin1: type=IDTSBCP_MONTRNG_RPM_BCP_STAT_Lin1
      COMRXL_BCP_NODE_ERR_BCP_STAT_Lin1: type=IDTSBCP_NODE_ERR_BCP_STAT_Lin1
      COMRXL_BCP_POST_RUN_STAT_BCP_STAT_Lin1: type=IDTSBCP_POST_RUN_STAT_BCP_STAT_Lin1
      COMRXL_RsErr_BCP_PUMP_BCP_STAT_Lin1: type=IDTSRsErr_BCP_PUMP_BCP_STAT_Lin1
      COMRXL_BCP_VERSION_BCP_VER_Lin1: type=IDTSBCP_VERSION_BCP_VER_Lin1
      COMRXL_BCP_SUPPLIER_BCP_VER_Lin1: type=IDTSBCP_SUPPLIER_BCP_VER_Lin1
      COMRXL_CPV_PosAct_CPV_STAT_V2_Lin1: type=IDTSCPV_PosAct_CPV_STAT_V2_Lin1
      COMRXL_CPV_ERR_CPV_STAT_V2_Lin1: type=IDTSCPV_ERR_CPV_STAT_V2_Lin1
      COMRXL_CPV_Sts_CPV_STAT_V2_Lin1: type=IDTSCPV_Sts_CPV_STAT_V2_Lin1
      COMRXL_RsErr_CPV_CPV_STAT_V2_Lin1: type=IDTSRsErr_CPV_CPV_STAT_V2_Lin1
      COMRXL_AirHeatrICns_HVEAHLIN18Fr01_Lin1: type=IDTSAirHeatrICns_HVEAHLIN18Fr01_Lin1
      COMRXL_AirHeatrHVmeas_HVEAHLIN18Fr01_Lin1: type=IDTSAirHeatrHVmeas_HVEAHLIN18Fr01_Lin1
      COMRXL_AirHeatrPCBTemp_HVEAHLIN18Fr01_Lin1: type=IDTSAirHeatrPCBTemp_HVEAHLIN18Fr01_Lin1
      COMRXL_AirHeatrCoreTemp_HVEAHLIN18Fr01_Lin1: type=IDTSAirHeatrCoreTemp_HVEAHLIN18Fr01_Lin1
      COMRXL_RsErr_EAH_HVEAHLIN18Fr02_Lin1: type=IDTSRsErr_EAH_HVEAHLIN18Fr02_Lin1
      COMRXL_AirHeatrWarnFltInCom_HVEAHLIN18Fr02_Lin1: type=IDTSAirHeatrWarnFltInCom_HVEAHLIN18Fr02_Lin1
      COMRXL_AirHeatrWarnHvOutOfRng_HVEAHLIN18Fr02_Lin1: type=IDTSAirHeatrWarnHvOutOfRng_HVEAHLIN18Fr02_Lin1
      COMRXL_AirHeatrWarnULoOutOfRng_HVEAHLIN18Fr02_Lin1: type=IDTSAirHeatrWarnULoOutOfRng_HVEAHLIN18Fr02_Lin1
      COMRXL_AirHeatrWarnTmpOvrheatg_HVEAHLIN18Fr02_Lin1: type=IDTSAirHeatrWarnTmpOvrheatg_HVEAHLIN18Fr02_Lin1
      COMRXL_AirHeatrWarnICnsOutOfRng_HVEAHLIN18Fr02_Lin1: type=IDTSAirHeatrWarnICnsOutOfRng_HVEAHLIN18Fr02_Lin1
      COMRXL_AirHeatrDmgIntHwProtn_HVEAHLIN18Fr02_Lin1: type=IDTSAirHeatrDmgIntHwProtn_HVEAHLIN18Fr02_Lin1
      COMRXL_AirHeatrDmgPCBTmpSnsrFlt_HVEAHLIN18Fr02_Lin1: type=IDTSAirHeatrDmgPCBTmpSnsrFlt_HVEAHLIN18Fr02_Lin1
      COMRXL_AirHeatrDmgCircForDrvrShoOrOpen_HVEAHLIN18Fr02_Lin1: type=IDTSAirHeatrDmgCircForDrvrShoOrOpen_HVEAHLIN18Fr02_Lin1
      COMRXL_AirHeatrDmgHVISnsrFlt_HVEAHLIN18Fr02_Lin1: type=IDTSAirHeatrDmgHVISnsrFlt_HVEAHLIN18Fr02_Lin1
      COMRXL_AirHeatrDmgMemErr_HVEAHLIN18Fr02_Lin1: type=IDTSAirHeatrDmgMemErr_HVEAHLIN18Fr02_Lin1
      COMRXL_AirHeatrDmgHtrCoreTmpSnsrFlt_HVEAHLIN18Fr02_Lin1: type=IDTSAirHeatrDmgHtrCoreTmpSnsrFlt_HVEAHLIN18Fr02_Lin1
      COMRXL_AirHeatrWarnPCBOvrTmp_HVEAHLIN18Fr02_Lin1: type=IDTSAirHeatrWarnPCBOvrTmp_HVEAHLIN18Fr02_Lin1
      COMRXL_AirHeatrWarnHtrCoreOvrTmp_HVEAHLIN18Fr02_Lin1: type=IDTSAirHeatrWarnHtrCoreOvrTmp_HVEAHLIN18Fr02_Lin1
      COMRXL_EOPA_RPM_TGT_EOPA_STAT_Lin1: type=IDTSEOPA_RPM_TGT_EOPA_STAT_Lin1
      COMRXL_EOPA_RPM_ACTL_EOPA_STAT_Lin1: type=IDTSEOPA_RPM_ACTL_EOPA_STAT_Lin1
      COMRXL_EOPA_VLTG_EOPA_STAT_Lin1: type=IDTSEOPA_VLTG_EOPA_STAT_Lin1
      COMRXL_EOPA_TEMP_EOPA_STAT_Lin1: type=IDTSEOPA_TEMP_EOPA_STAT_Lin1
      COMRXL_EOPA_CURR_EOPA_STAT_Lin1: type=IDTSEOPA_CURR_EOPA_STAT_Lin1
      COMRXL_EOPA_LOW_TMP_STAT_EOPA_STAT_Lin1: type=IDTSEOPA_LOW_TMP_STAT_EOPA_STAT_Lin1
      COMRXL_EOPA_MONTRNG_RPM_EOPA_STAT_Lin1: type=IDTSEOPA_MONTRNG_RPM_EOPA_STAT_Lin1
      COMRXL_EOPA_LMP_HM_AN_ON_EOPA_STAT_Lin1: type=IDTSEOPA_LMP_HM_AN_ON_EOPA_STAT_Lin1
      COMRXL_EOPA_OV_TMP_ER_EOPA_STAT_Lin1: type=IDTSEOPA_OV_TMP_ER_EOPA_STAT_Lin1
      COMRXL_EOPA_OV_CUR_ER_EOPA_STAT_Lin1: type=IDTSEOPA_OV_CUR_ER_EOPA_STAT_Lin1
      COMRXL_EOPA_DR_RN_ER_EOPA_STAT_Lin1: type=IDTSEOPA_DR_RN_ER_EOPA_STAT_Lin1
      COMRXL_EOPA_VLTG_ER_EOPA_STAT_Lin1: type=IDTSEOPA_VLTG_ER_EOPA_STAT_Lin1
      COMRXL_EOPA_Stall_Event_EOPA_STAT_Lin1: type=IDTSEOPA_Stall_Event_EOPA_STAT_Lin1
      COMRXL_EOPA_POST_RUN_STAT_EOPA_STAT_Lin1: type=IDTSEOPA_POST_RUN_STAT_EOPA_STAT_Lin1
      COMRXL_RsErr_EOPA_EOPA_STAT_Lin1: type=IDTSRsErr_EOPA_EOPA_STAT_Lin1
      COMRXL_EOPA_OIL_TEMP_EOPA_STAT2_Lin1: type=IDTSEOPA_OIL_TEMP_EOPA_STAT2_Lin1
      COMRXL_EOPA_HW_VER_EOPA_VER_Lin1: type=IDTSEOPA_HW_VER_EOPA_VER_Lin1
      COMRXL_EOPA_SW_VER_EOPA_VER_Lin1: type=IDTSEOPA_SW_VER_EOPA_VER_Lin1
      COMRXL_LTRBV_PosAct_LTRBV_STAT_Lin1: type=IDTSLTRBV_PosAct_LTRBV_STAT_Lin1
      COMRXL_LTRBV_ERR_LTRBV_STAT_Lin1: type=IDTSLTRBV_ERR_LTRBV_STAT_Lin1
      COMRXL_LTRBV_MotorVolt_LTRBV_STAT_Lin1: type=IDTSLTRBV_MotorVolt_LTRBV_STAT_Lin1
      COMRXL_LTRBV_Sts_LTRBV_STAT_Lin1: type=IDTSLTRBV_Sts_LTRBV_STAT_Lin1
      COMRXL_RsErr_LTRBV_LTRBV_STAT_Lin1: type=IDTSRsErr_LTRBV_LTRBV_STAT_Lin1
      COMRXL_CPV_MotorVolt_CPV_STAT_V2_Lin1: type=IDTSCPV_MotorVolt_CPV_STAT_V2_Lin1
      COMRXL_CPV_CalStat_CPV_STAT_V2_Lin1: type=IDTSCPV_CalStat_CPV_STAT_V2_Lin1
      COMRXL_AirHeatrSts_HVEAHLIN18Fr01_Lin1: type=IDTSAirHeatrSts_HVEAHLIN18Fr01_Lin1
      COMRXL_AirHeatrPwrCns_HVEAHLIN18Fr01_Lin1: type=IDTSAirHeatrPwrCns_HVEAHLIN18Fr01_Lin1
      COMRXL_EEXV_PosAct_EEXV_STAT_Lin1: type=IDTSEEXV_PosAct_EEXV_STAT_Lin1
      COMRXL_EEXV_CalStat_EEXV_STAT_Lin1: type=IDTSEEXV_CalStat_EEXV_STAT_Lin1
      COMRXL_EEXV_CalRq_EEXV_STAT_Lin1: type=IDTSEEXV_CalRq_EEXV_STAT_Lin1
      COMRXL_RsErr_EEXV_EEXV_STAT_Lin1: type=IDTSRsErr_EEXV_EEXV_STAT_Lin1
      COMRXL_EEXV_Sts_EEXV_STAT_Lin1: type=IDTSEEXV_Sts_EEXV_STAT_Lin1
      COMRXL_EEXV_ERR_EEXV_STAT_Lin1: type=IDTSEEXV_ERR_EEXV_STAT_Lin1
      COMRXL_EEXV_SupplyVolt_EEXV_STAT_Lin1: type=IDTSEEXV_SupplyVolt_EEXV_STAT_Lin1
      COMRXL_EEXV_Refrigerant_Pressure_EEXV_STAT_Lin1: type=IDTSEEXV_Refrigerant_Pressure_EEXV_STAT_Lin1
      COMRXL_EEXV_Board_Temp_EEXV_STAT_Lin1: type=IDTSEEXV_Board_Temp_EEXV_STAT_Lin1
      COMRXL_EEXV_Refrigerant_Temp_EEXV_STAT_Lin1: type=IDTSEEXV_Refrigerant_Temp_EEXV_STAT_Lin1
      COMRXL_EXVM_PosAct_EXVM_STAT_Lin1: type=IDTSEXVM_PosAct_EXVM_STAT_Lin1
      COMRXL_EXVM_CalStat_EXVM_STAT_Lin1: type=IDTSEXVM_CalStat_EXVM_STAT_Lin1
      COMRXL_EXVM_CalRq_EXVM_STAT_Lin1: type=IDTSEXVM_CalRq_EXVM_STAT_Lin1
      COMRXL_RsErr_EXVM_EXVM_STAT_Lin1: type=IDTSRsErr_EXVM_EXVM_STAT_Lin1
      COMRXL_EXVM_Sts_EXVM_STAT_Lin1: type=IDTSEXVM_Sts_EXVM_STAT_Lin1
      COMRXL_EXVM_ERR_EXVM_STAT_Lin1: type=IDTSEXVM_ERR_EXVM_STAT_Lin1
      COMRXL_EXVM_SupplyVolt_EXVM_STAT_Lin1: type=IDTSEXVM_SupplyVolt_EXVM_STAT_Lin1
      COMRXL_EXVM_Refrigerant_Pressure_EXVM_STAT_Lin1: type=IDTSEXVM_Refrigerant_Pressure_EXVM_STAT_Lin1
      COMRXL_EXVM_Board_Temp_EXVM_STAT_Lin1: type=IDTSEXVM_Board_Temp_EXVM_STAT_Lin1
      COMRXL_EXVM_Refrigerant_Temp_EXVM_STAT_Lin1: type=IDTSEXVM_Refrigerant_Temp_EXVM_STAT_Lin1
      COMRXL_LTRBV_CalStat_LTRBV_STAT_Lin1: type=IDTSLTRBV_CalStat_LTRBV_STAT_Lin1
      COMRXL_CoolantValve_ErrLinCom_CoolantValve_Com_Lin1: type=IDTSCoolantValve_ErrLinCom_CoolantValve_Com_Lin1
      COMRXL_CoolantValve_ErrPosition_CoolantValve_Com_Lin1: type=IDTSCoolantValve_ErrPosition_CoolantValve_Com_Lin1
      COMRXL_CoolantValve_SelfCalReq_CoolantValve_Com_Lin1: type=IDTSCoolantValve_SelfCalReq_CoolantValve_Com_Lin1
      COMRXL_CoolantValve_SystemState_CoolantValve_Com_Lin1: type=IDTSCoolantValve_SystemState_CoolantValve_Com_Lin1
      COMRXL_CoolantValve_EcuVoltage_CoolantValve_Com_Lin1: type=IDTSCoolantValve_EcuVoltage_CoolantValve_Com_Lin1
      COMRXL_CoolantValve_ActuatorPositionTrgt_CoolantValve_Com_Lin1: type=IDTSCoolantValve_ActuatorPositionTrgt_CoolantValve_Com_Lin1
      COMRXL_CoolantValve_ActuatorPositionAct_CoolantValve_Com_Lin1: type=IDTSCoolantValve_ActuatorPositionAct_CoolantValve_Com_Lin1
      COMRXL_CoolantValve_EcuTemperatur_CoolantValve_Com_Lin1: type=IDTSCoolantValve_EcuTemperatur_CoolantValve_Com_Lin1
      COMRXL_CoolantValve_Err_Motor_CoolantValve_Com_Lin1: type=IDTSCoolantValve_Err_Motor_CoolantValve_Com_Lin1
      COMRXL_CoolantValve_Err_Voltage_CoolantValve_Com_Lin1: type=IDTSCoolantValve_Err_Voltage_CoolantValve_Com_Lin1
      COMRXL_CoolantValve_Err_Ecu_CoolantValve_Com_Lin1: type=IDTSCoolantValve_Err_Ecu_CoolantValve_Com_Lin1
      COMRXL_CoolantValve_ResponseError_CoolantValve_Com_Lin1: type=IDTSCoolantValve_ResponseError_CoolantValve_Com_Lin1
    invalidation-policys:
      data-element=COMRXL_AAD_CurrPos_AAD_ECM_STATUS_Lin1, handle-invalid=KEEP
      data-element=COMRXL_AAD_CalStat_AAD_ECM_STATUS_Lin1, handle-invalid=DONT-INVALIDATE
      data-element=COMRXL_AAD_CalActv_AAD_ECM_STATUS_Lin1, handle-invalid=DONT-INVALIDATE
      data-element=COMRXL_AAD_ErrUnVolt_AAD_ECM_STATUS_Lin1, handle-invalid=DONT-INVALIDATE
      data-element=COMRXL_AAD_ErrOvrVolt_AAD_ECM_STATUS_Lin1, handle-invalid=DONT-INVALIDATE
      data-element=COMRXL_AAD_ErrOvrTemp_AAD_ECM_STATUS_Lin1, handle-invalid=DONT-INVALIDATE
      data-element=COMRXL_AAD_ErrMechStuck_AAD_ECM_STATUS_Lin1, handle-invalid=DONT-INVALIDATE
      data-element=COMRXL_AAD_ErrMechBreak_AAD_ECM_STATUS_Lin1, handle-invalid=DONT-INVALIDATE
      data-element=COMRXL_RsErr_AAD_AAD_ECM_STATUS_Lin1, handle-invalid=DONT-INVALIDATE
      data-element=COMRXL_BCP_RPM_TARGET_BCP_STAT_Lin1, handle-invalid=KEEP
      data-element=COMRXL_BCP_RPM_ACTUAL_BCP_STAT_Lin1, handle-invalid=KEEP
      data-element=COMRXL_BCP_VLTG_BCP_STAT_Lin1, handle-invalid=KEEP
      data-element=COMRXL_BCP_TEMP_BCP_STAT_Lin1, handle-invalid=KEEP
      data-element=COMRXL_BCP_CURR_BCP_STAT_Lin1, handle-invalid=KEEP
      data-element=COMRXL_BCP_FL_SAFE_ACTVTD_BCP_STAT_Lin1, handle-invalid=KEEP
      data-element=COMRXL_BCP_LMP_HM_AN_ON_BCP_STAT_Lin1, handle-invalid=KEEP
      data-element=COMRXL_BCP_AIR_PRE_ERR_BCP_STAT_Lin1, handle-invalid=KEEP
      data-element=COMRXL_BCP_OVR_TMP_ERR_BCP_STAT_Lin1, handle-invalid=KEEP
      data-element=COMRXL_BCP_OVR_CUR_ERR_BCP_STAT_Lin1, handle-invalid=KEEP
      data-element=COMRXL_BCP_DR_RN_ERR_BCP_STAT_Lin1, handle-invalid=KEEP
      data-element=COMRXL_BCP_VLTG_ERR_BCP_STAT_Lin1, handle-invalid=KEEP
      data-element=COMRXL_BCP_DBLK_ACTV_BCP_STAT_Lin1, handle-invalid=KEEP
      data-element=COMRXL_BCP_MONTRNG_RPM_BCP_STAT_Lin1, handle-invalid=KEEP
      data-element=COMRXL_BCP_NODE_ERR_BCP_STAT_Lin1, handle-invalid=KEEP
      data-element=COMRXL_BCP_POST_RUN_STAT_BCP_STAT_Lin1, handle-invalid=KEEP
      data-element=COMRXL_RsErr_BCP_PUMP_BCP_STAT_Lin1, handle-invalid=DONT-INVALIDATE
      data-element=COMRXL_BCP_VERSION_BCP_VER_Lin1, handle-invalid=KEEP
      data-element=COMRXL_BCP_SUPPLIER_BCP_VER_Lin1, handle-invalid=DONT-INVALIDATE
      data-element=COMRXL_CPV_PosAct_CPV_STAT_V2_Lin1, handle-invalid=KEEP
      data-element=COMRXL_CPV_ERR_CPV_STAT_V2_Lin1, handle-invalid=KEEP
      data-element=COMRXL_CPV_Sts_CPV_STAT_V2_Lin1, handle-invalid=KEEP
      data-element=COMRXL_RsErr_CPV_CPV_STAT_V2_Lin1, handle-invalid=DONT-INVALIDATE
      data-element=COMRXL_AirHeatrICns_HVEAHLIN18Fr01_Lin1, handle-invalid=KEEP
      data-element=COMRXL_AirHeatrHVmeas_HVEAHLIN18Fr01_Lin1, handle-invalid=KEEP
      data-element=COMRXL_AirHeatrPCBTemp_HVEAHLIN18Fr01_Lin1, handle-invalid=KEEP
      data-element=COMRXL_AirHeatrCoreTemp_HVEAHLIN18Fr01_Lin1, handle-invalid=KEEP
      data-element=COMRXL_RsErr_EAH_HVEAHLIN18Fr02_Lin1, handle-invalid=DONT-INVALIDATE
      data-element=COMRXL_AirHeatrWarnFltInCom_HVEAHLIN18Fr02_Lin1, handle-invalid=KEEP
      data-element=COMRXL_AirHeatrWarnHvOutOfRng_HVEAHLIN18Fr02_Lin1, handle-invalid=KEEP
      data-element=COMRXL_AirHeatrWarnULoOutOfRng_HVEAHLIN18Fr02_Lin1, handle-invalid=KEEP
      data-element=COMRXL_AirHeatrWarnTmpOvrheatg_HVEAHLIN18Fr02_Lin1, handle-invalid=KEEP
      data-element=COMRXL_AirHeatrWarnICnsOutOfRng_HVEAHLIN18Fr02_Lin1, handle-invalid=KEEP
      data-element=COMRXL_AirHeatrDmgIntHwProtn_HVEAHLIN18Fr02_Lin1, handle-invalid=KEEP
      data-element=COMRXL_AirHeatrDmgPCBTmpSnsrFlt_HVEAHLIN18Fr02_Lin1, handle-invalid=KEEP
      data-element=COMRXL_AirHeatrDmgCircForDrvrShoOrOpen_HVEAHLIN18Fr02_Lin1, handle-invalid=KEEP
      data-element=COMRXL_AirHeatrDmgHVISnsrFlt_HVEAHLIN18Fr02_Lin1, handle-invalid=KEEP
      data-element=COMRXL_AirHeatrDmgMemErr_HVEAHLIN18Fr02_Lin1, handle-invalid=KEEP
      data-element=COMRXL_AirHeatrDmgHtrCoreTmpSnsrFlt_HVEAHLIN18Fr02_Lin1, handle-invalid=KEEP
      data-element=COMRXL_AirHeatrWarnPCBOvrTmp_HVEAHLIN18Fr02_Lin1, handle-invalid=KEEP
      data-element=COMRXL_AirHeatrWarnHtrCoreOvrTmp_HVEAHLIN18Fr02_Lin1, handle-invalid=KEEP
      data-element=COMRXL_EOPA_RPM_TGT_EOPA_STAT_Lin1, handle-invalid=KEEP
      data-element=COMRXL_EOPA_RPM_ACTL_EOPA_STAT_Lin1, handle-invalid=KEEP
      data-element=COMRXL_EOPA_VLTG_EOPA_STAT_Lin1, handle-invalid=KEEP
      data-element=COMRXL_EOPA_TEMP_EOPA_STAT_Lin1, handle-invalid=KEEP
      data-element=COMRXL_EOPA_CURR_EOPA_STAT_Lin1, handle-invalid=KEEP
      data-element=COMRXL_EOPA_LOW_TMP_STAT_EOPA_STAT_Lin1, handle-invalid=KEEP
      data-element=COMRXL_EOPA_MONTRNG_RPM_EOPA_STAT_Lin1, handle-invalid=KEEP
      data-element=COMRXL_EOPA_LMP_HM_AN_ON_EOPA_STAT_Lin1, handle-invalid=KEEP
      data-element=COMRXL_EOPA_OV_TMP_ER_EOPA_STAT_Lin1, handle-invalid=KEEP
      data-element=COMRXL_EOPA_OV_CUR_ER_EOPA_STAT_Lin1, handle-invalid=KEEP
      data-element=COMRXL_EOPA_DR_RN_ER_EOPA_STAT_Lin1, handle-invalid=KEEP
      data-element=COMRXL_EOPA_VLTG_ER_EOPA_STAT_Lin1, handle-invalid=KEEP
      data-element=COMRXL_EOPA_Stall_Event_EOPA_STAT_Lin1, handle-invalid=KEEP
      data-element=COMRXL_EOPA_POST_RUN_STAT_EOPA_STAT_Lin1, handle-invalid=KEEP
      data-element=COMRXL_RsErr_EOPA_EOPA_STAT_Lin1, handle-invalid=DONT-INVALIDATE
      data-element=COMRXL_EOPA_OIL_TEMP_EOPA_STAT2_Lin1, handle-invalid=KEEP
      data-element=COMRXL_EOPA_HW_VER_EOPA_VER_Lin1, handle-invalid=KEEP
      data-element=COMRXL_EOPA_SW_VER_EOPA_VER_Lin1, handle-invalid=KEEP
      data-element=COMRXL_LTRBV_PosAct_LTRBV_STAT_Lin1, handle-invalid=KEEP
      data-element=COMRXL_LTRBV_ERR_LTRBV_STAT_Lin1, handle-invalid=KEEP
      data-element=COMRXL_LTRBV_MotorVolt_LTRBV_STAT_Lin1, handle-invalid=KEEP
      data-element=COMRXL_LTRBV_Sts_LTRBV_STAT_Lin1, handle-invalid=KEEP
      data-element=COMRXL_RsErr_LTRBV_LTRBV_STAT_Lin1, handle-invalid=DONT-INVALIDATE
      data-element=COMRXL_CPV_MotorVolt_CPV_STAT_V2_Lin1, handle-invalid=DONT-INVALIDATE
      data-element=COMRXL_CPV_CalStat_CPV_STAT_V2_Lin1, handle-invalid=DONT-INVALIDATE
      data-element=COMRXL_AirHeatrSts_HVEAHLIN18Fr01_Lin1, handle-invalid=DONT-INVALIDATE
      data-element=COMRXL_AirHeatrPwrCns_HVEAHLIN18Fr01_Lin1, handle-invalid=KEEP
      data-element=COMRXL_EEXV_PosAct_EEXV_STAT_Lin1, handle-invalid=KEEP
      data-element=COMRXL_EEXV_CalStat_EEXV_STAT_Lin1, handle-invalid=KEEP
      data-element=COMRXL_EEXV_CalRq_EEXV_STAT_Lin1, handle-invalid=DONT-INVALIDATE
      data-element=COMRXL_RsErr_EEXV_EEXV_STAT_Lin1, handle-invalid=DONT-INVALIDATE
      data-element=COMRXL_EEXV_Sts_EEXV_STAT_Lin1, handle-invalid=KEEP
      data-element=COMRXL_EEXV_ERR_EEXV_STAT_Lin1, handle-invalid=KEEP
      data-element=COMRXL_EEXV_SupplyVolt_EEXV_STAT_Lin1, handle-invalid=KEEP
      data-element=COMRXL_EEXV_Refrigerant_Pressure_EEXV_STAT_Lin1, handle-invalid=KEEP
      data-element=COMRXL_EEXV_Board_Temp_EEXV_STAT_Lin1, handle-invalid=KEEP
      data-element=COMRXL_EEXV_Refrigerant_Temp_EEXV_STAT_Lin1, handle-invalid=KEEP
      data-element=COMRXL_EXVM_PosAct_EXVM_STAT_Lin1, handle-invalid=KEEP
      data-element=COMRXL_EXVM_CalStat_EXVM_STAT_Lin1, handle-invalid=KEEP
      data-element=COMRXL_EXVM_CalRq_EXVM_STAT_Lin1, handle-invalid=DONT-INVALIDATE
      data-element=COMRXL_RsErr_EXVM_EXVM_STAT_Lin1, handle-invalid=DONT-INVALIDATE
      data-element=COMRXL_EXVM_Sts_EXVM_STAT_Lin1, handle-invalid=KEEP
      data-element=COMRXL_EXVM_ERR_EXVM_STAT_Lin1, handle-invalid=KEEP
      data-element=COMRXL_EXVM_SupplyVolt_EXVM_STAT_Lin1, handle-invalid=KEEP
      data-element=COMRXL_EXVM_Refrigerant_Pressure_EXVM_STAT_Lin1, handle-invalid=KEEP
      data-element=COMRXL_EXVM_Board_Temp_EXVM_STAT_Lin1, handle-invalid=KEEP
      data-element=COMRXL_EXVM_Refrigerant_Temp_EXVM_STAT_Lin1, handle-invalid=KEEP
      data-element=COMRXL_LTRBV_CalStat_LTRBV_STAT_Lin1, handle-invalid=DONT-INVALIDATE
      data-element=COMRXL_CoolantValve_ErrLinCom_CoolantValve_Com_Lin1, handle-invalid=DONT-INVALIDATE
      data-element=COMRXL_CoolantValve_ErrPosition_CoolantValve_Com_Lin1, handle-invalid=DONT-INVALIDATE
      data-element=COMRXL_CoolantValve_SelfCalReq_CoolantValve_Com_Lin1, handle-invalid=DONT-INVALIDATE
      data-element=COMRXL_CoolantValve_SystemState_CoolantValve_Com_Lin1, handle-invalid=DONT-INVALIDATE
      data-element=COMRXL_CoolantValve_EcuVoltage_CoolantValve_Com_Lin1, handle-invalid=DONT-INVALIDATE
      data-element=COMRXL_CoolantValve_ActuatorPositionTrgt_CoolantValve_Com_Lin1, handle-invalid=DONT-INVALIDATE
      data-element=COMRXL_CoolantValve_ActuatorPositionAct_CoolantValve_Com_Lin1, handle-invalid=DONT-INVALIDATE
      data-element=COMRXL_CoolantValve_EcuTemperatur_CoolantValve_Com_Lin1, handle-invalid=DONT-INVALIDATE
      data-element=COMRXL_CoolantValve_Err_Motor_CoolantValve_Com_Lin1, handle-invalid=DONT-INVALIDATE
      data-element=COMRXL_CoolantValve_Err_Voltage_CoolantValve_Com_Lin1, handle-invalid=DONT-INVALIDATE
      data-element=COMRXL_CoolantValve_Err_Ecu_CoolantValve_Com_Lin1, handle-invalid=DONT-INVALIDATE
      data-element=COMRXL_CoolantValve_ResponseError_CoolantValve_Com_Lin1, handle-invalid=DONT-INVALIDATE
  sender receiver interface Lin1ComTxSignalsSR
    29 x data, all with category=TYPE_REFERENCE, sw-calibration-access=READ-ONLY:
      COMTXL_AAD_PosRq_ECM_AAD_DEMAND_Lin1: type=IDTSAAD_PosRq_ECM_AAD_DEMAND_Lin1, init-value=COMTXL_AAD_PosRq_ECM_AAD_DEMAND_Lin1Value:15  # Raw signal data to be transmitted over the LIN bus for the Signal AAD_PosRq
      COMTXL_AAD_CalRq_ECM_AAD_DEMAND_Lin1: type=IDTSAAD_CalRq_ECM_AAD_DEMAND_Lin1, init-value=COMTXL_AAD_CalRq_ECM_AAD_DEMAND_Lin1Value:0  # Raw signal data to be transmitted over the LIN bus for the Signal AAD_CalRq
      COMTXL_AAD_InitialIP_CalRq_ECM_AAD_DEMAND_Lin1: type=IDTSAAD_InitialIP_CalRq_ECM_AAD_DEMAND_Lin1, init-value=0  # Raw signal data to be transmitted over the LIN bus for the Signal AAD_InitialIP_CalRq
      COMTXL_BCP_RPM_REQ_BCP_REQ_Lin1: type=IDTSBCP_RPM_REQ_BCP_REQ_Lin1, init-value=COMTXL_BCP_RPM_REQ_BCP_REQ_Lin1Value:255  # Raw signal data to be transmitted over the LIN bus for the Signal BCP_RPM_REQ
      COMTXL_BCP_POST_RUN_REQ_BCP_REQ_Lin1: type=IDTSBCP_POST_RUN_REQ_BCP_REQ_Lin1, init-value=COMTXL_BCP_POST_RUN_REQ_BCP_REQ_Lin1Value:7  # Raw signal data to be transmitted over the LIN bus for the Signal BCP_POST_RUN_REQ
      COMTXL_BCP_FL_SAFE_ACTVT_BCP_REQ_Lin1: type=IDTSBCP_FL_SAFE_ACTVT_BCP_REQ_Lin1, init-value=COMTXL_BCP_FL_SAFE_ACTVT_BCP_REQ_Lin1Value:3  # Raw signal data to be transmitted over the LIN bus for the Signal BCP_FL_SAFE_ACTVT
      COMTXL_CPV_PosRq_CPV_REQ_Lin1: type=IDTSCPV_PosRq_CPV_REQ_Lin1, init-value=COMTXL_CPV_PosRq_CPV_REQ_Lin1Value:0  # Raw signal data to be transmitted over the LIN bus for the Signal CPV_PosRq
      COMTXL_CPV_PosSv_CPV_REQ_Lin1: type=IDTSCPV_PosSv_CPV_REQ_Lin1, init-value=COMTXL_CPV_PosSv_CPV_REQ_Lin1Value:0  # Raw signal data to be transmitted over the LIN bus for the Signal CPV_PosSv
      COMTXL_CPV_CalRq_CPV_REQ_Lin1: type=IDTSCPV_CalRq_CPV_REQ_Lin1, init-value=COMTXL_CPV_CalRq_CPV_REQ_Lin1Value:0  # Raw signal data to be transmitted over the LIN bus for the Signal CPV_CalRq
      COMTXL_AirHeatrPwrTgt_HVEAHLIN18Fr03_Lin1: type=IDTSAirHeatrPwrTgt_HVEAHLIN18Fr03_Lin1, init-value=COMTXL_AirHeatrPwrTgt_HVEAHLIN18Fr03_Lin1Value:255  # Raw signal data to be transmitted over the LIN bus for the Signal AirHeatrPwrTgt
      COMTXL_AirHeatrEnad_HVEAHLIN18Fr03_Lin1: type=IDTSAirHeatrEnad_HVEAHLIN18Fr03_Lin1, init-value=COMTXL_AirHeatrEnad_HVEAHLIN18Fr03_Lin1Value:0  # Raw signal data to be transmitted over the LIN bus for the Signal AirHeatrEnad
      COMTXL_EOPA_RPM_COM_EOPA_REQ_Lin1: type=IDTSEOPA_RPM_COM_EOPA_REQ_Lin1, init-value=COMTXL_EOPA_RPM_COM_EOPA_REQ_Lin1Value:255  # Raw signal data to be transmitted over the LIN bus for the Signal EOPA_RPM_COM
      COMTXL_EOPA_POST_RUN_COM_EOPA_REQ_Lin1: type=IDTSEOPA_POST_RUN_COM_EOPA_REQ_Lin1, init-value=COMTXL_EOPA_POST_RUN_COM_EOPA_REQ_Lin1Value:7  # Raw signal data to be transmitted over the LIN bus for the Signal EOPA_POST_RUN_COM
      COMTXL_LTRBV_PosRq_LTRBV_REQ_Lin1: type=IDTSLTRBV_PosRq_LTRBV_REQ_Lin1, init-value=COMTXL_LTRBV_PosRq_LTRBV_REQ_Lin1Value:0  # Raw signal data to be transmitted over the LIN bus for the Signal LTRBV_PosRq
      COMTXL_LTRBV_PosSv_LTRBV_REQ_Lin1: type=IDTSLTRBV_PosSv_LTRBV_REQ_Lin1, init-value=COMTXL_LTRBV_PosSv_LTRBV_REQ_Lin1Value:0  # Raw signal data to be transmitted over the LIN bus for the Signal LTRBV_PosSv
      COMTXL_LTRBV_CalRq_LTRBV_REQ_Lin1: type=IDTSLTRBV_CalRq_LTRBV_REQ_Lin1, init-value=COMTXL_LTRBV_CalRq_LTRBV_REQ_Lin1Value:0  # Raw signal data to be transmitted over the LIN bus for the Signal LTRBV_CalRq
      COMTXL_EEXV_PosRq_EEXV_REQ_Lin1: type=IDTSEEXV_PosRq_EEXV_REQ_Lin1, init-value=COMTXL_EEXV_PosRq_EEXV_REQ_Lin1Value:0  # Raw signal data to be transmitted over the LIN bus for the Signal EEXV_PosRq
      COMTXL_EEXV_CalCmd_EEXV_REQ_Lin1: type=IDTSEEXV_CalCmd_EEXV_REQ_Lin1, init-value=COMTXL_EEXV_CalCmd_EEXV_REQ_Lin1Value:0  # Raw signal data to be transmitted over the LIN bus for the Signal EEXV_CalCmd
      COMTXL_EXVM_PosRq_EXVM_REQ_Lin1: type=IDTSEXVM_PosRq_EXVM_REQ_Lin1, init-value=COMTXL_EXVM_PosRq_EXVM_REQ_Lin1Value:0  # Raw signal data to be transmitted over the LIN bus for the Signal EXVM_PosRq
      COMTXL_EXVM_CalCmd_EXVM_REQ_Lin1: type=IDTSEXVM_CalCmd_EXVM_REQ_Lin1, init-value=COMTXL_EXVM_CalCmd_EXVM_REQ_Lin1Value:0  # Raw signal data to be transmitted over the LIN bus for the Signal EXVM_CalCmd
      COMTXL_Control_TargetPos_FCPS_CoolantValve_Control_Lin1: type=IDTSControl_TargetPos_FCPS_CoolantValve_Control_Lin1, init-value=COMTXL_Control_TargetPos_FCPS_CoolantValve_Control_Lin1Value:0  # Raw signal data to be transmitted over the LIN bus for the Signal Control_TargetPos
      COMTXL_Control_Reserved1_FCPS_CoolantValve_Control_Lin1: type=IDTSControl_Reserved1_FCPS_CoolantValve_Control_Lin1, init-value=COMTXL_Control_Reserved1_FCPS_CoolantValve_Control_Lin1Value:0  # Raw signal data to be transmitted over the LIN bus for the Signal Control_Reserved1
      COMTXL_Control_BlockDetEnbl_FCPS_CoolantValve_Control_Lin1: type=IDTSControl_BlockDetEnbl_FCPS_CoolantValve_Control_Lin1, init-value=COMTXL_Control_BlockDetEnbl_FCPS_CoolantValve_Control_Lin1Value:0  # Raw signal data to be transmitted over the LIN bus for the Signal Control_BlockDetEnbl
      COMTXL_Control_DiagFunctnValue_FCPS_CoolantValve_Control_Lin1: type=IDTSControl_DiagFunctnValue_FCPS_CoolantValve_Control_Lin1, init-value=COMTXL_Control_DiagFunctnValue_FCPS_CoolantValve_Control_Lin1Value:0  # Raw signal data to be transmitted over the LIN bus for the Signal Control_DiagFunctnValue
      COMTXL_Control_Reserved{2..6}_FCPS_CoolantValve_Control_Lin1: type=IDTSControl_Reserved{2..6}_FCPS_CoolantValve_Control_Lin1, init-value=COMTXL_Control_Reserved{2..6}_FCPS_CoolantValve_Control_Lin1Value:0  # Raw signal data to be transmitted over the LIN bus for the Signal Control_Reserved{2..6}
    invalidation-policys:
      data-element=COMTXL_AAD_PosRq_ECM_AAD_DEMAND_Lin1, handle-invalid=KEEP
      data-element=COMTXL_AAD_CalRq_ECM_AAD_DEMAND_Lin1, handle-invalid=DONT-INVALIDATE
      data-element=COMTXL_AAD_InitialIP_CalRq_ECM_AAD_DEMAND_Lin1, handle-invalid=DONT-INVALIDATE
      data-element=COMTXL_BCP_RPM_REQ_BCP_REQ_Lin1, handle-invalid=KEEP
      data-element=COMTXL_BCP_POST_RUN_REQ_BCP_REQ_Lin1, handle-invalid=KEEP
      data-element=COMTXL_BCP_FL_SAFE_ACTVT_BCP_REQ_Lin1, handle-invalid=KEEP
      data-element=COMTXL_CPV_PosRq_CPV_REQ_Lin1, handle-invalid=DONT-INVALIDATE
      data-element=COMTXL_CPV_PosSv_CPV_REQ_Lin1, handle-invalid=DONT-INVALIDATE
      data-element=COMTXL_CPV_CalRq_CPV_REQ_Lin1, handle-invalid=DONT-INVALIDATE
      data-element=COMTXL_AirHeatrPwrTgt_HVEAHLIN18Fr03_Lin1, handle-invalid=KEEP
      data-element=COMTXL_AirHeatrEnad_HVEAHLIN18Fr03_Lin1, handle-invalid=DONT-INVALIDATE
      data-element=COMTXL_EOPA_RPM_COM_EOPA_REQ_Lin1, handle-invalid=KEEP
      data-element=COMTXL_EOPA_POST_RUN_COM_EOPA_REQ_Lin1, handle-invalid=KEEP
      data-element=COMTXL_LTRBV_PosRq_LTRBV_REQ_Lin1, handle-invalid=KEEP
      data-element=COMTXL_LTRBV_PosSv_LTRBV_REQ_Lin1, handle-invalid=DONT-INVALIDATE
      data-element=COMTXL_LTRBV_CalRq_LTRBV_REQ_Lin1, handle-invalid=DONT-INVALIDATE
      data-element=COMTXL_EEXV_PosRq_EEXV_REQ_Lin1, handle-invalid=KEEP
      data-element=COMTXL_EEXV_CalCmd_EEXV_REQ_Lin1, handle-invalid=DONT-INVALIDATE
      data-element=COMTXL_EXVM_PosRq_EXVM_REQ_Lin1, handle-invalid=KEEP
      data-element=COMTXL_EXVM_CalCmd_EXVM_REQ_Lin1, handle-invalid=DONT-INVALIDATE
      data-element=COMTXL_Control_TargetPos_FCPS_CoolantValve_Control_Lin1, handle-invalid=DONT-INVALIDATE
      data-element=COMTXL_Control_Reserved1_FCPS_CoolantValve_Control_Lin1, handle-invalid=DONT-INVALIDATE
      data-element=COMTXL_Control_BlockDetEnbl_FCPS_CoolantValve_Control_Lin1, handle-invalid=DONT-INVALIDATE
      data-element=COMTXL_Control_DiagFunctnValue_FCPS_CoolantValve_Control_Lin1, handle-invalid=DONT-INVALIDATE
      data-element=COMTXL_Control_Reserved{2..6}_FCPS_CoolantValve_Control_Lin1, handle-invalid=DONT-INVALIDATE
