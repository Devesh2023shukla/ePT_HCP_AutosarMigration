AUTOSAR XML (schema 4-2-2)
package /DataDefinitions
  data type mapping set ADTtoIDTMapping: data-type-map{application-data-type=ADTSPostRunRqrd, implementation-data-type=boolean}
package /DataDefinitions/ARPackage_0
  app type ADTSPostRunRqrd: category=VALUE, compu-method=PostRunRqrdState
