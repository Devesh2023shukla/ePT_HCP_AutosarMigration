AUTOSAR XML (schema 4-2-2)
package /FCASharedInterfaces/IFSWCs/IFAppModeIf
  impl type AppModeIf_ModeType: compu {4=WAKEUP, 0=POSTRUN, 1=RUN, 2=SHUTDOWN, 3=STARTUP}, implementation-data-type=uint8
  mode declaration group EngMtnMods: category=EXPLICIT_ORDER, initial-mode=EngStopd, on-transition-value=2
    mode EngStopd: value=1
    mode EngMovg: value=0
  mode declaration group EngSpdMods: category=EXPLICIT_ORDER, initial-mode=LoSpd, on-transition-value=4
    4 x mode:
      LoSpd: value=1  # Engine synchronous events are enabled, and occurring at a rate slower than 1 EPP / 10ms
      MidSpd: value=2  # Engine synchronous events are enabled, and occurring at a rate that exceeds 1 EPP / 10ms, but is less than 1 EPP / 5ms
      HiSpd: value=3  # Engine synchronous events are enabled, and occurring at a rate that exceeds 1 EPP / 5ms
      NoEves: value=0  # Engine synchronous events are disabled.
  client server interface GetMODR_t_OS_PwrLtchTi
    operation GetMODR_t_OS_PwrLtchTi
      arg OsPwrLtchTi: type=uint16, direction=OUT, server-argument-impl-policy=USE-ARGUMENT-TYPE
  mode switch interface IFEngMtnMod
    mode group EngMtnMod: type=EngMtnMods
  mode switch interface IFEngSpdMod
    mode group EngSpdMod: type=EngSpdMods
  mode switch interface IFMdulPwrMod: is-service=true
    mode group AppMode_MDGP_ESH_Mode: type=BswMEcuModes
  sender receiver interface IFMode_APMR
    data Mode: type=AppModeIf_ModeType
  sender receiver interface IFMode_AppmodeIf: is-service=true
    data Mode: type=AppModeIf_ModeType
  client server interface IFRteMode
    6 x operation:
      GetMODR_e_CurrRTE_Mode
        arg CurrentMode: type=BswM_Rte_Mode, direction=OUT, server-argument-impl-policy=USE-ARGUMENT-TYPE
      GetMODR_b_InStrtUpMode
        arg InStartUp: type=boolean, direction=OUT, server-argument-impl-policy=USE-ARGUMENT-TYPE
      GetMODR_b_InRunMode
        arg InRun: type=boolean, direction=OUT, server-argument-impl-policy=USE-ARGUMENT-TYPE
      GetMODR_b_InPostRunMode
        arg InPostRun: type=boolean, direction=OUT, server-argument-impl-policy=USE-ARGUMENT-TYPE
      GetMODR_b_InShtDwnMode
        arg InShutDown: type=boolean, direction=OUT, server-argument-impl-policy=USE-ARGUMENT-TYPE
      GetMODR_b_InWakeUpMode
        arg InWakeUp: type=boolean, direction=OUT, server-argument-impl-policy=USE-ARGUMENT-TYPE
  mode switch interface IFSrvEngMtnMod: is-service=true, service-kind=DIAGNOSTIC-COMMUNICATION-MANAGER
    mode group SrvEngMtnMod: type=EngMtnMods
  sender receiver interface VeAPMR_b_RequestCommState
    9 x data, all with type=ComM_ModeType:
      VeAPMR_b_RequestCommState_FD3
      VeAPMR_b_RequestCommState_FD5
      VeAPMR_b_RequestCommState_FD11
      VeAPMR_b_RequestCommState_FD14
      VeAPMR_b_RequestCommState_FD16
      VeAPMR_b_RequestCommState_LIN{1..3}
      VeAPMR_b_RequestCommState_DCAN
  sender receiver interface VeCANR_e_CommStatus
    9 x data, all with type=ComM_ModeType:
      VeCANR_e_CommStatus_FD3
      VeCANR_e_CommStatus_FD5
      VeCANR_e_CommStatus_FD11
      VeCANR_e_CommStatus_FD14
      VeCANR_e_CommStatus_FD16
      VeCANR_e_CommStatus_LIN{1..3}
      VeCANR_e_CommStatus_DCAN
