AUTOSAR XML (schema 00050)
package /PortInterfaces
  sender receiver interface VeBSWR_e_NvmWriteStatus
    data VeBSWR_e_NvmWriteStatus: type=NvM_RequestResultType
