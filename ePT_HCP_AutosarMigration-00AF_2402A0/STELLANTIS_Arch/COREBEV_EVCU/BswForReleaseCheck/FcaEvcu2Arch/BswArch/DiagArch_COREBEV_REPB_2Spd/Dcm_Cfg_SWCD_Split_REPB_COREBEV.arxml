AUTOSAR XML (schema 00050)
package /AUTOSAR_Dcm
  10 x sender receiver interface:
    VeDCMB_b_ChargePortLockDisable
      data VeDCMB_b_ChargePortLockDisable: sw-calibration-access=READ-WRITE, type=boolean
    VeDCMB_b_VePermanentFltCodesDsb
      data VeDCMB_b_VePermanentFltCodesDsb: sw-calibration-access=READ-WRITE, type=boolean
    VeDCMB_b_DsblDiagFailSafe
      data VeDCMB_b_DsblDiagFailSafe: sw-calibration-access=READ-WRITE, type=boolean
    VeDIDR_b_IsDiagGlobalConditionsValid
      data VeDIDR_b_IsDiagGlobalConditionsValid: category=VALUE, sw-calibration-access=READ-ONLY, type=boolean
    VeDIDR_b_PostCodeClrDiagDsbl
      data VeDIDR_b_PostCodeClrDiagDsbl: category=VALUE, sw-calibration-access=READ-ONLY, type=boolean
    VeDIDR_b_ClearTrackingInfoService04
      data VeDIDR_b_ClearTrackingInfoService04: category=VALUE, sw-calibration-access=READ-ONLY, type=boolean
    VeDIDR_b_DiagSystemDsbl
      data VeDIDR_b_DiagSystemDsbl: category=VALUE, sw-calibration-access=READ-ONLY, type=boolean
    VeDIDR_b_Flashing_InProgress
      data VeDIDR_b_Flashing_InProgress: category=VALUE, sw-calibration-access=READ-ONLY, type=boolean
    VeDIDR_b_NonEmisMalfActv
      data VeDIDR_b_NonEmisMalfActv: category=VALUE, sw-calibration-access=READ-ONLY, type=boolean
    VeDIDR_e_SPT_State
      data VeDIDR_e_SPT_State: category=VALUE, sw-calibration-access=READ-ONLY, type=uint8
  nv data interface AeBSWR_b_PermanentFltCodesDsb
    nv-datas:
      data AeBSWR_b_PermanentFltCodesDsb: category=VALUE, sw-calibration-access=READ-ONLY, type=uint8
  nv data interface AeBSWR_b_ChargePortLockDisable
    nv-datas:
      data AeBSWR_b_ChargePortLockDisable: category=VALUE, sw-calibration-access=READ-ONLY, type=uint8
